ASAP2_VERSION 1 40
/begin PROJECT RS19_Prod ""
/begin HEADER "" VERSION "" /end HEADER
/begin MODULE RS19_Prod ""
/begin MOD_PAR "SAILOR" CPU_TYPE "SPC560P"
 /begin MEMORY_SEGMENT Code "External Flash Calibration Space" DATA FLASH INTERN 0x8000 0x5000 -1 -1 -1 -1 -1 /end MEMORY_SEGMENT
 /begin MEMORY_SEGMENT Code "External Flash unuse Space" CODE FLASH INTERN 0xD000 0x0000 -1 -1 -1 -1 -1 /end MEMORY_SEGMENT
 /begin MEMORY_SEGMENT Code "External Flash Code Space" CODE FLASH INTERN 0xD000 0x33000 -1 -1 -1 -1 -1 /end MEMORY_SEGMENT
 /begin MEMORY_SEGMENT Ram "External Ram BSS Space" VARIABLES RAM EXTERN 0x40000000 0x4800 -1 -1 -1 -1 -1 /end MEMORY_SEGMENT
 /begin MEMORY_SEGMENT Data "External RAM Calibration Space" DATA RAM EXTERN 0x40004800 0x5000 -1 -1 -1 -1 -1 /end MEMORY_SEGMENT
 /begin MEMORY_SEGMENT Ram "External Ram Stack Space" VARIABLES RAM EXTERN 0x40009800 0x800 -1 -1 -1 -1 -1 /end MEMORY_SEGMENT
/end MOD_PAR
/begin MOD_COMMON "" BYTE_ORDER MSB_FIRST ALIGNMENT_BYTE 1 ALIGNMENT_WORD 1 ALIGNMENT_LONG 2 ALIGNMENT_FLOAT32_IEEE 4 ALIGNMENT_FLOAT64_IEEE 8 /end MOD_COMMON
/begin IF_DATA ASAP1B_CCP
 /begin SOURCE "Cyl Event" 103 1
  /begin QP_BLOB 0 LENGTH 0x14 CAN_ID_FIXED 0x7D5 RASTER 0 REDUCTION_ALLOWED FIRST_PID 0x00 /end QP_BLOB
  DISPLAY_IDENTIFIER DAQ0 /end SOURCE
 /begin SOURCE "7.82ms" 1 782
  /begin QP_BLOB 1 LENGTH 0x14 CAN_ID_FIXED 0x7D6 RASTER 10 REDUCTION_ALLOWED FIRST_PID 0x14 /end QP_BLOB
  DISPLAY_IDENTIFIER DAQ1 /end SOURCE
 /begin SOURCE "15.6ms" 1 1562
  /begin QP_BLOB 2 LENGTH 0x14 CAN_ID_FIXED 0x7D7 RASTER 11 REDUCTION_ALLOWED FIRST_PID 0x28 /end QP_BLOB
  DISPLAY_IDENTIFIER DAQ2 /end SOURCE
 /begin SOURCE "125ms" 3 125
  /begin QP_BLOB 3 LENGTH 0x3A CAN_ID_FIXED 0x7D8 RASTER 25 REDUCTION_ALLOWED FIRST_PID 0x3C /end QP_BLOB
  DISPLAY_IDENTIFIER DAQ3 /end SOURCE
 /begin TP_BLOB 0x201 0x202 0x7D0 0x7D4 0x0 0x1 DAQ_MODE 1 CONSISTENCY 1 ADDRESS_EXTENSION 0
  /begin DEFINED_PAGES 1 "Working page" 0x0 0x40004800 0x5000 RAM RAM_INIT_BY_ECU DEFAULT /end DEFINED_PAGES
  /begin DEFINED_PAGES 2 "Reference page" 0x0 0x8000 0x5000 FLASH DEFAULT /end DEFINED_PAGES
  OPTIONAL_CMD 0xC OPTIONAL_CMD 0xD OPTIONAL_CMD 0xE OPTIONAL_CMD 0x11 OPTIONAL_CMD 0x19 BAUDRATE 250000 SAMPLE_POINT 70 SAMPLE_RATE 1 BTL_CYCLES 16 SJW 2 SYNC_EDGE 0 /begin CHECKSUM_PARAM 0x8001 20480 CHECKSUM_CALCULATION ACTIVE_PAGE /end CHECKSUM_PARAM RESUME_SUPPORTED /end TP_BLOB
 /begin SEED_KEY "" /end SEED_KEY
 /begin RASTER "Cyl Event Trigger" Cyl 0 103 1 /end RASTER
 /begin RASTER "AMAF Trigger" 1.00 1 3 1 /end RASTER
 /begin RASTER "3.91ms Trigger" 3.91 2 1 391 /end RASTER
 /begin RASTER "7.81ms Trigger" 7.81 10 1 781 /end RASTER
 /begin RASTER "15.62ms Trigger" 15.62 11 1 1562 /end RASTER
 /begin RASTER "125ms Trigger" 125 25 3 125 /end RASTER
/end IF_DATA
/begin CHARACTERISTIC C_AECutoffDltTPSThresh "cal comments" VALUE 0x9BD4 Scalar_UW 0.0 CM_Percent_0to200_2 0.0 199.9969024658203 /end CHARACTERISTIC
/begin CHARACTERISTIC C_AEEnableDltTPSThresh "cal comments" VALUE 0x9BD2 Scalar_SW 0.0 CM_Percent_N200to200 -199.9999847412109 199.9938812255859 /end CHARACTERISTIC
/begin CHARACTERISTIC C_AETPSDecFiltCoef "cal comments" VALUE 0xB5B8 Scalar_UW 0.0 CM_FiltCoef 0.0 0.9999847412109375 /end CHARACTERISTIC
/begin CHARACTERISTIC C_AETPSIncFiltCoef "cal comments" VALUE 0xB5B6 Scalar_UW 0.0 CM_FiltCoef 0.0 0.9999847412109375 /end CHARACTERISTIC
/begin CHARACTERISTIC C_AFLCBaroMinThresh "cal comments" VALUE 0xB564 Scalar_UW 0.0 CM_kpa_0to256_1 0.0 255.99609375 /end CHARACTERISTIC
/begin CHARACTERISTIC C_AFLCCellEngSpdBoundaryHyst "cal comments" VALUE 0xB57A Scalar_UW 0.0 CM_RPM_0to16384 0.0 16383.75 /end CHARACTERISTIC
/begin CHARACTERISTIC C_AFLCCellTPSBoundaryHyst "cal comments" VALUE 0xB57C Scalar_UW 0.0 CM_Percent_0to200_2 0.0 199.9969024658203 /end CHARACTERISTIC
/begin CHARACTERISTIC C_AFLCChargeAirTempMaxThresh "cal comments" VALUE 0xB570 Scalar_SW 0.0 CM_DegC_N256to256 -256.0 255.9921875 /end CHARACTERISTIC
/begin CHARACTERISTIC C_AFLCChargeAirTempMinThresh "cal comments" VALUE 0xB56E Scalar_SW 0.0 CM_DegC_N256to256 -256.0 255.9921875 /end CHARACTERISTIC
/begin CHARACTERISTIC C_AFLCCoolTempMaxThresh "cal comments" VALUE 0xB56C Scalar_SW 0.0 CM_DegC_N256to256 -256.0 255.9921875 /end CHARACTERISTIC
/begin CHARACTERISTIC C_AFLCCoolTempMinThresh "cal comments" VALUE 0xB56A Scalar_SW 0.0 CM_DegC_N256to256 -256.0 255.9921875 /end CHARACTERISTIC
/begin CHARACTERISTIC C_AFLCEngSpdDeltaThresh "cal comments" VALUE 0xB562 Scalar_UW 0.0 CM_RPM_0to16384 0.0 16383.75 /end CHARACTERISTIC
/begin CHARACTERISTIC C_AFLCEngSpdMaxThresh "cal comments" VALUE 0xB568 Scalar_UW 0.0 CM_RPM_0to16384 0.0 16383.75 /end CHARACTERISTIC
/begin CHARACTERISTIC C_AFLCEngSpdMinThresh "cal comments" VALUE 0xB566 Scalar_UW 0.0 CM_RPM_0to16384 0.0 16383.75 /end CHARACTERISTIC
/begin CHARACTERISTIC C_AFLCLearnedMultMax "cal comments" VALUE 0xB574 Scalar_UW 0.0 CM_Ratio_0to2_2 0.0 1.999969482421875 /end CHARACTERISTIC
/begin CHARACTERISTIC C_AFLCLearnedMultMin "cal comments" VALUE 0xB576 Scalar_UW 0.0 CM_Ratio_0to2_2 0.0 1.999969482421875 /end CHARACTERISTIC
/begin CHARACTERISTIC C_AFLCMultLearnCoef "cal comments" VALUE 0xB578 Scalar_UW 0.0 CM_FiltCoef 0.0 0.9999847412109375 /end CHARACTERISTIC
/begin CHARACTERISTIC C_AFLCSteadyStateTime "cal comments" VALUE 0xB572 Scalar_UW 0.0 CM_Second_0to1024 0.0 1023.984375 /end CHARACTERISTIC
/begin CHARACTERISTIC C_AFLCTPSDeltaThresh "cal comments" VALUE 0xB560 Scalar_SW 0.0 CM_Percent_N200to200 -199.9999847412109 199.9938812255859 /end CHARACTERISTIC
/begin CHARACTERISTIC C_AFRLeanLimitDuringAE "cal comments" VALUE 0x91D6 Scalar_UW 0.0 CM_AFR_0to32 0.0 31.99900627136231 /end CHARACTERISTIC
/begin CHARACTERISTIC C_AFRPERampDownStep "cal comments" VALUE 0x96F8 Scalar_UW 0.0 CM_AFR_0to32 0.0 31.99900627136231 /end CHARACTERISTIC
/begin CHARACTERISTIC C_AFRPERampInterval "cal comments" VALUE 0x96FA Scalar_UW 0.0 CM_Seconds_1 0.0 2047.96875 /end CHARACTERISTIC
/begin CHARACTERISTIC C_AFRPERampUpStep "cal comments" VALUE 0x96F6 Scalar_UW 0.0 CM_AFR_0to32 0.0 31.99900627136231 /end CHARACTERISTIC
/begin CHARACTERISTIC C_AFRRampDownStep "cal comments" VALUE 0x91E0 Scalar_UW 0.0 CM_AFR_0to32 0.0 31.99900627136231 /end CHARACTERISTIC
/begin CHARACTERISTIC C_AFRRampIntervalRun "cal comments" VALUE 0x91DA Scalar_UW 0.0 CM_Seconds_1 0.0 2047.96875 /end CHARACTERISTIC
/begin CHARACTERISTIC C_AFRRampUpStepIdle "cal comments" VALUE 0x91DC Scalar_UW 0.0 CM_AFR_0to32 0.0 31.99900627136231 /end CHARACTERISTIC
/begin CHARACTERISTIC C_AFRRampUpStepRun "cal comments" VALUE 0x91DE Scalar_UW 0.0 CM_AFR_0to32 0.0 31.99900627136231 /end CHARACTERISTIC
/begin CHARACTERISTIC C_AFR1SensorFiltCoef "cal comments" VALUE 0xB6D0 Scalar_UW 0.0 CM_FiltCoef 0.0 0.9999847412109375 /end CHARACTERISTIC
/begin CHARACTERISTIC C_AFRWarmUpOffsetDecayFactor "cal comments" VALUE 0x9876 Scalar_UW 0.0 CM_FactorRatio 0.0 0.9999847412109375 /end CHARACTERISTIC
/begin CHARACTERISTIC C_AltMAPCalcOffset "cal comments" VALUE 0xB6CA Scalar_UW 0.0 CM_kpa_0to256_1 0.0 255.99609375 /end CHARACTERISTIC
/begin CHARACTERISTIC C_BaroDefault "cal comments" VALUE 0xB678 Scalar_UW 0.0 CM_kpa_0to256_1 0.0 255.99609375 /end CHARACTERISTIC
/begin CHARACTERISTIC C_BaroMaxLimit "cal comments" VALUE 0xB67C Scalar_UW 0.0 CM_kpa_0to256_1 0.0 255.99609375 /end CHARACTERISTIC
/begin CHARACTERISTIC C_BaroMinLimit "cal comments" VALUE 0xB67E Scalar_UW 0.0 CM_kpa_0to256_1 0.0 255.99609375 /end CHARACTERISTIC
/begin CHARACTERISTIC C_BaroStallUpdateMAPCheckTimes "cal comments" VALUE 0xB6E2 Scalar_UW 0.0 CM_Count_0to65535_1 0.0 65535.0 /end CHARACTERISTIC
/begin CHARACTERISTIC C_BaroUpdateDltEngSpdThresh "cal comments" VALUE 0xB6F2 Scalar_UW 0.0 CM_RPM_0to16384 0.0 16383.75 /end CHARACTERISTIC
/begin CHARACTERISTIC C_BaroUpdtEngRunTPSDeltaMaxThrsh "cal comments" VALUE 0xB71C Scalar_SW 0.0 CM_Percent_N200to200 -199.9999847412109 199.9938812255859 /end CHARACTERISTIC
/begin CHARACTERISTIC C_BaroUpdtEngSpdThrshHi "cal comments" VALUE 0xB6F0 Scalar_UW 0.0 CM_RPM_0to16384 0.0 16383.75 /end CHARACTERISTIC
/begin CHARACTERISTIC C_BaroUpdtFiltCoefRun "cal comments" VALUE 0xB6F4 Scalar_UW 0.0 CM_FiltCoef 0.0 0.9999847412109375 /end CHARACTERISTIC
/begin CHARACTERISTIC C_BaroUpdtFiltCoefStall "cal comments" VALUE 0xB67A Scalar_UW 0.0 CM_FiltCoef 0.0 0.9999847412109375 /end CHARACTERISTIC
/begin CHARACTERISTIC C_ChargeAirTempFiltCoef "cal comments" VALUE 0x824E Scalar_UW 0.0 CM_FiltCoef 0.0 0.9999847412109375 /end CHARACTERISTIC
/begin CHARACTERISTIC C_CIDFailThreshold "cal comments" VALUE 0xB68E Scalar_UW 0.0 CM_Count_0to65535_1 0.0 65535.0 /end CHARACTERISTIC
/begin CHARACTERISTIC C_CIDPassThreshold "cal comments" VALUE 0xB68C Scalar_UW 0.0 CM_Count_0to65535_1 0.0 65535.0 /end CHARACTERISTIC
/begin CHARACTERISTIC C_CLAFREnbCoolTempThresh "cal comments" VALUE 0x9606 Scalar_SW 0.0 CM_DegC_N256to256 -256.0 255.9921875 /end CHARACTERISTIC
/begin CHARACTERISTIC C_CLFuelControlEnb "cal comments" VALUE 0x98C8 Scalar_UB 0.0 CM_Boolean1 0.0 1.0 /end CHARACTERISTIC
/begin CHARACTERISTIC C_CLFuelIntegralMultUsed "cal comments" VALUE 0x98C9 Scalar_UB 0.0 CM_Boolean1 0.0 1.0 /end CHARACTERISTIC
/begin CHARACTERISTIC C_StepForceControlEnable "cal comments" VALUE 0x9E40 Scalar_UB 0.0 CM_Boolean6 0.0 255.0 /end CHARACTERISTIC
/begin CHARACTERISTIC C_CCPS_U_CcpMaxVolt "cal comments" VALUE 0x0 Scalar_UW 0.0 CM_Volt_0to32_1 0.0 31.99900627136231 /end CHARACTERISTIC
/begin CHARACTERISTIC C_CCPS_t_RunTimeCold "cal comments" VALUE 0x0 Scalar_UW 0.0 CM_Count_0to65535_1 0.0 65535.0 /end CHARACTERISTIC
/begin CHARACTERISTIC C_CCPS_t_RunTimeHot "cal comments" VALUE 0x0 Scalar_UW 0.0 CM_Count_0to65535_1 0.0 65535.0 /end CHARACTERISTIC
/begin CHARACTERISTIC C_CCPS_T_StartupCold "cal comments" VALUE 0x0 Scalar_SW 0.0 CM_DegC_N256to256 -256.0 255.9921875 /end CHARACTERISTIC
/begin CHARACTERISTIC C_CCPS_T_CoolantHigh "cal comments" VALUE 0x0 Scalar_SW 0.0 CM_DegC_N256to256 -256.0 255.9921875 /end CHARACTERISTIC
/begin CHARACTERISTIC C_CCPS_T_CoolantLow "cal comments" VALUE 0x0 Scalar_SW 0.0 CM_DegC_N256to256 -256.0 255.9921875 /end CHARACTERISTIC
/begin CHARACTERISTIC C_CCPS_T_CoolantHyst "cal comments" VALUE 0x0 Scalar_SW 0.0 CM_DegC_N256to256 -256.0 255.9921875 /end CHARACTERISTIC
/begin CHARACTERISTIC C_CCPS_t_DFCOTime "cal comments" VALUE 0x0 Scalar_UW 0.0 CM_Second_0to1024 0.0 1023.984375 /end CHARACTERISTIC
/begin CHARACTERISTIC C_CCPS_t_RichO2Time "cal comments" VALUE 0x0 Scalar_UW 0.0 CM_Second_0to1024 0.0 1023.984375 /end CHARACTERISTIC
/begin CHARACTERISTIC C_CCPS_t_RichO2TimeHyst "cal comments" VALUE 0x0 Scalar_UW 0.0 CM_Second_0to1024 0.0 1023.984375 /end CHARACTERISTIC
/begin CHARACTERISTIC C_CCPS_Pct_TPSHigh "cal comments" VALUE 0x0 Scalar_UW 0.0 CM_Percent_0to200_2 0.0 199.9969024658203 /end CHARACTERISTIC
/begin CHARACTERISTIC C_CCPS_Pct_TPSLow "cal comments" VALUE 0x0 Scalar_UW 0.0 CM_Percent_0to200_2 0.0 199.9969024658203 /end CHARACTERISTIC
/begin CHARACTERISTIC C_CCPS_Pct_TPSHyst "cal comments" VALUE 0x0 Scalar_UW 0.0 CM_Percent_0to200_2 0.0 199.9969024658203 /end CHARACTERISTIC
/begin CHARACTERISTIC C_CCPS_Pct_DutyCycleMin "cal comments" VALUE 0x0 Scalar_UW 0.0 CM_Percent_0to200_2 0.0 199.9969024658203 /end CHARACTERISTIC
/begin CHARACTERISTIC C_CCPS_Pct_DutyCycleIdleMax "cal comments" VALUE 0x0 Scalar_UW 0.0 CM_Percent_0to200_2 0.0 199.9969024658203 /end CHARACTERISTIC
/begin CHARACTERISTIC CT_CCPS_r_BLM_BlmHigh "cal comments" CURVE 0x0 Scalar_UW 0.0 CM_Ratio_0to2_2 0.0 1.999969482421875
 /begin AXIS_DESCR FIX_AXIS NO_INPUT_QUANTITY CM_Equaloutput1 34 0.0 33.0 MAX_GRAD 0.0
  /begin FIX_AXIS_PAR_LIST 1 2 3 4 5 6 7 8 9 10 11 12 13 14 15 16 17 18 19 20 21 22 23 24 25 26 27 28 29 30 31 32 33 34 /end FIX_AXIS_PAR_LIST
 /end AXIS_DESCR
/end CHARACTERISTIC
/begin CHARACTERISTIC CT_CCPS_r_BLM_BlmLow "cal comments" CURVE 0x0 Scalar_UW 0.0 CM_Ratio_0to2_2 0.0 1.999969482421875
 /begin AXIS_DESCR FIX_AXIS NO_INPUT_QUANTITY CM_Equaloutput1 34 0.0 33.0 MAX_GRAD 0.0
  /begin FIX_AXIS_PAR_LIST 1 2 3 4 5 6 7 8 9 10 11 12 13 14 15 16 17 18 19 20 21 22 23 24 25 26 27 28 29 30 31 32 33 34 /end FIX_AXIS_PAR_LIST
 /end AXIS_DESCR
/end CHARACTERISTIC
/begin CHARACTERISTIC CT_CCPS_CL_IntHigh "cal comments" CURVE 0x0 Scalar_SW 0.0 CM_SignedWord_n32768to32768_2 -32768.0 32766.0
 /begin AXIS_DESCR FIX_AXIS NO_INPUT_QUANTITY CM_Equaloutput1 34 0.0 33.0 MAX_GRAD 0.0
  /begin FIX_AXIS_PAR_LIST 1 2 3 4 5 6 7 8 9 10 11 12 13 14 15 16 17 18 19 20 21 22 23 24 25 26 27 28 29 30 31 32 33 34 /end FIX_AXIS_PAR_LIST
 /end AXIS_DESCR
/end CHARACTERISTIC
/begin CHARACTERISTIC CT_CCPS_CL_IntLow "cal comments" CURVE 0x0 Scalar_SW 0.0 CM_SignedWord_n32768to32768_2 -32768.0 32766.0
 /begin AXIS_DESCR FIX_AXIS NO_INPUT_QUANTITY CM_Equaloutput1 34 0.0 33.0 MAX_GRAD 0.0
  /begin FIX_AXIS_PAR_LIST 1 2 3 4 5 6 7 8 9 10 11 12 13 14 15 16 17 18 19 20 21 22 23 24 25 26 27 28 29 30 31 32 33 34 /end FIX_AXIS_PAR_LIST
 /end AXIS_DESCR
/end CHARACTERISTIC
/begin CHARACTERISTIC CT_CCPS_Pct_DutyCycleStepUp "cal comments" CURVE 0x0 Scalar_UW 0.0 CM_Percent_0to200_2 0.0 199.9969024658203
 /begin AXIS_DESCR FIX_AXIS NO_INPUT_QUANTITY CM_Equaloutput1 34 0.0 33.0 MAX_GRAD 0.0
  /begin FIX_AXIS_PAR_LIST 1 2 3 4 5 6 7 8 9 10 11 12 13 14 15 16 17 18 19 20 21 22 23 24 25 26 27 28 29 30 31 32 33 34 /end FIX_AXIS_PAR_LIST
 /end AXIS_DESCR
/end CHARACTERISTIC
/begin CHARACTERISTIC CT_CCPS_Pct_DutyCycleStepDown "cal comments" CURVE 0x0 Scalar_UW 0.0 CM_Percent_0to200_2 0.0 199.9969024658203
 /begin AXIS_DESCR FIX_AXIS NO_INPUT_QUANTITY CM_Equaloutput1 34 0.0 33.0 MAX_GRAD 0.0
  /begin FIX_AXIS_PAR_LIST 1 2 3 4 5 6 7 8 9 10 11 12 13 14 15 16 17 18 19 20 21 22 23 24 25 26 27 28 29 30 31 32 33 34 /end FIX_AXIS_PAR_LIST
 /end AXIS_DESCR
/end CHARACTERISTIC
/begin CHARACTERISTIC CT_CCPS_t_DutyCycleStepTime "cal comments" CURVE 0x0 Scalar_UW 0.0 CM_Second_0to8192 0.0 8191.0
 /begin AXIS_DESCR FIX_AXIS NO_INPUT_QUANTITY CM_Equaloutput1 34 0.0 33.0 MAX_GRAD 0.0
  /begin FIX_AXIS_PAR_LIST 1 2 3 4 5 6 7 8 9 10 11 12 13 14 15 16 17 18 19 20 21 22 23 24 25 26 27 28 29 30 31 32 33 34 /end FIX_AXIS_PAR_LIST
 /end AXIS_DESCR
/end CHARACTERISTIC
/begin CHARACTERISTIC C_CCPS_n_RPMMinHigh "cal comments" VALUE 0x0 Scalar_UW 0.0 udf_CM_18586 0.0 16383.75 /end CHARACTERISTIC
/begin CHARACTERISTIC C_CCPS_n_RPMMinLow "cal comments" VALUE 0x0 Scalar_UW 0.0 udf_CM_18586 0.0 16383.75 /end CHARACTERISTIC
/begin CHARACTERISTIC C_CCPS_t_BPWHigh "cal comments" VALUE 0x0 Scalar_UW 0.0 CM_msec_0to1024 0.0 1023.984375 /end CHARACTERISTIC
/begin CHARACTERISTIC C_CCPS_t_BPWLow "cal comments" VALUE 0x0 Scalar_UW 0.0 CM_msec_0to1024 0.0 1023.984375 /end CHARACTERISTIC
/begin CHARACTERISTIC CT_CCPS_Pct_DutyCycleMax "cal comments" CURVE 0x2 2D_Array_UW 0.0 CM_Percent_0to200_2 0.0 199.9969024658203
 /begin AXIS_DESCR COM_AXIS NO_INPUT_QUANTITY CM_RPM_0to16384 17 0.0 16383.75 AXIS_PTS_REF CA_EngSpd17Step1 MAX_GRAD 0.0 /end AXIS_DESCR
/end CHARACTERISTIC
/begin CHARACTERISTIC C_CLIdleEnableDelay "cal comments" VALUE 0x9DE4 Scalar_UW 0.0 CM_Second_0to1024 0.0 1023.984375 /end CHARACTERISTIC
/begin CHARACTERISTIC C_CLIdleSwitchDelay "cal comments" VALUE 0x9DE6 Scalar_UW 0.0 CM_Second_0to1024 0.0 1023.984375 /end CHARACTERISTIC
/begin CHARACTERISTIC C_CLIdleSpdUpDelay "cal comments" VALUE 0x9DE8 Scalar_UW 0.0 CM_Second_0to1024 0.0 1023.984375 /end CHARACTERISTIC
/begin CHARACTERISTIC C_CLIdleSpdDwnDelay "cal comments" VALUE 0x9DEA Scalar_UW 0.0 CM_Second_0to1024 0.0 1023.984375 /end CHARACTERISTIC
/begin CHARACTERISTIC C_CLIdleSpdH2LDelay "cal comments" VALUE 0x9DEC Scalar_UW 0.0 CM_Second_0to1024 0.0 1023.984375 /end CHARACTERISTIC
/begin CHARACTERISTIC C_ClosedLoopAFR "cal comments" VALUE 0x95FC Scalar_UW 0.0 CM_AFR_0to32 0.0 31.99900627136231 /end CHARACTERISTIC
/begin CHARACTERISTIC C_CLTThreshToEnbNextPrimePulse "cal comments" VALUE 0x91A2 Scalar_SW 0.0 CM_DegC_N256to256 -256.0 255.9921875 /end CHARACTERISTIC
/begin CHARACTERISTIC C_ColdEngineIdleEnrichEnable "cal comments" VALUE 0x91D4 Scalar_UB 0.0 CM_Boolean2 0.0 1.0 /end CHARACTERISTIC
/begin CHARACTERISTIC C_ColdEnrichCompTempThresh "cal comments" VALUE 0x91D8 Scalar_SW 0.0 CM_DegC_N256to256 -256.0 255.9921875 /end CHARACTERISTIC
/begin CHARACTERISTIC C_CoolantTempFiltCoef "cal comments" VALUE 0xB698 Scalar_UW 0.0 CM_FiltCoef 0.0 0.9999847412109375 /end CHARACTERISTIC
/begin CHARACTERISTIC C_CrankAFROffset "cal comments" VALUE 0x9726 Scalar_UW 0.0 CM_AFR_0to32 0.0 31.99900627136231 /end CHARACTERISTIC
/begin CHARACTERISTIC C_CrankAFROffsetDecayDealy "cal comments" VALUE 0x9728 Scalar_UW 0.0 CM_Count_0to65535 0.0 65535.0 /end CHARACTERISTIC
/begin CHARACTERISTIC C_CrankAFROffsetDecayFactor "cal comments" VALUE 0x972A Scalar_UW 0.0 CM_FactorRatio 0.0 0.9999847412109375 /end CHARACTERISTIC
/begin CHARACTERISTIC C_CrankAFROffsetDecayInterval "cal comments" VALUE 0x972C Scalar_UB 0.0 CM_Second_0to8 0.0 7.96875 /end CHARACTERISTIC
/begin CHARACTERISTIC C_CrankAFROffsetResetCltTempThrsh "cal comments" VALUE 0x972E Scalar_SW 0.0 CM_DegC_N256to256 -256.0 255.9921875 /end CHARACTERISTIC
/begin CHARACTERISTIC C_CrankAFROffsetResetRunTimeThrsh "cal comments" VALUE 0x9730 Scalar_UW 0.0 CM_Second_0to65535 0.0 65535.0 /end CHARACTERISTIC
/begin CHARACTERISTIC C_CrankToRunEngSpdThresh "cal comments" VALUE 0xB65C Scalar_UW 0.0 CM_RPM_0to16384 0.0 16383.75 /end CHARACTERISTIC
/begin CHARACTERISTIC C_CylinderDisplacement "cal comments" VALUE 0x824C Scalar_UW 0.0 CM_milliliter_0to1024 0.0 1023.984375 /end CHARACTERISTIC
/begin CHARACTERISTIC C_DECutoffDltTPSThresh "cal comments" VALUE 0x9BD6 Scalar_UW 0.0 CM_Percent_0to200_2 0.0 199.9969024658203 /end CHARACTERISTIC
/begin CHARACTERISTIC C_DEEnableDltTPSThresh "cal comments" VALUE 0x9BD0 Scalar_SW 0.0 CM_Percent_N200to200 -199.9999847412109 199.9938812255859 /end CHARACTERISTIC
/begin CHARACTERISTIC C_DEEnableEngSpdThresh "cal comments" VALUE 0x95CE Scalar_UW 0.0 CM_RPM_0to16384 0.0 16383.75 /end CHARACTERISTIC
/begin CHARACTERISTIC C_DefaultCoolTemp "cal comments" VALUE 0xB6D8 Scalar_SW 0.0 CM_DegC_N256to256 -256.0 255.9921875 /end CHARACTERISTIC
/begin CHARACTERISTIC C_DefaultCoolTempRunTimeFactor "cal comments" VALUE 0xB6D6 Scalar_UW 0.0 CM_FactorRatio 0.0 0.9999847412109375 /end CHARACTERISTIC
/begin CHARACTERISTIC C_DeltaMAPThrshForBaroUpdtStall "cal comments" VALUE 0xB6D2 Scalar_UW 0.0 CM_kpa_0to256_1 0.0 255.99609375 /end CHARACTERISTIC
/begin CHARACTERISTIC C_IDLELoopCounter "cal comments" VALUE 0xB7B9 Scalar_UB 0.0 CM_Count1 0.0 255.0 /end CHARACTERISTIC
/begin CHARACTERISTIC C_DesireSpeedDecreaseStepFactor "cal comments" VALUE 0x9EAA Scalar_UW 0.0 CM_Ratio_0to2_2 0.0 1.999969482421875 /end CHARACTERISTIC
/begin CHARACTERISTIC C_DesireSpeedDecreaseStepMin "cal comments" VALUE 0x9EA6 Scalar_UW 0.0 udf_CM_18586 0.0 16383.75 /end CHARACTERISTIC
/begin CHARACTERISTIC C_DesireSpeedGapDuringStartUp "cal comments" VALUE 0x9EA8 Scalar_UW 0.0 udf_CM_18586 0.0 16383.75 /end CHARACTERISTIC
/begin CHARACTERISTIC C_DesireSpeedIncreaseStepFactor "cal comments" VALUE 0x9EA4 Scalar_UW 0.0 CM_Ratio_0to2_2 0.0 1.999969482421875 /end CHARACTERISTIC
/begin CHARACTERISTIC C_DesireSpeedIncreaseStepMin "cal comments" VALUE 0x9E9C Scalar_UW 0.0 udf_CM_18586 0.0 16383.75 /end CHARACTERISTIC
/begin CHARACTERISTIC C_DesireSpeedUpOfst "cal comments" VALUE 0x9E9E Scalar_UW 0.0 udf_CM_18586 0.0 16383.75 /end CHARACTERISTIC
/begin CHARACTERISTIC C_DesireSpeedDwnOfst "cal comments" VALUE 0x9EA0 Scalar_UW 0.0 udf_CM_18586 0.0 16383.75 /end CHARACTERISTIC
/begin CHARACTERISTIC C_DesireSpeedH2LOfst "cal comments" VALUE 0x9EA2 Scalar_UW 0.0 udf_CM_18586 0.0 16383.75 /end CHARACTERISTIC
/begin CHARACTERISTIC C_DETPSDecFiltCoef "cal comments" VALUE 0xB5BC Scalar_UW 0.0 CM_FiltCoef 0.0 0.9999847412109375 /end CHARACTERISTIC
/begin CHARACTERISTIC C_DETPSIncFiltCoef "cal comments" VALUE 0xB5BA Scalar_UW 0.0 CM_FiltCoef 0.0 0.9999847412109375 /end CHARACTERISTIC
/begin CHARACTERISTIC C_EngineRunThreshCold "cal comments" VALUE 0xB66A Scalar_UB 0.0 CM_Count2 0.0 255.0 /end CHARACTERISTIC
/begin CHARACTERISTIC C_EngineRunThreshCoolTempHi "cal comments" VALUE 0xB666 Scalar_SW 0.0 CM_DegC_N256to256 -256.0 255.9921875 /end CHARACTERISTIC
/begin CHARACTERISTIC C_EngineRunThreshCoolTempLo "cal comments" VALUE 0xB664 Scalar_SW 0.0 CM_DegC_N256to256 -256.0 255.9921875 /end CHARACTERISTIC
/begin CHARACTERISTIC C_EngineRunThreshHot "cal comments" VALUE 0xB662 Scalar_UB 0.0 CM_Count2 0.0 255.0 /end CHARACTERISTIC
/begin CHARACTERISTIC C_EngineRunThreshWarm "cal comments" VALUE 0xB66B Scalar_UB 0.0 CM_Count2 0.0 255.0 /end CHARACTERISTIC
/begin CHARACTERISTIC C_EngineTurningResetDelayTime "cal comments" VALUE 0xB68A Scalar_UW 0.0 CM_Second_0to512 0.0 511.9921875 /end CHARACTERISTIC
/begin CHARACTERISTIC C_EngSpdDeltaCalcNumber "cal comments" VALUE 0xB682 Scalar_UB 0.0 CM_Count2 0.0 255.0 /end CHARACTERISTIC
/begin CHARACTERISTIC C_EngSpdFiltCoef "cal comments" VALUE 0xB680 Scalar_UW 0.0 CM_FiltCoef 0.0 0.9999847412109375 /end CHARACTERISTIC
/begin CHARACTERISTIC C_EOIRampInterval "cal comments" VALUE 0x91D2 Scalar_UW 0.0 CM_Second_0to1024 0.0 1023.984375 /end CHARACTERISTIC
/begin CHARACTERISTIC C_EOIRampStep "cal comments" VALUE 0x91D0 Scalar_UW 0.0 CM_CrankAngle_0to1024 0.0 1023.984375 /end CHARACTERISTIC
/begin CHARACTERISTIC C_ExpectMAPUsedTPSThreshHi "cal comments" VALUE 0xB590 Scalar_UW 0.0 CM_Percent_0to200_2 0.0 199.9969024658203 /end CHARACTERISTIC
/begin CHARACTERISTIC C_ExpectMAPUsedTPSThreshLo "cal comments" VALUE 0xB58E Scalar_UW 0.0 CM_Percent_0to200_2 0.0 199.9969024658203 /end CHARACTERISTIC
/begin CHARACTERISTIC C_ExtPEModeAFRExtraOffset "cal comments" VALUE 0x9604 Scalar_UW 0.0 CM_AFR_0to32 0.0 31.99900627136231 /end CHARACTERISTIC
/begin CHARACTERISTIC C_ExtPEModeCoolTempThresh "cal comments" VALUE 0x95FE Scalar_SW 0.0 CM_DegC_N256to256 -256.0 255.9921875 /end CHARACTERISTIC
/begin CHARACTERISTIC C_ExtPEModeDisableDelay "cal comments" VALUE 0x9602 Scalar_UW 0.0 CM_Second_0to65535 0.0 65535.0 /end CHARACTERISTIC
/begin CHARACTERISTIC C_ExtPEModeEnableDelay "cal comments" VALUE 0x9600 Scalar_UW 0.0 CM_Second_0to65535 0.0 65535.0 /end CHARACTERISTIC
/begin CHARACTERISTIC C_FPWIgnoreThresh "cal comments" VALUE 0x95D6 Scalar_UW 0.0 CM_msec_0to1024 0.0 1023.984375 /end CHARACTERISTIC
/begin CHARACTERISTIC C_FPWMaxThresh "cal comments" VALUE 0x95D2 Scalar_UW 0.0 CM_msec_0to1024 0.0 1023.984375 /end CHARACTERISTIC
/begin CHARACTERISTIC C_FPW_IAC_Max "cal comments" VALUE 0x95D4 Scalar_UW 0.0 CM_msec_0to1024 0.0 1023.984375 /end CHARACTERISTIC
/begin CHARACTERISTIC C_FPWMinThresh "cal comments" VALUE 0x95D0 Scalar_UW 0.0 CM_msec_0to1024 0.0 1023.984375 /end CHARACTERISTIC
/begin CHARACTERISTIC C_CylPhase "cal comments" CURVE 0x8056 2D_Array_UW 0.0 CM_Count1 0.0 720.0
 /begin AXIS_DESCR FIX_AXIS NO_INPUT_QUANTITY CM_EOI 4 0.0 4.0 MAX_GRAD 0.0 /begin FIX_AXIS_PAR_LIST 0 1 2 3 /end FIX_AXIS_PAR_LIST /end AXIS_DESCR
/end CHARACTERISTIC
/begin CHARACTERISTIC C_9177_HSY_CFG_VRS "cal comments" VALUE 0x804F Scalar_UB 0.0 CM_Count1 0.0 255.0 /end CHARACTERISTIC
/begin CHARACTERISTIC C_NbOfCyls "cal comments" VALUE 0x8050 Scalar_UB 0.0 CM_Count1 0.0 4.0 /end CHARACTERISTIC
/begin CHARACTERISTIC C_NbOfCylForFuel "cal comments" VALUE 0x8051 Scalar_UB 0.0 CM_Count1 0.0 4.0 /end CHARACTERISTIC
/begin CHARACTERISTIC C_NbOfWheelTeeth "cal comments" VALUE 0x8052 Scalar_UB 0.0 CM_Count1 0.0 60.0 /end CHARACTERISTIC
/begin CHARACTERISTIC C_NbOfMissingTeeth "cal comments" VALUE 0x8053 Scalar_UB 0.0 CM_Count1 0.0 2.0 /end CHARACTERISTIC
/begin CHARACTERISTIC C_MapCylTDCtooth "cal comments" VALUE 0x8054 Scalar_UB 0.0 CM_Count1 0.0 60.0 /end CHARACTERISTIC
/begin CHARACTERISTIC C_RubbishSignalForDucar "cal comments" VALUE 0x805E Scalar_UB 0.0 CM_Boolean6 0.0 255.0 /end CHARACTERISTIC
/begin CHARACTERISTIC C_TwoStrokeCylinder "cal comments" VALUE 0x805F Scalar_UB 0.0 CM_Boolean6 0.0 255.0 /end CHARACTERISTIC
/begin CHARACTERISTIC C_CodeVersion "cal comments" VALUE 0x8004 Scalar_UL 0.0 CM_VERSION1 0.0 4294967295.0 /end CHARACTERISTIC
/begin CHARACTERISTIC C_CalVersion "cal comments" VALUE 0x8008 Scalar_UL 0.0 CM_VERSION1 0.0 4294967295.0 /end CHARACTERISTIC
/begin CHARACTERISTIC C_HWIO_CCP_Output_Usage "cal comments" VALUE 0x800C Scalar_UB 0.0 CM_Count1 0.0 255.0 /end CHARACTERISTIC
/begin CHARACTERISTIC C_HWIO_FPR_Output_Usage "cal comments" VALUE 0x800D Scalar_UB 0.0 CM_Count1 0.0 255.0 /end CHARACTERISTIC
/begin CHARACTERISTIC C_HWIO_O2HTR_Output_Usage "cal comments" VALUE 0x800E Scalar_UB 0.0 CM_Count1 0.0 255.0 /end CHARACTERISTIC
/begin CHARACTERISTIC C_HWIO_TACH_Output_Usage "cal comments" VALUE 0x800F Scalar_UB 0.0 CM_Count1 0.0 255.0 /end CHARACTERISTIC
/begin CHARACTERISTIC C_HWIO_DCM_Output_Usage "cal comments" VALUE 0x8010 Scalar_UB 0.0 CM_Count1 0.0 255.0 /end CHARACTERISTIC
/begin CHARACTERISTIC C_HWIO_SPRK1_Output_Usage "cal comments" VALUE 0x8011 Scalar_UB 0.0 CM_Count1 0.0 255.0 /end CHARACTERISTIC
/begin CHARACTERISTIC C_HWIO_SPRK2_Output_Usage "cal comments" VALUE 0x8012 Scalar_UB 0.0 CM_Count1 0.0 255.0 /end CHARACTERISTIC
/begin CHARACTERISTIC C_HWIO_SPRK3_Output_Usage "cal comments" VALUE 0x8013 Scalar_UB 0.0 CM_Count1 0.0 255.0 /end CHARACTERISTIC
/begin CHARACTERISTIC C_HWIO_SPRK4_Output_Usage "cal comments" VALUE 0x8014 Scalar_UB 0.0 CM_Count1 0.0 255.0 /end CHARACTERISTIC
/begin CHARACTERISTIC C_FuelCLEnbRunTimeThrsh "cal comments" VALUE 0x98CC Scalar_UW 0.0 CM_Second_0to65535 0.0 65535.0 /end CHARACTERISTIC
/begin CHARACTERISTIC C_FuellLowLoadCondEngSpdThrsh "cal comments" VALUE 0x99C8 Scalar_UW 0.0 CM_RPM_0to16384 0.0 16383.75 /end CHARACTERISTIC
/begin CHARACTERISTIC C_FuellLowLoadCondMAPThrsh "cal comments" VALUE 0x99CA Scalar_UW 0.0 CM_kpa_0to256_1 0.0 255.99609375 /end CHARACTERISTIC
/begin CHARACTERISTIC C_FuelO2RichLeanWindowDelta "cal comments" VALUE 0x99CC Scalar_UW 0.0 CM_mVolt_1 0.0 1023.96875 /end CHARACTERISTIC
/begin CHARACTERISTIC C_FuelO2RLThreshMaxLimit "cal comments" VALUE 0x9984 Scalar_UW 0.0 CM_mVolt_1 0.0 1023.96875 /end CHARACTERISTIC
/begin CHARACTERISTIC C_FuelO2RLThreshMinLimit "cal comments" VALUE 0x9986 Scalar_UW 0.0 CM_mVolt_1 0.0 1023.96875 /end CHARACTERISTIC
/begin CHARACTERISTIC C_FuelPropLowLoadCond "cal comments" VALUE 0x9AC8 Scalar_UW 0.0 CM_Percent_0to200_2 0.0 199.9969024658203 /end CHARACTERISTIC
/begin CHARACTERISTIC C_DiagFuelPumpDC "cal comments" VALUE 0x973C Scalar_UW 0.0 CM_Percent_0to200_2 0.0 199.9969024658203 /end CHARACTERISTIC
/begin CHARACTERISTIC C_FuelPumpFreq "cal comments" VALUE 0x803E Scalar_UW 0.0 CM_Hz_0to16384 0.0 16383.75 /end CHARACTERISTIC
/begin CHARACTERISTIC C_LinFlexFuncSel "cal comments" VALUE 0x8040 Scalar_UB 0.0 CM_Count1 0.0 4.0 /end CHARACTERISTIC
/begin CHARACTERISTIC C_ProductTypeSel "cal comments" VALUE 0x8041 Scalar_UB 0.0 CM_Count1 0.0 4.0 /end CHARACTERISTIC
/begin CHARACTERISTIC C_FuelPumpOffDelay "cal comments" VALUE 0x91A4 Scalar_UW 0.0 CM_Second_0to512 0.0 511.9921875 /end CHARACTERISTIC
/begin CHARACTERISTIC C_FuelSTFTRichClampCltThrsh "cal comments" VALUE 0x99D6 Scalar_SW 0.0 CM_DegC_N256to256 -256.0 255.9921875 /end CHARACTERISTIC
/begin CHARACTERISTIC C_FuelSTFTRichClampVacThrsh "cal comments" VALUE 0x99D4 Scalar_UW 0.0 CM_kpa_0to256_1 0.0 255.99609375 /end CHARACTERISTIC
/begin CHARACTERISTIC C_FUEL_T_LightOffAFR_CltThrshHi "cal comments" VALUE 0x99CE Scalar_SW 0.0 CM_DegC_N256to256 -256.0 255.9921875 /end CHARACTERISTIC
/begin CHARACTERISTIC C_FUEL_T_LightOffAFR_CltThrshLo "cal comments" VALUE 0x99D0 Scalar_SW 0.0 CM_DegC_N256to256 -256.0 255.9921875 /end CHARACTERISTIC
/begin CHARACTERISTIC C_FUEL_p_CL_LeanBiasThrsh "cal comments" VALUE 0x99D2 Scalar_UW 0.0 CM_kpa_0to256_1 0.0 255.99609375 /end CHARACTERISTIC
/begin CHARACTERISTIC C_FuelSTFuelTrimMax "cal comments" VALUE 0x99B2 Scalar_SW 0.0 CM_SignedWord_n32768to32768_2 -32768.0 32766.0 /end CHARACTERISTIC
/begin CHARACTERISTIC C_FuelSTFuelTrimMaxPE "cal comments" VALUE 0x99B4 Scalar_SW 0.0 CM_SignedWord_n32768to32768_2 -32768.0 32766.0 /end CHARACTERISTIC
/begin CHARACTERISTIC C_FuelSTFuelTrimMin "cal comments" VALUE 0x99B6 Scalar_SW 0.0 CM_SignedWord_n32768to32768_2 -32768.0 32766.0 /end CHARACTERISTIC
/begin CHARACTERISTIC C_FuelSTFuelTrimPctConvFactor "cal comments" VALUE 0x9AE8 Scalar_UW 0.0 CM_Percent_0to200 0.0 199.9969482421875 /end CHARACTERISTIC
/begin CHARACTERISTIC C_FuelSTFuelTrimPWConvFactor "cal comments" VALUE 0x99B8 Scalar_UW 0.0 CM_Ratio_0to2_1 0.0 1.999969482421875 /end CHARACTERISTIC
/begin CHARACTERISTIC C_FUEL_Pct_ClearFloodTPS "cal comments" VALUE 0x0 Scalar_UW 0.0 CM_Percent_0to200_2 0.0 199.9969024658203 /end CHARACTERISTIC
/begin CHARACTERISTIC C_FUEL_t_ClearFloodTime "cal comments" VALUE 0x0 Scalar_UW 0.0 CM_Second_0to4096 0.0 4095.9375 /end CHARACTERISTIC
/begin CHARACTERISTIC CT_FUEL_Pct_DFCO_TPS_Thrsh "cal comments" CURVE 0x2 2D_Array_UW 0.0 CM_Percent_0to200_2 0.0 199.9969024658203
 /begin AXIS_DESCR FIX_AXIS NO_INPUT_QUANTITY CM_Equaloutput1 17 0.0 12800.0 MAX_GRAD 0.0
  /begin FIX_AXIS_PAR_LIST 0 800 1600 2400 3200 4000 4800 5600 6400 7200 8000 8800 9600 10400 11200 12000 12800 /end FIX_AXIS_PAR_LIST
 /end AXIS_DESCR
/end CHARACTERISTIC
/begin CHARACTERISTIC C_FUEL_Pct_DFCO_TPS_Hys "cal comments" VALUE 0x0 Scalar_UW 0.0 CM_Percent_0to200_2 0.0 199.9969024658203 /end CHARACTERISTIC
/begin CHARACTERISTIC CT_FUEL_t_DFCOMetTime "cal comments" CURVE 0x2 2D_Array_UB 0.0 CM_Second_0to4 0.0 3.984375
 /begin AXIS_DESCR COM_AXIS NO_INPUT_QUANTITY CM_RPM_0to16384 9 0.0 16383.75 AXIS_PTS_REF CA_EngSpd9Step1 MAX_GRAD 0.0 /end AXIS_DESCR
/end CHARACTERISTIC
/begin CHARACTERISTIC C_FUEL_n_DFCOdRPMDa "cal comments" VALUE 0x0 Scalar_UW 0.0 CM_RPM_0to16384 0.0 16383.75 /end CHARACTERISTIC
/begin CHARACTERISTIC C_FUEL_n_DFCOEnable_RPMThrsh "cal comments" VALUE 0x0 Scalar_UW 0.0 CM_RPM_0to16384 0.0 16383.75 /end CHARACTERISTIC
/begin CHARACTERISTIC C_FUEL_T_DFCO_CoolTempThrsh "cal comments" VALUE 0x0 Scalar_SW 0.0 CM_DegC_N256to256 -256.0 255.9921875 /end CHARACTERISTIC
/begin CHARACTERISTIC C_FUEL_p_DFCO_MAP_Hys "cal comments" VALUE 0x0 Scalar_UW 0.0 CM_kpa_0to256_1 0.0 255.99609375 /end CHARACTERISTIC
/begin CHARACTERISTIC CT_FUEL_p_DFCO_MAP_Thrsh "cal comments" CURVE 0x2 2D_Array_UB 0.0 CM_kpa_8bit 0.0 127.5
 /begin AXIS_DESCR FIX_AXIS NO_INPUT_QUANTITY CM_Equaloutput1 17 0.0 12800.0 MAX_GRAD 0.0
  /begin FIX_AXIS_PAR_LIST 0 800 1600 2400 3200 4000 4800 5600 6400 7200 8000 8800 9600 10400 11200 12000 12800 /end FIX_AXIS_PAR_LIST
 /end AXIS_DESCR
/end CHARACTERISTIC
/begin CHARACTERISTIC C_FUEL_n_DFCOExit_Thrsh "cal comments" VALUE 0x0 Scalar_UW 0.0 CM_RPM_0to16384 0.0 16383.75 /end CHARACTERISTIC
/begin CHARACTERISTIC C_FUEL_r_DFCOExit_FuelDecayFactor "cal comments" VALUE 0x0 Scalar_UB 0.0 CM_Mult_0to1_2 0.0 0.99609375 /end CHARACTERISTIC
/begin CHARACTERISTIC C_FUEL_t_DFCOExit_FuelDecayTime "cal comments" VALUE 0x0 Scalar_UW 0.0 CM_Second_0to1024 0.0 1023.984375 /end CHARACTERISTIC
/begin CHARACTERISTIC C_FUEL_t_DFCO_RunTimeThrsh "cal comments" VALUE 0x0 Scalar_UW 0.0 CM_Count_0to65535_1 0.0 65535.0 /end CHARACTERISTIC
/begin CHARACTERISTIC C_FUEL_t_DFCO_Spark_Exit_Dly "cal comments" VALUE 0x0 Scalar_UW 0.0 CM_Second_0to1024 0.0 1023.984375 /end CHARACTERISTIC
/begin CHARACTERISTIC C_FUEL_t_DFCO_RampOUT_Interval "cal comments" VALUE 0x0 Scalar_UW 0.0 CM_Second_0to1024 0.0 1023.984375 /end CHARACTERISTIC
/begin CHARACTERISTIC C_FUEL_r_DFCO_RampOUT_Step "cal comments" VALUE 0x0 Scalar_UW 0.0 CM_Ratio_0to2_2 0.0 1.999969482421875 /end CHARACTERISTIC
/begin CHARACTERISTIC C_FUEL_n_DFCO_RampOUT_ExitThresh "cal comments" VALUE 0x0 Scalar_UW 0.0 CM_RPM_0to16384 0.0 16383.75 /end CHARACTERISTIC
/begin CHARACTERISTIC C_FUEL_DFCO_DeclutchExitDFCO "cal comments" VALUE 0x0 Scalar_UB 0.0 CM_Boolean2 0.0 1.0 /end CHARACTERISTIC
/begin CHARACTERISTIC C_FUEL_t_DFCO_Declutch_Delay "cal comments" VALUE 0x0 Scalar_UW 0.0 CM_Second_0to1024 0.0 1023.984375 /end CHARACTERISTIC
/begin CHARACTERISTIC C_FUEL_r_DFCO_RampOUT_Initial "cal comments" VALUE 0x0 Scalar_UW 0.0 CM_Ratio_0to2_2 0.0 1.999969482421875 /end CHARACTERISTIC
/begin CHARACTERISTIC C_FUEL_n_DFCO_RampOUT_MinVSS "cal comments" VALUE 0x0 Scalar_UW 0.0 CM_KPH_0to512 0.0 511.9921875 /end CHARACTERISTIC
/begin CHARACTERISTIC CT_FUEL_r_DFCOExit_TempFactor "cal comments" CURVE 0x2 2D_Array_UB 0.0 CM_Mult0_to_2_ratio 0.0 1.9921875
 /begin AXIS_DESCR FIX_AXIS NO_INPUT_QUANTITY CM_Equaloutput1 17 -28.0 164.0 MAX_GRAD 0.0 /begin FIX_AXIS_PAR_LIST -28 -16 -4 8 20 32 44 56 68 80 92 104 116 128 140 152 164 /end FIX_AXIS_PAR_LIST /end AXIS_DESCR
/end CHARACTERISTIC
/begin CHARACTERISTIC CT_FUEL_t_DFCOExitBPW "cal comments" CURVE 0x2 2D_Array_UW 0.0 CM_msec_0to1024 0.0 1023.984375
 /begin AXIS_DESCR FIX_AXIS NO_INPUT_QUANTITY CM_Second_0to1024 17 0 16.0 MAX_GRAD 0.0
  /begin FIX_AXIS_PAR_LIST 0.0 1.0 2.0 3.0 4.0 5.0 6.0 7.0 8.0 9.0 10.0 11.0 12.0 13.0 14.0 15.0 16.0 /end FIX_AXIS_PAR_LIST
 /end AXIS_DESCR
/end CHARACTERISTIC
/begin CHARACTERISTIC CT_FUEL_COWeightFactor "cal comments" MAP 0x9AF9 3D_Array_UB 0.0 CM_Mult_0to1 0.0 0.99609375
 /begin AXIS_DESCR COM_AXIS NO_INPUT_QUANTITY CM_kpa_0to256_1 10 0.0 255.99609375 AXIS_PTS_REF CA_MAP10Step1 MAX_GRAD 0.0 /end AXIS_DESCR
 /begin AXIS_DESCR COM_AXIS NO_INPUT_QUANTITY CM_RPM_0to16384 9 0.0 16383.75 AXIS_PTS_REF CA_EngSpd9Step1 MAX_GRAD 0.0 /end AXIS_DESCR
/end CHARACTERISTIC
/begin CHARACTERISTIC C_FUEL_COAdjIATMinThrsh "cal comments" VALUE 0x9AEA Scalar_SW 0.0 CM_DegC_N256to256 -256.0 255.9921875 /end CHARACTERISTIC
/begin CHARACTERISTIC C_FUEL_COAdjIATMaxThrsh "cal comments" VALUE 0x9AEC Scalar_SW 0.0 CM_DegC_N256to256 -256.0 255.9921875 /end CHARACTERISTIC
/begin CHARACTERISTIC C_FUEL_COAdjCoolMinThrsh "cal comments" VALUE 0x9AEE Scalar_SW 0.0 CM_DegC_N256to256 -256.0 255.9921875 /end CHARACTERISTIC
/begin CHARACTERISTIC C_FUEL_COAdjCoolMaxThrsh "cal comments" VALUE 0x9AF0 Scalar_SW 0.0 CM_DegC_N256to256 -256.0 255.9921875 /end CHARACTERISTIC
/begin CHARACTERISTIC C_FUEL_COPinGndTime "cal comments" VALUE 0x9AF2 Scalar_UW 0.0 CM_Second_0to4096 0.0 4095.9375 /end CHARACTERISTIC
/begin CHARACTERISTIC C_FUEL_COMultStep "cal comments" VALUE 0x9AF4 Scalar_UW 0.0 CM_FactorRatio 0.0 0.9999847412109375 /end CHARACTERISTIC
/begin CHARACTERISTIC C_FUEL_COADDefMult "cal comments" VALUE 0x9B54 Scalar_SW 0.0 CM_FactorRatio_N1to1 0.0 0.9999847412109375 /end CHARACTERISTIC
/begin CHARACTERISTIC C_FUEL_COAdjustEn "cal comments" VALUE 0x9B56 Scalar_UB 0.0 CM_Boolean6 0.0 255.0 /end CHARACTERISTIC
/begin CHARACTERISTIC C_GPIO_VSS_FUNC "cal comments" VALUE 0x801D Scalar_UB 0.0 CM_Count1 0.0 255.0 /end CHARACTERISTIC
/begin CHARACTERISTIC C_GPIO_DCMEN_FUNC "cal comments" VALUE 0x8019 Scalar_UB 0.0 CM_Count1 0.0 255.0 /end CHARACTERISTIC
/begin CHARACTERISTIC C_GPIO_DCMCS_FUNC "cal comments" VALUE 0x801A Scalar_UB 0.0 CM_Count1 0.0 255.0 /end CHARACTERISTIC
/begin CHARACTERISTIC C_GPIO_DCMDIR_FUNC "cal comments" VALUE 0x801B Scalar_UB 0.0 CM_Count1 0.0 255.0 /end CHARACTERISTIC
/begin CHARACTERISTIC C_GPIO_DCMPWM_FUNC "cal comments" VALUE 0x801C Scalar_UB 0.0 CM_Count1 0.0 255.0 /end CHARACTERISTIC
/begin CHARACTERISTIC C_GPIO_LP_SW_FUNC "cal comments" VALUE 0x801E Scalar_UB 0.0 CM_Count1 0.0 255.0 /end CHARACTERISTIC
/begin CHARACTERISTIC C_GPIO_PN_SW_FUNC "cal comments" VALUE 0x801F Scalar_UB 0.0 CM_Count1 0.0 255.0 /end CHARACTERISTIC
/begin CHARACTERISTIC C_GPIO_Rollover_FUNC "cal comments" VALUE 0x8020 Scalar_UB 0.0 CM_Count1 0.0 255.0 /end CHARACTERISTIC
/begin CHARACTERISTIC C_GPIO_DIAG_FUNC "cal comments" VALUE 0x8021 Scalar_UB 0.0 CM_Count1 0.0 255.0 /end CHARACTERISTIC
/begin CHARACTERISTIC C_GPIO_O2A_FUNC "cal comments" VALUE 0x8022 Scalar_UB 0.0 CM_Count1 0.0 255.0 /end CHARACTERISTIC
/begin CHARACTERISTIC C_GPIO_O2B_FUNC "cal comments" VALUE 0x8023 Scalar_UB 0.0 CM_Count1 0.0 255.0 /end CHARACTERISTIC
/begin CHARACTERISTIC C_GPIO_CLT_FUNC "cal comments" VALUE 0x8024 Scalar_UB 0.0 CM_Count1 0.0 255.0 /end CHARACTERISTIC
/begin CHARACTERISTIC C_GPIO_MAT_FUNC "cal comments" VALUE 0x8025 Scalar_UB 0.0 CM_Count1 0.0 255.0 /end CHARACTERISTIC
/begin CHARACTERISTIC C_GPIO_MAP_FUNC "cal comments" VALUE 0x8026 Scalar_UB 0.0 CM_Count1 0.0 255.0 /end CHARACTERISTIC
/begin CHARACTERISTIC C_GPIO_TPS1_FUNC "cal comments" VALUE 0x8027 Scalar_UB 0.0 CM_Count1 0.0 255.0 /end CHARACTERISTIC
/begin CHARACTERISTIC C_GPIO_TPS2_FUNC "cal comments" VALUE 0x8028 Scalar_UB 0.0 CM_Count1 0.0 255.0 /end CHARACTERISTIC
/begin CHARACTERISTIC C_GPIO_FCVPS_FUNC "cal comments" VALUE 0x8029 Scalar_UB 0.0 CM_Count1 0.0 255.0 /end CHARACTERISTIC
/begin CHARACTERISTIC C_GPIO_TACH_FUNC "cal comments" VALUE 0x802A Scalar_UB 0.0 CM_Count1 0.0 255.0 /end CHARACTERISTIC
/begin CHARACTERISTIC C_GPIO_CCP_FUNC "cal comments" VALUE 0x802B Scalar_UB 0.0 CM_Count1 0.0 255.0 /end CHARACTERISTIC
/begin CHARACTERISTIC C_GPIO_O2HTR_FUNC "cal comments" VALUE 0x802C Scalar_UB 0.0 CM_Count1 0.0 255.0 /end CHARACTERISTIC
/begin CHARACTERISTIC C_GPIO_IDLE_EN_FUNC "cal comments" VALUE 0x802E Scalar_UB 0.0 CM_Count1 0.0 255.0 /end CHARACTERISTIC
/begin CHARACTERISTIC C_GPIO_IDLE_DIR_FUNC "cal comments" VALUE 0x802F Scalar_UB 0.0 CM_Count1 0.0 255.0 /end CHARACTERISTIC
/begin CHARACTERISTIC C_GPIO_IDLE_STEP_FUNC "cal comments" VALUE 0x8030 Scalar_UB 0.0 CM_Count1 0.0 255.0 /end CHARACTERISTIC
/begin CHARACTERISTIC C_GPIO_8101CS_FUNC "cal comments" VALUE 0x8031 Scalar_UB 0.0 CM_Count1 0.0 255.0 /end CHARACTERISTIC
/begin CHARACTERISTIC C_GPIO_INJ1_FUNC "cal comments" VALUE 0x8032 Scalar_UB 0.0 CM_Count1 0.0 255.0 /end CHARACTERISTIC
/begin CHARACTERISTIC C_GPIO_INJ2_FUNC "cal comments" VALUE 0x8033 Scalar_UB 0.0 CM_Count1 0.0 255.0 /end CHARACTERISTIC
/begin CHARACTERISTIC C_GPIO_INJ3_FUNC "cal comments" VALUE 0x8034 Scalar_UB 0.0 CM_Count1 0.0 255.0 /end CHARACTERISTIC
/begin CHARACTERISTIC C_GPIO_INJ4_FUNC "cal comments" VALUE 0x8035 Scalar_UB 0.0 CM_Count1 0.0 255.0 /end CHARACTERISTIC
/begin CHARACTERISTIC C_GPIO_MIL_FUNC "cal comments" VALUE 0x802D Scalar_UB 0.0 CM_Count1 0.0 255.0 /end CHARACTERISTIC
/begin CHARACTERISTIC C_GPIO_VI0_FUNC "cal comments" VALUE 0x8036 Scalar_UB 0.0 CM_Count1 0.0 255.0 /end CHARACTERISTIC
/begin CHARACTERISTIC C_GPIO_VI1_FUNC "cal comments" VALUE 0x8037 Scalar_UB 0.0 CM_Count1 0.0 255.0 /end CHARACTERISTIC
/begin CHARACTERISTIC C_GPIO_VI2_FUNC "cal comments" VALUE 0x8038 Scalar_UB 0.0 CM_Count1 0.0 255.0 /end CHARACTERISTIC
/begin CHARACTERISTIC C_GPIO_VI3_FUNC "cal comments" VALUE 0x8039 Scalar_UB 0.0 CM_Count1 0.0 255.0 /end CHARACTERISTIC
/begin CHARACTERISTIC C_GPIO_VI4_FUNC "cal comments" VALUE 0x803A Scalar_UB 0.0 CM_Count1 0.0 255.0 /end CHARACTERISTIC
/begin CHARACTERISTIC C_GPIO_VI5_FUNC "cal comments" VALUE 0x803B Scalar_UB 0.0 CM_Count1 0.0 255.0 /end CHARACTERISTIC
/begin CHARACTERISTIC C_GPIO_VI6_FUNC "cal comments" VALUE 0x803C Scalar_UB 0.0 CM_Count1 0.0 255.0 /end CHARACTERISTIC
/begin CHARACTERISTIC C_GPIO_VI7_FUNC "cal comments" VALUE 0x803D Scalar_UB 0.0 CM_Count1 0.0 255.0 /end CHARACTERISTIC
/begin CHARACTERISTIC C_HeatedO2SensorUsed "cal comments" VALUE 0x919C Scalar_UB 0.0 CM_Boolean2 0.0 1.0 /end CHARACTERISTIC
/begin CHARACTERISTIC C_HighEngSpdFCOThreshHi "cal comments" VALUE 0x92A6 Scalar_UW 0.0 CM_RPM_0to16384 0.0 16383.75 /end CHARACTERISTIC
/begin CHARACTERISTIC C_HighEngSpdFCOThreshLo "cal comments" VALUE 0x92A4 Scalar_UW 0.0 CM_RPM_0to16384 0.0 16383.75 /end CHARACTERISTIC
/begin CHARACTERISTIC C_FUEL_n_LackOilHighRPM "cal comments" VALUE 0xC16A Scalar_UW 0.0 CM_RPM_0to16384 0.0 16383.75 /end CHARACTERISTIC
/begin CHARACTERISTIC C_FUEL_n_LackOilLowRPM "cal comments" VALUE 0xC16C Scalar_UW 0.0 CM_RPM_0to16384 0.0 16383.75 /end CHARACTERISTIC
/begin CHARACTERISTIC C_FUEL_LackOil_CutOffEn "cal comments" VALUE 0xC16E Scalar_UB 0.0 CM_Boolean6 0.0 255.0 /end CHARACTERISTIC
/begin CHARACTERISTIC C_OSWPFiltCoef "cal comments" VALUE 0xC170 Scalar_UW 0.0 CM_FiltCoef 0.0 0.9999847412109375 /end CHARACTERISTIC
/begin CHARACTERISTIC C_OSWPSignalConvSlope "cal comments" VALUE 0xC172 Scalar_UW 0.0 CM_Percent_0to200_2 0.0 199.9969024658203 /end CHARACTERISTIC
/begin CHARACTERISTIC C_OSWPSignalConvIntercept "cal comments" VALUE 0xC174 Scalar_SW 0.0 CM_Percent_N200to200 -199.9999847412109 199.9938812255859 /end CHARACTERISTIC
/begin CHARACTERISTIC C_FUEL_n_COAHighRPM "cal comments" VALUE 0xC176 Scalar_UW 0.0 CM_RPM_0to16384 0.0 16383.75 /end CHARACTERISTIC
/begin CHARACTERISTIC C_FUEL_n_COALowRPM "cal comments" VALUE 0xC178 Scalar_UW 0.0 CM_RPM_0to16384 0.0 16383.75 /end CHARACTERISTIC
/begin CHARACTERISTIC C_FUEL_COA_CutOffEn "cal comments" VALUE 0xC17A Scalar_UB 0.0 CM_Boolean6 0.0 255.0 /end CHARACTERISTIC
/begin CHARACTERISTIC C_FUEL_COA_LowActive "cal comments" VALUE 0xC17B Scalar_UB 0.0 CM_Boolean6 0.0 255.0 /end CHARACTERISTIC
/begin CHARACTERISTIC C_FUEL_t_COA_Ignore "cal comments" VALUE 0xC17C Scalar_UW 0.0 CM_Seconds_1 0.0 2047.96875 /end CHARACTERISTIC
/begin CHARACTERISTIC C_FUEL_t_COA_Filt "cal comments" VALUE 0xC17E Scalar_UW 0.0 CM_Seconds_1 0.0 2047.96875 /end CHARACTERISTIC
/begin CHARACTERISTIC C_FUEL_t_COA_Lock "cal comments" VALUE 0xC180 Scalar_UW 0.0 CM_Seconds_1 0.0 2047.96875 /end CHARACTERISTIC
/begin CHARACTERISTIC C_MultFuelSWFiltTime "cal comments" VALUE 0xC15C Scalar_UW 0.0 CM_Second_0to4096 0.0 4095.9375 /end CHARACTERISTIC
/begin CHARACTERISTIC C_MultFuelValvePulseOnTimeDuringCrank "cal comments" VALUE 0xC15E Scalar_UW 0.0 CM_Second_0to4096 0.0 4095.9375 /end CHARACTERISTIC
/begin CHARACTERISTIC C_MultFuelValvePulseOffTimeDuringCrank "cal comments" VALUE 0xC160 Scalar_UW 0.0 CM_Second_0to4096 0.0 4095.9375 /end CHARACTERISTIC
/begin CHARACTERISTIC C_VIOS_MultFuelSWLowActive "cal comments" VALUE 0xC162 Scalar_UB 0.0 CM_Boolean6 0.0 255.0 /end CHARACTERISTIC
/begin CHARACTERISTIC C_MultFuelType "cal comments" VALUE 0xC163 Scalar_UB 0.0 CM_Count1 0.0 255.0 /end CHARACTERISTIC
/begin CHARACTERISTIC C_MultFuelTypeLvl_Gas_NG "cal comments" VALUE 0xC164 Scalar_UW 0.0 CM_Percent_0to100_1 0.0 99.9984130859375 /end CHARACTERISTIC
/begin CHARACTERISTIC C_MultFuelTypeLvl_NG_LPG "cal comments" VALUE 0xC166 Scalar_UW 0.0 CM_Percent_0to100_1 0.0 99.9984130859375 /end CHARACTERISTIC
/begin CHARACTERISTIC C_FUEL_n_CltOverHeatHighRPM "cal comments" VALUE 0x9734 Scalar_UW 0.0 CM_RPM_0to16384 0.0 16383.75 /end CHARACTERISTIC
/begin CHARACTERISTIC C_FUEL_n_CltOverHeatLowRPM "cal comments" VALUE 0x9736 Scalar_UW 0.0 CM_RPM_0to16384 0.0 16383.75 /end CHARACTERISTIC
/begin CHARACTERISTIC C_FUEL_CltOverHeat_CutOffEn "cal comments" VALUE 0x9738 Scalar_UB 0.0 CM_Boolean6 0.0 255.0 /end CHARACTERISTIC
/begin CHARACTERISTIC C_Fuel_Cont_IGNOff_HiRPM "cal comments" VALUE 0x973A Scalar_UW 0.0 CM_RPM_0to16384 0.0 16383.75 /end CHARACTERISTIC
/begin CHARACTERISTIC C_ACSW_Current_High_Thresh "cal comments" VALUE 0xB216 Scalar_UW 0.0 CM_Percent_0to100_1 0.0 99.9984130859375 /end CHARACTERISTIC
/begin CHARACTERISTIC C_ACSW_Current_Hsyt "cal comments" VALUE 0xB218 Scalar_UW 0.0 CM_Percent_0to100_1 0.0 99.9984130859375 /end CHARACTERISTIC
/begin CHARACTERISTIC C_ACSW_IdleDelayTime "cal comments" VALUE 0xB21A Scalar_UW 0.0 CM_Second_0to512 0.0 511.9921875 /end CHARACTERISTIC
/begin CHARACTERISTIC C_DC_CurrentSignalConvIntercept "cal comments" VALUE 0xB21E Scalar_SW 0.0 CM_Ratio_n256to256 -256.0 255.9921875 /end CHARACTERISTIC
/begin CHARACTERISTIC C_DC_CurrentSignalConvSlope "cal comments" VALUE 0xB21C Scalar_UW 0.0 CM_amp_0to512_1 0.0 511.9921875 /end CHARACTERISTIC
/begin CHARACTERISTIC C_DC_CurrentFiltCoef "cal comments" VALUE 0xB220 Scalar_UW 0.0 CM_FiltCoef 0.0 0.9999847412109375 /end CHARACTERISTIC
/begin CHARACTERISTIC C_IDLEMoveBatVoltMaxLimit "cal comments" VALUE 0xB7A8 Scalar_UW 0.0 CM_Volt_0to32_1 0.0 31.99900627136231 /end CHARACTERISTIC
/begin CHARACTERISTIC C_IDLEMoveBatVoltMinLimit "cal comments" VALUE 0xB7AA Scalar_UW 0.0 CM_Volt_0to32_1 0.0 31.99900627136231 /end CHARACTERISTIC
/begin CHARACTERISTIC C_IdleDerivEngSpdHiDeadBand "cal comments" VALUE 0x9EAE Scalar_UW 0.0 CM_RPM_0to16384 0.0 16383.75 /end CHARACTERISTIC
/begin CHARACTERISTIC C_IdleDerivEngSpdHiDeadBand2 "cal comments" VALUE 0x9EF8 Scalar_UW 0.0 CM_RPM_0to16384 0.0 16383.75 /end CHARACTERISTIC
/begin CHARACTERISTIC C_IdleDerivEngSpdLoDeadBand "cal comments" VALUE 0x9EB0 Scalar_UW 0.0 CM_RPM_0to16384 0.0 16383.75 /end CHARACTERISTIC
/begin CHARACTERISTIC C_IdleDerivEngSpdLoDeadBand2 "cal comments" VALUE 0x9EFA Scalar_UW 0.0 CM_RPM_0to16384 0.0 16383.75 /end CHARACTERISTIC
/begin CHARACTERISTIC C_IdleEnableEngSpdThresh "cal comments" VALUE 0x9EFE Scalar_UW 0.0 CM_RPM_0to16384 0.0 16383.75 /end CHARACTERISTIC
/begin CHARACTERISTIC C_IdleEnableTPSThresh "cal comments" VALUE 0x9F00 Scalar_UW 0.0 CM_Percent_0to200_2 0.0 199.9969024658203 /end CHARACTERISTIC
/begin CHARACTERISTIC C_IdleIntEnbEngSpdErrorThresh "cal comments" VALUE 0x9EAC Scalar_UW 0.0 CM_RPM_0to16384 0.0 16383.75 /end CHARACTERISTIC
/begin CHARACTERISTIC C_IdleIntInitDefault "cal comments" VALUE 0x9EFC Scalar_UW 0.0 CM_Percent_0to200_2 0.0 199.9969024658203 /end CHARACTERISTIC
/begin CHARACTERISTIC C_IdlePropEngSpdHiDeadBand "cal comments" VALUE 0x9EB2 Scalar_UW 0.0 CM_RPM_0to16384 0.0 16383.75 /end CHARACTERISTIC
/begin CHARACTERISTIC C_IdlePropEngSpdLoDeadBand "cal comments" VALUE 0x9EB4 Scalar_UW 0.0 CM_RPM_0to16384 0.0 16383.75 /end CHARACTERISTIC
/begin CHARACTERISTIC CT_IdlePropEngSpdHigh_EX "cal comments" MAP 0x9F05 3D_Array_UB 0.0 CM_Percent_0to100 0.0 99.609375
 /begin AXIS_DESCR COM_AXIS NO_INPUT_QUANTITY CM_RPM_0to16384 17 0.0 16383.75 AXIS_PTS_REF CA_EngSpd17Step4 MAX_GRAD 0.0 /end AXIS_DESCR
 /begin AXIS_DESCR COM_AXIS NO_INPUT_QUANTITY CM_kpa_0to256_1 8 0.0 255.99609375 AXIS_PTS_REF CA_MAP8Step3 MAX_GRAD 0.0 /end AXIS_DESCR
/end CHARACTERISTIC
/begin CHARACTERISTIC CT_IdlePropEngSpdLow_EX "cal comments" MAP 0x9F90 3D_Array_UB 0.0 CM_Percent_0to100 0.0 99.609375
 /begin AXIS_DESCR COM_AXIS NO_INPUT_QUANTITY CM_RPM_0to16384 17 0.0 16383.75 AXIS_PTS_REF CA_EngSpd17Step4 MAX_GRAD 0.0 /end AXIS_DESCR
 /begin AXIS_DESCR COM_AXIS NO_INPUT_QUANTITY CM_kpa_0to256_1 8 0.0 255.99609375 AXIS_PTS_REF CA_MAP8Step3 MAX_GRAD 0.0 /end AXIS_DESCR
/end CHARACTERISTIC
/begin CHARACTERISTIC CT_IdleIntGainEngSpdHigh_EX "cal comments" MAP 0xA01B 3D_Array_UB 0.0 CM_Mult0_to_2_ratio1 0.0 1.9921875
 /begin AXIS_DESCR FIX_AXIS NO_INPUT_QUANTITY CM_Equaloutput1 11 0.0 500.0 MAX_GRAD 0.0 /begin FIX_AXIS_PAR_LIST 0 50 100 150 200 250 300 350 400 450 500 /end FIX_AXIS_PAR_LIST /end AXIS_DESCR
 /begin AXIS_DESCR COM_AXIS NO_INPUT_QUANTITY CM_kpa_0to256_1 8 0.0 255.99609375 AXIS_PTS_REF CA_MAP8Step3 MAX_GRAD 0.0 /end AXIS_DESCR
/end CHARACTERISTIC
/begin CHARACTERISTIC CT_IdleIntGainEngSpdLow_EX "cal comments" MAP 0xA076 3D_Array_UB 0.0 CM_Mult0_to_2_ratio1 0.0 1.9921875
 /begin AXIS_DESCR FIX_AXIS NO_INPUT_QUANTITY CM_Equaloutput1 11 0.0 500.0 MAX_GRAD 0.0 /begin FIX_AXIS_PAR_LIST 0 50 100 150 200 250 300 350 400 450 500 /end FIX_AXIS_PAR_LIST /end AXIS_DESCR
 /begin AXIS_DESCR COM_AXIS NO_INPUT_QUANTITY CM_kpa_0to256_1 8 0.0 255.99609375 AXIS_PTS_REF CA_MAP8Step3 MAX_GRAD 0.0 /end AXIS_DESCR
/end CHARACTERISTIC
/begin CHARACTERISTIC C_IACV_n_BattOffsetMax "cal comments" VALUE 0x9BD8 Scalar_UW 0.0 udf_CM_18586 0.0 16383.75 /end CHARACTERISTIC
/begin CHARACTERISTIC C_IACV_n_BattRPMStep "cal comments" VALUE 0x9BDA Scalar_UW 0.0 udf_CM_18586 0.0 16383.75 /end CHARACTERISTIC
/begin CHARACTERISTIC C_IACV_r_StartUpFactor "cal comments" VALUE 0x9BDC Scalar_UW 0.0 CM_FactorRatio 0.0 0.9999847412109375 /end CHARACTERISTIC
/begin CHARACTERISTIC C_IACV_t_BattWaitTime "cal comments" VALUE 0x9BDE Scalar_UW 0.0 CM_Second_0to1024 0.0 1023.984375 /end CHARACTERISTIC
/begin CHARACTERISTIC C_IACV_t_DsrdSpdSUDecayTime "cal comments" VALUE 0x9BE0 Scalar_UW 0.0 CM_Second_0to1024 0.0 1023.984375 /end CHARACTERISTIC
/begin CHARACTERISTIC C_IACV_t_LowBattWaitTime "cal comments" VALUE 0x9BE2 Scalar_UW 0.0 CM_Second_0to1024 0.0 1023.984375 /end CHARACTERISTIC
/begin CHARACTERISTIC C_IACV_U_BattHigh "cal comments" VALUE 0x9BE4 Scalar_UW 0.0 CM_Volt_0to32_1 0.0 31.99900627136231 /end CHARACTERISTIC
/begin CHARACTERISTIC C_IACV_U_BattLow "cal comments" VALUE 0x9BE6 Scalar_UW 0.0 CM_Volt_0to32_1 0.0 31.99900627136231 /end CHARACTERISTIC
/begin CHARACTERISTIC CT_IACV_n_BaseDsrdSpd "cal comments" CURVE 0x9BEA 2D_Array_UW 0.0 CM_RPM_0to16384 0.0 16383.75
 /begin AXIS_DESCR FIX_AXIS NO_INPUT_QUANTITY CM_Equaloutput1 17 -28.0 164.0 MAX_GRAD 0.0 /begin FIX_AXIS_PAR_LIST -28 -16 -4 8 20 32 44 56 68 80 92 104 116 128 140 152 164 /end FIX_AXIS_PAR_LIST /end AXIS_DESCR
/end CHARACTERISTIC
/begin CHARACTERISTIC CT_IACV_pct_DsrdThrotFollow "cal comments" MAP 0x9C46 3D_Array_UB 0.0 CM_Percent_0to100 0.0 99.609375
 /begin AXIS_DESCR FIX_AXIS NO_INPUT_QUANTITY CM_Equaloutput1 9 0.0 50.0 MAX_GRAD 0.0 /begin FIX_AXIS_PAR_LIST 0 6.25 12.5 18.75 25 31.25 37.5 43.75 50 /end FIX_AXIS_PAR_LIST /end AXIS_DESCR
 /begin AXIS_DESCR FIX_AXIS NO_INPUT_QUANTITY CM_Equaloutput1 9 800.0 7200.0 MAX_GRAD 0.0 /begin FIX_AXIS_PAR_LIST 800 1600 2400 3200 4000 4800 5600 6400 7200 /end FIX_AXIS_PAR_LIST /end AXIS_DESCR
/end CHARACTERISTIC
/begin CHARACTERISTIC CT_IACV_r_TFDecayCoeff "cal comments" CURVE 0x9C9A 2D_Array_UB 0.0 CM_Mult_0to1 0.0 0.99609375
 /begin AXIS_DESCR FIX_AXIS NO_INPUT_QUANTITY CM_Equaloutput1 9 800.0 7200.0 MAX_GRAD 0.0 /begin FIX_AXIS_PAR_LIST 800 1600 2400 3200 4000 4800 5600 6400 7200 /end FIX_AXIS_PAR_LIST /end AXIS_DESCR
/end CHARACTERISTIC
/begin CHARACTERISTIC CT_IACV_r_TFRampUpCoeff "cal comments" CURVE 0x9CA5 2D_Array_UB 0.0 CM_Mult_0to1 0.0 0.99609375
 /begin AXIS_DESCR FIX_AXIS NO_INPUT_QUANTITY CM_Equaloutput1 9 0.0 50.0 MAX_GRAD 0.0 /begin FIX_AXIS_PAR_LIST 0 6.25 12.5 18.75 25 31.25 37.5 43.75 50 /end FIX_AXIS_PAR_LIST /end AXIS_DESCR
/end CHARACTERISTIC
/begin CHARACTERISTIC CT_IACV_r_ThrotFollowFactor "cal comments" CURVE 0x9CB0 2D_Array_UB 0.0 CM_Mult0_to_2_ratio 0.0 1.9921875
 /begin AXIS_DESCR FIX_AXIS NO_INPUT_QUANTITY CM_Equaloutput1 17 -28.0 164.0 MAX_GRAD 0.0 /begin FIX_AXIS_PAR_LIST -28 -16 -4 8 20 32 44 56 68 80 92 104 116 128 140 152 164 /end FIX_AXIS_PAR_LIST /end AXIS_DESCR
/end CHARACTERISTIC
/begin CHARACTERISTIC C_IACV_r_TF_NeutralDecayCoeff "cal comments" VALUE 0x9CC2 Scalar_UW 0.0 CM_FactorRatio 0.0 0.9999847412109375 /end CHARACTERISTIC
/begin CHARACTERISTIC C_IACVEnableEngSpdThresh "cal comments" VALUE 0x9C40 Scalar_UW 0.0 CM_RPM_0to16384 0.0 16383.75 /end CHARACTERISTIC
/begin CHARACTERISTIC C_IACVEnableTPSThresh "cal comments" VALUE 0x9C42 Scalar_UW 0.0 CM_Percent_0to200_2 0.0 199.9969024658203 /end CHARACTERISTIC
/begin CHARACTERISTIC C_IACVIntEnbEngSpdErrorThresh "cal comments" VALUE 0x9CC4 Scalar_UW 0.0 CM_RPM_0to16384 0.0 16383.75 /end CHARACTERISTIC
/begin CHARACTERISTIC C_IACVPropEngSpdHiDeadBand "cal comments" VALUE 0x9CCC Scalar_UW 0.0 CM_RPM_0to16384 0.0 16383.75 /end CHARACTERISTIC
/begin CHARACTERISTIC C_IACVPropEngSpdLoDeadBand "cal comments" VALUE 0x9CCE Scalar_UW 0.0 CM_RPM_0to16384 0.0 16383.75 /end CHARACTERISTIC
/begin CHARACTERISTIC C_IACV_pct_AiflowLrnBaseVal "cal comments" VALUE 0x9CD0 Scalar_UW 0.0 CM_Percent_0to200_2 0.0 199.9969024658203 /end CHARACTERISTIC
/begin CHARACTERISTIC C_IACV_pct_AirflowMaxIntgOffset "cal comments" VALUE 0x9CD2 Scalar_UW 0.0 CM_Percent_0to200_2 0.0 199.9969024658203 /end CHARACTERISTIC
/begin CHARACTERISTIC C_IACV_pct_AirflowSlowLrnOffset "cal comments" VALUE 0x9CD4 Scalar_UW 0.0 CM_Percent_0to200_2 0.0 199.9969024658203 /end CHARACTERISTIC
/begin CHARACTERISTIC C_IACV_r_AirflowRPMErrCoeff "cal comments" VALUE 0x9CD6 Scalar_UW 0.0 CM_FactorRatio 0.0 0.9999847412109375 /end CHARACTERISTIC
/begin CHARACTERISTIC C_IACV_r_CrankDecayFactor "cal comments" VALUE 0x9CD8 Scalar_UW 0.0 CM_FactorRatio 0.0 0.9999847412109375 /end CHARACTERISTIC
/begin CHARACTERISTIC C_IACV_r_AirflowICoolMaxFactor "cal comments" VALUE 0x9D7E Scalar_UW 0.0 CM_FactorRatio 0.0 0.9999847412109375 /end CHARACTERISTIC
/begin CHARACTERISTIC C_IACV_t_AirflowBattDelayTime "cal comments" VALUE 0x9CDA Scalar_UW 0.0 CM_Second_0to1024 0.0 1023.984375 /end CHARACTERISTIC
/begin CHARACTERISTIC C_IACV_t_CrankDecayTime "cal comments" VALUE 0x9CDC Scalar_UW 0.0 CM_Second_0to1024 0.0 1023.984375 /end CHARACTERISTIC
/begin CHARACTERISTIC C_IACV_t_MotorResetDly "cal comments" VALUE 0x9CE0 Scalar_UW 0.0 CM_Second_0to1024 0.0 1023.984375 /end CHARACTERISTIC
/begin CHARACTERISTIC C_IACVCLDelayAftStartUp "cal comments" VALUE 0x9CE2 Scalar_UW 0.0 CM_Second_0to1024 0.0 1023.984375 /end CHARACTERISTIC
/begin CHARACTERISTIC C_IACV_U_AirflowAltCrank "cal comments" VALUE 0x9CE4 Scalar_UW 0.0 CM_Volt_0to32_1 0.0 31.99900627136231 /end CHARACTERISTIC
/begin CHARACTERISTIC C_IACV_U_AirflowAltIncVolt "cal comments" VALUE 0x9CE6 Scalar_UW 0.0 CM_Volt_0to32_1 0.0 31.99900627136231 /end CHARACTERISTIC
/begin CHARACTERISTIC C_IACV_T_EngTmpWarm "cal comments" VALUE 0x9CDE Scalar_SW 0.0 CM_DegC_N256to256 -256.0 255.9921875 /end CHARACTERISTIC
/begin CHARACTERISTIC C_IACV_pct_AirflowSlowLrnLimit "cal comments" VALUE 0x9DE2 Scalar_UW 0.0 CM_Percent_0to200_2 0.0 199.9969024658203 /end CHARACTERISTIC
/begin CHARACTERISTIC CT_IACV_p_IntegralDeltaHiThrs "cal comments" CURVE 0x9CEA 2D_Array_UB 0.0 CM_kpa_8bit 0.0 127.5
 /begin AXIS_DESCR FIX_AXIS NO_INPUT_QUANTITY CM_Equaloutput1 7 -28.0 164.0 MAX_GRAD 0.0 /begin FIX_AXIS_PAR_LIST -28 4 36 68 100 132 164 /end FIX_AXIS_PAR_LIST /end AXIS_DESCR
/end CHARACTERISTIC
/begin CHARACTERISTIC CT_IACV_p_IntegralDeltaLowThrs "cal comments" CURVE 0x9DD4 2D_Array_UW 0.0 CM_kpa_0to256_1 0.0 255.99609375
 /begin AXIS_DESCR FIX_AXIS NO_INPUT_QUANTITY CM_Equaloutput1 7 -28.0 164.0 MAX_GRAD 0.0 /begin FIX_AXIS_PAR_LIST -28 4 36 68 100 132 164 /end FIX_AXIS_PAR_LIST /end AXIS_DESCR
/end CHARACTERISTIC
/begin CHARACTERISTIC CT_IACV_pct_AirflowBattVoltOff "cal comments" CURVE 0x9CF3 2D_Array_UB 0.0 CM_Percent_0to100 0.0 99.609375
 /begin AXIS_DESCR FIX_AXIS NO_INPUT_QUANTITY CM_Equaloutput1 17 6 18.8 MAX_GRAD 0.0
  /begin FIX_AXIS_PAR_LIST 6 6.8 7.6 8.4 9.2 10 10.8 11.6 12.4 13.2 14.0 14.8 15.6 16.4 17.2 18 18.8 /end FIX_AXIS_PAR_LIST
 /end AXIS_DESCR
/end CHARACTERISTIC
/begin CHARACTERISTIC CT_IACV_pct_AirflowCrankOffset "cal comments" CURVE 0x9D06 2D_Array_UB 0.0 CM_Percent_0to100 0.0 99.609375
 /begin AXIS_DESCR FIX_AXIS NO_INPUT_QUANTITY CM_Equaloutput1 17 -28.0 164.0 MAX_GRAD 0.0 /begin FIX_AXIS_PAR_LIST -28 -16 -4 8 20 32 44 56 68 80 92 104 116 128 140 152 164 /end FIX_AXIS_PAR_LIST /end AXIS_DESCR
/end CHARACTERISTIC
/begin CHARACTERISTIC CT_IACV_r_AirflowICoolOffsetFact "cal comments" CURVE 0x9D82 2D_Array_UB 0.0 CM_Mult_0to1_2 0.0 0.99609375
 /begin AXIS_DESCR FIX_AXIS NO_INPUT_QUANTITY CM_Equaloutput1 17 -28.0 164.0 MAX_GRAD 0.0 /begin FIX_AXIS_PAR_LIST -28 -16 -4 8 20 32 44 56 68 80 92 104 116 128 140 152 164 /end FIX_AXIS_PAR_LIST /end AXIS_DESCR
/end CHARACTERISTIC
/begin CHARACTERISTIC C_CLIACVEnableDelay "cal comments" VALUE 0x9C0C Scalar_UW 0.0 CM_Second_0to1024 0.0 1023.984375 /end CHARACTERISTIC
/begin CHARACTERISTIC CT_IACVFlowBaroMult "cal comments" CURVE 0x9D2C 2D_Array_UB 0.0 CM_Mult_0to8 0.0 7.96875
 /begin AXIS_DESCR FIX_AXIS NO_INPUT_QUANTITY CM_Equaloutput1 6 55.0 105.0 MAX_GRAD 0.0 /begin FIX_AXIS_PAR_LIST 55 65 75 85 95 105 /end FIX_AXIS_PAR_LIST /end AXIS_DESCR
/end CHARACTERISTIC
/begin CHARACTERISTIC CT_IACVAirflowColdOffset "cal comments" CURVE 0x9D19 2D_Array_UB 0.0 CM_Percent_0to100 0.0 99.609375
 /begin AXIS_DESCR FIX_AXIS NO_INPUT_QUANTITY CM_Equaloutput1 17 -28.0 164.0 MAX_GRAD 0.0 /begin FIX_AXIS_PAR_LIST -28 -16 -4 8 20 32 44 56 68 80 92 104 116 128 140 152 164 /end FIX_AXIS_PAR_LIST /end AXIS_DESCR
/end CHARACTERISTIC
/begin CHARACTERISTIC CT_IACVDerivEngSpdHigh "cal comments" CURVE 0x9D34 2D_Array_UB 0.0 CM_Percent_0to100 0.0 99.609375
 /begin AXIS_DESCR FIX_AXIS NO_INPUT_QUANTITY CM_Equaloutput1 17 0.0 128.0 MAX_GRAD 0.0 /begin FIX_AXIS_PAR_LIST 0 8 16 24 32 40 48 56 64 72 80 88 96 104 112 120 128 /end FIX_AXIS_PAR_LIST /end AXIS_DESCR
/end CHARACTERISTIC
/begin CHARACTERISTIC CT_IACVDerivEngSpdLow "cal comments" CURVE 0x9D47 2D_Array_UB 0.0 CM_Percent_0to100 0.0 99.609375
 /begin AXIS_DESCR FIX_AXIS NO_INPUT_QUANTITY CM_Equaloutput1 17 0.0 128.0 MAX_GRAD 0.0 /begin FIX_AXIS_PAR_LIST 0 8 16 24 32 40 48 56 64 72 80 88 96 104 112 120 128 /end FIX_AXIS_PAR_LIST /end AXIS_DESCR
/end CHARACTERISTIC
/begin CHARACTERISTIC CT_IACVDesireSpdStartup "cal comments" CURVE 0x9C10 2D_Array_UW 0.0 CM_RPM_0to16384 0.0 16383.75
 /begin AXIS_DESCR FIX_AXIS NO_INPUT_QUANTITY CM_Equaloutput1 17 -28.0 164.0 MAX_GRAD 0.0 /begin FIX_AXIS_PAR_LIST -28 -16 -4 8 20 32 44 56 68 80 92 104 116 128 140 152 164 /end FIX_AXIS_PAR_LIST /end AXIS_DESCR
/end CHARACTERISTIC
/begin CHARACTERISTIC CT_IACVIntGainEngSpdHigh "cal comments" CURVE 0x9D95 2D_Array_UB 0.0 CM_Mult0_to_2_ratio1 0.0 1.9921875
 /begin AXIS_DESCR FIX_AXIS NO_INPUT_QUANTITY CM_Equaloutput1 11 0.0 500.0 MAX_GRAD 0.0 /begin FIX_AXIS_PAR_LIST 0 50 100 150 200 250 300 350 400 450 500 /end FIX_AXIS_PAR_LIST /end AXIS_DESCR
/end CHARACTERISTIC
/begin CHARACTERISTIC CT_IACVIntGainEngSpdLow "cal comments" CURVE 0x9DA2 2D_Array_UB 0.0 CM_Mult0_to_2_ratio1 0.0 1.9921875
 /begin AXIS_DESCR FIX_AXIS NO_INPUT_QUANTITY CM_Equaloutput1 11 0.0 500.0 MAX_GRAD 0.0 /begin FIX_AXIS_PAR_LIST 0 50 100 150 200 250 300 350 400 450 500 /end FIX_AXIS_PAR_LIST /end AXIS_DESCR
/end CHARACTERISTIC
/begin CHARACTERISTIC CT_IACVPropEngSpdHigh "cal comments" CURVE 0x9D5A 2D_Array_UB 0.0 CM_Percent_0to100 0.0 99.609375
 /begin AXIS_DESCR COM_AXIS NO_INPUT_QUANTITY CM_RPM_0to16384 17 0.0 16383.75 AXIS_PTS_REF CA_EngSpd17Step4 MAX_GRAD 0.0 /end AXIS_DESCR
/end CHARACTERISTIC
/begin CHARACTERISTIC CT_IACVPropEngSpdLow "cal comments" CURVE 0x9D6D 2D_Array_UB 0.0 CM_Percent_0to100 0.0 99.609375
 /begin AXIS_DESCR COM_AXIS NO_INPUT_QUANTITY CM_RPM_0to16384 17 0.0 16383.75 AXIS_PTS_REF CA_EngSpd17Step4 MAX_GRAD 0.0 /end AXIS_DESCR
/end CHARACTERISTIC
/begin CHARACTERISTIC CT_IACV_t_CoolantDecayTime "cal comments" CURVE 0x9DB0 2D_Array_UW 0.0 CM_Second_0to1024 0.0 1023.984375
 /begin AXIS_DESCR FIX_AXIS NO_INPUT_QUANTITY CM_Equaloutput1 17 -28.0 164.0 MAX_GRAD 0.0 /begin FIX_AXIS_PAR_LIST -28 -16 -4 8 20 32 44 56 68 80 92 104 116 128 140 152 164 /end FIX_AXIS_PAR_LIST /end AXIS_DESCR
/end CHARACTERISTIC
/begin CHARACTERISTIC C_VIOS_IACV_PstnDft "cal comments" VALUE 0xB79F Scalar_UB 0.0 CM_Count4 0.0 255.0 /end CHARACTERISTIC
/begin CHARACTERISTIC C_VIOS_IACV_PstnMax "cal comments" VALUE 0xB7A0 Scalar_UB 0.0 CM_Count4 0.0 255.0 /end CHARACTERISTIC
/begin CHARACTERISTIC C_VIOS_IACV_PstnMin "cal comments" VALUE 0xB7A1 Scalar_UB 0.0 CM_Count4 0.0 255.0 /end CHARACTERISTIC
/begin CHARACTERISTIC C_IACVMotorParkDelay "cal comments" VALUE 0xB7A2 Scalar_UW 0.0 CM_Count_0to65535 0.0 65535.0 /end CHARACTERISTIC
/begin CHARACTERISTIC C_IACVStepMotorHiEn "cal comments" VALUE 0xB7A4 Scalar_UB 0.0 CM_Boolean6 0.0 255.0 /end CHARACTERISTIC
/begin CHARACTERISTIC C_IACVStepMotorDir "cal comments" VALUE 0xB7A5 Scalar_UB 0.0 CM_Boolean6 0.0 255.0 /end CHARACTERISTIC
/begin CHARACTERISTIC C_IACVLoopCounter "cal comments" VALUE 0xB7A6 Scalar_UB 0.0 CM_Count1 0.0 255.0 /end CHARACTERISTIC
/begin CHARACTERISTIC C_IACVMoveBatVoltMaxLimit "cal comments" VALUE 0xB772 Scalar_UW 0.0 CM_Volt_0to32_1 0.0 31.99900627136231 /end CHARACTERISTIC
/begin CHARACTERISTIC C_IACVMoveBatVoltMinLimit "cal comments" VALUE 0xB774 Scalar_UW 0.0 CM_Volt_0to32_1 0.0 31.99900627136231 /end CHARACTERISTIC
/begin CHARACTERISTIC C_IACVMotorDirChangeDelay "cal comments" VALUE 0xB778 Scalar_UB 0.0 CM_Count4 0.0 255.0 /end CHARACTERISTIC
/begin CHARACTERISTIC C_IACVMotorStartDelay "cal comments" VALUE 0xB776 Scalar_UB 0.0 CM_Count4 0.0 255.0 /end CHARACTERISTIC
/begin CHARACTERISTIC C_IACVMotorStartDelaySteps "cal comments" VALUE 0xB777 Scalar_UB 0.0 CM_Count4 0.0 255.0 /end CHARACTERISTIC
/begin CHARACTERISTIC CT_IACVDsrdMtrPstn "cal comments" CURVE 0xB77B 2D_Array_UB 0.0 CM_Count4 0.0 255.0
 /begin AXIS_DESCR FIX_AXIS NO_INPUT_QUANTITY CM_Equaloutput1 17 0.0 100.0 MAX_GRAD 0.0
  /begin FIX_AXIS_PAR_LIST 0.0 6.25 12.5 18.75 25.0 31.25 37.5 43.75 50.0 56.25 62.5 68.75 75.0 81.25 87.5 93.75 100.0 /end FIX_AXIS_PAR_LIST
 /end AXIS_DESCR
/end CHARACTERISTIC
/begin CHARACTERISTIC CT_IACV_ParkPstn "cal comments" CURVE 0xB78E 2D_Array_UB 0.0 CM_Count4 0.0 255.0
 /begin AXIS_DESCR FIX_AXIS NO_INPUT_QUANTITY CM_Equaloutput1 17 -28.0 164.0 MAX_GRAD 0.0 /begin FIX_AXIS_PAR_LIST -28 -16 -4 8 20 32 44 56 68 80 92 104 116 128 140 152 164 /end FIX_AXIS_PAR_LIST /end AXIS_DESCR
/end CHARACTERISTIC
/begin CHARACTERISTIC C_IACV_ForChokeEnable "cal comments" VALUE 0x9C32 Scalar_UB 0.0 CM_Boolean6 0.0 255.0 /end CHARACTERISTIC
/begin CHARACTERISTIC C_IACVMotorResetEachPowerDown "cal comments" VALUE 0x9C3C Scalar_UB 0.0 CM_Boolean1 0.0 1.0 /end CHARACTERISTIC
/begin CHARACTERISTIC C_IACVMotorRstEn "cal comments" VALUE 0x9C3E Scalar_UB 0.0 CM_Boolean1 0.0 1.0 /end CHARACTERISTIC
/begin CHARACTERISTIC C_IACVMotorResetEngSpdThresh "cal comments" VALUE 0x9C36 Scalar_UW 0.0 CM_RPM_0to16384 0.0 16383.75 /end CHARACTERISTIC
/begin CHARACTERISTIC C_IACVMotorResetIGNOffDelay "cal comments" VALUE 0x9C3A Scalar_UW 0.0 CM_Second_0to512 0.0 511.9921875 /end CHARACTERISTIC
/begin CHARACTERISTIC C_IACVMotorResetMaxPintleSeatStep "cal comments" VALUE 0x9C3D Scalar_UB 0.0 CM_Count4 0.0 255.0 /end CHARACTERISTIC
/begin CHARACTERISTIC C_IACVMotorResetTPSThresh "cal comments" VALUE 0x9C38 Scalar_UW 0.0 CM_Percent_0to200_2 0.0 199.9969024658203 /end CHARACTERISTIC
/begin CHARACTERISTIC C_IACVPosLostCoolTempThresh "cal comments" VALUE 0x9C34 Scalar_SW 0.0 CM_DegC_N256to256 -256.0 255.9921875 /end CHARACTERISTIC
/begin CHARACTERISTIC CT_BSTPPropCntrHigh "cal comments" CURVE 0x8F0E 2D_Array_UB 0.0 CM_Percent_0to100 0.0 99.609375
 /begin AXIS_DESCR COM_AXIS NO_INPUT_QUANTITY CM_kpa_0to256_1 9 0.0 255.99609375 AXIS_PTS_REF CA_MAP9Step2 MAX_GRAD 0.0 /end AXIS_DESCR
/end CHARACTERISTIC
/begin CHARACTERISTIC CT_BSTPPropCntrLow "cal comments" CURVE 0x8F21 2D_Array_UB 0.0 CM_Percent_0to100 0.0 99.609375
 /begin AXIS_DESCR COM_AXIS NO_INPUT_QUANTITY CM_kpa_0to256_1 9 0.0 255.99609375 AXIS_PTS_REF CA_MAP9Step2 MAX_GRAD 0.0 /end AXIS_DESCR
/end CHARACTERISTIC
/begin CHARACTERISTIC CT_BSTPIntGainHigh "cal comments" CURVE 0x8F34 2D_Array_UB 0.0 CM_Mult0_to_2_ratio 0.0 1.9921875
 /begin AXIS_DESCR COM_AXIS NO_INPUT_QUANTITY CM_kpa_0to256_1 9 0.0 255.99609375 AXIS_PTS_REF CA_MAP9Step2 MAX_GRAD 0.0 /end AXIS_DESCR
/end CHARACTERISTIC
/begin CHARACTERISTIC CT_BSTPIntGainLow "cal comments" CURVE 0x8F41 2D_Array_UB 0.0 CM_Mult0_to_2_ratio 0.0 1.9921875
 /begin AXIS_DESCR COM_AXIS NO_INPUT_QUANTITY CM_kpa_0to256_1 9 0.0 255.99609375 AXIS_PTS_REF CA_MAP9Step2 MAX_GRAD 0.0 /end AXIS_DESCR
/end CHARACTERISTIC
/begin CHARACTERISTIC C_BSTPClosedLoopOffset "cal comments" VALUE 0x8F60 Scalar_UW 0.0 CM_kpa_0to256_1 0.0 255.99609375 /end CHARACTERISTIC
/begin CHARACTERISTIC C_BSTPCLControlRange "cal comments" VALUE 0x8F62 Scalar_UW 0.0 CM_kpa_0to256_1 0.0 255.99609375 /end CHARACTERISTIC
/begin CHARACTERISTIC C_BSTPIntEnbErrorThresh "cal comments" VALUE 0x8F06 Scalar_UW 0.0 CM_kpa_0to256_1 0.0 255.99609375 /end CHARACTERISTIC
/begin CHARACTERISTIC C_BSTPPropHiDeadBand "cal comments" VALUE 0x8F08 Scalar_UW 0.0 CM_kpa_0to256_1 0.0 255.99609375 /end CHARACTERISTIC
/begin CHARACTERISTIC C_BSTPPropLoDeadBand "cal comments" VALUE 0x8F0A Scalar_UW 0.0 CM_kpa_0to256_1 0.0 255.99609375 /end CHARACTERISTIC
/begin CHARACTERISTIC C_BSTPControlEnable "cal comments" VALUE 0x8F04 Scalar_UB 0.0 CM_Count1 0.0 255.0 /end CHARACTERISTIC
/begin CHARACTERISTIC C_CLBSTPEnableDelay "cal comments" VALUE 0x8F02 Scalar_UW 0.0 CM_Second_0to1024 0.0 1023.984375 /end CHARACTERISTIC
/begin CHARACTERISTIC CT_BSTPDsrd "cal comments" MAP 0x8F67 3D_Array_UB 0.0 CM_kpa_0_256_8bit 0.0 255
 /begin AXIS_DESCR COM_AXIS NO_INPUT_QUANTITY udf_CM_18705 21 0.0 511.9921875 AXIS_PTS_REF CA_GramStep21 MAX_GRAD 0.0 /end AXIS_DESCR
 /begin AXIS_DESCR COM_AXIS NO_INPUT_QUANTITY CM_RPM_0to16384 17 0.0 16383.75 AXIS_PTS_REF CA_EngSpd17Step1 MAX_GRAD 0.0 /end AXIS_DESCR
/end CHARACTERISTIC
/begin CHARACTERISTIC CT_BSTPDsrdMaxLimit "cal comments" MAP 0x90CF 3D_Array_UB 0.0 CM_kpa_0_256_8bit 0.0 255
 /begin AXIS_DESCR FIX_AXIS NO_INPUT_QUANTITY CM_Equaloutput1 9 -28.0 36.0 MAX_GRAD 0.0 /begin FIX_AXIS_PAR_LIST -28 -20 -12 -4 4 12 20 28 36 /end FIX_AXIS_PAR_LIST /end AXIS_DESCR
 /begin AXIS_DESCR COM_AXIS NO_INPUT_QUANTITY CM_RPM_0to16384 17 0.0 16383.75 AXIS_PTS_REF CA_EngSpd17Step1 MAX_GRAD 0.0 /end AXIS_DESCR
/end CHARACTERISTIC
/begin CHARACTERISTIC CT_BSTPWithoutControl "cal comments" CURVE 0x8F4E 2D_Array_UB 0 CM_kpa_0_256_8bit 0.0 255
 /begin AXIS_DESCR COM_AXIS NO_INPUT_QUANTITY CM_RPM_0to16384 17 0.0 16383.75 AXIS_PTS_REF CA_EngSpd17Step1 MAX_GRAD 0.0 /end AXIS_DESCR
/end CHARACTERISTIC
/begin CHARACTERISTIC CT_BSTPFactorIATCorr "cal comments" CURVE 0x916A 2D_Array_UB 0.0 CM_Mult0_to_2_ratio 0.0 1.9921875
 /begin AXIS_DESCR FIX_AXIS NO_INPUT_QUANTITY CM_Equaloutput1 9 -28.0 36.0 MAX_GRAD 0.0 /begin FIX_AXIS_PAR_LIST -28 -20 -12 -4 4 12 20 28 36 /end FIX_AXIS_PAR_LIST /end AXIS_DESCR
/end CHARACTERISTIC
/begin CHARACTERISTIC C_IgnCoil_Prot_Current "cal comments" CURVE 0x8043 2D_Array_UB 0.0 CM_Count1 0.0 255.0
 /begin AXIS_DESCR FIX_AXIS NO_INPUT_QUANTITY CM_EOI 4 0.0 4.0 MAX_GRAD 0.0 /begin FIX_AXIS_PAR_LIST 0 1 2 3 /end FIX_AXIS_PAR_LIST /end AXIS_DESCR
/end CHARACTERISTIC
/begin CHARACTERISTIC C_IgnCoil_STG_Threhold "cal comments" CURVE 0x8047 2D_Array_UB 0.0 CM_Count1 0.0 255.0
 /begin AXIS_DESCR FIX_AXIS NO_INPUT_QUANTITY CM_EOI 4 0.0 4.0 MAX_GRAD 0.0 /begin FIX_AXIS_PAR_LIST 0 1 2 3 /end FIX_AXIS_PAR_LIST /end AXIS_DESCR
/end CHARACTERISTIC
/begin CHARACTERISTIC C_InjectorType "cal comments" CURVE 0x804B 2D_Array_UB 0.0 CM_Count1 0.0 255.0
 /begin AXIS_DESCR FIX_AXIS NO_INPUT_QUANTITY CM_EOI 4 0.0 4.0 MAX_GRAD 0.0 /begin FIX_AXIS_PAR_LIST 0 1 2 3 /end FIX_AXIS_PAR_LIST /end AXIS_DESCR
/end CHARACTERISTIC
/begin CHARACTERISTIC C_IGNOffDelayTime "cal comments" VALUE 0xB670 Scalar_UW 0.0 CM_Second_0to512 0.0 511.9921875 /end CHARACTERISTIC
/begin CHARACTERISTIC C_IGNOnDelay "cal comments" VALUE 0xB6DC Scalar_UW 0.0 CM_Second_0to512 0.0 511.9921875 /end CHARACTERISTIC
/begin CHARACTERISTIC C_IGNOnDelayEngSpdThreshHi "cal comments" VALUE 0xB6E0 Scalar_UW 0.0 CM_RPM_0to16384 0.0 16383.75 /end CHARACTERISTIC
/begin CHARACTERISTIC C_IGNOnDelayEngSpdThreshLo "cal comments" VALUE 0xB6DE Scalar_UW 0.0 CM_RPM_0to16384 0.0 16383.75 /end CHARACTERISTIC
/begin CHARACTERISTIC C_IGNOnVoltThreshHi "cal comments" VALUE 0xB66C Scalar_UW 0.0 CM_Volt_0to32_1 0.0 31.99900627136231 /end CHARACTERISTIC
/begin CHARACTERISTIC C_IGNOnVoltThreshLo "cal comments" VALUE 0xB66E Scalar_UW 0.0 CM_Volt_0to32_1 0.0 31.99900627136231 /end CHARACTERISTIC
/begin CHARACTERISTIC C_IGNVoltFiltCoef "cal comments" VALUE 0xB672 Scalar_UW 0.0 CM_FiltCoef 0.0 0.9999847412109375 /end CHARACTERISTIC
/begin CHARACTERISTIC C_InjectorFlow "cal comments" VALUE 0x91CA Scalar_UW 0.0 CM_GramPerSecond 0.0 15.999755859375 /end CHARACTERISTIC
/begin CHARACTERISTIC C_ValveFlow "cal comments" VALUE 0x91CC Scalar_UW 0.0 CM_GramPerSecond 0.0 15.999755859375 /end CHARACTERISTIC
/begin CHARACTERISTIC C_IntakeAirTempDefault "cal comments" VALUE 0xB6D4 Scalar_SW 0.0 CM_DegC_N256to256 -256.0 255.9921875 /end CHARACTERISTIC
/begin CHARACTERISTIC C_IntakeAirTempFiltCoef "cal comments" VALUE 0xB660 Scalar_UW 0.0 CM_FiltCoef 0.0 0.9999847412109375 /end CHARACTERISTIC
/begin CHARACTERISTIC C_MAPCIDEnable "cal comments" VALUE 0xB214 Scalar_UB 0.0 CM_Boolean4 0.0 1.0 /end CHARACTERISTIC
/begin CHARACTERISTIC C_MAPCIDEngSpdErrorThresh "cal comments" VALUE 0xB694 Scalar_SW 0.0 CM_RPM_n8192to8192 -8192.0 8191.75 /end CHARACTERISTIC
/begin CHARACTERISTIC C_MAPCIDEngSpdThreshHi "cal comments" VALUE 0xB690 Scalar_UW 0.0 CM_RPM_0to16384 0.0 16383.75 /end CHARACTERISTIC
/begin CHARACTERISTIC C_MAPCIDEngSpdThreshLo "cal comments" VALUE 0xB692 Scalar_UW 0.0 CM_RPM_0to16384 0.0 16383.75 /end CHARACTERISTIC
/begin CHARACTERISTIC C_MAPCIDMAPFiltCoef "cal comments" VALUE 0xB69C Scalar_UW 0.0 CM_FiltCoef 0.0 0.9999847412109375 /end CHARACTERISTIC
/begin CHARACTERISTIC C_MAPCIDMAPThresh "cal comments" VALUE 0xB69A Scalar_UW 0.0 CM_kpa_0to256_1 0.0 255.99609375 /end CHARACTERISTIC
/begin CHARACTERISTIC C_MAPCIDTPSDeltaThresh "cal comments" VALUE 0xB53A Scalar_SW 0.0 CM_Percent_N200to200 -199.9999847412109 199.9938812255859 /end CHARACTERISTIC
/begin CHARACTERISTIC C_MAPFiltCoef "cal comments" VALUE 0xB6BA Scalar_UW 0.0 CM_FiltCoef 0.0 0.9999847412109375 /end CHARACTERISTIC
/begin CHARACTERISTIC C_MAPMaxLimit "cal comments" VALUE 0xB69E Scalar_UW 0.0 CM_kpa_0to256_1 0.0 255.99609375 /end CHARACTERISTIC
/begin CHARACTERISTIC C_MAPMinLimit "cal comments" VALUE 0xB6A0 Scalar_UW 0.0 CM_kpa_0to256_1 0.0 255.99609375 /end CHARACTERISTIC
/begin CHARACTERISTIC C_MAPReadingAngleMaxLimit "cal comments" VALUE 0xB6CC Scalar_UW 0.0 CM_CrankAngle_0to1024 0.0 1023.984375 /end CHARACTERISTIC
/begin CHARACTERISTIC C_MAPReadingAngleMinLimit "cal comments" VALUE 0xB6CE Scalar_UW 0.0 CM_CrankAngle_0to1024 0.0 1023.984375 /end CHARACTERISTIC
/begin CHARACTERISTIC C_MAPSignalConvIntercept "cal comments" VALUE 0xB676 Scalar_SW 0.0 CM_Ratio_n128to128 -128.0 127.99609375 /end CHARACTERISTIC
/begin CHARACTERISTIC C_MAPSignalConvSlope "cal comments" VALUE 0xB674 Scalar_UW 0.0 CM_kpa_0to512_1 0.0 511.9921875 /end CHARACTERISTIC
/begin CHARACTERISTIC C_FPSignalConvIntercept "cal comments" VALUE 0xC196 Scalar_SW 0.0 CM_Ratio_n128to128 -128.0 127.99609375 /end CHARACTERISTIC
/begin CHARACTERISTIC C_FPSignalConvSlope "cal comments" VALUE 0xC194 Scalar_UW 0.0 CM_kpa_0to512_1 0.0 511.9921875 /end CHARACTERISTIC
/begin CHARACTERISTIC CT_FPFiltCoef "cal comments" CURVE 0xC19C 2D_Array_UW 0.0 CM_FiltCoef 0.0 0.9999847412109375
 /begin AXIS_DESCR COM_AXIS NO_INPUT_QUANTITY CM_kpa_0to256_1 8 0.0 255.99609375 AXIS_PTS_REF CA_MAP8Step3 MAX_GRAD 0.0 /end AXIS_DESCR
/end CHARACTERISTIC
/begin CHARACTERISTIC C_FPRelativeSensorUsed "cal comments" VALUE 0xC198 Scalar_UB 0.0 CM_Boolean4 0.0 1.0 /end CHARACTERISTIC
/begin CHARACTERISTIC C_BSTPSignalConvIntercept "cal comments" VALUE 0xBF34 Scalar_SW 0.0 CM_Ratio_n128to128 -128.0 127.99609375 /end CHARACTERISTIC
/begin CHARACTERISTIC C_BSTPSignalConvSlope "cal comments" VALUE 0xBF32 Scalar_UW 0.0 CM_kpa_0to512_1 0.0 511.9921875 /end CHARACTERISTIC
/begin CHARACTERISTIC C_BSTPFiltCoef "cal comments" VALUE 0xBF36 Scalar_UW 0.0 CM_FiltCoef 0.0 0.9999847412109375 /end CHARACTERISTIC
/begin CHARACTERISTIC CT_BSTCDutyCycleBase "cal comments" MAP 0xBF5C 3D_Array_UW 0.0 CM_Percent_0to200_2 0.0 199.9969024658203
 /begin AXIS_DESCR COM_AXIS NO_INPUT_QUANTITY CM_kpa_0to256_1 22 0.0 255.99609375 AXIS_PTS_REF CA_MAP22Step1 MAX_GRAD 0.0 /end AXIS_DESCR
 /begin AXIS_DESCR COM_AXIS NO_INPUT_QUANTITY CM_kpa_0to256_1 15 0.0 255.99609375 AXIS_PTS_REF CA_MAP15Step1 MAX_GRAD 0.0 /end AXIS_DESCR
/end CHARACTERISTIC
/begin CHARACTERISTIC C_BSTCPWMFrequency "cal comments" VALUE 0xC15A Scalar_UW 0.0 CM_Hz_0to16384 0.0 16383.75 /end CHARACTERISTIC
/begin CHARACTERISTIC C_WPSignalConvIntercept "cal comments" VALUE 0xC184 Scalar_SW 0.0 CM_Ratio_n8to8 -8.0 7.999755859375 /end CHARACTERISTIC
/begin CHARACTERISTIC C_WPSignalConvSlope "cal comments" VALUE 0xC182 Scalar_UW 0.0 CM_mpa_0to16_1 0.0 15.999755859375 /end CHARACTERISTIC
/begin CHARACTERISTIC C_WPP_AMP_RESCALE "cal comments" VALUE 0xC188 Scalar_UW 0.0 CM_amp_0to512_1 0.0 511.9921875 /end CHARACTERISTIC
/begin CHARACTERISTIC C_WPPCurrThresh "cal comments" VALUE 0xC18A Scalar_UW 0.0 CM_amp_0to512_1 0.0 511.9921875 /end CHARACTERISTIC
/begin CHARACTERISTIC C_WPPCurrHyst "cal comments" VALUE 0xC18C Scalar_UW 0.0 CM_amp_0to512_1 0.0 511.9921875 /end CHARACTERISTIC
/begin CHARACTERISTIC C_WPP_NoWaterTime "cal comments" VALUE 0xC192 Scalar_UW 0.0 CM_Seconds_1 0.0 2047.96875 /end CHARACTERISTIC
/begin CHARACTERISTIC C_WPP_WakeupTime "cal comments" VALUE 0xC190 Scalar_UW 0.0 CM_Seconds_1 0.0 2047.96875 /end CHARACTERISTIC
/begin CHARACTERISTIC C_WPPCurrFiltCoef "cal comments" VALUE 0xC18E Scalar_UW 0.0 CM_FiltCoef 0.0 0.9999847412109375 /end CHARACTERISTIC
/begin CHARACTERISTIC C_MaxBatteryVoltForO2Heater "cal comments" VALUE 0x919A Scalar_UW 0.0 CM_Volt_0to32_1 0.0 31.99900627136231 /end CHARACTERISTIC
/begin CHARACTERISTIC C_MinRefPeriodUpdtMinEngSpd "cal comments" VALUE 0xB684 Scalar_UW 0.0 CM_Second_0to512 0.0 511.9921875 /end CHARACTERISTIC
/begin CHARACTERISTIC C_NVMForceReset "cal comments" VALUE 0x9173 Scalar_UB 0.0 CM_Boolean2 0.0 1.0 /end CHARACTERISTIC
/begin CHARACTERISTIC C_O2ErrorMaxLimit "cal comments" VALUE 0x9998 Scalar_UW 0.0 CM_mVolt_1 0.0 1023.96875 /end CHARACTERISTIC
/begin CHARACTERISTIC C_O2FiltVoltInitValue "cal comments" VALUE 0x9908 Scalar_UW 0.0 CM_mVolt_1 0.0 1023.96875 /end CHARACTERISTIC
/begin CHARACTERISTIC C_O2HeaterAccFuelMassUpdateTime "cal comments" VALUE 0x919E Scalar_UW 0.0 CM_Second_0to4096 0.0 4095.9375 /end CHARACTERISTIC
/begin CHARACTERISTIC C_O2HeaterCoolantTempThresh "cal comments" VALUE 0x9174 Scalar_SW 0.0 CM_DegC_N256to256 -256.0 255.9921875 /end CHARACTERISTIC
/begin CHARACTERISTIC C_O2HeaterDCNormFactor "cal comments" VALUE 0xB248 Scalar_UB 0.0 CM_Mult0_to_2_ratio 0.0 1.9921875 /end CHARACTERISTIC
/begin CHARACTERISTIC C_O2HeaterDCReducedEngSpdThrsh "cal comments" VALUE 0xB24A Scalar_UW 0.0 CM_RPM_0to16384 0.0 16383.75 /end CHARACTERISTIC
/begin CHARACTERISTIC C_O2HeaterDCReducedFactor "cal comments" VALUE 0xB249 Scalar_UB 0.0 CM_Mult0_to_2_ratio 0.0 1.9921875 /end CHARACTERISTIC
/begin CHARACTERISTIC C_O2HeaterDCReducedMAPThrsh "cal comments" VALUE 0xB24C Scalar_UW 0.0 CM_kpa_0to256_1 0.0 255.99609375 /end CHARACTERISTIC
/begin CHARACTERISTIC C_O2HeaterEnbKeyOnDelay "cal comments" VALUE 0x91A0 Scalar_UW 0.0 CM_Second_0to4096 0.0 4095.9375 /end CHARACTERISTIC
/begin CHARACTERISTIC C_O2HeaterPWMFrequency "cal comments" VALUE 0xB246 Scalar_UW 0.0 CM_Hz_0to16384 0.0 16383.75 /end CHARACTERISTIC
/begin CHARACTERISTIC C_O2ReadyResetTimeThresh "cal comments" VALUE 0x98F4 Scalar_UW 0.0 CM_Second_0to1024 0.0 1023.984375 /end CHARACTERISTIC
/begin CHARACTERISTIC C_O2ReadyThresh "cal comments" VALUE 0x98F2 Scalar_UW 0.0 CM_mVolt_1 0.0 1023.96875 /end CHARACTERISTIC
/begin CHARACTERISTIC C_O2ReadyTimeThresh "cal comments" VALUE 0x98F6 Scalar_UW 0.0 CM_Second_0to1024 0.0 1023.984375 /end CHARACTERISTIC
/begin CHARACTERISTIC C_PEIdleWithAFROLEngSpdThresh "cal comments" VALUE 0x9B6E Scalar_UW 0.0 CM_RPM_0to16384 0.0 16383.75 /end CHARACTERISTIC
/begin CHARACTERISTIC C_PowerdownDelayTime "cal comments" VALUE 0xB668 Scalar_UW 0.0 CM_Second_0to512 0.0 511.9921875 /end CHARACTERISTIC
/begin CHARACTERISTIC C_PowerEnrichDsblTPSThrshHyst "cal comments" VALUE 0x9B6C Scalar_UW 0.0 CM_Percent_0to200_2 0.0 199.9969024658203 /end CHARACTERISTIC
/begin CHARACTERISTIC C_PrimePulseForceEnb "cal comments" VALUE 0x9732 Scalar_UB 0.0 CM_Boolean1 0.0 1.0 /end CHARACTERISTIC
/begin CHARACTERISTIC C_PrimeToSequentialFuelDelay "cal comments" VALUE 0x91CE Scalar_UB 0.0 CM_Count1 0.0 255.0 /end CHARACTERISTIC
/begin CHARACTERISTIC C_ReferenceBaro "cal comments" VALUE 0xB5BE Scalar_UW 0.0 CM_kpa_0to256_1 0.0 255.99609375 /end CHARACTERISTIC
/begin CHARACTERISTIC C_RunToCrankEngSpdThresh "cal comments" VALUE 0xB65E Scalar_UW 0.0 CM_RPM_0to16384 0.0 16383.75 /end CHARACTERISTIC
/begin CHARACTERISTIC C_SMTR_LowActive "cal comments" VALUE 0xA0D2 Scalar_UB 0.0 CM_Boolean6 0.0 255.0 /end CHARACTERISTIC
/begin CHARACTERISTIC C_SMTR_FaultStart_Forbid "cal comments" VALUE 0xA0D3 Scalar_UB 0.0 CM_Boolean6 0.0 255.0 /end CHARACTERISTIC
/begin CHARACTERISTIC C_SMTR_IGN_Start "cal comments" VALUE 0xA0D4 Scalar_UB 0.0 CM_Boolean6 0.0 255.0 /end CHARACTERISTIC
/begin CHARACTERISTIC C_SMTR_t_Duration "cal comments" VALUE 0xA0D6 Scalar_UW 0.0 CM_Seconds_1 0.0 2047.96875 /end CHARACTERISTIC
/begin CHARACTERISTIC C_SMTR_t_Interval "cal comments" VALUE 0xA0D8 Scalar_UW 0.0 CM_Seconds_1 0.0 2047.96875 /end CHARACTERISTIC
/begin CHARACTERISTIC C_SMTR_t_Button_Delay "cal comments" VALUE 0xA0DC Scalar_UW 0.0 CM_Seconds_1 0.0 2047.96875 /end CHARACTERISTIC
/begin CHARACTERISTIC C_SMTR_c_Attempt "cal comments" VALUE 0xA0DA Scalar_UB 0.0 CM_Count3 0.0 255.0 /end CHARACTERISTIC
/begin CHARACTERISTIC C_SMTR_DutyCycle "cal comments" VALUE 0xA0DE Scalar_UW 0.0 CM_Percent_0to200_2 0.0 199.9969024658203 /end CHARACTERISTIC
/begin CHARACTERISTIC C_FUEL_STP_En "cal comments" VALUE 0xC168 Scalar_UB 0.0 CM_Boolean6 0.0 255.0 /end CHARACTERISTIC
/begin CHARACTERISTIC C_FUEL_STP_LowActive "cal comments" VALUE 0xC169 Scalar_UB 0.0 CM_Boolean6 0.0 255.0 /end CHARACTERISTIC
/begin CHARACTERISTIC CT_ETCMSprTPSHigh "cal comments" CURVE 0xA0FA 2D_Array_UB 0.0 CM_Percent_0to100 0.0 99.609375
 /begin AXIS_DESCR COM_AXIS NO_INPUT_QUANTITY CM_Percent_0to200_2 11 0.0 199.9969024658203 AXIS_PTS_REF CA_TPS11Step MAX_GRAD 0.0 /end AXIS_DESCR
/end CHARACTERISTIC
/begin CHARACTERISTIC CT_ETCMSprTPSLow "cal comments" CURVE 0xA107 2D_Array_UB 0.0 CM_Percent_0to100 0.0 99.609375
 /begin AXIS_DESCR COM_AXIS NO_INPUT_QUANTITY CM_Percent_0to200_2 11 0.0 199.9969024658203 AXIS_PTS_REF CA_TPS11Step MAX_GRAD 0.0 /end AXIS_DESCR
/end CHARACTERISTIC
/begin CHARACTERISTIC CT_ETCMDerivTPSHigh "cal comments" CURVE 0xA114 2D_Array_UB 0.0 CM_Percent_0to100 0.0 99.609375
 /begin AXIS_DESCR COM_AXIS NO_INPUT_QUANTITY CM_Percent_0to200_2 11 0.0 199.9969024658203 AXIS_PTS_REF CA_TPS11Step MAX_GRAD 0.0 /end AXIS_DESCR
/end CHARACTERISTIC
/begin CHARACTERISTIC CT_ETCMDerivTPSLow "cal comments" CURVE 0xA121 2D_Array_UB 0.0 CM_Percent_0to100 0.0 99.609375
 /begin AXIS_DESCR COM_AXIS NO_INPUT_QUANTITY CM_Percent_0to200_2 11 0.0 199.9969024658203 AXIS_PTS_REF CA_TPS11Step MAX_GRAD 0.0 /end AXIS_DESCR
/end CHARACTERISTIC
/begin CHARACTERISTIC CT_ETCMPropTPSHigh "cal comments" CURVE 0xA12E 2D_Array_UB 0.0 CM_Percent_0to100 0.0 99.609375
 /begin AXIS_DESCR COM_AXIS NO_INPUT_QUANTITY CM_Percent_0to200_2 11 0.0 199.9969024658203 AXIS_PTS_REF CA_TPS11Step MAX_GRAD 0.0 /end AXIS_DESCR
/end CHARACTERISTIC
/begin CHARACTERISTIC CT_ETCMPropTPSLow "cal comments" CURVE 0xA13B 2D_Array_UB 0.0 CM_Percent_0to100 0.0 99.609375
 /begin AXIS_DESCR COM_AXIS NO_INPUT_QUANTITY CM_Percent_0to200_2 11 0.0 199.9969024658203 AXIS_PTS_REF CA_TPS11Step MAX_GRAD 0.0 /end AXIS_DESCR
/end CHARACTERISTIC
/begin CHARACTERISTIC CT_ETCMIntGainTPSHigh "cal comments" CURVE 0xA148 2D_Array_UB 0.0 CM_Mult0_to_2_ratio1 0.0 1.9921875
 /begin AXIS_DESCR COM_AXIS NO_INPUT_QUANTITY CM_Percent_0to200_2 11 0.0 199.9969024658203 AXIS_PTS_REF CA_TPS11Step MAX_GRAD 0.0 /end AXIS_DESCR
/end CHARACTERISTIC
/begin CHARACTERISTIC CT_ETCMIntGainTPSLow "cal comments" CURVE 0xA155 2D_Array_UB 0.0 CM_Mult0_to_2_ratio1 0.0 1.9921875
 /begin AXIS_DESCR COM_AXIS NO_INPUT_QUANTITY CM_Percent_0to200_2 11 0.0 199.9969024658203 AXIS_PTS_REF CA_TPS11Step MAX_GRAD 0.0 /end AXIS_DESCR
/end CHARACTERISTIC
/begin CHARACTERISTIC CT_ETCM_LTermOpenMax "cal comments" CURVE 0xA162 2D_Array_UB 0.0 CM_Percent_0to200_3 0.0 199.21875
 /begin AXIS_DESCR FIX_AXIS NO_INPUT_QUANTITY CM_Equaloutput1 9 6.400000095367432 19.20000076293945 MAX_GRAD 0.0 /begin FIX_AXIS_PAR_LIST 6.4 8 9.6 11.2 12.8 14.4 16 17.6 19.2 /end FIX_AXIS_PAR_LIST /end AXIS_DESCR
/end CHARACTERISTIC
/begin CHARACTERISTIC CT_ETCM_LTermCloseMax "cal comments" CURVE 0xA16D 2D_Array_UB 0.0 CM_Percent_0to200_3 0.0 199.21875
 /begin AXIS_DESCR FIX_AXIS NO_INPUT_QUANTITY CM_Equaloutput1 9 6.400000095367432 19.20000076293945 MAX_GRAD 0.0 /begin FIX_AXIS_PAR_LIST 6.4 8 9.6 11.2 12.8 14.4 16 17.6 19.2 /end FIX_AXIS_PAR_LIST /end AXIS_DESCR
/end CHARACTERISTIC
/begin CHARACTERISTIC C_ETCM_AntiFrictClsPulse "cal comments" VALUE 0xA176 Scalar_UW 0.0 CM_Percent_0to200_2 0.0 199.9969024658203 /end CHARACTERISTIC
/begin CHARACTERISTIC C_ETCM_AntiFrictOpnPulse "cal comments" VALUE 0xA178 Scalar_UW 0.0 CM_Percent_0to200_2 0.0 199.9969024658203 /end CHARACTERISTIC
/begin CHARACTERISTIC C_DC_ETCM_OpeningMax "cal comments" VALUE 0xA17E Scalar_UW 0.0 CM_Percent_0to200_2 0.0 199.9969024658203 /end CHARACTERISTIC
/begin CHARACTERISTIC C_DC_ETCM_ClosingMax "cal comments" VALUE 0xA180 Scalar_UW 0.0 CM_Percent_0to200_2 0.0 199.9969024658203 /end CHARACTERISTIC
/begin CHARACTERISTIC C_ETCM_AboveLTDCTime "cal comments" VALUE 0xA182 Scalar_UW 0.0 CM_Second_0to512 0.0 511.9921875 /end CHARACTERISTIC
/begin CHARACTERISTIC C_ETCM_ClipLTDCTime "cal comments" VALUE 0xA184 Scalar_UW 0.0 CM_Second_0to512 0.0 511.9921875 /end CHARACTERISTIC
/begin CHARACTERISTIC C_ETCMSprTPSDeadBand "cal comments" VALUE 0xA188 Scalar_UW 0.0 CM_Percent_0to200_2 0.0 199.9969024658203 /end CHARACTERISTIC
/begin CHARACTERISTIC C_ETCMFricTPSDeadBand "cal comments" VALUE 0xA18A Scalar_UW 0.0 CM_Percent_0to200_2 0.0 199.9969024658203 /end CHARACTERISTIC
/begin CHARACTERISTIC C_ETCMDerivTPSHiDeadBand "cal comments" VALUE 0xA18C Scalar_UW 0.0 CM_Percent_0to200_2 0.0 199.9969024658203 /end CHARACTERISTIC
/begin CHARACTERISTIC C_ETCMDerivTPSLoDeadBand "cal comments" VALUE 0xA18E Scalar_UW 0.0 CM_Percent_0to200_2 0.0 199.9969024658203 /end CHARACTERISTIC
/begin CHARACTERISTIC C_ETCMPropTPSHiDeadBand "cal comments" VALUE 0xA190 Scalar_UW 0.0 CM_Percent_0to200_2 0.0 199.9969024658203 /end CHARACTERISTIC
/begin CHARACTERISTIC C_ETCMPropTPSLoDeadBand "cal comments" VALUE 0xA192 Scalar_UW 0.0 CM_Percent_0to200_2 0.0 199.9969024658203 /end CHARACTERISTIC
/begin CHARACTERISTIC C_ETCMIntTPSDeadBand "cal comments" VALUE 0xA194 Scalar_UW 0.0 CM_Percent_0to200_2 0.0 199.9969024658203 /end CHARACTERISTIC
/begin CHARACTERISTIC C_ETCMIntTPSDltRange "cal comments" VALUE 0xA196 Scalar_UW 0.0 CM_Percent_0to200_2 0.0 199.9969024658203 /end CHARACTERISTIC
/begin CHARACTERISTIC C_ETCM_IntegralNegLimit "cal comments" VALUE 0xA198 Scalar_SW 0.0 CM_Percent_N200to200 -199.9999847412109 199.9938812255859 /end CHARACTERISTIC
/begin CHARACTERISTIC C_ETCM_IntegralPosLimit "cal comments" VALUE 0xA19A Scalar_SW 0.0 CM_Percent_N200to200 -199.9999847412109 199.9938812255859 /end CHARACTERISTIC
/begin CHARACTERISTIC C_ETCM_SteeringDCmin "cal comments" VALUE 0xA19C Scalar_SW 0.0 CM_Percent_N200to200 -199.9999847412109 199.9938812255859 /end CHARACTERISTIC
/begin CHARACTERISTIC C_ETCM_SteeringDCmax "cal comments" VALUE 0xA19E Scalar_SW 0.0 CM_Percent_N200to200 -199.9999847412109 199.9938812255859 /end CHARACTERISTIC
/begin CHARACTERISTIC C_ETCM_UsedForSteering "cal comments" VALUE 0xA17A Scalar_UB 0.0 CM_Boolean6 0.0 255.0 /end CHARACTERISTIC
/begin CHARACTERISTIC C_ETCM_DirLogic "cal comments" VALUE 0xA17B Scalar_UB 0.0 CM_Boolean6 0.0 255.0 /end CHARACTERISTIC
/begin CHARACTERISTIC C_ETCM_Frequency "cal comments" VALUE 0xA186 Scalar_UW 0.0 CM_Hz_0to16384 0.0 16383.75 /end CHARACTERISTIC
/begin CHARACTERISTIC C_ETCM_IGNRef "cal comments" VALUE 0xA17C Scalar_UW 0.0 CM_Volt_0to32_1 0.0 31.99900627136231 /end CHARACTERISTIC
/begin CHARACTERISTIC C_U_GEN_VOLT_RESCALE "cal comments" VALUE 0x0 Scalar_UW 0.0 CM_Volt_0to1024_1 0.0 1023.984375 /end CHARACTERISTIC
/begin CHARACTERISTIC C_GENVFiltCoef "cal comments" VALUE 0x0 Scalar_UW 0.0 CM_FiltCoef 0.0 0.9999847412109375 /end CHARACTERISTIC
/begin CHARACTERISTIC C_GENVDesired "cal comments" VALUE 0x0 Scalar_UW 0.0 CM_Volt_0to1024_1 0.0 1023.984375 /end CHARACTERISTIC
/begin CHARACTERISTIC C_GENVPropVOLTHiDeadBand "cal comments" VALUE 0x0 Scalar_UW 0.0 CM_Volt_0to1024_1 0.0 1023.984375 /end CHARACTERISTIC
/begin CHARACTERISTIC C_GENVPropVOLTLoDeadBand "cal comments" VALUE 0x0 Scalar_UW 0.0 CM_Volt_0to1024_1 0.0 1023.984375 /end CHARACTERISTIC
/begin CHARACTERISTIC C_GENVIntVOLTDeadBand "cal comments" VALUE 0x0 Scalar_UW 0.0 CM_Volt_0to1024_1 0.0 1023.984375 /end CHARACTERISTIC
/begin CHARACTERISTIC C_GENVIntVOLTDltRange "cal comments" VALUE 0x0 Scalar_UW 0.0 CM_Volt_0to1024_1 0.0 1023.984375 /end CHARACTERISTIC
/begin CHARACTERISTIC CT_GENVPropVOLTHigh "cal comments" CURVE 0x2 2D_Array_UB 0.0 CM_Percent_0to100 0.0 99.609375
 /begin AXIS_DESCR COM_AXIS NO_INPUT_QUANTITY CM_Volt_0to1024_1 11 0.0 1023.984375 AXIS_PTS_REF CA_GENV11Step MAX_GRAD 0.0 /end AXIS_DESCR
/end CHARACTERISTIC
/begin CHARACTERISTIC CT_GENVPropVOLTLow "cal comments" CURVE 0x2 2D_Array_UB 0.0 CM_Percent_0to100 0.0 99.609375
 /begin AXIS_DESCR COM_AXIS NO_INPUT_QUANTITY CM_Volt_0to1024_1 11 0.0 1023.984375 AXIS_PTS_REF CA_GENV11Step MAX_GRAD 0.0 /end AXIS_DESCR
/end CHARACTERISTIC
/begin CHARACTERISTIC CT_GENVIntGainVOLTHigh "cal comments" CURVE 0x2 2D_Array_UB 0.0 CM_Mult0_to_2_ratio1 0.0 1.9921875
 /begin AXIS_DESCR COM_AXIS NO_INPUT_QUANTITY CM_Volt_0to1024_1 11 0.0 1023.984375 AXIS_PTS_REF CA_GENV11Step MAX_GRAD 0.0 /end AXIS_DESCR
/end CHARACTERISTIC
/begin CHARACTERISTIC CT_GENVIntGainVOLTLow "cal comments" CURVE 0x2 2D_Array_UB 0.0 CM_Mult0_to_2_ratio1 0.0 1.9921875
 /begin AXIS_DESCR COM_AXIS NO_INPUT_QUANTITY CM_Volt_0to1024_1 11 0.0 1023.984375 AXIS_PTS_REF CA_GENV11Step MAX_GRAD 0.0 /end AXIS_DESCR
/end CHARACTERISTIC
/begin CHARACTERISTIC C_SMTR_n_Rotate_Dsbl_Thrsh "cal comments" VALUE 0xA0CE Scalar_UW 0.0 CM_RPM_0to16384 0.0 16383.75 /end CHARACTERISTIC
/begin CHARACTERISTIC C_SMTR_n_Rotate_Enbl_Thrsh "cal comments" VALUE 0xA0D0 Scalar_UW 0.0 CM_RPM_0to16384 0.0 16383.75 /end CHARACTERISTIC
/begin CHARACTERISTIC C_SACrankExitRampInterval "cal comments" VALUE 0xA1D8 Scalar_UW 0.0 CM_Second_0to1024 0.0 1023.984375 /end CHARACTERISTIC
/begin CHARACTERISTIC C_SACrankExitRampStep "cal comments" VALUE 0xA1DE Scalar_SW 0.0 CM_SparkAngle_N256to256 -256.0 255.9921875 /end CHARACTERISTIC
/begin CHARACTERISTIC C_SANormalRampDownStep "cal comments" VALUE 0xA1DA Scalar_SW 0.0 CM_SparkAngle_N256to256 -256.0 255.9921875 /end CHARACTERISTIC
/begin CHARACTERISTIC C_SANormalRampUpStep "cal comments" VALUE 0xA1DC Scalar_SW 0.0 CM_SparkAngle_N256to256 -256.0 255.9921875 /end CHARACTERISTIC
/begin CHARACTERISTIC C_SparkAdvanceMaxLimit "cal comments" VALUE 0xA1C4 Scalar_SW 0.0 CM_SparkAngle_N256to256 -256.0 255.9921875 /end CHARACTERISTIC
/begin CHARACTERISTIC C_SparkAdvanceMinLimit "cal comments" VALUE 0xA1C6 Scalar_SW 0.0 CM_SparkAngle_N256to256 -256.0 255.9921875 /end CHARACTERISTIC
/begin CHARACTERISTIC C_SPRK_phi_DFCO "cal comments" VALUE 0xA1C8 Scalar_SW 0.0 CM_SparkAngle_N256to256 -256.0 255.9921875 /end CHARACTERISTIC
/begin CHARACTERISTIC C_SparkDeliverModeAfterCID "cal comments" VALUE 0xB696 Scalar_UB 0.0 CM_Boolean4 0.0 1.0 /end CHARACTERISTIC
/begin CHARACTERISTIC C_SparkDwellIATMultRumTimeThrsh "cal comments" VALUE 0xAEC4 Scalar_UW 0.0 CM_Second_0to65535 0.0 65535.0 /end CHARACTERISTIC
/begin CHARACTERISTIC C_SparkPETableUsed "cal comments" VALUE 0xAEC6 Scalar_UB 0.0 CM_Boolean1 0.0 1.0 /end CHARACTERISTIC
/begin CHARACTERISTIC C_IGNOff_Through_Spark "cal comments" VALUE 0xAEED Scalar_UB 0.0 CM_Boolean1 0.0 1.0 /end CHARACTERISTIC
/begin CHARACTERISTIC C_SAGovCntrlEn "cal comments" VALUE 0xB20E Scalar_UB 0.0 CM_Boolean1 0.0 1.0 /end CHARACTERISTIC
/begin CHARACTERISTIC C_SAGovIntRampInterval "cal comments" VALUE 0xB210 Scalar_UW 0.0 CM_Second_0to1024 0.0 1023.984375 /end CHARACTERISTIC
/begin CHARACTERISTIC C_SAGovIntRampStep "cal comments" VALUE 0xB212 Scalar_UW 0.0 CM_Percent_0to200_2 0.0 199.9969024658203 /end CHARACTERISTIC
/begin CHARACTERISTIC C_SAGovPropDeadBand "cal comments" VALUE 0xAF9C Scalar_UW 0.0 CM_RPM_0to16384 0.0 16383.75 /end CHARACTERISTIC
/begin CHARACTERISTIC C_SAGovIntDeadBand "cal comments" VALUE 0xAF9E Scalar_UW 0.0 CM_RPM_0to16384 0.0 16383.75 /end CHARACTERISTIC
/begin CHARACTERISTIC C_SAGovIntDltRange "cal comments" VALUE 0xAFA0 Scalar_UW 0.0 CM_RPM_0to16384 0.0 16383.75 /end CHARACTERISTIC
/begin CHARACTERISTIC C_SAGovAngleCntrlRange "cal comments" VALUE 0xAFA2 Scalar_SW 0.0 CM_SparkAngle_N256to256 -256.0 255.9921875 /end CHARACTERISTIC
/begin CHARACTERISTIC CT_SAGovMaxLimit_NG "cal comments" MAP 0xAFA7 D_Array_SB 0.0 CM_Angle_8bit -64.0 63.5
 /begin AXIS_DESCR COM_AXIS NO_INPUT_QUANTITY CM_kpa_0to256_1 18 0.0 255.99609375 AXIS_PTS_REF CA_MAP18Step1 MAX_GRAD 0.0 /end AXIS_DESCR
 /begin AXIS_DESCR COM_AXIS NO_INPUT_QUANTITY CM_RPM_0to16384 17 0.0 16383.75 AXIS_PTS_REF CA_EngSpd17Step1 MAX_GRAD 0.0 /end AXIS_DESCR
/end CHARACTERISTIC
/begin CHARACTERISTIC CT_SAGovMaxLimit_LPG "cal comments" MAP 0xB0DC D_Array_SB 0.0 CM_Angle_8bit -64.0 63.5
 /begin AXIS_DESCR COM_AXIS NO_INPUT_QUANTITY CM_kpa_0to256_1 18 0.0 255.99609375 AXIS_PTS_REF CA_MAP18Step1 MAX_GRAD 0.0 /end AXIS_DESCR
 /begin AXIS_DESCR COM_AXIS NO_INPUT_QUANTITY CM_RPM_0to16384 17 0.0 16383.75 AXIS_PTS_REF CA_EngSpd17Step1 MAX_GRAD 0.0 /end AXIS_DESCR
/end CHARACTERISTIC
/begin CHARACTERISTIC CT_SAGovIntGainHigh "cal comments" CURVE 0xAF84 2D_Array_UB 0.0 CM_Mult0_to_2_ratio1 0.0 1.9921875
 /begin AXIS_DESCR COM_AXIS NO_INPUT_QUANTITY CM_RPM_0to16384 17 0.0 16383.75 AXIS_PTS_REF CA_EngSpd11Step1 MAX_GRAD 0.0 /end AXIS_DESCR
/end CHARACTERISTIC
/begin CHARACTERISTIC CT_SAGovIntGainLow "cal comments" CURVE 0xAF91 2D_Array_UB 0.0 CM_Mult0_to_2_ratio1 0.0 1.9921875
 /begin AXIS_DESCR COM_AXIS NO_INPUT_QUANTITY CM_RPM_0to16384 17 0.0 16383.75 AXIS_PTS_REF CA_EngSpd11Step1 MAX_GRAD 0.0 /end AXIS_DESCR
/end CHARACTERISTIC
/begin CHARACTERISTIC CT_SAGovPropHigh "cal comments" CURVE 0xAF6A 2D_Array_UB 0.0 CM_Percent_0to100 0.0 99.609375
 /begin AXIS_DESCR COM_AXIS NO_INPUT_QUANTITY CM_RPM_0to16384 17 0.0 16383.75 AXIS_PTS_REF CA_EngSpd11Step1 MAX_GRAD 0.0 /end AXIS_DESCR
/end CHARACTERISTIC
/begin CHARACTERISTIC CT_SAGovPropLow "cal comments" CURVE 0xAF77 2D_Array_UB 0.0 CM_Percent_0to100 0.0 99.609375
 /begin AXIS_DESCR COM_AXIS NO_INPUT_QUANTITY CM_RPM_0to16384 17 0.0 16383.75 AXIS_PTS_REF CA_EngSpd11Step1 MAX_GRAD 0.0 /end AXIS_DESCR
/end CHARACTERISTIC
/begin CHARACTERISTIC CT_SparkAngle1TableAllocate "cal comments" CURVE 0xAEEE 2D_Array_UB 0.0 CM_Count1 0.0 255.0
 /begin AXIS_DESCR FIX_AXIS NO_INPUT_QUANTITY CM_FUEL_TYPE 3 0.0 3.0 MAX_GRAD 0.0 /begin FIX_AXIS_PAR_LIST 0 1 2 /end FIX_AXIS_PAR_LIST /end AXIS_DESCR
/end CHARACTERISTIC
/begin CHARACTERISTIC CT_SparkAngle2TableAllocate "cal comments" CURVE 0xAEF1 2D_Array_UB 0.0 CM_Count1 0.0 255.0
 /begin AXIS_DESCR FIX_AXIS NO_INPUT_QUANTITY CM_FUEL_TYPE 3 0.0 3.0 MAX_GRAD 0.0 /begin FIX_AXIS_PAR_LIST 0 1 2 /end FIX_AXIS_PAR_LIST /end AXIS_DESCR
/end CHARACTERISTIC
/begin CHARACTERISTIC C_SparkPowerOffDwell "cal comments" VALUE 0xAE42 Scalar_UW 0.0 CM_msec_0to1024 0.0 1023.984375 /end CHARACTERISTIC
/begin CHARACTERISTIC C_SpdCntrlDerivInterval "cal comments" VALUE 0x9EF7 Scalar_UB 0.0 CM_Count4 0.0 255.0 /end CHARACTERISTIC
/begin CHARACTERISTIC C_TPSNoMoveAsEngineKilledEn "cal comments" VALUE 0x9E3E Scalar_UB 0.0 CM_Count1 0.0 255.0 /end CHARACTERISTIC
/begin CHARACTERISTIC C_SpeedControlEnable "cal comments" VALUE 0x9E3F Scalar_UB 0.0 CM_Count1 0.0 255.0 /end CHARACTERISTIC
/begin CHARACTERISTIC C_SpeedControlIntDerivLearnning "cal comments" VALUE 0x9E41 Scalar_UB 0.0 CM_Boolean6 0.0 255.0 /end CHARACTERISTIC
/begin CHARACTERISTIC C_SpeedControlLvl0 "cal comments" VALUE 0x9E0E Scalar_UW 0.0 CM_Percent_0to100_1 0.0 99.9984130859375 /end CHARACTERISTIC
/begin CHARACTERISTIC C_SpeedControlLvl1 "cal comments" VALUE 0x9E10 Scalar_UW 0.0 CM_Percent_0to100_1 0.0 99.9984130859375 /end CHARACTERISTIC
/begin CHARACTERISTIC C_SpeedControlLvl2 "cal comments" VALUE 0x9E12 Scalar_UW 0.0 CM_Percent_0to100_1 0.0 99.9984130859375 /end CHARACTERISTIC
/begin CHARACTERISTIC C_SpeedControlLvl3 "cal comments" VALUE 0x9E14 Scalar_UW 0.0 CM_Percent_0to100_1 0.0 99.9984130859375 /end CHARACTERISTIC
/begin CHARACTERISTIC C_SpeedControlLvl4 "cal comments" VALUE 0x9E16 Scalar_UW 0.0 CM_Percent_0to100_1 0.0 99.9984130859375 /end CHARACTERISTIC
/begin CHARACTERISTIC C_SpeedControlLvl5 "cal comments" VALUE 0x9E18 Scalar_UW 0.0 CM_Percent_0to100_1 0.0 99.9984130859375 /end CHARACTERISTIC
/begin CHARACTERISTIC C_IDLEMotorDirChangeDelay "cal comments" VALUE 0xB7AE Scalar_UB 0.0 CM_Count4 0.0 255.0 /end CHARACTERISTIC
/begin CHARACTERISTIC C_IDLEMotorStartDelay "cal comments" VALUE 0xB7AC Scalar_UB 0.0 CM_Count4 0.0 255.0 /end CHARACTERISTIC
/begin CHARACTERISTIC C_IDLEMotorStartDelaySteps "cal comments" VALUE 0xB7AD Scalar_UB 0.0 CM_Count4 0.0 255.0 /end CHARACTERISTIC
/begin CHARACTERISTIC C_IDLEStepMotorHiEn "cal comments" VALUE 0xB7AF Scalar_UB 0.0 CM_Boolean6 0.0 255.0 /end CHARACTERISTIC
/begin CHARACTERISTIC C_IDLEStepMotorDir "cal comments" VALUE 0xB7B0 Scalar_UB 0.0 CM_Boolean6 0.0 255.0 /end CHARACTERISTIC
/begin CHARACTERISTIC C_FCVMoveBatVoltMaxLimit "cal comments" VALUE 0xB7BA Scalar_UW 0.0 CM_Volt_0to32_1 0.0 31.99900627136231 /end CHARACTERISTIC
/begin CHARACTERISTIC C_FCVMoveBatVoltMinLimit "cal comments" VALUE 0xB7BC Scalar_UW 0.0 CM_Volt_0to32_1 0.0 31.99900627136231 /end CHARACTERISTIC
/begin CHARACTERISTIC C_FCVMotorDirChangeDelay "cal comments" VALUE 0xB7C0 Scalar_UB 0.0 CM_Count4 0.0 255.0 /end CHARACTERISTIC
/begin CHARACTERISTIC C_FCVMotorStartDelay "cal comments" VALUE 0xB7BE Scalar_UB 0.0 CM_Count4 0.0 255.0 /end CHARACTERISTIC
/begin CHARACTERISTIC C_FCVMotorStartDelaySteps "cal comments" VALUE 0xB7BF Scalar_UB 0.0 CM_Count4 0.0 255.0 /end CHARACTERISTIC
/begin CHARACTERISTIC C_FCVStepMotorHiEn "cal comments" VALUE 0xB7C1 Scalar_UB 0.0 CM_Boolean6 0.0 255.0 /end CHARACTERISTIC
/begin CHARACTERISTIC C_FCVStepMotorDir "cal comments" VALUE 0xB7C2 Scalar_UB 0.0 CM_Boolean6 0.0 255.0 /end CHARACTERISTIC
/begin CHARACTERISTIC C_FCVPSCloseSlowZone "cal comments" VALUE 0xB7C6 Scalar_UW 0.0 CM_Percent_0to200_2 0.0 199.9969024658203 /end CHARACTERISTIC
/begin CHARACTERISTIC C_FCVMtrFCVPSDeltaOneStep "cal comments" VALUE 0xB7C4 Scalar_UW 0.0 CM_Percent_0to200_2 0.0 199.9969024658203 /end CHARACTERISTIC
/begin CHARACTERISTIC C_FCVPSFiltCoef "cal comments" VALUE 0xBF30 Scalar_UW 0.0 CM_FiltCoef 0.0 0.9999847412109375 /end CHARACTERISTIC
/begin CHARACTERISTIC C_FCVPSOpenSlowZone "cal comments" VALUE 0xB7C8 Scalar_UW 0.0 CM_Percent_0to200_2 0.0 199.9969024658203 /end CHARACTERISTIC
/begin CHARACTERISTIC C_FCVPSSlope "cal comments" VALUE 0xBF2E Scalar_UW 0.0 CM_Ratio_0to8 0.0 7.9998779296875 /end CHARACTERISTIC
/begin CHARACTERISTIC C_FCVPSZeroInitial "cal comments" VALUE 0xBF2C Scalar_UW 0.0 CM_Percent_0to200_2 0.0 199.9969024658203 /end CHARACTERISTIC
/begin CHARACTERISTIC C_FCVPSMinimumLrnCntThresh "cal comments" VALUE 0xB7CA Scalar_UB 0.0 CM_Count1 0.0 255.0 /end CHARACTERISTIC
/begin CHARACTERISTIC C_FCVLoopCounter "cal comments" VALUE 0xB7CB Scalar_UB 0.0 CM_Count1 0.0 255.0 /end CHARACTERISTIC
/begin CHARACTERISTIC C_FCV_PstnMax "cal comments" VALUE 0xB7CC Scalar_UB 0.0 CM_Count4 0.0 255.0 /end CHARACTERISTIC
/begin CHARACTERISTIC C_FCVStepMotorCLEn "cal comments" VALUE 0xB7CD Scalar_UB 0.0 CM_Boolean6 0.0 255.0 /end CHARACTERISTIC
/begin CHARACTERISTIC C_FCVMotorParkDelay "cal comments" VALUE 0xB7F6 Scalar_UW 0.0 CM_Count_0to65535 0.0 65535.0 /end CHARACTERISTIC
/begin CHARACTERISTIC CT_FCVPS_NG_ParkPstn "cal comments" CURVE 0xB7D0 2D_Array_UW 0.0 CM_Percent_0to200_2 0.0 199.9969024658203
 /begin AXIS_DESCR FIX_AXIS NO_INPUT_QUANTITY CM_Equaloutput1 9 -40.0 152.0 MAX_GRAD 0.0 /begin FIX_AXIS_PAR_LIST -40 -16 8 32 56 80 104 128 152 /end FIX_AXIS_PAR_LIST /end AXIS_DESCR
/end CHARACTERISTIC
/begin CHARACTERISTIC CT_FCVPS_LPG_ParkPstn "cal comments" CURVE 0xB7E4 2D_Array_UW 0.0 CM_Percent_0to200_2 0.0 199.9969024658203
 /begin AXIS_DESCR FIX_AXIS NO_INPUT_QUANTITY CM_Equaloutput1 9 -40.0 152.0 MAX_GRAD 0.0 /begin FIX_AXIS_PAR_LIST -40 -16 8 32 56 80 104 128 152 /end FIX_AXIS_PAR_LIST /end AXIS_DESCR
/end CHARACTERISTIC
/begin CHARACTERISTIC CT_FCVPS_FP_CorrFactor_NG "cal comments" MAP 0xB877 3D_Array_UB 0.0 CM_Mult0_to_2_ratio 0.0 1.9921875
 /begin AXIS_DESCR COM_AXIS NO_INPUT_QUANTITY udf_CM_18705 17 0.0 511.9921875 AXIS_PTS_REF CA_AirGramStep17 MAX_GRAD 0.0 /end AXIS_DESCR
 /begin AXIS_DESCR COM_AXIS NO_INPUT_QUANTITY CM_kpa_n256to256_1 8 -256 255.9921875 AXIS_PTS_REF CA_MAP8Step1 MAX_GRAD 0.0 /end AXIS_DESCR
/end CHARACTERISTIC
/begin CHARACTERISTIC CT_FCVPS_Baro_CorrFactor_NG "cal comments" MAP 0xB902 3D_Array_UB 0.0 CM_Mult0_to_2_ratio 0.0 1.9921875
 /begin AXIS_DESCR COM_AXIS NO_INPUT_QUANTITY udf_CM_18705 17 0.0 511.9921875 AXIS_PTS_REF CA_AirGramStep17 MAX_GRAD 0.0 /end AXIS_DESCR
 /begin AXIS_DESCR COM_AXIS NO_INPUT_QUANTITY CM_kpa_0to256_1 8 0.0 255.99609375 AXIS_PTS_REF CA_MAP8Step2 MAX_GRAD 0.0 /end AXIS_DESCR
/end CHARACTERISTIC
/begin CHARACTERISTIC CT_FCVPS_FP_CorrFactor_LPG "cal comments" MAP 0xB98D 3D_Array_UB 0.0 CM_Mult0_to_2_ratio 0.0 1.9921875
 /begin AXIS_DESCR COM_AXIS NO_INPUT_QUANTITY udf_CM_18705 17 0.0 511.9921875 AXIS_PTS_REF CA_AirGramStep17 MAX_GRAD 0.0 /end AXIS_DESCR
 /begin AXIS_DESCR COM_AXIS NO_INPUT_QUANTITY CM_kpa_n256to256_1 8 -256 255.9921875 AXIS_PTS_REF CA_MAP8Step1 MAX_GRAD 0.0 /end AXIS_DESCR
/end CHARACTERISTIC
/begin CHARACTERISTIC CT_FCVPS_Baro_CorrFactor_LPG "cal comments" MAP 0xBA18 3D_Array_UB 0.0 CM_Mult0_to_2_ratio 0.0 1.9921875
 /begin AXIS_DESCR COM_AXIS NO_INPUT_QUANTITY udf_CM_18705 17 0.0 511.9921875 AXIS_PTS_REF CA_AirGramStep17 MAX_GRAD 0.0 /end AXIS_DESCR
 /begin AXIS_DESCR COM_AXIS NO_INPUT_QUANTITY CM_kpa_0to256_1 8 0.0 255.99609375 AXIS_PTS_REF CA_MAP8Step2 MAX_GRAD 0.0 /end AXIS_DESCR
/end CHARACTERISTIC
/begin CHARACTERISTIC CT_DesireFCVPS_NG "cal comments" MAP 0xBAA4 3D_Array_UW 0.0 CM_Percent_0to200_2 0.0 199.9969024658203
 /begin AXIS_DESCR COM_AXIS NO_INPUT_QUANTITY udf_CM_18705 17 0.0 511.9921875 AXIS_PTS_REF CA_AirGramStep17 MAX_GRAD 0.0 /end AXIS_DESCR
 /begin AXIS_DESCR COM_AXIS NO_INPUT_QUANTITY udf_CM_16444 17 0.0 15.999755859375 AXIS_PTS_REF CA_FuelGramStep17 MAX_GRAD 0.0 /end AXIS_DESCR
/end CHARACTERISTIC
/begin CHARACTERISTIC CT_DesireFCVPS_LPG "cal comments" MAP 0xBCEA 3D_Array_UW 0.0 CM_Percent_0to200_2 0.0 199.9969024658203
 /begin AXIS_DESCR COM_AXIS NO_INPUT_QUANTITY udf_CM_18705 17 0.0 511.9921875 AXIS_PTS_REF CA_AirGramStep17 MAX_GRAD 0.0 /end AXIS_DESCR
 /begin AXIS_DESCR COM_AXIS NO_INPUT_QUANTITY udf_CM_16444 17 0.0 15.999755859375 AXIS_PTS_REF CA_FuelGramStep17 MAX_GRAD 0.0 /end AXIS_DESCR
/end CHARACTERISTIC
/begin CHARACTERISTIC C_TachOutOption "cal comments" VALUE 0x8042 Scalar_UB 0.0 CM_Enum_0to4 0.0 255.0 /end CHARACTERISTIC
/begin CHARACTERISTIC C_TargetWheelErrorOfst "cal comments" VALUE 0xB6DA Scalar_SW 0.0 CM_SparkAngle_N256to256 -256.0 255.9921875 /end CHARACTERISTIC
/begin CHARACTERISTIC C_TeethNumBeforeSync "cal comments" VALUE 0x8015 Scalar_UB 0.0 CM_Count1 0.0 255.0 /end CHARACTERISTIC
/begin CHARACTERISTIC C_IDLETPSCloseSlowZone "cal comments" VALUE 0xB7B4 Scalar_UW 0.0 CM_Percent_0to200_2 0.0 199.9969024658203 /end CHARACTERISTIC
/begin CHARACTERISTIC C_IDLEMtrTPSDeltaOneStep "cal comments" VALUE 0xB7B2 Scalar_UW 0.0 CM_Percent_0to200_2 0.0 199.9969024658203 /end CHARACTERISTIC
/begin CHARACTERISTIC C_TPSFiltCoef "cal comments" VALUE 0xB536 Scalar_UW 0.0 CM_FiltCoef 0.0 0.9999847412109375 /end CHARACTERISTIC
/begin CHARACTERISTIC C_IDLETPSMinimumLrnCntThresh "cal comments" VALUE 0xB7B8 Scalar_UB 0.0 CM_Count1 0.0 255.0 /end CHARACTERISTIC
/begin CHARACTERISTIC C_IDLETPSOpenSlowZone "cal comments" VALUE 0xB7B6 Scalar_UW 0.0 CM_Percent_0to200_2 0.0 199.9969024658203 /end CHARACTERISTIC
/begin CHARACTERISTIC C_TPSSensorPresent "cal comments" VALUE 0x8018 Scalar_UB 0.0 CM_Boolean4 0.0 1.0 /end CHARACTERISTIC
/begin CHARACTERISTIC C_TPSSlope "cal comments" VALUE 0xB538 Scalar_UW 0.0 CM_Ratio_0to8 0.0 7.9998779296875 /end CHARACTERISTIC
/begin CHARACTERISTIC C_TPSSpdCtrlMinimum "cal comments" VALUE 0x9E9A Scalar_UW 0.0 CM_Percent_0to200_2 0.0 199.9969024658203 /end CHARACTERISTIC
/begin CHARACTERISTIC C_TPSZeroInitialDefault "cal comments" VALUE 0xB534 Scalar_UW 0.0 CM_Percent_0to200_2 0.0 199.9969024658203 /end CHARACTERISTIC
/begin CHARACTERISTIC C_TransientFuelEnable "cal comments" VALUE 0x962E Scalar_UB 0.0 CM_Boolean1 0.0 1.0 /end CHARACTERISTIC
/begin CHARACTERISTIC C_TrimPulseEnbEngSpdThresh "cal comments" VALUE 0x9BB4 Scalar_UW 0.0 CM_RPM_0to16384 0.0 16383.75 /end CHARACTERISTIC
/begin CHARACTERISTIC C_TrimPulseEnbEngSpdThreshHyst "cal comments" VALUE 0x9BB6 Scalar_UW 0.0 CM_RPM_0to16384 0.0 16383.75 /end CHARACTERISTIC
/begin CHARACTERISTIC C_TrimPulseScalarCyl "cal comments" CURVE 0x9BAC 2D_Array_UW 0.0 CM_Ratio_0to2_2 0.0 1.999969482421875
 /begin AXIS_DESCR FIX_AXIS NO_INPUT_QUANTITY CM_EOI 4 0.0 4.0 MAX_GRAD 0.0 /begin FIX_AXIS_PAR_LIST 0 1 2 3 /end FIX_AXIS_PAR_LIST /end AXIS_DESCR
/end CHARACTERISTIC
/begin CHARACTERISTIC C_TrimPulseWidthMinLimit "cal comments" VALUE 0x9BAA Scalar_UW 0.0 CM_msec_0to1024 0.0 1023.984375 /end CHARACTERISTIC
/begin CHARACTERISTIC C_TwoCylinderEngine "cal comments" VALUE 0xB215 Scalar_UB 0.0 CM_Boolean4 0.0 1.0 /end CHARACTERISTIC
/begin CHARACTERISTIC C_ValidToothOccurredResetTime "cal comments" VALUE 0xB688 Scalar_UW 0.0 CM_Second_0to512 0.0 511.9921875 /end CHARACTERISTIC
/begin CHARACTERISTIC CT_AccEnrichDecayFactorCoolTemp "cal comments" CURVE 0x97AC 2D_Array_UB 0.0 CM_Mult_0to1 0.0 0.99609375
 /begin AXIS_DESCR FIX_AXIS NO_INPUT_QUANTITY CM_Equaloutput1 17 -28.0 164.0 MAX_GRAD 0.0 /begin FIX_AXIS_PAR_LIST -28 -16 -4 8 20 32 44 56 68 80 92 104 116 128 140 152 164 /end FIX_AXIS_PAR_LIST /end AXIS_DESCR
/end CHARACTERISTIC
/begin CHARACTERISTIC CT_AccEnrichDecayFactorEngSpd "cal comments" CURVE 0x92AA 2D_Array_UB 0.0 CM_Mult_0to1_2 0.0 0.99609375
 /begin AXIS_DESCR COM_AXIS NO_INPUT_QUANTITY CM_RPM_0to16384 17 0.0 16383.75 AXIS_PTS_REF CA_EngSpd17Step1 MAX_GRAD 0.0 /end AXIS_DESCR
/end CHARACTERISTIC
/begin CHARACTERISTIC CT_AEDeltaFuelMultBase "cal comments" CURVE 0x92D0 2D_Array_UW 0.0 CM_Grams0to8 0.0 7.999755859375
 /begin AXIS_DESCR FIX_AXIS NO_INPUT_QUANTITY CM_Equaloutput1 18 0.0 1.700000092387199e-002 MAX_GRAD 0.0
  /begin FIX_AXIS_PAR_LIST 0 1.e-003 2.e-003 3.e-003 4.e-003 5.e-003 6.e-003 7.e-003 8.e-003 8.999999999999999e-003 1.e-002 1.1e-002 1.2e-002 1.3e-002 1.4e-002 1.5e-002 1.6e-002 1.7e-002 /end FIX_AXIS_PAR_LIST
 /end AXIS_DESCR
/end CHARACTERISTIC
/begin CHARACTERISTIC CT_AEDeltaFuelMultCoolTemp "cal comments" CURVE 0x97D2 2D_Array_UB 0.0 CM_mult_0to4 0.0 3.984375
 /begin AXIS_DESCR FIX_AXIS NO_INPUT_QUANTITY CM_Equaloutput1 17 -28.0 164.0 MAX_GRAD 0.0 /begin FIX_AXIS_PAR_LIST -28 -16 -4 8 20 32 44 56 68 80 92 104 116 128 140 152 164 /end FIX_AXIS_PAR_LIST /end AXIS_DESCR
/end CHARACTERISTIC
/begin CHARACTERISTIC CT_AEDeltaFuelMultSpeedLoad "cal comments" MAP 0x931E 3D_Array_UW 0.0 CM_Grams0to2 0.0 1.99993896484375
 /begin AXIS_DESCR COM_AXIS NO_INPUT_QUANTITY CM_RPM_0to16384 17 0.0 16383.75 AXIS_PTS_REF CA_EngSpd17Step2 MAX_GRAD 0.0 /end AXIS_DESCR
 /begin AXIS_DESCR FIX_AXIS NO_INPUT_QUANTITY CM_Equaloutput1 10 15.0 105.0 MAX_GRAD 0.0 /begin FIX_AXIS_PAR_LIST 15 25 35 45 55 65 75 85 95 105 /end FIX_AXIS_PAR_LIST /end AXIS_DESCR
/end CHARACTERISTIC
/begin CHARACTERISTIC CT_AFLCCellEngSpdBoundary "cal comments" VAL_BLK 0xB588 ValueBlock_UW 0.0 CM_RPM_0to16384_1 0.0 16383.75 NUMBER 3 /end CHARACTERISTIC
/begin CHARACTERISTIC CT_AFLCCellTPSBoundary "cal comments" VAL_BLK 0xB57E ValueBlock_UW 0.0 CM_Percent_0to200_1 0.0 199.9969024658203 NUMBER 5 /end CHARACTERISTIC
/begin CHARACTERISTIC CT_AFLCTPSMaxThresh "cal comments" CURVE 0xB53E 2D_Array_UW 0.0 CM_Percent_0to200_2 0.0 199.9969024658203
 /begin AXIS_DESCR COM_AXIS NO_INPUT_QUANTITY CM_RPM_0to16384 17 0.0 16383.75 AXIS_PTS_REF CA_EngSpd17Step1 MAX_GRAD 0.0 /end AXIS_DESCR
/end CHARACTERISTIC
/begin CHARACTERISTIC CT_AFRCrank "cal comments" CURVE 0x9852 2D_Array_UB 0.0 CM_AFR_8bit 0.0 31.875
 /begin AXIS_DESCR FIX_AXIS NO_INPUT_QUANTITY CM_Equaloutput1 17 -28.0 164.0 MAX_GRAD 0.0 /begin FIX_AXIS_PAR_LIST -28 -16 -4 8 20 32 44 56 68 80 92 104 116 128 140 152 164 /end FIX_AXIS_PAR_LIST /end AXIS_DESCR
/end CHARACTERISTIC
/begin CHARACTERISTIC CT_AFRCrankBaroComp "cal comments" CURVE 0x9631 2D_Array_SB 0.0 CM_AFR_n4to4 -4.0 3.96875
 /begin AXIS_DESCR FIX_AXIS NO_INPUT_QUANTITY CM_Equaloutput1 6 55.0 105.0 MAX_GRAD 0.0 /begin FIX_AXIS_PAR_LIST 55 65 75 85 95 105 /end FIX_AXIS_PAR_LIST /end AXIS_DESCR
/end CHARACTERISTIC
/begin CHARACTERISTIC C_AFRCrankToRunDecayFactor "cal comments" VALUE 0x98B2 Scalar_UW 0.0 CM_FactorRatio 0.0 0.9999847412109375 /end CHARACTERISTIC
/begin CHARACTERISTIC CT_AFRCrankToRunDecayInterval "cal comments" CURVE 0x98A0 2D_Array_UB 0.0 CM_Second_0to8 0.0 7.96875
 /begin AXIS_DESCR FIX_AXIS NO_INPUT_QUANTITY CM_Equaloutput1 17 -28.0 164.0 MAX_GRAD 0.0 /begin FIX_AXIS_PAR_LIST -28 -16 -4 8 20 32 44 56 68 80 92 104 116 128 140 152 164 /end FIX_AXIS_PAR_LIST /end AXIS_DESCR
/end CHARACTERISTIC
/begin CHARACTERISTIC CT_AFRLeanLimit "cal comments" CURVE 0x91E4 2D_Array_UB 0.0 CM_AFR_8bit 0.0 31.875
 /begin AXIS_DESCR FIX_AXIS NO_INPUT_QUANTITY CM_Equaloutput1 17 -28.0 164.0 MAX_GRAD 0.0 /begin FIX_AXIS_PAR_LIST -28 -16 -4 8 20 32 44 56 68 80 92 104 116 128 140 152 164 /end FIX_AXIS_PAR_LIST /end AXIS_DESCR
/end CHARACTERISTIC
/begin CHARACTERISTIC CT_AFRLeanLimitForColdIdleEnrich "cal comments" CURVE 0x91F7 2D_Array_UB 0.0 CM_AFR_8bit 0.0 31.875
 /begin AXIS_DESCR FIX_AXIS NO_INPUT_QUANTITY CM_Equaloutput1 17 -28.0 164.0 MAX_GRAD 0.0 /begin FIX_AXIS_PAR_LIST -28 -16 -4 8 20 32 44 56 68 80 92 104 116 128 140 152 164 /end FIX_AXIS_PAR_LIST /end AXIS_DESCR
/end CHARACTERISTIC
/begin CHARACTERISTIC CT_AFROpenLoopInPEIdle "cal comments" CURVE 0x9722 2D_Array_UB 0.0 CM_AFR_8bit 0.0 31.875
 /begin AXIS_DESCR COM_AXIS NO_INPUT_QUANTITY CM_RPM_0to16384 4 0.0 16383.75 AXIS_PTS_REF CA_EngSpd4Step1 MAX_GRAD 0.0 /end AXIS_DESCR
/end CHARACTERISTIC
/begin CHARACTERISTIC CT_AFRPECoolTempMult "cal comments" CURVE 0x97F8 2D_Array_UB 0.0 CM_Mult0_to_2_ratio 0.0 1.9921875
 /begin AXIS_DESCR FIX_AXIS NO_INPUT_QUANTITY CM_Equaloutput1 17 -28.0 164.0 MAX_GRAD 0.0 /begin FIX_AXIS_PAR_LIST -28 -16 -4 8 20 32 44 56 68 80 92 104 116 128 140 152 164 /end FIX_AXIS_PAR_LIST /end AXIS_DESCR
/end CHARACTERISTIC
/begin CHARACTERISTIC CT_AFRPowerEnrich "cal comments" MAP 0x980C 3D_Array_UB 0.0 CM_AFR_8bit 0.0 31.875
 /begin AXIS_DESCR COM_AXIS NO_INPUT_QUANTITY CM_Percent_0to200_2 4 0.0 199.9969024658203 AXIS_PTS_REF CA_Percent1 MAX_GRAD 0.0 /end AXIS_DESCR
 /begin AXIS_DESCR COM_AXIS NO_INPUT_QUANTITY CM_RPM_0to16384 17 0.0 16383.75 AXIS_PTS_REF CA_EngSpd17Step1 MAX_GRAD 0.0 /end AXIS_DESCR
/end CHARACTERISTIC
/begin CHARACTERISTIC CT_AFRWarmUpOffsetBaroCompIdle "cal comments" CURVE 0x9641 2D_Array_SB 0.0 CM_AFR_n4to4 -4.0 3.96875
 /begin AXIS_DESCR FIX_AXIS NO_INPUT_QUANTITY CM_Equaloutput1 6 55.0 105.0 MAX_GRAD 0.0 /begin FIX_AXIS_PAR_LIST 55 65 75 85 95 105 /end FIX_AXIS_PAR_LIST /end AXIS_DESCR
/end CHARACTERISTIC
/begin CHARACTERISTIC CT_AFRWarmUpOffsetBaroCompRun "cal comments" CURVE 0x9639 2D_Array_SB 0.0 CM_AFR_n4to4 -4.0 3.96875
 /begin AXIS_DESCR FIX_AXIS NO_INPUT_QUANTITY CM_Equaloutput1 6 55.0 105.0 MAX_GRAD 0.0 /begin FIX_AXIS_PAR_LIST 55 65 75 85 95 105 /end FIX_AXIS_PAR_LIST /end AXIS_DESCR
/end CHARACTERISTIC
/begin CHARACTERISTIC CT_AFRWarmUpOffsetDecayIntervel "cal comments" CURVE 0x9865 2D_Array_UB 0.0 CM_Second_0to8 0.0 7.96875
 /begin AXIS_DESCR FIX_AXIS NO_INPUT_QUANTITY CM_Equaloutput1 17 -28.0 164.0 MAX_GRAD 0.0 /begin FIX_AXIS_PAR_LIST -28 -16 -4 8 20 32 44 56 68 80 92 104 116 128 140 152 164 /end FIX_AXIS_PAR_LIST /end AXIS_DESCR
/end CHARACTERISTIC
/begin CHARACTERISTIC CT_AFRWarmUpOffsetIdle "cal comments" CURVE 0x987A 2D_Array_UB 0.0 CM_AFR_8bit 0.0 31.875
 /begin AXIS_DESCR FIX_AXIS NO_INPUT_QUANTITY CM_Equaloutput1 17 -28.0 164.0 MAX_GRAD 0.0 /begin FIX_AXIS_PAR_LIST -28 -16 -4 8 20 32 44 56 68 80 92 104 116 128 140 152 164 /end FIX_AXIS_PAR_LIST /end AXIS_DESCR
/end CHARACTERISTIC
/begin CHARACTERISTIC CT_AFRWarmUpOffsetRun "cal comments" CURVE 0x988D 2D_Array_UB 0.0 CM_AFR_8bit 0.0 31.875
 /begin AXIS_DESCR FIX_AXIS NO_INPUT_QUANTITY CM_Equaloutput1 17 -28.0 164.0 MAX_GRAD 0.0 /begin FIX_AXIS_PAR_LIST -28 -16 -4 8 20 32 44 56 68 80 92 104 116 128 140 152 164 /end FIX_AXIS_PAR_LIST /end AXIS_DESCR
/end CHARACTERISTIC
/begin CHARACTERISTIC CT_AirFuelRatioBase "cal comments" MAP 0x964A 3D_Array_UB 0.0 CM_AFR_8bit 0.0 31.875
 /begin AXIS_DESCR COM_AXIS NO_INPUT_QUANTITY CM_RPM_0to16384 17 0.0 16383.75 AXIS_PTS_REF CA_EngSpd17Step2 MAX_GRAD 0.0 /end AXIS_DESCR
 /begin AXIS_DESCR COM_AXIS NO_INPUT_QUANTITY CM_kpa_0to256_1 10 0.0 255.99609375 AXIS_PTS_REF CA_MAP10Step1 MAX_GRAD 0.0 /end AXIS_DESCR
/end CHARACTERISTIC
/begin CHARACTERISTIC CT_AirFuelRatioBaseCoolTempMult "cal comments" CURVE 0x98B6 2D_Array_UB 0.0 CM_Mult0_to_2_ratio 0.0 1.9921875
 /begin AXIS_DESCR FIX_AXIS NO_INPUT_QUANTITY CM_Equaloutput1 17 -28.0 164.0 MAX_GRAD 0.0 /begin FIX_AXIS_PAR_LIST -28 -16 -4 8 20 32 44 56 68 80 92 104 116 128 140 152 164 /end FIX_AXIS_PAR_LIST /end AXIS_DESCR
/end CHARACTERISTIC
/begin CHARACTERISTIC CT_AltMAPCalcMult "cal comments" CURVE 0xB6BE 2D_Array_UB 0.0 CM_Mult0_to_2_ratio 0.0 1.9921875
 /begin AXIS_DESCR FIX_AXIS NO_INPUT_QUANTITY CM_Equaloutput1 11 55.0 105.0 MAX_GRAD 0.0 /begin FIX_AXIS_PAR_LIST 55 60 65 70 75 80 85 90 95 100 105 /end FIX_AXIS_PAR_LIST /end AXIS_DESCR
/end CHARACTERISTIC
/begin CHARACTERISTIC CT_BaroReadTooth "cal comments" CURVE 0xB6E6 2D_Array_UB 0.0 CM_Count3 0.0 255.0
 /begin AXIS_DESCR COM_AXIS NO_INPUT_QUANTITY CM_RPM_0to16384 9 0.0 16383.75 AXIS_PTS_REF CA_EngSpd9Step1 MAX_GRAD 0.0 /end AXIS_DESCR
/end CHARACTERISTIC
/begin CHARACTERISTIC C_MapBaroUsed "cal comments" VALUE 0xB6EF Scalar_UB 0.0 CM_Boolean4 0.0 1.0 /end CHARACTERISTIC
/begin CHARACTERISTIC CT_BaroUpdtEngRunOfstMain "cal comments" MAP 0xB721 3D_Array_UB 0.0 CM_kpa_8bit 0.0 127.5
 /begin AXIS_DESCR FIX_AXIS NO_INPUT_QUANTITY CM_Equaloutput1 9 0.0 100.0 MAX_GRAD 0.0 /begin FIX_AXIS_PAR_LIST 0 12.5 25 37.5 50 62.5 75 87.5 100 /end FIX_AXIS_PAR_LIST /end AXIS_DESCR
 /begin AXIS_DESCR COM_AXIS NO_INPUT_QUANTITY CM_RPM_0to16384 9 0.0 16383.75 AXIS_PTS_REF CA_EngSpd9Step1 MAX_GRAD 0.0 /end AXIS_DESCR
/end CHARACTERISTIC
/begin CHARACTERISTIC CT_BaroUpdtEngRunTPSMaxThresh "cal comments" CURVE 0xB70B 2D_Array_UB 0.0 CM_Percent_0to200_3 0.0 199.21875
 /begin AXIS_DESCR COM_AXIS NO_INPUT_QUANTITY CM_RPM_0to16384 17 0.0 16383.75 AXIS_PTS_REF CA_EngSpd17Step1 MAX_GRAD 0.0 /end AXIS_DESCR
/end CHARACTERISTIC
/begin CHARACTERISTIC CT_BaroUpdtEngRunTPSMinThresh "cal comments" CURVE 0xB6F8 2D_Array_UB 0.0 CM_Percent_0to200_3 0.0 199.21875
 /begin AXIS_DESCR COM_AXIS NO_INPUT_QUANTITY CM_RPM_0to16384 17 0.0 16383.75 AXIS_PTS_REF CA_EngSpd17Step1 MAX_GRAD 0.0 /end AXIS_DESCR
/end CHARACTERISTIC
/begin CHARACTERISTIC CT_CATFactorCLTIATCorr "cal comments" MAP 0x8EB8 D_Array_SB 0.0 CM_Ratio_n2to2 -2.0 1.984375
 /begin AXIS_DESCR FIX_AXIS NO_INPUT_QUANTITY CM_Equaloutput1 6 -28.0 92.0 MAX_GRAD 0.0 /begin FIX_AXIS_PAR_LIST -28 -4 20 44 68 92 /end FIX_AXIS_PAR_LIST /end AXIS_DESCR
 /begin AXIS_DESCR FIX_AXIS NO_INPUT_QUANTITY CM_Equaloutput1 9 -28.0 164.0 MAX_GRAD 0.0 /begin FIX_AXIS_PAR_LIST -28 -4 20 44 68 92 116 140 164 /end FIX_AXIS_PAR_LIST /end AXIS_DESCR
/end CHARACTERISTIC
/begin CHARACTERISTIC CT_ChargeAirTempFactorCyl1 "cal comments" MAP 0x8253 D_Array_SB 0.0 CM_Ratio_n2to2 -2.0 1.984375
 /begin AXIS_DESCR FIX_AXIS NO_INPUT_QUANTITY CM_Equaloutput1 9 25.0 105.0 MAX_GRAD 0.0 /begin FIX_AXIS_PAR_LIST 25 35 45 55 65 75 85 95 105 /end FIX_AXIS_PAR_LIST /end AXIS_DESCR
 /begin AXIS_DESCR COM_AXIS NO_INPUT_QUANTITY CM_RPM_0to16384 10 0.0 16383.75 AXIS_PTS_REF CA_EngSpd10Step1 MAX_GRAD 0.0 /end AXIS_DESCR
/end CHARACTERISTIC
/begin CHARACTERISTIC CT_ColdEngFPWMultIdle "cal comments" CURVE 0x960A 2D_Array_UB 0.0 CM_Mult0_to_2_ratio 0.0 1.9921875
 /begin AXIS_DESCR FIX_AXIS NO_INPUT_QUANTITY CM_Equaloutput1 17 -28.0 164.0 MAX_GRAD 0.0 /begin FIX_AXIS_PAR_LIST -28 -16 -4 8 20 32 44 56 68 80 92 104 116 128 140 152 164 /end FIX_AXIS_PAR_LIST /end AXIS_DESCR
/end CHARACTERISTIC
/begin CHARACTERISTIC CT_ColdEngFPWMultRun "cal comments" CURVE 0x961D 2D_Array_UB 0.0 CM_Mult0_to_2_ratio 0.0 1.9921875
 /begin AXIS_DESCR FIX_AXIS NO_INPUT_QUANTITY CM_Equaloutput1 17 -28.0 164.0 MAX_GRAD 0.0 /begin FIX_AXIS_PAR_LIST -28 -16 -4 8 20 32 44 56 68 80 92 104 116 128 140 152 164 /end FIX_AXIS_PAR_LIST /end AXIS_DESCR
/end CHARACTERISTIC
/begin CHARACTERISTIC CT_CoolantTemp "cal comments" CURVE 0xB606 2D_Array_SW 0.0 CM_DegC_N256to256 -256.0 255.9921875
 /begin AXIS_DESCR FIX_AXIS NO_INPUT_QUANTITY CM_Equaloutput1 33 0.0 100.0 MAX_GRAD 0.0
  /begin FIX_AXIS_PAR_LIST 0 3.125 6.25 9.375 12.5 15.625 18.75 21.875 25 28.125 31.25 34.375 37.5 40.625 43.75 46.875 50 53.125 56.25 59.375 62.5 65.625 68.75 71.875 75 78.125 81.25 84.375 87.5 90.625 93.75 96.875 100 /end FIX_AXIS_PAR_LIST
 /end AXIS_DESCR
/end CHARACTERISTIC
/begin CHARACTERISTIC CT_DecEnleanDecayFactorCoolTemp "cal comments" CURVE 0x97BF 2D_Array_UB 0.0 CM_Mult_0to1 0.0 0.99609375
 /begin AXIS_DESCR FIX_AXIS NO_INPUT_QUANTITY CM_Equaloutput1 17 -28.0 164.0 MAX_GRAD 0.0 /begin FIX_AXIS_PAR_LIST -28 -16 -4 8 20 32 44 56 68 80 92 104 116 128 140 152 164 /end FIX_AXIS_PAR_LIST /end AXIS_DESCR
/end CHARACTERISTIC
/begin CHARACTERISTIC CT_DecEnleanDecayFactorEngSpd "cal comments" CURVE 0x92BD 2D_Array_UB 0.0 CM_Mult_0to1_2 0.0 0.99609375
 /begin AXIS_DESCR COM_AXIS NO_INPUT_QUANTITY CM_RPM_0to16384 17 0.0 16383.75 AXIS_PTS_REF CA_EngSpd17Step1 MAX_GRAD 0.0 /end AXIS_DESCR
/end CHARACTERISTIC
/begin CHARACTERISTIC CT_DEDeltaFuelMultBase "cal comments" CURVE 0x92F6 2D_Array_UW 0.0 CM_Grams0to8 0.0 7.999755859375
 /begin AXIS_DESCR FIX_AXIS NO_INPUT_QUANTITY CM_Equaloutput1 18 0.0 1.700000092387199e-002 MAX_GRAD 0.0
  /begin FIX_AXIS_PAR_LIST 0 1.e-003 2.e-003 3.e-003 4.e-003 5.e-003 6.e-003 7.e-003 8.e-003 8.999999999999999e-003 1.e-002 1.1e-002 1.2e-002 1.3e-002 1.4e-002 1.5e-002 1.6e-002 1.7e-002 /end FIX_AXIS_PAR_LIST
 /end AXIS_DESCR
/end CHARACTERISTIC
/begin CHARACTERISTIC CT_DEDeltaFuelMultCoolTemp "cal comments" CURVE 0x97E5 2D_Array_UB 0.0 CM_mult_0to4 0.0 3.984375
 /begin AXIS_DESCR FIX_AXIS NO_INPUT_QUANTITY CM_Equaloutput1 17 -28.0 164.0 MAX_GRAD 0.0 /begin FIX_AXIS_PAR_LIST -28 -16 -4 8 20 32 44 56 68 80 92 104 116 128 140 152 164 /end FIX_AXIS_PAR_LIST /end AXIS_DESCR
/end CHARACTERISTIC
/begin CHARACTERISTIC CT_DEDeltaFuelMultSpeedLoad "cal comments" MAP 0x9476 3D_Array_UW 0.0 CM_Grams0to2 0.0 1.99993896484375
 /begin AXIS_DESCR COM_AXIS NO_INPUT_QUANTITY CM_RPM_0to16384 17 0.0 16383.75 AXIS_PTS_REF CA_EngSpd17Step2 MAX_GRAD 0.0 /end AXIS_DESCR
 /begin AXIS_DESCR FIX_AXIS NO_INPUT_QUANTITY CM_Equaloutput1 10 15.0 105.0 MAX_GRAD 0.0 /begin FIX_AXIS_PAR_LIST 15 25 35 45 55 65 75 85 95 105 /end FIX_AXIS_PAR_LIST /end AXIS_DESCR
/end CHARACTERISTIC
/begin CHARACTERISTIC CT_DefaultTPS "cal comments" CURVE 0xB594 2D_Array_UW 0.0 CM_Percent_0to200_2 0.0 199.9969024658203
 /begin AXIS_DESCR FIX_AXIS NO_INPUT_QUANTITY CM_Equaloutput1 17 0.0 6400.0 MAX_GRAD 0.0
  /begin FIX_AXIS_PAR_LIST 0 400 800 1200 1600 2000 2400 2800 3200 3600 4000 4400 4800 5200 5600 6000 6400 /end FIX_AXIS_PAR_LIST
 /end AXIS_DESCR
/end CHARACTERISTIC
/begin CHARACTERISTIC CT_DesireEngineSpeed "cal comments" CURVE 0x9DEE 2D_Array_UW 0.0 udf_CM_18586 0.0 16383.75
 /begin AXIS_DESCR FIX_AXIS NO_INPUT_QUANTITY CM_Equaloutput1 5 1.0 5.0 MAX_GRAD 0.0 /begin FIX_AXIS_PAR_LIST 1 2 3 4 5 /end FIX_AXIS_PAR_LIST /end AXIS_DESCR
/end CHARACTERISTIC
/begin CHARACTERISTIC CT_DesireEngSpdLinear "cal comments" CURVE 0x9DFA 2D_Array_UW 0.0 CM_RPM_0to16384 0.0 16383.75
 /begin AXIS_DESCR FIX_AXIS NO_INPUT_QUANTITY CM_Equaloutput1 2 20.0 75.0 MAX_GRAD 0.0 /begin FIX_AXIS_PAR_LIST 20.0 75.0 /end FIX_AXIS_PAR_LIST /end AXIS_DESCR
/end CHARACTERISTIC
/begin CHARACTERISTIC CT_DesireEngSpdLinear2 "cal comments" CURVE 0x9DFE 2D_Array_UW 0.0 CM_RPM_0to16384 0.0 16383.75
 /begin AXIS_DESCR FIX_AXIS NO_INPUT_QUANTITY CM_Equaloutput1 2 20.0 75.0 MAX_GRAD 0.0 /begin FIX_AXIS_PAR_LIST 20.0 75.0 /end FIX_AXIS_PAR_LIST /end AXIS_DESCR
/end CHARACTERISTIC
/begin CHARACTERISTIC CT_EstimatedTorque "cal comments" MAP 0x4 udf_RL_19771 0.0 udf_CM_18544 -128.0 127.99609375
 /begin AXIS_DESCR COM_AXIS NO_INPUT_QUANTITY CM_kpa_0to256_1 18 0.0 255.99609375 AXIS_PTS_REF CA_MAP18Step1 MAX_GRAD 0.0 /end AXIS_DESCR
 /begin AXIS_DESCR COM_AXIS NO_INPUT_QUANTITY CM_RPM_0to16384 17 0.0 16383.75 AXIS_PTS_REF CA_EngSpd17Step1 MAX_GRAD 0.0 /end AXIS_DESCR
/end CHARACTERISTIC
/begin CHARACTERISTIC CT_FPWCorrFactorForFPVolt "cal comments" CURVE 0x929B 2D_Array_UB 0.0 CM_Mult0_to_2_ratio 0.0 1.9921875
 /begin AXIS_DESCR FIX_AXIS NO_INPUT_QUANTITY CM_Equaloutput1 9 6.400000095367432 19.20000076293945 MAX_GRAD 0.0 /begin FIX_AXIS_PAR_LIST 6.4 8 9.6 11.2 12.8 14.4 16 17.6 19.2 /end FIX_AXIS_PAR_LIST /end AXIS_DESCR
/end CHARACTERISTIC
/begin CHARACTERISTIC CT_FuelCLEnbCoolTempThrsh "cal comments" CURVE 0x98D0 2D_Array_SW 0.0 CM_DegC_N256to256 -256.0 255.9921875
 /begin AXIS_DESCR FIX_AXIS NO_INPUT_QUANTITY CM_Equaloutput1 17 -28.0 164.0 MAX_GRAD 0.0 /begin FIX_AXIS_PAR_LIST -28 -16 -4 8 20 32 44 56 68 80 92 104 116 128 140 152 164 /end FIX_AXIS_PAR_LIST /end AXIS_DESCR
/end CHARACTERISTIC
/begin CHARACTERISTIC CT_FuelCLIntDelayO2ErrMult "cal comments" CURVE 0x99AB 2D_Array_UB 0.0 CM_Mult_0to1_2 0.0 0.99609375
 /begin AXIS_DESCR FIX_AXIS NO_INPUT_QUANTITY CM_Equaloutput1 6 0.0 347.5 MAX_GRAD 0.0 /begin FIX_AXIS_PAR_LIST 0 69.5 139 208.5 278 347.5 /end FIX_AXIS_PAR_LIST /end AXIS_DESCR
/end CHARACTERISTIC
/begin CHARACTERISTIC CT_FuelCLIntLearningDelay "cal comments" CURVE 0x999C 2D_Array_UB 0.0 CM_Second_0to4 0.0 3.984375
 /begin AXIS_DESCR COM_AXIS NO_INPUT_QUANTITY CM_RPM_0to16384 13 0.0 16383.75 AXIS_PTS_REF CA_EngSpd13Step3 MAX_GRAD 0.0 /end AXIS_DESCR
/end CHARACTERISTIC
/begin CHARACTERISTIC CT_FuelEOICrank "cal comments" CURVE 0x926E 2D_Array_UW 0.0 CM_CrankAngle_0to1024 0.0 1023.984375
 /begin AXIS_DESCR FIX_AXIS NO_INPUT_QUANTITY CM_Equaloutput1 9 -40.0 152.0 MAX_GRAD 0.0 /begin FIX_AXIS_PAR_LIST -40 -16 8 32 56 80 104 128 152 /end FIX_AXIS_PAR_LIST /end AXIS_DESCR
/end CHARACTERISTIC
/begin CHARACTERISTIC CT_FuelEOIRun "cal comments" CURVE 0x9282 2D_Array_UW 0.0 CM_CrankAngle_0to1024 0.0 1023.984375
 /begin AXIS_DESCR COM_AXIS NO_INPUT_QUANTITY CM_RPM_0to16384 6 0.0 16383.75 AXIS_PTS_REF CA_EngSpd6Step2 MAX_GRAD 0.0 /end AXIS_DESCR
/end CHARACTERISTIC
/begin CHARACTERISTIC CT_FuelEOITrimPulse "cal comments" CURVE 0x9BBA 2D_Array_UW 0.0 CM_CrankAngle_0to1024 0.0 1023.984375
 /begin AXIS_DESCR FIX_AXIS NO_INPUT_QUANTITY CM_Equaloutput1 9 -40.0 152.0 MAX_GRAD 0.0 /begin FIX_AXIS_PAR_LIST -40 -16 8 32 56 80 104 128 152 /end FIX_AXIS_PAR_LIST /end AXIS_DESCR
/end CHARACTERISTIC
/begin CHARACTERISTIC C_TrimPulseBeforeCIDsucceed "cal comments" VALUE 0x9BCC Scalar_UB 0.0 CM_Boolean1 0.0 1.0 /end CHARACTERISTIC
/begin CHARACTERISTIC C_TrimPulseEnbTPSThresh "cal comments" VALUE 0x9BCE Scalar_UW 0.0 CM_Percent_0to200_2 0.0 199.9969024658203 /end CHARACTERISTIC
/begin CHARACTERISTIC CT_FuelO2RichLeanThreshBase "cal comments" MAP 0x990D 3D_Array_UB 0.0 CM_mVolt 0.0 1016.0
 /begin AXIS_DESCR COM_AXIS NO_INPUT_QUANTITY CM_kpa_0to256_1 9 0.0 255.99609375 AXIS_PTS_REF CA_MAP9Step3 MAX_GRAD 0.0 /end AXIS_DESCR
 /begin AXIS_DESCR COM_AXIS NO_INPUT_QUANTITY CM_RPM_0to16384 13 0.0 16383.75 AXIS_PTS_REF CA_EngSpd13Step3 MAX_GRAD 0.0 /end AXIS_DESCR
/end CHARACTERISTIC
/begin CHARACTERISTIC CT_FuelPropLeanToRich "cal comments" MAP 0x9A53 3D_Array_UB 0.0 CM_Percent_0to100 0.0 99.609375
 /begin AXIS_DESCR COM_AXIS NO_INPUT_QUANTITY CM_kpa_0to256_1 9 0.0 255.99609375 AXIS_PTS_REF CA_MAP9Step3 MAX_GRAD 0.0 /end AXIS_DESCR
 /begin AXIS_DESCR COM_AXIS NO_INPUT_QUANTITY CM_RPM_0to16384 13 0.0 16383.75 AXIS_PTS_REF CA_EngSpd13Step3 MAX_GRAD 0.0 /end AXIS_DESCR
/end CHARACTERISTIC
/begin CHARACTERISTIC CT_FuelPropMinDuration "cal comments" CURVE 0x9ACC 2D_Array_UB 0.0 CM_Second_0to4 0.0 3.984375
 /begin AXIS_DESCR COM_AXIS NO_INPUT_QUANTITY CM_RPM_0to16384 13 0.0 16383.75 AXIS_PTS_REF CA_EngSpd13Step3 MAX_GRAD 0.0 /end AXIS_DESCR
/end CHARACTERISTIC
/begin CHARACTERISTIC CT_FuelPropO2ErrMult "cal comments" CURVE 0x99BC 2D_Array_UW 0.0 CM_FactorRatio 0.0 0.9999847412109375
 /begin AXIS_DESCR FIX_AXIS NO_INPUT_QUANTITY CM_Equaloutput1 6 0.0 347.5 MAX_GRAD 0.0 /begin FIX_AXIS_PAR_LIST 0 69.5 139 208.5 278 347.5 /end FIX_AXIS_PAR_LIST /end AXIS_DESCR
/end CHARACTERISTIC
/begin CHARACTERISTIC CT_FuelPropRichBiasHoldTimeGain "cal comments" CURVE 0x9ADB 2D_Array_UB 0.0 CM_Mult0_to_2_ratio 0.0 1.9921875
 /begin AXIS_DESCR COM_AXIS NO_INPUT_QUANTITY CM_RPM_0to16384 13 0.0 16383.75 AXIS_PTS_REF CA_EngSpd13Step3 MAX_GRAD 0.0 /end AXIS_DESCR
/end CHARACTERISTIC
/begin CHARACTERISTIC CT_FuelPropRichToLean "cal comments" MAP 0x99DB 3D_Array_UB 0.0 CM_Percent_0to100 0.0 99.609375
 /begin AXIS_DESCR COM_AXIS NO_INPUT_QUANTITY CM_kpa_0to256_1 9 0.0 255.99609375 AXIS_PTS_REF CA_MAP9Step3 MAX_GRAD 0.0 /end AXIS_DESCR
 /begin AXIS_DESCR COM_AXIS NO_INPUT_QUANTITY CM_RPM_0to16384 13 0.0 16383.75 AXIS_PTS_REF CA_EngSpd13Step3 MAX_GRAD 0.0 /end AXIS_DESCR
/end CHARACTERISTIC
/begin CHARACTERISTIC CT_FuelPumpDutyCycle "cal comments" CURVE 0x924A 2D_Array_UW 0.0 CM_Percent_0to200_2 0.0 199.9969024658203
 /begin AXIS_DESCR FIX_AXIS NO_INPUT_QUANTITY CM_Equaloutput1 17 6.0 18.79999923706055 MAX_GRAD 0.0
  /begin FIX_AXIS_PAR_LIST 6 6.8 7.6 8.4 9.199999999999999 10 10.8 11.6 12.4 13.2 14 14.8 15.6 16.4 17.2 18 18.8 /end FIX_AXIS_PAR_LIST
 /end AXIS_DESCR
/end CHARACTERISTIC
/begin CHARACTERISTIC CT_FuelPumpWorkTimeForPP "cal comments" CURVE 0x91A8 2D_Array_UW 0.0 CM_Second_0to512 0.0 511.9921875
 /begin AXIS_DESCR FIX_AXIS NO_INPUT_QUANTITY CM_Equaloutput1 17 -28.0 164.0 MAX_GRAD 0.0 /begin FIX_AXIS_PAR_LIST -28 -16 -4 8 20 32 44 56 68 80 92 104 116 128 140 152 164 /end FIX_AXIS_PAR_LIST /end AXIS_DESCR
/end CHARACTERISTIC
/begin CHARACTERISTIC CT_IdleAirflowColdOffset "cal comments" CURVE 0x9EB8 2D_Array_UB 0.0 CM_Percent_0to100 0.0 99.609375
 /begin AXIS_DESCR FIX_AXIS NO_INPUT_QUANTITY CM_Equaloutput1 17 -28.0 164.0 MAX_GRAD 0.0 /begin FIX_AXIS_PAR_LIST -28 -16 -4 8 20 32 44 56 68 80 92 104 116 128 140 152 164 /end FIX_AXIS_PAR_LIST /end AXIS_DESCR
/end CHARACTERISTIC
/begin CHARACTERISTIC CT_IdleDerivEngSpdHigh "cal comments" CURVE 0x9ECB 2D_Array_UB 0.0 CM_Percent_0to100 0.0 99.609375
 /begin AXIS_DESCR FIX_AXIS NO_INPUT_QUANTITY CM_Equaloutput1 17 0.0 128.0 MAX_GRAD 0.0 /begin FIX_AXIS_PAR_LIST 0 8 16 24 32 40 48 56 64 72 80 88 96 104 112 120 128 /end FIX_AXIS_PAR_LIST /end AXIS_DESCR
/end CHARACTERISTIC
/begin CHARACTERISTIC CT_IdleDerivEngSpdLow "cal comments" CURVE 0x9EDE 2D_Array_UB 0.0 CM_Percent_0to100 0.0 99.609375
 /begin AXIS_DESCR FIX_AXIS NO_INPUT_QUANTITY CM_Equaloutput1 17 0.0 128.0 MAX_GRAD 0.0 /begin FIX_AXIS_PAR_LIST 0 8 16 24 32 40 48 56 64 72 80 88 96 104 112 120 128 /end FIX_AXIS_PAR_LIST /end AXIS_DESCR
/end CHARACTERISTIC
/begin CHARACTERISTIC CT_IdleDesireSpdStartup "cal comments" CURVE 0x9E1C 2D_Array_UW 0.0 CM_RPM_0to16384 0.0 16383.75
 /begin AXIS_DESCR FIX_AXIS NO_INPUT_QUANTITY CM_Equaloutput1 17 -28.0 164.0 MAX_GRAD 0.0 /begin FIX_AXIS_PAR_LIST -28 -16 -4 8 20 32 44 56 68 80 92 104 116 128 140 152 164 /end FIX_AXIS_PAR_LIST /end AXIS_DESCR
/end CHARACTERISTIC
/begin CHARACTERISTIC CT_IdleIntGainEngSpdHigh "cal comments" CURVE 0x2 2D_Array_UB 0.0 CM_Mult0_to_2_ratio1 0.0 1.9921875
 /begin AXIS_DESCR FIX_AXIS NO_INPUT_QUANTITY CM_Equaloutput1 11 0.0 500.0 MAX_GRAD 0.0 /begin FIX_AXIS_PAR_LIST 0 50 100 150 200 250 300 350 400 450 500 /end FIX_AXIS_PAR_LIST /end AXIS_DESCR
/end CHARACTERISTIC
/begin CHARACTERISTIC CT_IdleIntGainEngSpdLow "cal comments" CURVE 0x2 2D_Array_UB 0.0 CM_Mult0_to_2_ratio1 0.0 1.9921875
 /begin AXIS_DESCR FIX_AXIS NO_INPUT_QUANTITY CM_Equaloutput1 11 0.0 500.0 MAX_GRAD 0.0 /begin FIX_AXIS_PAR_LIST 0 50 100 150 200 250 300 350 400 450 500 /end FIX_AXIS_PAR_LIST /end AXIS_DESCR
/end CHARACTERISTIC
/begin CHARACTERISTIC CT_IdlePropEngSpdHigh "cal comments" CURVE 0x2 2D_Array_UB 0.0 CM_Percent_0to100 0.0 99.609375
 /begin AXIS_DESCR COM_AXIS NO_INPUT_QUANTITY CM_RPM_0to16384 17 0.0 16383.75 AXIS_PTS_REF CA_EngSpd17Step4 MAX_GRAD 0.0 /end AXIS_DESCR
/end CHARACTERISTIC
/begin CHARACTERISTIC CT_IdlePropEngSpdLow "cal comments" CURVE 0x2 2D_Array_UB 0.0 CM_Percent_0to100 0.0 99.609375
 /begin AXIS_DESCR COM_AXIS NO_INPUT_QUANTITY CM_RPM_0to16384 17 0.0 16383.75 AXIS_PTS_REF CA_EngSpd17Step4 MAX_GRAD 0.0 /end AXIS_DESCR
/end CHARACTERISTIC
/begin CHARACTERISTIC CT_InjectorOffset "cal comments" CURVE 0x9290 2D_Array_UB 0.0 CM_msec_0to4 0.0 3.984375
 /begin AXIS_DESCR FIX_AXIS NO_INPUT_QUANTITY CM_Equaloutput1 9 6.400000095367432 19.20000076293945 MAX_GRAD 0.0 /begin FIX_AXIS_PAR_LIST 6.4 8 9.6 11.2 12.8 14.4 16 17.6 19.2 /end FIX_AXIS_PAR_LIST /end AXIS_DESCR
/end CHARACTERISTIC
/begin CHARACTERISTIC CT_IntakeAirTemp "cal comments" CURVE 0xB5C2 2D_Array_SW 0.0 CM_DegC_N256to256 -256.0 255.9921875
 /begin AXIS_DESCR FIX_AXIS NO_INPUT_QUANTITY CM_Equaloutput1 33 0.0 100.0 MAX_GRAD 0.0
  /begin FIX_AXIS_PAR_LIST 0 3.125 6.25 9.375 12.5 15.625 18.75 21.875 25 28.125 31.25 34.375 37.5 40.625 43.75 46.875 50 53.125 56.25 59.375 62.5 65.625 68.75 71.875 75 78.125 81.25 84.375 87.5 90.625 93.75 96.875 100 /end FIX_AXIS_PAR_LIST
 /end AXIS_DESCR
/end CHARACTERISTIC
/begin CHARACTERISTIC CT_MAPCIDEnableMAPThresh "cal comments" CURVE 0xB64A 2D_Array_UB 0.0 CM_kpa_8bit 0.0 127.5
 /begin AXIS_DESCR FIX_AXIS NO_INPUT_QUANTITY CM_Equaloutput1 17 0.0 12800.0 MAX_GRAD 0.0
  /begin FIX_AXIS_PAR_LIST 0 800 1600 2400 3200 4000 4800 5600 6400 7200 8000 8800 9600 10400 11200 12000 12800 /end FIX_AXIS_PAR_LIST
 /end AXIS_DESCR
/end CHARACTERISTIC
/begin CHARACTERISTIC CT_MAPDefault "cal comments" CURVE 0xB6A4 2D_Array_UW 0.0 CM_kpa_0to256_1 0.0 255.99609375
 /begin AXIS_DESCR FIX_AXIS NO_INPUT_QUANTITY CM_Equaloutput1 11 55.0 105.0 MAX_GRAD 0.0 /begin FIX_AXIS_PAR_LIST 55 60 65 70 75 80 85 90 95 100 105 /end FIX_AXIS_PAR_LIST /end AXIS_DESCR
/end CHARACTERISTIC
/begin CHARACTERISTIC CT_MAPEstimateMain "cal comments" MAP 0xB303 3D_Array_UB 0.0 CM_kpa_8bit 0.0 127.5
 /begin AXIS_DESCR COM_AXIS NO_INPUT_QUANTITY CM_RPM_0to16384 17 0.0 16383.75 AXIS_PTS_REF CA_EngSpd17Step2 MAX_GRAD 0.0 /end AXIS_DESCR
 /begin AXIS_DESCR FIX_AXIS NO_INPUT_QUANTITY CM_Equaloutput1 33 0.0 100.0 MAX_GRAD 0.0
  /begin FIX_AXIS_PAR_LIST 0 3.125 6.25 9.375 12.5 15.625 18.75 21.875 25 28.125 31.25 34.375 37.5 40.625 43.75 46.875 50 53.125 56.25 59.375 62.5 65.625 68.75 71.875 75 78.125 81.25 84.375 87.5 90.625 93.75 96.875 100 /end FIX_AXIS_PAR_LIST
 /end AXIS_DESCR
/end CHARACTERISTIC
/begin CHARACTERISTIC CT_MAPReadAngleMain "cal comments" MAP 0xB25E 3D_Array_UW 0.0 CM_CrankAngle_0to1024 0.0 1023.984375
 /begin AXIS_DESCR COM_AXIS NO_INPUT_QUANTITY CM_kpa_0to256_1 9 0.0 255.99609375 AXIS_PTS_REF CA_MAP9Step1 MAX_GRAD 0.0 /end AXIS_DESCR
 /begin AXIS_DESCR COM_AXIS NO_INPUT_QUANTITY CM_RPM_0to16384 9 0.0 16383.75 AXIS_PTS_REF CA_EngSpd9Step1 MAX_GRAD 0.0 /end AXIS_DESCR
/end CHARACTERISTIC
/begin CHARACTERISTIC CT_O2ErrorCalcOffset "cal comments" CURVE 0x998A 2D_Array_UB 0.0 CM_mVolt 0.0 1016.0
 /begin AXIS_DESCR COM_AXIS NO_INPUT_QUANTITY CM_RPM_0to16384 13 0.0 16383.75 AXIS_PTS_REF CA_EngSpd13Step3 MAX_GRAD 0.0 /end AXIS_DESCR
/end CHARACTERISTIC
/begin CHARACTERISTIC CT_O2HeaterAccFuelMassThresh "cal comments" CURVE 0x9178 2D_Array_UW 0.0 CM_Grams0to8_1 0.0 7.999755859375
 /begin AXIS_DESCR FIX_AXIS NO_INPUT_QUANTITY CM_Equaloutput1 17 -28.0 164.0 MAX_GRAD 0.0 /begin FIX_AXIS_PAR_LIST -28 -16 -4 8 20 32 44 56 68 80 92 104 116 128 140 152 164 /end FIX_AXIS_PAR_LIST /end AXIS_DESCR
/end CHARACTERISTIC
/begin CHARACTERISTIC CT_O2HeaterDutyCycleMain "cal comments" CURVE 0xB224 2D_Array_UW 0.0 CM_Percent_0to200_2 0.0 199.9969024658203
 /begin AXIS_DESCR FIX_AXIS NO_INPUT_QUANTITY CM_Equaloutput1 17 -28.0 164.0 MAX_GRAD 0.0 /begin FIX_AXIS_PAR_LIST -28 -16 -4 8 20 32 44 56 68 80 92 104 116 128 140 152 164 /end FIX_AXIS_PAR_LIST /end AXIS_DESCR
/end CHARACTERISTIC
/begin CHARACTERISTIC CT_O2SignalFiltCoef "cal comments" CURVE 0x98FA 2D_Array_UB 0.0 CM_FiltCoef_1 0.0 0.99609375
 /begin AXIS_DESCR COM_AXIS NO_INPUT_QUANTITY CM_RPM_0to16384 13 0.0 16383.75 AXIS_PTS_REF CA_EngSpd13Step3 MAX_GRAD 0.0 /end AXIS_DESCR
/end CHARACTERISTIC
/begin CHARACTERISTIC CT_PowerEnrichDelayTime "cal comments" CURVE 0x95DA 2D_Array_UW 0.0 CM_Second_0to1024 0.0 1023.984375
 /begin AXIS_DESCR FIX_AXIS NO_INPUT_QUANTITY CM_Equaloutput1 17 0.0 12800.0 MAX_GRAD 0.0
  /begin FIX_AXIS_PAR_LIST 0 800 1600 2400 3200 4000 4800 5600 6400 7200 8000 8800 9600 10400 11200 12000 12800 /end FIX_AXIS_PAR_LIST
 /end AXIS_DESCR
/end CHARACTERISTIC
/begin CHARACTERISTIC CT_PowerEnrichEnbTPSThresh "cal comments" CURVE 0x9B5A 2D_Array_UB 0.0 CM_Percent_0to200_3 0.0 199.21875
 /begin AXIS_DESCR COM_AXIS NO_INPUT_QUANTITY CM_RPM_0to16384 17 0.0 16383.75 AXIS_PTS_REF CA_EngSpd17Step1 MAX_GRAD 0.0 /end AXIS_DESCR
/end CHARACTERISTIC
/begin CHARACTERISTIC CT_PowerEnrichExitDelay "cal comments" CURVE 0x96FE 2D_Array_UW 0.0 CM_Second_0to1024 0.0 1023.984375
 /begin AXIS_DESCR FIX_AXIS NO_INPUT_QUANTITY CM_Equaloutput1 17 0.0 12800.0 MAX_GRAD 0.0
  /begin FIX_AXIS_PAR_LIST 0 800 1600 2400 3200 4000 4800 5600 6400 7200 8000 8800 9600 10400 11200 12000 12800 /end FIX_AXIS_PAR_LIST
 /end AXIS_DESCR
/end CHARACTERISTIC
/begin CHARACTERISTIC CT_PrimePulseBaroMult "cal comments" CURVE 0x9242 2D_Array_UB 0.0 CM_Mult0_to_2_ratio 0.0 1.9921875
 /begin AXIS_DESCR FIX_AXIS NO_INPUT_QUANTITY CM_Equaloutput1 6 55.0 105.0 MAX_GRAD 0.0 /begin FIX_AXIS_PAR_LIST 55 65 75 85 95 105 /end FIX_AXIS_PAR_LIST /end AXIS_DESCR
/end CHARACTERISTIC
/begin CHARACTERISTIC CT_PrimePulseDelay "cal comments" CURVE 0x920A 2D_Array_UB 0.0 CM_Mult0_to_2_second 0.0 1.9921875
 /begin AXIS_DESCR FIX_AXIS NO_INPUT_QUANTITY CM_Equaloutput1 17 -28.0 164.0 MAX_GRAD 0.0 /begin FIX_AXIS_PAR_LIST -28 -16 -4 8 20 32 44 56 68 80 92 104 116 128 140 152 164 /end FIX_AXIS_PAR_LIST /end AXIS_DESCR
/end CHARACTERISTIC
/begin CHARACTERISTIC CT_PrimePulseWidth "cal comments" CURVE 0x9740 2D_Array_UW 0.0 CM_msec_0to1024 0.0 1023.984375
 /begin AXIS_DESCR FIX_AXIS NO_INPUT_QUANTITY CM_Equaloutput1 17 -28.0 164.0 MAX_GRAD 0.0 /begin FIX_AXIS_PAR_LIST -28 -16 -4 8 20 32 44 56 68 80 92 104 116 128 140 152 164 /end FIX_AXIS_PAR_LIST /end AXIS_DESCR
/end CHARACTERISTIC
/begin CHARACTERISTIC CT_PrimePulseWidth_NG "cal comments" CURVE 0x9764 2D_Array_UW 0.0 CM_msec_0to1024 0.0 1023.984375
 /begin AXIS_DESCR FIX_AXIS NO_INPUT_QUANTITY CM_Equaloutput1 17 -28.0 164.0 MAX_GRAD 0.0 /begin FIX_AXIS_PAR_LIST -28 -16 -4 8 20 32 44 56 68 80 92 104 116 128 140 152 164 /end FIX_AXIS_PAR_LIST /end AXIS_DESCR
/end CHARACTERISTIC
/begin CHARACTERISTIC CT_PrimePulseWidth_LPG "cal comments" CURVE 0x9788 2D_Array_UW 0.0 CM_msec_0to1024 0.0 1023.984375
 /begin AXIS_DESCR FIX_AXIS NO_INPUT_QUANTITY CM_Equaloutput1 17 -28.0 164.0 MAX_GRAD 0.0 /begin FIX_AXIS_PAR_LIST -28 -16 -4 8 20 32 44 56 68 80 92 104 116 128 140 152 164 /end FIX_AXIS_PAR_LIST /end AXIS_DESCR
/end CHARACTERISTIC
/begin CHARACTERISTIC CT_RunTimeThreshToEnbNextPrimePulse "cal comments" CURVE 0x921E 2D_Array_UW 0.0 CM_Second_0to512 0.0 511.9921875
 /begin AXIS_DESCR FIX_AXIS NO_INPUT_QUANTITY CM_Equaloutput1 17 -28.0 164.0 MAX_GRAD 0.0 /begin FIX_AXIS_PAR_LIST -28 -16 -4 8 20 32 44 56 68 80 92 104 116 128 140 152 164 /end FIX_AXIS_PAR_LIST /end AXIS_DESCR
/end CHARACTERISTIC
/begin CHARACTERISTIC CT_SACoolTempOfst "cal comments" MAP 0xA3A3 D_Array_SB 0.0 CM_Angle_8bit -64.0 63.5
 /begin AXIS_DESCR FIX_AXIS NO_INPUT_QUANTITY CM_Equaloutput1 17 -28.0 164.0 MAX_GRAD 0.0 /begin FIX_AXIS_PAR_LIST -28 -16 -4 8 20 32 44 56 68 80 92 104 116 128 140 152 164 /end FIX_AXIS_PAR_LIST /end AXIS_DESCR
 /begin AXIS_DESCR FIX_AXIS NO_INPUT_QUANTITY CM_Equaloutput1 9 15.0 115.0 MAX_GRAD 0.0 /begin FIX_AXIS_PAR_LIST 15 27.5 40 52.5 65 77.5 90 102.5 115 /end FIX_AXIS_PAR_LIST /end AXIS_DESCR
/end CHARACTERISTIC
/begin CHARACTERISTIC CT_SACrankBaroOffset "cal comments" CURVE 0xAF1C 2D_Array_SB 0.0 CM_Angle_8bit -64.0 63.5
 /begin AXIS_DESCR FIX_AXIS NO_INPUT_QUANTITY CM_Equaloutput1 11 55.0 105.0 MAX_GRAD 0.0 /begin FIX_AXIS_PAR_LIST 55 60 65 70 75 80 85 90 95 100 105 /end FIX_AXIS_PAR_LIST /end AXIS_DESCR
/end CHARACTERISTIC
/begin CHARACTERISTIC CT_SACrankMain "cal comments" CURVE 0xAEF6 2D_Array_SB 0.0 CM_Angle_8bit -64.0 63.5
 /begin AXIS_DESCR FIX_AXIS NO_INPUT_QUANTITY CM_Equaloutput1 17 -28.0 164.0 MAX_GRAD 0.0 /begin FIX_AXIS_PAR_LIST -28 -16 -4 8 20 32 44 56 68 80 92 104 116 128 140 152 164 /end FIX_AXIS_PAR_LIST /end AXIS_DESCR
/end CHARACTERISTIC
/begin CHARACTERISTIC CT_SAIntakeAirTempOfst "cal comments" MAP 0xA307 D_Array_SB 0.0 CM_Angle_8bit -64.0 63.5
 /begin AXIS_DESCR FIX_AXIS NO_INPUT_QUANTITY CM_Equaloutput1 17 -28.0 164.0 MAX_GRAD 0.0 /begin FIX_AXIS_PAR_LIST -28 -16 -4 8 20 32 44 56 68 80 92 104 116 128 140 152 164 /end FIX_AXIS_PAR_LIST /end AXIS_DESCR
 /begin AXIS_DESCR FIX_AXIS NO_INPUT_QUANTITY CM_Equaloutput1 9 15.0 115.0 MAX_GRAD 0.0 /begin FIX_AXIS_PAR_LIST 15 27.5 40 52.5 65 77.5 90 102.5 115 /end FIX_AXIS_PAR_LIST /end AXIS_DESCR
/end CHARACTERISTIC
/begin CHARACTERISTIC CT_SAPEMainCyl1 "cal comments" MAP 0xAE47 D_Array_SB 0.0 CM_Angle_8bit -64.0 63.5
 /begin AXIS_DESCR FIX_AXIS NO_INPUT_QUANTITY CM_Equaloutput1 6 50.0 100.0 MAX_GRAD 0.0 /begin FIX_AXIS_PAR_LIST 50 60 70 80 90 100 /end FIX_AXIS_PAR_LIST /end AXIS_DESCR
 /begin AXIS_DESCR COM_AXIS NO_INPUT_QUANTITY CM_RPM_0to16384 17 0.0 16383.75 AXIS_PTS_REF CA_EngSpd17Step3 MAX_GRAD 0.0 /end AXIS_DESCR
/end CHARACTERISTIC
/begin CHARACTERISTIC CT_SparkAdvanceMain "cal comments" MAP 0xA43F D_Array_SB 0.0 CM_Angle_8bit -64.0 63.5
 /begin AXIS_DESCR COM_AXIS NO_INPUT_QUANTITY CM_kpa_0to256_1 18 0.0 255.99609375 AXIS_PTS_REF CA_MAP18Step1 MAX_GRAD 0.0 /end AXIS_DESCR
 /begin AXIS_DESCR COM_AXIS NO_INPUT_QUANTITY CM_RPM_0to16384 17 0.0 16383.75 AXIS_PTS_REF CA_EngSpd17Step1 MAX_GRAD 0.0 /end AXIS_DESCR
/end CHARACTERISTIC
/begin CHARACTERISTIC CT_SparkAdvanceCyl2Offset2Main "cal comments" MAP 0xA574 D_Array_SB 0.0 CM_Angle_8bit -64.0 63.5
 /begin AXIS_DESCR COM_AXIS NO_INPUT_QUANTITY CM_kpa_0to256_1 18 0.0 255.99609375 AXIS_PTS_REF CA_MAP18Step1 MAX_GRAD 0.0 /end AXIS_DESCR
 /begin AXIS_DESCR COM_AXIS NO_INPUT_QUANTITY CM_RPM_0to16384 17 0.0 16383.75 AXIS_PTS_REF CA_EngSpd17Step1 MAX_GRAD 0.0 /end AXIS_DESCR
/end CHARACTERISTIC
/begin CHARACTERISTIC CT_SparkAdvanceCyl3Offset2Main "cal comments" MAP 0xA6A9 D_Array_SB 0.0 CM_Angle_8bit -64.0 63.5
 /begin AXIS_DESCR COM_AXIS NO_INPUT_QUANTITY CM_kpa_0to256_1 18 0.0 255.99609375 AXIS_PTS_REF CA_MAP18Step1 MAX_GRAD 0.0 /end AXIS_DESCR
 /begin AXIS_DESCR COM_AXIS NO_INPUT_QUANTITY CM_RPM_0to16384 17 0.0 16383.75 AXIS_PTS_REF CA_EngSpd17Step1 MAX_GRAD 0.0 /end AXIS_DESCR
/end CHARACTERISTIC
/begin CHARACTERISTIC CT_SparkAdvanceCyl4Offset2Main "cal comments" MAP 0xA7DE D_Array_SB 0.0 CM_Angle_8bit -64.0 63.5
 /begin AXIS_DESCR COM_AXIS NO_INPUT_QUANTITY CM_kpa_0to256_1 18 0.0 255.99609375 AXIS_PTS_REF CA_MAP18Step1 MAX_GRAD 0.0 /end AXIS_DESCR
 /begin AXIS_DESCR COM_AXIS NO_INPUT_QUANTITY CM_RPM_0to16384 17 0.0 16383.75 AXIS_PTS_REF CA_EngSpd17Step1 MAX_GRAD 0.0 /end AXIS_DESCR
/end CHARACTERISTIC
/begin CHARACTERISTIC CT_SparkAdvanceSub "cal comments" MAP 0xA913 D_Array_SB 0.0 CM_Angle_8bit -64.0 63.5
 /begin AXIS_DESCR COM_AXIS NO_INPUT_QUANTITY CM_kpa_0to256_1 18 0.0 255.99609375 AXIS_PTS_REF CA_MAP18Step1 MAX_GRAD 0.0 /end AXIS_DESCR
 /begin AXIS_DESCR COM_AXIS NO_INPUT_QUANTITY CM_RPM_0to16384 17 0.0 16383.75 AXIS_PTS_REF CA_EngSpd17Step1 MAX_GRAD 0.0 /end AXIS_DESCR
/end CHARACTERISTIC
/begin CHARACTERISTIC CT_SparkAdvanceCyl2Offset2Sub "cal comments" MAP 0xAA48 D_Array_SB 0.0 CM_Angle_8bit -64.0 63.5
 /begin AXIS_DESCR COM_AXIS NO_INPUT_QUANTITY CM_kpa_0to256_1 18 0.0 255.99609375 AXIS_PTS_REF CA_MAP18Step1 MAX_GRAD 0.0 /end AXIS_DESCR
 /begin AXIS_DESCR COM_AXIS NO_INPUT_QUANTITY CM_RPM_0to16384 17 0.0 16383.75 AXIS_PTS_REF CA_EngSpd17Step1 MAX_GRAD 0.0 /end AXIS_DESCR
/end CHARACTERISTIC
/begin CHARACTERISTIC CT_SparkAdvanceCyl3Offset2Sub "cal comments" MAP 0xAB7D D_Array_SB 0.0 CM_Angle_8bit -64.0 63.5
 /begin AXIS_DESCR COM_AXIS NO_INPUT_QUANTITY CM_kpa_0to256_1 18 0.0 255.99609375 AXIS_PTS_REF CA_MAP18Step1 MAX_GRAD 0.0 /end AXIS_DESCR
 /begin AXIS_DESCR COM_AXIS NO_INPUT_QUANTITY CM_RPM_0to16384 17 0.0 16383.75 AXIS_PTS_REF CA_EngSpd17Step1 MAX_GRAD 0.0 /end AXIS_DESCR
/end CHARACTERISTIC
/begin CHARACTERISTIC CT_SparkAdvanceCyl4Offset2Sub "cal comments" MAP 0xACB2 D_Array_SB 0.0 CM_Angle_8bit -64.0 63.5
 /begin AXIS_DESCR COM_AXIS NO_INPUT_QUANTITY CM_kpa_0to256_1 18 0.0 255.99609375 AXIS_PTS_REF CA_MAP18Step1 MAX_GRAD 0.0 /end AXIS_DESCR
 /begin AXIS_DESCR COM_AXIS NO_INPUT_QUANTITY CM_RPM_0to16384 17 0.0 16383.75 AXIS_PTS_REF CA_EngSpd17Step1 MAX_GRAD 0.0 /end AXIS_DESCR
/end CHARACTERISTIC
/begin CHARACTERISTIC C_PickupTooth2TDCAngle "cal comments" VALUE 0x8016 Scalar_SW 0.0 CM_SparkAngle_N256to256 -256.0 255.9921875 /end CHARACTERISTIC
/begin CHARACTERISTIC CT_SAIdleMain "cal comments" CURVE 0xAF09 2D_Array_SB 0.0 CM_Angle_8bit -64.0 63.5
 /begin AXIS_DESCR FIX_AXIS NO_INPUT_QUANTITY CM_Equaloutput1 17 -28.0 164.0 MAX_GRAD 0.0 /begin FIX_AXIS_PAR_LIST -28 -16 -4 8 20 32 44 56 68 80 92 104 116 128 140 152 164 /end FIX_AXIS_PAR_LIST /end AXIS_DESCR
/end CHARACTERISTIC
/begin CHARACTERISTIC CT_SAIdleLimit "cal comments" CURVE 0xADE6 2D_Array_SB 0.0 CM_Angle_8bit -64.0 63.5
 /begin AXIS_DESCR COM_AXIS NO_INPUT_QUANTITY CM_RPM_0to16384 6 0.0 16383.75 AXIS_PTS_REF CA_EngSpd6Step1 MAX_GRAD 0.0 /end AXIS_DESCR
/end CHARACTERISTIC
/begin CHARACTERISTIC CT_SAIdleRPMoffset "cal comments" CURVE 0xAEB2 2D_Array_SB 0.0 CM_Angle_8bit -64.0 63.5
 /begin AXIS_DESCR COM_AXIS NO_INPUT_QUANTITY CM_RPM_0to16384 6 0.0 16383.75 AXIS_PTS_REF CA_EngSpd6Step1 MAX_GRAD 0.0 /end AXIS_DESCR
/end CHARACTERISTIC
/begin CHARACTERISTIC CT_SAIdleBaroComp "cal comments" CURVE 0xADEE 2D_Array_SB 0.0 CM_Angle_8bit -64.0 63.5
 /begin AXIS_DESCR FIX_AXIS NO_INPUT_QUANTITY CM_Equaloutput1 11 55.0 105.0 MAX_GRAD 0.0 /begin FIX_AXIS_PAR_LIST 55 60 65 70 75 80 85 90 95 100 105 /end FIX_AXIS_PAR_LIST /end AXIS_DESCR
/end CHARACTERISTIC
/begin CHARACTERISTIC CT_SAIdleBattComp "cal comments" CURVE 0xADFB 2D_Array_SB 0.0 CM_Angle_8bit -64.0 63.5
 /begin AXIS_DESCR FIX_AXIS NO_INPUT_QUANTITY CM_Equaloutput1 17 6.0 18.79999923706055 MAX_GRAD 0.0
  /begin FIX_AXIS_PAR_LIST 6 6.8 7.6 8.4 9.199999999999999 10 10.8 11.6 12.4 13.2 14 14.8 15.6 16.4 17.2 18 18.8 /end FIX_AXIS_PAR_LIST
 /end AXIS_DESCR
/end CHARACTERISTIC
/begin CHARACTERISTIC CT_SAIdleDyn "cal comments" CURVE 0xAE0E 2D_Array_SB 0.0 CM_Angle_8bit -64.0 63.5
 /begin AXIS_DESCR FIX_AXIS NO_INPUT_QUANTITY CM_Equaloutput1 33 -512.0 512.0 MAX_GRAD 0.0
  /begin FIX_AXIS_PAR_LIST -512 -480 -448 -416 -384 -352 -320 -288 -256 -224 -192 -160 -128 -96 -64 -32 0 32 64 96 128 160 192 224 256 288 320 352 384 416 448 480 512 /end FIX_AXIS_PAR_LIST
 /end AXIS_DESCR
/end CHARACTERISTIC
/begin CHARACTERISTIC C_SPRK_t_CtoIDLE_DelayTime "cal comments" VALUE 0xAE30 Scalar_UW 0.0 CM_Seconds_1 0.0 2047.96875 /end CHARACTERISTIC
/begin CHARACTERISTIC C_SPRK_t_RtoIDLE_DelayTime "cal comments" VALUE 0xAE32 Scalar_UW 0.0 CM_Seconds_1 0.0 2047.96875 /end CHARACTERISTIC
/begin CHARACTERISTIC CT_SparkDwellIntakeAirTempMult "cal comments" CURVE 0xAEBA 2D_Array_UB 0.0 CM_Mult0_to_2_ratio 0.0 1.9921875
 /begin AXIS_DESCR FIX_AXIS NO_INPUT_QUANTITY CM_Equaloutput1 9 -28.0 36.0 MAX_GRAD 0.0 /begin FIX_AXIS_PAR_LIST -28 -20 -12 -4 4 12 20 28 36 /end FIX_AXIS_PAR_LIST /end AXIS_DESCR
/end CHARACTERISTIC
/begin CHARACTERISTIC CT_SparkDwellMain "cal comments" MAP 0xA1E3 3D_Array_UB 0.0 CM_msec 0.0 15.9375
 /begin AXIS_DESCR FIX_AXIS NO_INPUT_QUANTITY CM_Equaloutput1 17 6.0 18.79999923706055 MAX_GRAD 0.0
  /begin FIX_AXIS_PAR_LIST 6 6.8 7.6 8.4 9.199999999999999 10 10.8 11.6 12.4 13.2 14 14.8 15.6 16.4 17.2 18 18.8 /end FIX_AXIS_PAR_LIST
 /end AXIS_DESCR
 /begin AXIS_DESCR FIX_AXIS NO_INPUT_QUANTITY CM_Equaloutput1 17 0.0 12800.0 MAX_GRAD 0.0
  /begin FIX_AXIS_PAR_LIST 0 800 1600 2400 3200 4000 4800 5600 6400 7200 8000 8800 9600 10400 11200 12000 12800 /end FIX_AXIS_PAR_LIST
 /end AXIS_DESCR
/end CHARACTERISTIC
/begin CHARACTERISTIC CT_SparkDwellMaxLimit "cal comments" CURVE 0xAE36 2D_Array_UB 0.0 CM_msec 0.0 15.9375
 /begin AXIS_DESCR FIX_AXIS NO_INPUT_QUANTITY CM_Equaloutput1 9 0.0 12800.0 MAX_GRAD 0.0 /begin FIX_AXIS_PAR_LIST 0 1600 3200 4800 6400 8000 9600 11200 12800 /end FIX_AXIS_PAR_LIST /end AXIS_DESCR
/end CHARACTERISTIC
/begin CHARACTERISTIC CT_SpeedControlDerivLvlMult "cal comments" CURVE 0x9E04 2D_Array_UW 0.0 udf_CM_18376 0.0 15.999755859375
 /begin AXIS_DESCR FIX_AXIS NO_INPUT_QUANTITY CM_Equaloutput1 5 1.0 5.0 MAX_GRAD 0.0 /begin FIX_AXIS_PAR_LIST 1 2 3 4 5 /end FIX_AXIS_PAR_LIST /end AXIS_DESCR
/end CHARACTERISTIC
/begin CHARACTERISTIC CT_SpeedControlFlowBaroMult "cal comments" CURVE 0x9EF1 2D_Array_UB 0.0 CM_Mult_0to8 0.0 7.96875
 /begin AXIS_DESCR FIX_AXIS NO_INPUT_QUANTITY CM_Equaloutput1 6 55.0 105.0 MAX_GRAD 0.0 /begin FIX_AXIS_PAR_LIST 55 65 75 85 95 105 /end FIX_AXIS_PAR_LIST /end AXIS_DESCR
/end CHARACTERISTIC
/begin CHARACTERISTIC CT_ThrottleFlow "cal comments" CURVE 0x9E44 2D_Array_UW 0.0 udf_CM_18698 0.0 511.9921875
 /begin AXIS_DESCR COM_AXIS NO_INPUT_QUANTITY CM_Percent_0to200_2 21 0.0 199.9969024658203 AXIS_PTS_REF CA_PercentStep21 MAX_GRAD 0.0 /end AXIS_DESCR
/end CHARACTERISTIC
/begin CHARACTERISTIC CT_ThrottleFlow_Reverse "cal comments" CURVE 0x9E70 2D_Array_UW 0.0 CM_Percent_0to200_2 0.0 199.9969024658203
 /begin AXIS_DESCR COM_AXIS NO_INPUT_QUANTITY udf_CM_18705 21 0.0 511.9921875 AXIS_PTS_REF CA_GramStep21 MAX_GRAD 0.0 /end AXIS_DESCR
/end CHARACTERISTIC
/begin CHARACTERISTIC CT_TimpPulseWidthMult "cal comments" MAP 0x9B73 3D_Array_UB 0.0 CM_Mult_0to8 0.0 7.96875
 /begin AXIS_DESCR FIX_AXIS NO_INPUT_QUANTITY CM_Equaloutput1 9 -28.0 164.0 MAX_GRAD 0.0 /begin FIX_AXIS_PAR_LIST -28 -4 20 44 68 92 116 140 164 /end FIX_AXIS_PAR_LIST /end AXIS_DESCR
 /begin AXIS_DESCR FIX_AXIS NO_INPUT_QUANTITY CM_Equaloutput1 6 800.0 2800.0 MAX_GRAD 0.0 /begin FIX_AXIS_PAR_LIST 800 1200 1600 2000 2400 2800 /end FIX_AXIS_PAR_LIST /end AXIS_DESCR
/end CHARACTERISTIC
/begin CHARACTERISTIC CT_VEAltCorrFactor "cal comments" MAP 0x8E73 3D_Array_UB 0.0 CM_Mult0_to_2_ratio 0.0 1.9921875
 /begin AXIS_DESCR COM_AXIS NO_INPUT_QUANTITY CM_kpa_0to256_1 6 0.0 255.99609375 AXIS_PTS_REF CA_VELoad6Step MAX_GRAD 0.0 /end AXIS_DESCR
 /begin AXIS_DESCR FIX_AXIS NO_INPUT_QUANTITY CM_Equaloutput1 11 55.0 105.0 MAX_GRAD 0.0 /begin FIX_AXIS_PAR_LIST 55 60 65 70 75 80 85 90 95 100 105 /end FIX_AXIS_PAR_LIST /end AXIS_DESCR
/end CHARACTERISTIC
/begin CHARACTERISTIC CT_VEMainHighLoadCyl1 "cal comments" MAP 0x82B2 3D_Array_UW 0.0 CM_Percent_0to200_2 0.0 199.9969024658203
 /begin AXIS_DESCR COM_AXIS NO_INPUT_QUANTITY CM_kpa_0to256_1 22 0.0 255.99609375 AXIS_PTS_REF CA_MAP22Step1 MAX_GRAD 0.0 /end AXIS_DESCR
 /begin AXIS_DESCR COM_AXIS NO_INPUT_QUANTITY CM_RPM_0to16384 17 0.0 16383.75 AXIS_PTS_REF CA_EngSpd17Step1 MAX_GRAD 0.0 /end AXIS_DESCR
/end CHARACTERISTIC
/begin CHARACTERISTIC CT_VEMainHighLoadCyl2 "cal comments" MAP 0x85A2 3D_Array_UW 0.0 CM_Percent_0to200_2 0.0 199.9969024658203
 /begin AXIS_DESCR COM_AXIS NO_INPUT_QUANTITY CM_kpa_0to256_1 22 0.0 255.99609375 AXIS_PTS_REF CA_MAP22Step1 MAX_GRAD 0.0 /end AXIS_DESCR
 /begin AXIS_DESCR COM_AXIS NO_INPUT_QUANTITY CM_RPM_0to16384 17 0.0 16383.75 AXIS_PTS_REF CA_EngSpd17Step1 MAX_GRAD 0.0 /end AXIS_DESCR
/end CHARACTERISTIC
/begin CHARACTERISTIC CT_VEMainHighLoadCyl3 "cal comments" MAP 0x8892 3D_Array_UW 0.0 CM_Percent_0to200_2 0.0 199.9969024658203
 /begin AXIS_DESCR COM_AXIS NO_INPUT_QUANTITY CM_kpa_0to256_1 22 0.0 255.99609375 AXIS_PTS_REF CA_MAP22Step1 MAX_GRAD 0.0 /end AXIS_DESCR
 /begin AXIS_DESCR COM_AXIS NO_INPUT_QUANTITY CM_RPM_0to16384 17 0.0 16383.75 AXIS_PTS_REF CA_EngSpd17Step1 MAX_GRAD 0.0 /end AXIS_DESCR
/end CHARACTERISTIC
/begin CHARACTERISTIC CT_VEMainHighLoadCyl4 "cal comments" MAP 0x8B82 3D_Array_UW 0.0 CM_Percent_0to200_2 0.0 199.9969024658203
 /begin AXIS_DESCR COM_AXIS NO_INPUT_QUANTITY CM_kpa_0to256_1 22 0.0 255.99609375 AXIS_PTS_REF CA_MAP22Step1 MAX_GRAD 0.0 /end AXIS_DESCR
 /begin AXIS_DESCR COM_AXIS NO_INPUT_QUANTITY CM_RPM_0to16384 17 0.0 16383.75 AXIS_PTS_REF CA_EngSpd17Step1 MAX_GRAD 0.0 /end AXIS_DESCR
/end CHARACTERISTIC
/begin CHARACTERISTIC C_VESynForCalEn "cal comments" VALUE 0x8E6E Scalar_UB 0.0 CM_Boolean6 0.0 255.0 /end CHARACTERISTIC
/begin CHARACTERISTIC C_VETriFuelEn "cal comments" VALUE 0x8E6F Scalar_UB 0.0 CM_Boolean6 0.0 255.0 /end CHARACTERISTIC
/begin CHARACTERISTIC CT_VirtualTPS "cal comments" CURVE 0xB250 2D_Array_UB 0.0 CM_Percent_0to200_3 0.0 199.21875
 /begin AXIS_DESCR COM_AXIS NO_INPUT_QUANTITY CM_kpa_0to256_1 10 0.0 255.99609375 AXIS_PTS_REF CA_MAP10Step1 MAX_GRAD 0.0 /end AXIS_DESCR
/end CHARACTERISTIC
/begin CHARACTERISTIC D_BatteryVoltTooHighThresh "cal comments" VALUE 0xC33A Scalar_UW 0.0 CM_Volt_0to32_2 0.0 31.99900627136231 /end CHARACTERISTIC
/begin CHARACTERISTIC D_BatteryVoltTooLowThresh "cal comments" VALUE 0xC33C Scalar_UW 0.0 CM_Volt_0to32_2 0.0 31.99900627136231 /end CHARACTERISTIC
/begin CHARACTERISTIC D_BatVoltDiagPassTimeThrsh "cal comments" VALUE 0xC370 Scalar_UW 0.0 CM_Count_0to65535_2 0.0 65535.0 /end CHARACTERISTIC
/begin CHARACTERISTIC D_BatVoltEnb "cal comments" VALUE 0xC376 Scalar_UB 0.0 CM_Boolean6 0.0 255.0 /end CHARACTERISTIC
/begin CHARACTERISTIC D_BatVoltHighFailTimeThrsh "cal comments" VALUE 0xC36E Scalar_UW 0.0 CM_Count_0to65535_2 0.0 65535.0 /end CHARACTERISTIC
/begin CHARACTERISTIC D_BatVoltLightEnb "cal comments" VALUE 0xC377 Scalar_UB 0.0 CM_Boolean6 0.0 255.0 /end CHARACTERISTIC
/begin CHARACTERISTIC D_BatVoltLowFailTimeThrsh "cal comments" VALUE 0xC36C Scalar_UW 0.0 CM_Count_0to65535_2 0.0 65535.0 /end CHARACTERISTIC
/begin CHARACTERISTIC D_BatVoltRangeThreshHi "cal comments" VALUE 0xC374 Scalar_UW 0.0 CM_Volt_0to32_1 0.0 31.99900627136231 /end CHARACTERISTIC
/begin CHARACTERISTIC D_BatVoltRangeThreshLo "cal comments" VALUE 0xC372 Scalar_UW 0.0 CM_Volt_0to32_1 0.0 31.99900627136231 /end CHARACTERISTIC
/begin CHARACTERISTIC D_GENVDiagPassTimeThrsh "cal comments" VALUE 0x0 Scalar_UW 0.0 CM_Count_0to65535_2 0.0 65535.0 /end CHARACTERISTIC
/begin CHARACTERISTIC D_GENVEnb "cal comments" VALUE 0x0 Scalar_UB 0.0 CM_Boolean6 0.0 255.0 /end CHARACTERISTIC
/begin CHARACTERISTIC D_GENVHighFailTimeThrsh "cal comments" VALUE 0x0 Scalar_UW 0.0 CM_Count_0to65535_2 0.0 65535.0 /end CHARACTERISTIC
/begin CHARACTERISTIC D_GENVLightEnb "cal comments" VALUE 0x0 Scalar_UB 0.0 CM_Boolean6 0.0 255.0 /end CHARACTERISTIC
/begin CHARACTERISTIC D_GENVLowFailTimeThrsh "cal comments" VALUE 0x0 Scalar_UW 0.0 CM_Count_0to65535_2 0.0 65535.0 /end CHARACTERISTIC
/begin CHARACTERISTIC D_GENVRangeThreshHi "cal comments" VALUE 0x0 Scalar_UW 0.0 CM_Volt_0to1024_1 0.0 1023.984375 /end CHARACTERISTIC
/begin CHARACTERISTIC D_GENVRangeThreshLo "cal comments" VALUE 0x0 Scalar_UW 0.0 CM_Volt_0to1024_1 0.0 1023.984375 /end CHARACTERISTIC
/begin CHARACTERISTIC D_CoolTempShortEnb "cal comments" VALUE 0xC212 Scalar_UB 0.0 CM_Boolean6 0.0 255.0 /end CHARACTERISTIC
/begin CHARACTERISTIC D_CoolTempShortLightEnb "cal comments" VALUE 0xC213 Scalar_UB 0.0 CM_Boolean6 0.0 255.0 /end CHARACTERISTIC
/begin CHARACTERISTIC D_CoolTempFailTimeThrsh "cal comments" VALUE 0xC206 Scalar_UW 0.0 CM_Count_0to65535_1 0.0 65535.0 /end CHARACTERISTIC
/begin CHARACTERISTIC D_CoolTempPassTimeThrsh "cal comments" VALUE 0xC208 Scalar_UW 0.0 CM_Count_0to65535_1 0.0 65535.0 /end CHARACTERISTIC
/begin CHARACTERISTIC D_CoolTempShortRangeThreshHi "cal comments" VALUE 0xC20A Scalar_UW 0.0 CM_Percent_0to100_1 0.0 99.9984130859375 /end CHARACTERISTIC
/begin CHARACTERISTIC D_CoolTempShortRangeThreshLo "cal comments" VALUE 0xC20C Scalar_UW 0.0 CM_Percent_0to100_1 0.0 99.9984130859375 /end CHARACTERISTIC
/begin CHARACTERISTIC D_CoolTempOverHeatLightEnb "cal comments" VALUE 0xC214 Scalar_UB 0.0 CM_Boolean6 0.0 255.0 /end CHARACTERISTIC
/begin CHARACTERISTIC D_CoolTempOverHeatThresh "cal comments" VALUE 0xC20E Scalar_SW 0.0 CM_DegC_N256to256 -256.0 255.9921875 /end CHARACTERISTIC
/begin CHARACTERISTIC D_CoolTempOverHeat2Thresh "cal comments" VALUE 0xC210 Scalar_SW 0.0 CM_DegC_N256to256 -256.0 255.9921875 /end CHARACTERISTIC
/begin CHARACTERISTIC D_CoolTemp2ShortEnb "cal comments" VALUE 0xC21E Scalar_UB 0.0 CM_Boolean6 0.0 255.0 /end CHARACTERISTIC
/begin CHARACTERISTIC D_CoolTemp2ShortLightEnb "cal comments" VALUE 0xC21F Scalar_UB 0.0 CM_Boolean6 0.0 255.0 /end CHARACTERISTIC
/begin CHARACTERISTIC D_CoolTemp2FailTimeThrsh "cal comments" VALUE 0xC216 Scalar_UW 0.0 CM_Count_0to65535_1 0.0 65535.0 /end CHARACTERISTIC
/begin CHARACTERISTIC D_CoolTemp2PassTimeThrsh "cal comments" VALUE 0xC218 Scalar_UW 0.0 CM_Count_0to65535_1 0.0 65535.0 /end CHARACTERISTIC
/begin CHARACTERISTIC D_CoolTemp2ShortRangeThreshHi "cal comments" VALUE 0xC21A Scalar_UW 0.0 CM_Percent_0to100_1 0.0 99.9984130859375 /end CHARACTERISTIC
/begin CHARACTERISTIC D_CoolTemp2ShortRangeThreshLo "cal comments" VALUE 0xC21C Scalar_UW 0.0 CM_Percent_0to100_1 0.0 99.9984130859375 /end CHARACTERISTIC
/begin CHARACTERISTIC D_FPShortEnb "cal comments" VALUE 0xC25C Scalar_UB 0.0 CM_Boolean6 0.0 255.0 /end CHARACTERISTIC
/begin CHARACTERISTIC D_FPShortLightEnb "cal comments" VALUE 0xC25D Scalar_UB 0.0 CM_Boolean6 0.0 255.0 /end CHARACTERISTIC
/begin CHARACTERISTIC D_FPFailTimeThrsh "cal comments" VALUE 0xC254 Scalar_UW 0.0 CM_Count_0to65535_1 0.0 65535.0 /end CHARACTERISTIC
/begin CHARACTERISTIC D_FPPassTimeThrsh "cal comments" VALUE 0xC256 Scalar_UW 0.0 CM_Count_0to65535_1 0.0 65535.0 /end CHARACTERISTIC
/begin CHARACTERISTIC D_FPShortRangeThreshHi "cal comments" VALUE 0xC258 Scalar_UW 0.0 CM_Percent_0to100_1 0.0 99.9984130859375 /end CHARACTERISTIC
/begin CHARACTERISTIC D_FPShortRangeThreshLo "cal comments" VALUE 0xC25A Scalar_UW 0.0 CM_Percent_0to100_1 0.0 99.9984130859375 /end CHARACTERISTIC
/begin CHARACTERISTIC D_CrankNoisySignalFailTimeThrsh "cal comments" VALUE 0xC236 Scalar_UW 0.0 CM_Count_0to65535 0.0 65535.0 /end CHARACTERISTIC
/begin CHARACTERISTIC D_CrankNoisySignalPassTimeThrsh "cal comments" VALUE 0xC238 Scalar_UW 0.0 CM_Count_0to65535 0.0 65535.0 /end CHARACTERISTIC
/begin CHARACTERISTIC D_CrankNoisySignalToothErrThrsh "cal comments" VALUE 0xC234 Scalar_UW 0.0 CM_Count_0to65535 0.0 65535.0 /end CHARACTERISTIC
/begin CHARACTERISTIC D_CrankNoSignalDeltaIGNVoltThrsh "cal comments" VALUE 0xC23E Scalar_UW 0.0 CM_Volt_0to32_1 0.0 31.99900627136231 /end CHARACTERISTIC
/begin CHARACTERISTIC D_CrankNoSignalDeltaMAPThrsh "cal comments" VALUE 0xC23A Scalar_UW 0.0 CM_kpa_0to256_1 0.0 255.99609375 /end CHARACTERISTIC
/begin CHARACTERISTIC D_CrankNoSignalFailTimeThrsh "cal comments" VALUE 0xC23C Scalar_UW 0.0 CM_Second_0to512_1 0.0 511.9921875 /end CHARACTERISTIC
/begin CHARACTERISTIC D_CrankNoSignalPassTimeThrsh "cal comments" VALUE 0xC240 Scalar_UW 0.0 CM_Second_0to512_1 0.0 511.9921875 /end CHARACTERISTIC
/begin CHARACTERISTIC D_CrankSignalEnb "cal comments" VALUE 0xC242 Scalar_UB 0.0 CM_Boolean6 0.0 255.0 /end CHARACTERISTIC
/begin CHARACTERISTIC D_CrankSignalLightEnb "cal comments" VALUE 0xC243 Scalar_UB 0.0 CM_Boolean6 0.0 255.0 /end CHARACTERISTIC
/begin CHARACTERISTIC D_FuelPumpShortEnb "cal comments" VALUE 0xC24C Scalar_UB 0.0 CM_Boolean6 0.0 255.0 /end CHARACTERISTIC
/begin CHARACTERISTIC D_FuelPumpShortFailThresh "cal comments" VALUE 0xC24E Scalar_UB 0.0 CM_Count1 0.0 255.0 /end CHARACTERISTIC
/begin CHARACTERISTIC D_FuelPumpShortLightEnb "cal comments" VALUE 0xC24D Scalar_UB 0.0 CM_Boolean6 0.0 255.0 /end CHARACTERISTIC
/begin CHARACTERISTIC D_FuelPumpShortPassThresh "cal comments" VALUE 0xC24F Scalar_UB 0.0 CM_Count1 0.0 255.0 /end CHARACTERISTIC
/begin CHARACTERISTIC D_DCMShortEnb "cal comments" VALUE 0xC1AC Scalar_UB 0.0 CM_Boolean6 0.0 255.0 /end CHARACTERISTIC
/begin CHARACTERISTIC D_DCMShortFailThresh "cal comments" VALUE 0xC1AE Scalar_UB 0.0 CM_Count1 0.0 255.0 /end CHARACTERISTIC
/begin CHARACTERISTIC D_DCMShortLightEnb "cal comments" VALUE 0xC1AD Scalar_UB 0.0 CM_Boolean6 0.0 255.0 /end CHARACTERISTIC
/begin CHARACTERISTIC D_DCMShortPassThresh "cal comments" VALUE 0xC1AF Scalar_UB 0.0 CM_Count1 0.0 255.0 /end CHARACTERISTIC
/begin CHARACTERISTIC D_CCPShortEnb "cal comments" VALUE 0x0 Scalar_UB 0.0 CM_Boolean6 0.0 255.0 /end CHARACTERISTIC
/begin CHARACTERISTIC D_CCPShortFailThresh "cal comments" VALUE 0x0 Scalar_UB 0.0 CM_Count1 0.0 255.0 /end CHARACTERISTIC
/begin CHARACTERISTIC D_CCPShortLightEnb "cal comments" VALUE 0x0 Scalar_UB 0.0 CM_Boolean6 0.0 255.0 /end CHARACTERISTIC
/begin CHARACTERISTIC D_CCPShortPassThresh "cal comments" VALUE 0x0 Scalar_UB 0.0 CM_Count1 0.0 255.0 /end CHARACTERISTIC
/begin CHARACTERISTIC D_IgnitionCoilEnb "cal comments" CURVE 0xC244 2D_Array_UB 0.0 CM_Count1 0.0 1.0
 /begin AXIS_DESCR FIX_AXIS NO_INPUT_QUANTITY CM_EOI 4 0.0 4.0 MAX_GRAD 0.0 /begin FIX_AXIS_PAR_LIST 0 1 2 3 /end FIX_AXIS_PAR_LIST /end AXIS_DESCR
/end CHARACTERISTIC
/begin CHARACTERISTIC D_IgnitionCoilLightEnb "cal comments" CURVE 0xC248 2D_Array_UB 0.0 CM_Count1 0.0 1.0
 /begin AXIS_DESCR FIX_AXIS NO_INPUT_QUANTITY CM_EOI 4 0.0 4.0 MAX_GRAD 0.0 /begin FIX_AXIS_PAR_LIST 0 1 2 3 /end FIX_AXIS_PAR_LIST /end AXIS_DESCR
/end CHARACTERISTIC
/begin CHARACTERISTIC D_InjCyShortFailThresh "cal comments" CURVE 0xC347 2D_Array_UB 0.0 CM_Count1 0.0 255.0
 /begin AXIS_DESCR FIX_AXIS NO_INPUT_QUANTITY CM_EOI 4 0.0 4.0 MAX_GRAD 0.0 /begin FIX_AXIS_PAR_LIST 0 1 2 3 /end FIX_AXIS_PAR_LIST /end AXIS_DESCR
/end CHARACTERISTIC
/begin CHARACTERISTIC D_InjCyShortPassThresh "cal comments" CURVE 0xC34B 2D_Array_UB 0.0 CM_Count1 0.0 255.0
 /begin AXIS_DESCR FIX_AXIS NO_INPUT_QUANTITY CM_EOI 4 0.0 4.0 MAX_GRAD 0.0 /begin FIX_AXIS_PAR_LIST 0 1 2 3 /end FIX_AXIS_PAR_LIST /end AXIS_DESCR
/end CHARACTERISTIC
/begin CHARACTERISTIC D_InjectorCylEnb "cal comments" CURVE 0xC2F4 2D_Array_UB 0.0 CM_Count1 0.0 1.0
 /begin AXIS_DESCR FIX_AXIS NO_INPUT_QUANTITY CM_EOI 4 0.0 4.0 MAX_GRAD 0.0 /begin FIX_AXIS_PAR_LIST 0 1 2 3 /end FIX_AXIS_PAR_LIST /end AXIS_DESCR
/end CHARACTERISTIC
/begin CHARACTERISTIC D_InjectorCylLightEnb "cal comments" CURVE 0xC2F8 2D_Array_UB 0.0 CM_Count1 0.0 1.0
 /begin AXIS_DESCR FIX_AXIS NO_INPUT_QUANTITY CM_EOI 4 0.0 4.0 MAX_GRAD 0.0 /begin FIX_AXIS_PAR_LIST 0 1 2 3 /end FIX_AXIS_PAR_LIST /end AXIS_DESCR
/end CHARACTERISTIC
/begin CHARACTERISTIC D_IntakeAirTempShortEnb "cal comments" VALUE 0xC2A4 Scalar_UB 0.0 CM_Boolean6 0.0 255.0 /end CHARACTERISTIC
/begin CHARACTERISTIC D_IntakeAirTempFailTimeThrsh "cal comments" VALUE 0xC298 Scalar_UW 0.0 CM_Count_0to65535_1 0.0 65535.0 /end CHARACTERISTIC
/begin CHARACTERISTIC D_IntakeAirTempPassTimeThrsh "cal comments" VALUE 0xC29A Scalar_UW 0.0 CM_Count_0to65535_3 0.0 65535.0 /end CHARACTERISTIC
/begin CHARACTERISTIC D_IntakeAirTempShortLightEnb "cal comments" VALUE 0xC2A5 Scalar_UB 0.0 CM_Boolean6 0.0 255.0 /end CHARACTERISTIC
/begin CHARACTERISTIC D_IntakeAirTempDiagRunTimeThrsh "cal comments" VALUE 0xC296 Scalar_UW 0.0 CM_Count_0to65535_1 0.0 65535.0 /end CHARACTERISTIC
/begin CHARACTERISTIC D_IntakeAirTempShortRangeThreshHi "cal comments" VALUE 0xC29C Scalar_UW 0.0 CM_Percent_0to100_1 0.0 99.9984130859375 /end CHARACTERISTIC
/begin CHARACTERISTIC D_IntakeAirTempShortRangeThreshLo "cal comments" VALUE 0xC29E Scalar_UW 0.0 CM_Percent_0to100_1 0.0 99.9984130859375 /end CHARACTERISTIC
/begin CHARACTERISTIC D_IntakeAirOverTemp1Thresh "cal comments" VALUE 0xC2A0 Scalar_SW 0.0 CM_DegC_N256to256 -256.0 255.9921875 /end CHARACTERISTIC
/begin CHARACTERISTIC D_IntakeAirOverTemp2Thresh "cal comments" VALUE 0xC2A2 Scalar_SW 0.0 CM_DegC_N256to256 -256.0 255.9921875 /end CHARACTERISTIC
/begin CHARACTERISTIC D_ACSShortHighFailTimeThrsh "cal comments" VALUE 0xC2A6 Scalar_UW 0.0 CM_Count_0to65535_1 0.0 65535.0 /end CHARACTERISTIC
/begin CHARACTERISTIC D_ACSShortHighPassTimeThrsh "cal comments" VALUE 0xC2A8 Scalar_UW 0.0 CM_Count_0to65535_1 0.0 65535.0 /end CHARACTERISTIC
/begin CHARACTERISTIC D_ACSShortLowFailTimeThrsh "cal comments" VALUE 0xC2AA Scalar_UW 0.0 CM_Count_0to65535_1 0.0 65535.0 /end CHARACTERISTIC
/begin CHARACTERISTIC D_ACSShortLowPassTimeThrsh "cal comments" VALUE 0xC2AC Scalar_UW 0.0 CM_Count_0to65535_1 0.0 65535.0 /end CHARACTERISTIC
/begin CHARACTERISTIC D_ACSShortRangeThreshHi "cal comments" VALUE 0xC2AE Scalar_UW 0.0 CM_Percent_0to100_1 0.0 99.9984130859375 /end CHARACTERISTIC
/begin CHARACTERISTIC D_ACSShortRangeThreshLo "cal comments" VALUE 0xC2B0 Scalar_UW 0.0 CM_Percent_0to100_1 0.0 99.9984130859375 /end CHARACTERISTIC
/begin CHARACTERISTIC D_ACSShortEnb "cal comments" VALUE 0xC2B2 Scalar_UB 0.0 CM_Boolean6 0.0 255.0 /end CHARACTERISTIC
/begin CHARACTERISTIC D_ACSShortLightEnb "cal comments" VALUE 0xC2B3 Scalar_UB 0.0 CM_Boolean6 0.0 255.0 /end CHARACTERISTIC
/begin CHARACTERISTIC D_WPSShortHighFailTimeThrsh "cal comments" VALUE 0xC2B4 Scalar_UW 0.0 CM_Count_0to65535_1 0.0 65535.0 /end CHARACTERISTIC
/begin CHARACTERISTIC D_WPSShortHighPassTimeThrsh "cal comments" VALUE 0xC2B6 Scalar_UW 0.0 CM_Count_0to65535_1 0.0 65535.0 /end CHARACTERISTIC
/begin CHARACTERISTIC D_WPSShortLowFailTimeThrsh "cal comments" VALUE 0xC2B8 Scalar_UW 0.0 CM_Count_0to65535_1 0.0 65535.0 /end CHARACTERISTIC
/begin CHARACTERISTIC D_WPSShortLowPassTimeThrsh "cal comments" VALUE 0xC2BA Scalar_UW 0.0 CM_Count_0to65535_1 0.0 65535.0 /end CHARACTERISTIC
/begin CHARACTERISTIC D_WPSShortRangeThreshHi "cal comments" VALUE 0xC2BC Scalar_UW 0.0 CM_Percent_0to100_1 0.0 99.9984130859375 /end CHARACTERISTIC
/begin CHARACTERISTIC D_WPSShortRangeThreshLo "cal comments" VALUE 0xC2BE Scalar_UW 0.0 CM_Percent_0to100_1 0.0 99.9984130859375 /end CHARACTERISTIC
/begin CHARACTERISTIC D_WPSShortEnb "cal comments" VALUE 0xC2C0 Scalar_UB 0.0 CM_Boolean6 0.0 255.0 /end CHARACTERISTIC
/begin CHARACTERISTIC D_WPSShortLightEnb "cal comments" VALUE 0xC2C1 Scalar_UB 0.0 CM_Boolean6 0.0 255.0 /end CHARACTERISTIC
/begin CHARACTERISTIC D_MAPShortEnb "cal comments" VALUE 0xC32C Scalar_UB 0.0 CM_Boolean6 0.0 255.0 /end CHARACTERISTIC
/begin CHARACTERISTIC D_MAPShortHiDiagFailThrsh "cal comments" VALUE 0xC32A Scalar_UW 0.0 CM_Percent_0to100_1 0.0 99.9984130859375 /end CHARACTERISTIC
/begin CHARACTERISTIC D_MAPShortHiEngSpdThrsh "cal comments" VALUE 0xC30C Scalar_UW 0.0 CM_RPM_0to16384 0.0 16383.75 /end CHARACTERISTIC
/begin CHARACTERISTIC D_MAPShortHighFailTimeThrsh "cal comments" VALUE 0xC304 Scalar_UW 0.0 CM_Count_0to65535_2 0.0 65535.0 /end CHARACTERISTIC
/begin CHARACTERISTIC D_MAPShortHighPassTimeThrsh "cal comments" VALUE 0xC306 Scalar_UW 0.0 CM_Count_0to65535_2 0.0 65535.0 /end CHARACTERISTIC
/begin AXIS_PTS CA_TPS11Step "AXIS comments" 0xA0E2 NO_INPUT_QUANTITY AxisPtsX_UW 0.0 CM_Percent_0to200_2 11 0.0 199.9969024658203 /end AXIS_PTS
/begin AXIS_PTS CA_GENV11Step "AXIS comments" 0x2 NO_INPUT_QUANTITY AxisPtsX_UW 0.0 CM_Volt_0to1024_1 11 0.0 1023.984375 /end AXIS_PTS
/begin AXIS_PTS CA_EngSpd10Step1 "AXIS comments" 0x8076 NO_INPUT_QUANTITY AxisPtsX_UW 0.0 CM_RPM_0to16384 10 0.0 16383.75 /end AXIS_PTS
/begin AXIS_PTS CA_EngSpd13Step3 "AXIS comments" 0x808C NO_INPUT_QUANTITY AxisPtsX_UW 0.0 CM_RPM_0to16384 13 0.0 16383.75 /end AXIS_PTS
/begin AXIS_PTS CA_EngSpd17Step1 "AXIS comments" 0x80A8 NO_INPUT_QUANTITY AxisPtsX_UW 0.0 CM_RPM_0to16384 17 0.0 16383.75 /end AXIS_PTS
/begin AXIS_PTS CA_EngSpd17Step2 "AXIS comments" 0x8170 NO_INPUT_QUANTITY AxisPtsX_UW 0.0 CM_RPM_0to16384 17 0.0 16383.75 /end AXIS_PTS
/begin AXIS_PTS CA_EngSpd17Step3 "AXIS comments" 0xA1A2 NO_INPUT_QUANTITY AxisPtsX_UW 0.0 CM_RPM_0to16384 17 0.0 16383.75 /end AXIS_PTS
/begin AXIS_PTS CA_EngSpd17Step4 "AXIS comments" 0x8194 NO_INPUT_QUANTITY AxisPtsX_UW 0.0 CM_RPM_0to16384 17 0.0 16383.75 /end AXIS_PTS
/begin AXIS_PTS CA_EngSpd11Step1 "AXIS comments" 0xAF52 NO_INPUT_QUANTITY AxisPtsX_UW 0.0 CM_RPM_0to16384 11 0.0 16383.75 /end AXIS_PTS
/begin AXIS_PTS CA_EngSpd4Step1 "AXIS comments" 0x81DE NO_INPUT_QUANTITY AxisPtsX_UW 0.0 CM_RPM_0to16384 4 0.0 16383.75 /end AXIS_PTS
/begin AXIS_PTS CA_EngSpd6Step1 "AXIS comments" 0x81D0 NO_INPUT_QUANTITY AxisPtsX_UW 0.0 CM_RPM_0to16384 6 0.0 16383.75 /end AXIS_PTS
/begin AXIS_PTS CA_EngSpd6Step2 "AXIS comments" 0x81B8 NO_INPUT_QUANTITY AxisPtsX_UW 0.0 CM_RPM_0to16384 6 0.0 16383.75 /end AXIS_PTS
/begin AXIS_PTS CA_EngSpd9Step1 "AXIS comments" 0x8062 NO_INPUT_QUANTITY AxisPtsX_UW 0.0 CM_RPM_0to16384 9 0.0 16383.75 /end AXIS_PTS
/begin AXIS_PTS CA_GramStep21 "AXIS comments" 0x8214 NO_INPUT_QUANTITY AxisPtsX_UW 0.0 udf_CM_18705 21 0.0 511.9921875 /end AXIS_PTS
/begin AXIS_PTS CA_AirGramStep17 "AXIS comments" 0xB84A NO_INPUT_QUANTITY AxisPtsX_UW 0.0 udf_CM_18705 17 0.0 511.9921875 /end AXIS_PTS
/begin AXIS_PTS CA_FuelGramStep17 "AXIS comments" 0xB81E NO_INPUT_QUANTITY AxisPtsX_UW 0.0 udf_CM_16444 17 0.0 15.999755859375 /end AXIS_PTS
/begin AXIS_PTS CA_MAP10Step1 "AXIS comments" 0x8106 NO_INPUT_QUANTITY AxisPtsX_UW 0.0 CM_kpa_0to256_1 10 0.0 255.99609375 /end AXIS_PTS
/begin AXIS_PTS CA_MAP18Step1 "AXIS comments" 0x811C NO_INPUT_QUANTITY AxisPtsX_UW 0.0 CM_kpa_0to256_1 18 0.0 255.99609375 /end AXIS_PTS
/begin AXIS_PTS CA_MAP15Step1 "AXIS comments" 0xBF3A NO_INPUT_QUANTITY AxisPtsX_UW 0.0 CM_kpa_0to256_1 15 0.0 255.99609375 /end AXIS_PTS
/begin AXIS_PTS CA_MAP22Step1 "AXIS comments" 0x8142 NO_INPUT_QUANTITY AxisPtsX_UW 0.0 CM_kpa_0to256_1 22 0.0 255.99609375 /end AXIS_PTS
/begin AXIS_PTS CA_MAP8Step1 "AXIS comments" 0xB7FA NO_INPUT_QUANTITY AxisPtsX_SW 0.0 CM_kpa_n256to256_1 8 -256 255.9921875 /end AXIS_PTS
/begin AXIS_PTS CA_MAP8Step2 "AXIS comments" 0xB80C NO_INPUT_QUANTITY AxisPtsX_UW 0.0 CM_kpa_0to256_1 8 0.0 255.99609375 /end AXIS_PTS
/begin AXIS_PTS CA_MAP8Step3 "AXIS comments" 0x80F4 NO_INPUT_QUANTITY AxisPtsX_UW 0.0 CM_kpa_0to256_1 8 0.0 255.99609375 /end AXIS_PTS
/begin AXIS_PTS CA_MAP9Step1 "AXIS comments" 0x80CC NO_INPUT_QUANTITY AxisPtsX_UW 0.0 CM_kpa_0to256_1 9 0.0 255.99609375 /end AXIS_PTS
/begin AXIS_PTS CA_MAP9Step3 "AXIS comments" 0x80E0 NO_INPUT_QUANTITY AxisPtsX_UW 0.0 CM_kpa_0to256_1 9 0.0 255.99609375 /end AXIS_PTS
/begin AXIS_PTS CA_MAP9Step2 "AXIS comments" 0x8EF0 NO_INPUT_QUANTITY AxisPtsX_UW 0.0 CM_kpa_0to256_1 9 0.0 255.99609375 /end AXIS_PTS
/begin AXIS_PTS CA_Percent1 "AXIS comments" 0x81C6 NO_INPUT_QUANTITY AxisPtsX_UW 0.0 CM_Percent_0to200_2 4 0.0 199.9969024658203 /end AXIS_PTS
/begin AXIS_PTS CA_PercentStep21 "AXIS comments" 0x81E8 NO_INPUT_QUANTITY AxisPtsX_UW 0.0 CM_Percent_0to200_2 21 0.0 199.9969024658203 /end AXIS_PTS
/begin AXIS_PTS CA_VELoad6Step "AXIS comments" 0x8240 NO_INPUT_QUANTITY AxisPtsX_UW 0.0 CM_kpa_0to256_1 6 0.0 255.99609375 /end AXIS_PTS
/begin COMPU_METHOD udf_CM_15471 "Ax + B" RAT_FUNC "%4.0" "None" COEFFS 0 1 0 0 0 1 /end COMPU_METHOD
/begin COMPU_METHOD udf_CM_15478 "Ax + B" RAT_FUNC "%4.0" "None" COEFFS 0 1 0 0 0 1 /end COMPU_METHOD
/begin COMPU_METHOD CM_Boolean1 "" RAT_FUNC "%1.0" "bool" COEFFS 0 1 0 0 0 1 /end COMPU_METHOD
/begin COMPU_METHOD CM_Boolean2 "" RAT_FUNC "%1.0" "boolean" COEFFS 0 1 0 0 0 1 /end COMPU_METHOD
/begin COMPU_METHOD CM_Boolean4 "" RAT_FUNC "%1.0" "None" COEFFS 0 1 0 0 0 1 /end COMPU_METHOD
/begin COMPU_METHOD udf_CM_15709 "Ax + B" RAT_FUNC "%4.0" "None" COEFFS 0 1 0 0 0 1 /end COMPU_METHOD
/begin COMPU_METHOD CM_VERSION1 "" RAT_FUNC "%10.0" "Date" COEFFS 0 1 0 0 0 1 /end COMPU_METHOD
/begin COMPU_METHOD CM_Count1 "" RAT_FUNC "%3.0" "count" COEFFS 0 1 0 0 0 1 /end COMPU_METHOD
/begin COMPU_METHOD CM_Count2 "" RAT_FUNC "%3.0" "counts" COEFFS 0 1 0 0 0 1 /end COMPU_METHOD
/begin COMPU_METHOD CM_Count3 "" RAT_FUNC "%3.0" "None" COEFFS 0 1 0 0 0 1 /end COMPU_METHOD
/begin COMPU_METHOD CM_Count4 "" RAT_FUNC "%3.0" "steps" COEFFS 0 1 0 0 0 1 /end COMPU_METHOD
/begin COMPU_METHOD CM_EOI "" TAB_VERB "%10.4" "" COMPU_TAB_REF CM_EOI_TAB /end COMPU_METHOD
/begin COMPU_METHOD CM_FUEL_TYPE "" TAB_VERB "%10.4" "" COMPU_TAB_REF CM_FUEL_TYPE_TAB /end COMPU_METHOD
/begin COMPU_METHOD udf_CM_16276 "Ax + B" RAT_FUNC "%4.0" "boolean" COEFFS 0 1 0 0 0 1 /end COMPU_METHOD
/begin COMPU_METHOD udf_CM_16444 "Ax + B" RAT_FUNC "%4.4" "grm" COEFFS 0.0 4096.0 0.0 0.0 0.0 1.0 /end COMPU_METHOD
/begin COMPU_METHOD udf_CM_16542 "Ax + B" RAT_FUNC "%4.0" "None" COEFFS 0 1 0 0 0 1 /end COMPU_METHOD
/begin COMPU_METHOD udf_CM_16549 "Ax + B" RAT_FUNC "%4.0" "Counts" COEFFS 0 1 0 0 0 1 /end COMPU_METHOD
/begin COMPU_METHOD udf_CM_16556 "Ax + B" RAT_FUNC "%4.0" "None" COEFFS 0 1 0 0 0 1 /end COMPU_METHOD
/begin COMPU_METHOD udf_CM_16563 "Ax + B" RAT_FUNC "%4.0" "None" COEFFS 0 1 0 0 0 1 /end COMPU_METHOD
/begin COMPU_METHOD udf_CM_16570 "Ax + B" RAT_FUNC "%4.0" "None" COEFFS 0 1 0 0 0 1 /end COMPU_METHOD
/begin COMPU_METHOD udf_CM_16577 "Ax + B" RAT_FUNC "%4.0" "Counts" COEFFS 0 1 0 0 0 1 /end COMPU_METHOD
/begin COMPU_METHOD udf_CM_16584 "Ax + B" RAT_FUNC "%4.0" "None" COEFFS 0 1 0 0 0 1 /end COMPU_METHOD
/begin COMPU_METHOD udf_CM_16591 "Ax + B" RAT_FUNC "%4.0" "None" COEFFS 0 1 0 0 0 1 /end COMPU_METHOD
/begin COMPU_METHOD udf_CM_16696 "Ax + B" RAT_FUNC "%4.0" "None" COEFFS 0 1 0 0 0 1 /end COMPU_METHOD
/begin COMPU_METHOD udf_CM_16878 "Ax + B" RAT_FUNC "%4.4" "msec" COEFFS 0.0 64.0 0.0 0.0 0.0 1.0 /end COMPU_METHOD
/begin COMPU_METHOD udf_CM_16948 "Ax + B" RAT_FUNC "%4.0" "None" COEFFS 0 1 0 0 0 1 /end COMPU_METHOD
/begin COMPU_METHOD udf_CM_16955 "Ax + B" RAT_FUNC "%4.0" "None" COEFFS 0 1 0 0 0 1 /end COMPU_METHOD
/begin COMPU_METHOD udf_CM_16997 "Ax + B" RAT_FUNC "%4.0" "Counts" COEFFS 0 1 0 0 0 1 /end COMPU_METHOD
/begin COMPU_METHOD udf_CM_17004 "Ax + B" RAT_FUNC "%4.0" "None" COEFFS 0 1 0 0 0 1 /end COMPU_METHOD
/begin COMPU_METHOD udf_CM_17011 "Ax + B" RAT_FUNC "%4.0" "None" COEFFS 0 1 0 0 0 1 /end COMPU_METHOD
/begin COMPU_METHOD udf_CM_17018 "Ax + B" RAT_FUNC "%4.0" "None" COEFFS 0 1 0 0 0 1 /end COMPU_METHOD
/begin COMPU_METHOD udf_CM_17025 "Ax + B" RAT_FUNC "%4.0" "Counts" COEFFS 0 1 0 0 0 1 /end COMPU_METHOD
/begin COMPU_METHOD udf_CM_17032 "Ax + B" RAT_FUNC "%4.0" "None" COEFFS 0 1 0 0 0 1 /end COMPU_METHOD
/begin COMPU_METHOD CM_Mult0_to_2_ratio "" RAT_FUNC "%5.4" "ratio" COEFFS 0.0 128.0 0.0 0.0 0.0 1.0 /end COMPU_METHOD
/begin COMPU_METHOD CM_Mult0_to_2_ratio1 "" RAT_FUNC "%5.4" "ratio/512rpm" COEFFS 0.0 128.0 0.0 0.0 0.0 1.0 /end COMPU_METHOD
/begin COMPU_METHOD CM_Mult0_to_2_second "" RAT_FUNC "%5.4" "sec" COEFFS 0.0 128.0 0.0 0.0 0.0 1.0 /end COMPU_METHOD
/begin COMPU_METHOD CM_Equaloutput1 "Default N=E compu method" RAT_FUNC "%10.4" "" COEFFS 0 1 0 0 0 1 /end COMPU_METHOD
/begin COMPU_METHOD CM_Boolean6 "Default N=E compu method" RAT_FUNC "%10.4" "Boolean" COEFFS 0 1 0 0 0 1 /end COMPU_METHOD
/begin COMPU_METHOD CM_Enum_0to4 "" RAT_FUNC "%1.0" "enum" COEFFS 0 1 0 0 0 1 /end COMPU_METHOD
/begin COMPU_METHOD CM_AFR_8bit "" RAT_FUNC "%4.2" "afr" COEFFS 0.0 8.0 0.0 0.0 0.0 1.0 /end COMPU_METHOD
/begin COMPU_METHOD CM_AFR_n4to4 "" RAT_FUNC "%4.3" "afr" COEFFS 0.0 32.0 0.0 0.0 0.0 1.0 /end COMPU_METHOD
/begin COMPU_METHOD CM_Angle_8bit "" RAT_FUNC "%3.1" "angle" COEFFS 0.0 2.0 0.0 0.0 0.0 1.0 /end COMPU_METHOD
/begin COMPU_METHOD CM_Grams0to2 "" RAT_FUNC "%6.5" "gms" COEFFS 0.0 32768.00013421773 0.0 0.0 0.0 1.0 /end COMPU_METHOD
/begin COMPU_METHOD CM_Grams0to8 "" RAT_FUNC "%6.5" "gms" COEFFS 0.0 8192.000033554432 0.0 0.0 0.0 1.0 /end COMPU_METHOD
/begin COMPU_METHOD CM_Grams0to8_1 "" RAT_FUNC "%6.5" "grams" COEFFS 0.0 8192.000033554432 0.0 0.0 0.0 1.0 /end COMPU_METHOD
/begin COMPU_METHOD CM_FiltCoef "" RAT_FUNC "%7.6" "coef" COEFFS 0.0 65536.00026843546 0.0 0.0 0.0 1.0 /end COMPU_METHOD
/begin COMPU_METHOD CM_FactorRatio "" RAT_FUNC "%7.6" "ratio" COEFFS 0.0 65536.00026843546 0.0 0.0 0.0 1.0 /end COMPU_METHOD
/begin COMPU_METHOD CM_FactorRatio_N1to1 "" RAT_FUNC "%7.6" "ratio" COEFFS 0.0 32768.00013421773 0.0 0.0 0.0 1.0 /end COMPU_METHOD
/begin COMPU_METHOD CM_GramPerSecond "" RAT_FUNC "%7.5" "grams/sec" COEFFS 0.0 4096.0 0.0 0.0 0.0 1.0 /end COMPU_METHOD
/begin COMPU_METHOD udf_CM_18376 "" RAT_FUNC "%7.5" "ratio" COEFFS 0.0 4096.0 0.0 0.0 0.0 1.0 /end COMPU_METHOD
/begin COMPU_METHOD CM_kpa_8bit "" RAT_FUNC "%4.1" "kpa" COEFFS 0.0 2.0 0.0 0.0 0.0 1.0 /end COMPU_METHOD
/begin COMPU_METHOD CM_kpa_0_256_8bit "" RAT_FUNC "%4.1" "kpa" COEFFS 0.0 1.0 0.0 0.0 0.0 1.0 /end COMPU_METHOD
/begin COMPU_METHOD CM_msec "" RAT_FUNC "%5.3" "msec" COEFFS 0.0 16.0 0.0 0.0 0.0 1.0 /end COMPU_METHOD
/begin COMPU_METHOD CM_mVolt "" RAT_FUNC "%4.0" "millivolt" COEFFS 0.0 0.25 0.0 0.0 0.0 1.0 /end COMPU_METHOD
/begin COMPU_METHOD CM_mVolt_1 "" RAT_FUNC "%7.3" "millivolt" COEFFS 0.0 64.0 0.0 0.0 0.0 1.0 /end COMPU_METHOD
/begin COMPU_METHOD CM_Ratio_0to2_1 "" RAT_FUNC "%6.5" "msec/count" COEFFS 0.0 32768.00013421773 0.0 0.0 0.0 1.0 /end COMPU_METHOD
/begin COMPU_METHOD CM_Ratio_0to2_2 "" RAT_FUNC "%6.5" "ratio" COEFFS 0.0 32768.00013421773 0.0 0.0 0.0 1.0 /end COMPU_METHOD
/begin COMPU_METHOD CM_Seconds_1 "" RAT_FUNC "%7.3" "sec" COEFFS 0.0 32.0 0.0 0.0 0.0 1.0 /end COMPU_METHOD
/begin COMPU_METHOD CM_Percent_N200to200 "" RAT_FUNC "%7.4" "percent" COEFFS 0.0 163.8400167772177 0.0 0.0 0.0 1.0 /end COMPU_METHOD
/begin COMPU_METHOD CM_SparkAngle_N256to256 "" RAT_FUNC "%7.4" "angle" COEFFS 0.0 128.0 0.0 0.0 0.0 1.0 /end COMPU_METHOD
/begin COMPU_METHOD CM_DegC_N256to256 "" RAT_FUNC "%7.4" "degC" COEFFS 0.0 128.0 0.0 0.0 0.0 1.0 /end COMPU_METHOD
/begin COMPU_METHOD CM_FiltCoef_1 "" RAT_FUNC "%5.4" "coef" COEFFS 0.0 256.0 0.0 0.0 0.0 1.0 /end COMPU_METHOD
/begin COMPU_METHOD CM_Mult_0to1 "" RAT_FUNC "%5.4" "not_specified" COEFFS 0.0 256.0 0.0 0.0 0.0 1.0 /end COMPU_METHOD
/begin COMPU_METHOD CM_Mult_0to1_2 "" RAT_FUNC "%5.4" "ratio" COEFFS 0.0 256.0 0.0 0.0 0.0 1.0 /end COMPU_METHOD
/begin COMPU_METHOD CM_Percent_0to200 "" RAT_FUNC "%8.5" "percent/count" COEFFS 0.0 327.6800000536871 0.0 0.0 0.0 1.0 /end COMPU_METHOD
/begin COMPU_METHOD CM_Percent_0to100 "" RAT_FUNC "%5.3" "percent" COEFFS 0.0 2.56 0.0 0.0 0.0 1.0 /end COMPU_METHOD
/begin COMPU_METHOD CM_Percent_0to100_1 "" RAT_FUNC "%6.4" "percent" COEFFS 0.0 655.3603892316423 0.0 0.0 0.0 1.0 /end COMPU_METHOD
/begin COMPU_METHOD CM_Percent_0to200_1 "" RAT_FUNC "%7.4" "" COEFFS 0.0 327.6800872415464 0.0 0.0 0.0 1.0 /end COMPU_METHOD
/begin COMPU_METHOD CM_Percent_0to200_2 "" RAT_FUNC "%7.4" "percent" COEFFS 0.0 327.6800872415464 0.0 0.0 0.0 1.0 /end COMPU_METHOD
/begin COMPU_METHOD CM_Percent_0to200_3 "" RAT_FUNC "%6.3" "percent" COEFFS 0.0 1.28 0.0 0.0 0.0 1.0 /end COMPU_METHOD
/begin COMPU_METHOD CM_Ratio_0to8 "" RAT_FUNC "%6.5" "ratio" COEFFS 0.0 8192.0 0.0 0.0 0.0 1.0 /end COMPU_METHOD
/begin COMPU_METHOD CM_Ratio_n256to256 "" RAT_FUNC "%7.4" "amps" COEFFS 0.0 128.0 0.0 0.0 0.0 1.0 /end COMPU_METHOD
/begin COMPU_METHOD CM_Ratio_n128to128 "" RAT_FUNC "%7.4" "kpa" COEFFS 0.0 256.0 0.0 0.0 0.0 1.0 /end COMPU_METHOD
/begin COMPU_METHOD CM_Ratio_n8to8 "" RAT_FUNC "%7.4" "mpa" COEFFS 0.0 4096.0 0.0 0.0 0.0 1.0 /end COMPU_METHOD
/begin COMPU_METHOD udf_CM_18544 "" RAT_FUNC "%7.4" "NM" COEFFS 0.0 256.0 0.0 0.0 0.0 1.0 /end COMPU_METHOD
/begin COMPU_METHOD CM_Ratio_n2to2 "" RAT_FUNC "%4.3" "ratio" COEFFS 0.0 64.0 0.0 0.0 0.0 1.0 /end COMPU_METHOD
/begin COMPU_METHOD CM_RPM_n8192to8192 "" RAT_FUNC "%6.2" "rpm" COEFFS 0.0 4.0 0.0 0.0 0.0 1.0 /end COMPU_METHOD
/begin COMPU_METHOD CM_RPM_0to16384_1 "" RAT_FUNC "%7.2" "" COEFFS 0.0 4.0 0.0 0.0 0.0 1.0 /end COMPU_METHOD
/begin COMPU_METHOD CM_Hz_0to16384 "" RAT_FUNC "%7.2" "hertz" COEFFS 0.0 4.0 0.0 0.0 0.0 1.0 /end COMPU_METHOD
/begin COMPU_METHOD CM_RPM_0to16384 "" RAT_FUNC "%7.2" "rpm" COEFFS 0.0 4.0 0.0 0.0 0.0 1.0 /end COMPU_METHOD
/begin COMPU_METHOD udf_CM_18586 "" RAT_FUNC "%7.2" "RPM" COEFFS 0.0 4.0 0.0 0.0 0.0 1.0 /end COMPU_METHOD
/begin COMPU_METHOD CM_amp_0to512_1 "" RAT_FUNC "%7.4" "amp" COEFFS 0.0 128.0 0.0 0.0 0.0 1.0 /end COMPU_METHOD
/begin COMPU_METHOD CM_kpa_0to512_1 "" RAT_FUNC "%7.4" "kpa" COEFFS 0.0 128.0 0.0 0.0 0.0 1.0 /end COMPU_METHOD
/begin COMPU_METHOD CM_kpa_n256to256_1 "" RAT_FUNC "%7.4" "kpa" COEFFS 0.0 128.0 0.0 0.0 0.0 1.0 /end COMPU_METHOD
/begin COMPU_METHOD CM_kpa_0to256_1 "" RAT_FUNC "%7.4" "kpa" COEFFS 0.0 256.0 0.0 0.0 0.0 1.0 /end COMPU_METHOD
/begin COMPU_METHOD CM_mpa_0to16_1 "" RAT_FUNC "%7.4" "mpa" COEFFS 0.0 4096.0 0.0 0.0 0.0 1.0 /end COMPU_METHOD
/begin COMPU_METHOD CM_CrankAngle_0to1024 "" RAT_FUNC "%7.3" "angle" COEFFS 0.0 64.0 0.0 0.0 0.0 1.0 /end COMPU_METHOD
/begin COMPU_METHOD CM_milliliter_0to1024 "" RAT_FUNC "%7.3" "milliliter" COEFFS 0.0 64.0 0.0 0.0 0.0 1.0 /end COMPU_METHOD
/begin COMPU_METHOD CM_msec_0to1024 "" RAT_FUNC "%7.3" "msec" COEFFS 0.0 64.0 0.0 0.0 0.0 1.0 /end COMPU_METHOD
/begin COMPU_METHOD CM_Second_0to1024 "" RAT_FUNC "%7.3" "sec" COEFFS 0.0 64.0 0.0 0.0 0.0 1.0 /end COMPU_METHOD
/begin COMPU_METHOD CM_Second_0to8192 "" RAT_FUNC "%7.3" "sec" COEFFS 0.0 8.0 0.0 0.0 0.0 1.0 /end COMPU_METHOD
/begin COMPU_METHOD CM_SignedWord_n32768to32768_2 "" RAT_FUNC "%5.0" "counts" COEFFS 0 1 0 0 0 1 /end COMPU_METHOD
/begin COMPU_METHOD CM_AFR_0to32 "" RAT_FUNC "%6.4" "afr" COEFFS 0.0 2048.001048576537 0.0 0.0 0.0 1.0 /end COMPU_METHOD
/begin COMPU_METHOD CM_Volt_0to32_1 "" RAT_FUNC "%6.4" "volt" COEFFS 0.0 2048.001048576537 0.0 0.0 0.0 1.0 /end COMPU_METHOD
/begin COMPU_METHOD CM_Volt_0to1024_1 "" RAT_FUNC "%6.4" "volt" COEFFS 0.0 64.0 0.0 0.0 0.0 1.0 /end COMPU_METHOD
/begin COMPU_METHOD CM_Volt_0to32_2 "" RAT_FUNC "%6.4" "volts" COEFFS 0.0 2048.001048576537 0.0 0.0 0.0 1.0 /end COMPU_METHOD
/begin COMPU_METHOD CM_Second_0to4096 "" RAT_FUNC "%7.3" "sec" COEFFS 0.0 16.0 0.0 0.0 0.0 1.0 /end COMPU_METHOD
/begin COMPU_METHOD CM_KPH_0to512 "" RAT_FUNC "%7.4" "kph" COEFFS 0.0 128.0 0.0 0.0 0.0 1.0 /end COMPU_METHOD
/begin COMPU_METHOD udf_CM_18698 "" RAT_FUNC "%7.4" "gram" COEFFS 0.0 128.0 0.0 0.0 0.0 1.0 /end COMPU_METHOD
/begin COMPU_METHOD udf_CM_18705 "" RAT_FUNC "%7.4" "grams" COEFFS 0.0 128.0 0.0 0.0 0.0 1.0 /end COMPU_METHOD
/begin COMPU_METHOD CM_Second_0to512 "" RAT_FUNC "%7.4" "sec" COEFFS 0.0 128.0 0.0 0.0 0.0 1.0 /end COMPU_METHOD
/begin COMPU_METHOD CM_Second_0to512_1 "" RAT_FUNC "%7.4" "seconds" COEFFS 0.0 128.0 0.0 0.0 0.0 1.0 /end COMPU_METHOD
/begin COMPU_METHOD CM_Count_0to65535 "" RAT_FUNC "%5.0" "count" COEFFS 0 1 0 0 0 1 /end COMPU_METHOD
/begin COMPU_METHOD CM_Count_0to65535_1 "" RAT_FUNC "%5.0" "counts" COEFFS 0 1 0 0 0 1 /end COMPU_METHOD
/begin COMPU_METHOD CM_Count_0to65535_2 "" RAT_FUNC "%5.0" "None" COEFFS 0 1 0 0 0 1 /end COMPU_METHOD
/begin COMPU_METHOD CM_Count_0to65535_3 "" RAT_FUNC "%5.0" "percent" COEFFS 0 1 0 0 0 1 /end COMPU_METHOD
/begin COMPU_METHOD CM_Second_0to65535 "" RAT_FUNC "%5.0" "sec" COEFFS 0 1 0 0 0 1 /end COMPU_METHOD
/begin COMPU_METHOD CM_msec_0to4 "" RAT_FUNC "%4.3" "msec" COEFFS 0.0 64.0 0.0 0.0 0.0 1.0 /end COMPU_METHOD
/begin COMPU_METHOD CM_mult_0to4 "" RAT_FUNC "%4.3" "not_specified" COEFFS 0.0 64.0 0.0 0.0 0.0 1.0 /end COMPU_METHOD
/begin COMPU_METHOD CM_Second_0to4 "" RAT_FUNC "%4.3" "sec" COEFFS 0.0 64.0 0.0 0.0 0.0 1.0 /end COMPU_METHOD
/begin COMPU_METHOD CM_Mult_0to8 "" RAT_FUNC "%4.3" "ratio" COEFFS 0.0 32.0 0.0 0.0 0.0 1.0 /end COMPU_METHOD
/begin COMPU_METHOD CM_Second_0to8 "" RAT_FUNC "%4.3" "sec" COEFFS 0.0 32.0 0.0 0.0 0.0 1.0 /end COMPU_METHOD
/begin COMPU_VTAB CM_EOI_TAB "" TAB_VERB 4 0 "Cyl1" 1 "Cyl2" 2 "Cyl3" 3 "Cyl4" /end COMPU_VTAB
/begin COMPU_VTAB CM_FUEL_TYPE_TAB "" TAB_VERB 3 0 "Gasoline" 1 "NG" 2 "LPG" /end COMPU_VTAB
/begin RECORD_LAYOUT 2D_Array_SB FNC_VALUES 1 SBYTE COLUMN_DIR DIRECT ALIGNMENT_WORD 1 ALIGNMENT_LONG 2 /end RECORD_LAYOUT
/begin RECORD_LAYOUT 2D_Array_SW FNC_VALUES 1 SWORD COLUMN_DIR DIRECT ALIGNMENT_WORD 1 ALIGNMENT_LONG 2 /end RECORD_LAYOUT
/begin RECORD_LAYOUT 2D_Array_UB FNC_VALUES 1 UBYTE COLUMN_DIR DIRECT ALIGNMENT_WORD 1 ALIGNMENT_LONG 2 /end RECORD_LAYOUT
/begin RECORD_LAYOUT 2D_Array_UW FNC_VALUES 1 UWORD COLUMN_DIR DIRECT ALIGNMENT_WORD 1 ALIGNMENT_LONG 2 /end RECORD_LAYOUT
/begin RECORD_LAYOUT D_Array_SB FNC_VALUES 1 SBYTE COLUMN_DIR DIRECT ALIGNMENT_WORD 1 ALIGNMENT_LONG 2 /end RECORD_LAYOUT
/begin RECORD_LAYOUT udf_RL_19771 FNC_VALUES 1 SWORD COLUMN_DIR DIRECT ALIGNMENT_WORD 1 ALIGNMENT_LONG 2 /end RECORD_LAYOUT
/begin RECORD_LAYOUT 3D_Array_UB FNC_VALUES 1 UBYTE COLUMN_DIR DIRECT ALIGNMENT_WORD 1 ALIGNMENT_LONG 2 /end RECORD_LAYOUT
/begin RECORD_LAYOUT 3D_Array_UW FNC_VALUES 1 UWORD COLUMN_DIR DIRECT ALIGNMENT_WORD 1 ALIGNMENT_LONG 2 /end RECORD_LAYOUT
/begin RECORD_LAYOUT AxisPtsX_UW AXIS_PTS_X 1 UWORD INDEX_INCR DIRECT ALIGNMENT_WORD 1 ALIGNMENT_LONG 2 /end RECORD_LAYOUT
/begin RECORD_LAYOUT AxisPtsX_SW AXIS_PTS_X 1 SWORD INDEX_INCR DIRECT ALIGNMENT_WORD 1 ALIGNMENT_LONG 2 /end RECORD_LAYOUT
/begin RECORD_LAYOUT Scalar_SW FNC_VALUES 1 SWORD COLUMN_DIR DIRECT ALIGNMENT_WORD 1 ALIGNMENT_LONG 2 /end RECORD_LAYOUT
/begin RECORD_LAYOUT Scalar_UB FNC_VALUES 1 UBYTE COLUMN_DIR DIRECT ALIGNMENT_WORD 1 ALIGNMENT_LONG 2 /end RECORD_LAYOUT
/begin RECORD_LAYOUT Scalar_UW FNC_VALUES 1 UWORD COLUMN_DIR DIRECT ALIGNMENT_WORD 1 ALIGNMENT_LONG 2 /end RECORD_LAYOUT
/begin RECORD_LAYOUT ValueBlock_UW FNC_VALUES 1 UWORD COLUMN_DIR DIRECT ALIGNMENT_WORD 1 ALIGNMENT_LONG 2 /end RECORD_LAYOUT
/begin RECORD_LAYOUT Scalar_UL FNC_VALUES 1 ULONG COLUMN_DIR DIRECT ALIGNMENT_WORD 1 ALIGNMENT_LONG 2 /end RECORD_LAYOUT
/end MODULE
/end PROJECT
