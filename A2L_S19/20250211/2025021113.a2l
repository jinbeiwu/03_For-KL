ASAP2_VERSION 1 40
/begin PROJECT RS19_Prod ""
/begin HEADER "" VERSION "" /end HEADER
/begin MODULE RS19_Prod ""
/begin MOD_COMMON "" BYTE_ORDER MSB_FIRST ALIGNMENT_BYTE 1 ALIGNMENT_WORD 1 ALIGNMENT_LONG 2 ALIGNMENT_FLOAT32_IEEE 4 ALIGNMENT_FLOAT64_IEEE 8 /end MOD_COMMON
/begin MEASUREMENT AIRF_T_Inverse_CAT_Term "var comments" UWORD udf_CM_15261 0 0.0 0.0 0.9999849796295166 ECU_ADDRESS 0x40002664 /end MEASUREMENT
/begin MEASUREMENT FuelEOI "var comments" UWORD udf_CM_16465 0 0.0 0.0 1023.984375 ECU_ADDRESS 0x40002772 /end MEASUREMENT
/begin MEASUREMENT FuelEOITarget "var comments" UWORD udf_CM_16472 0 0.0 0.0 1023.984375 ECU_ADDRESS 0x4000277E /end MEASUREMENT
/begin MEASUREMENT FuelEOITrim "var comments" UWORD udf_CM_16479 0 0.0 0.0 1023.984375 ECU_ADDRESS 0x40002788 /end MEASUREMENT
/begin MEASUREMENT O2HeaterOutputEnable "var comments" UBYTE udf_CM_17452 0 0.0 0.0 255.0 ECU_ADDRESS 0x400026BB /end MEASUREMENT
/begin MEASUREMENT FuelInj1Enb "var comments" UBYTE udf_CM_16486 0 0.0 0.0 255.0 DISPLAY_IDENTIFIER FuelInjEnb[0] ECU_ADDRESS 0x40002780 /end MEASUREMENT
/begin MEASUREMENT FuelInj2Enb "var comments" UBYTE udf_CM_16493 0 0.0 0.0 255.0 DISPLAY_IDENTIFIER FuelInjEnb[1] ECU_ADDRESS 0x40002781 /end MEASUREMENT
/begin MEASUREMENT InjectorOffset "var comments" UWORD udf_CM_17046 0 0.0 0.0 1023.984375 ECU_ADDRESS 0x4000278A /end MEASUREMENT
/begin MEASUREMENT FO21Filt "var comments" UWORD udf_CM_16325 0 0.0 0.0 1023.984375 DISPLAY_IDENTIFIER FO2Filt ECU_ADDRESS 0x400028B4 /end MEASUREMENT
/begin MEASUREMENT FO2Error "var comments" UWORD udf_CM_17536 0 0.0 0.0 1023.984375 ECU_ADDRESS 0x40002896 /end MEASUREMENT
/begin MEASUREMENT FO21Ready "var comments" UBYTE udf_CM_16339 0 0.0 0.0 255.0 DISPLAY_IDENTIFIER FO2Ready ECU_ADDRESS 0x400028AB /end MEASUREMENT
/begin MEASUREMENT FO21RichOld "var comments" UBYTE udf_CM_16311 0 0.0 0.0 1.0 ECU_ADDRESS 0x4000289A /end MEASUREMENT
/begin MEASUREMENT FO21FiltRich "var comments" UBYTE udf_CM_16332 0 0.0 0.0 1.0 DISPLAY_IDENTIFIER FO2FiltRich ECU_ADDRESS 0x400028AF /end MEASUREMENT
/begin MEASUREMENT FO21Rich "var comments" UBYTE udf_CM_16346 0 0.0 0.0 1.0 DISPLAY_IDENTIFIER FO2Rich ECU_ADDRESS 0x400028A4 /end MEASUREMENT
/begin MEASUREMENT FO2RLThresh "var comments" UWORD udf_CM_16360 0 0.0 0.0 1023.984375 ECU_ADDRESS 0x400028A6 /end MEASUREMENT
/begin MEASUREMENT FO21RLChange "var comments" UBYTE udf_CM_16353 0 0.0 0.0 255.0 DISPLAY_IDENTIFIER FO2RLChange ECU_ADDRESS 0x4000289C /end MEASUREMENT
/begin MEASUREMENT FO2FiltRLChange "var comments" UBYTE udf_CM_16353 0 0.0 0.0 255.0 ECU_ADDRESS 0x4000289F /end MEASUREMENT
/begin MEASUREMENT O2HeaterEnb "var comments" UBYTE udf_CM_17445 0 0.0 0.0 255.0 DISPLAY_IDENTIFIER O2HeaterEnable ECU_ADDRESS 0x400026BA /end MEASUREMENT
/begin MEASUREMENT ExtPEModeEnb "var comments" UBYTE udf_CM_16269 0 0.0 0.0 255.0 ECU_ADDRESS 0x400026F7 /end MEASUREMENT
/begin MEASUREMENT FuelPumpEnb "var comments" UBYTE udf_CM_16605 0 0.0 0.0 255.0 ECU_ADDRESS 0x40002796 /end MEASUREMENT
/begin MEASUREMENT FuelPumpCurr "var comments" UWORD udf_CM_17389 0 0.0 0.0 65535.0 ECU_ADDRESS 0x40002798 /end MEASUREMENT
/begin MEASUREMENT PowerEnrich "var comments" UBYTE udf_CM_17613 0 0.0 0.0 255.0 ECU_ADDRESS 0x4000278C /end MEASUREMENT
/begin MEASUREMENT COA_LrnMult "var comments" UWORD udf_CM_16626 0 0.0 0.0 1.999969005584717 ECU_ADDRESS 0x400028DE /end MEASUREMENT
/begin MEASUREMENT COA_Updated "var comments" UBYTE udf_CM_16710 0 0.0 0.0 255.0 ECU_ADDRESS 0x400028C8 /end MEASUREMENT
/begin MEASUREMENT COA_LrnAllowed "var comments" UBYTE udf_CM_16710 0 0.0 0.0 255.0 ECU_ADDRESS 0x400028CC /end MEASUREMENT
/begin MEASUREMENT COA_Cell_NG "var comments" UWORD udf_CM_16626 0 0.0 0.0 1.999969005584717 LAYOUT COLUMN_DIR MATRIX_DIM 17 ECU_ADDRESS 0x400002FA /end MEASUREMENT
/begin MEASUREMENT COA_Cell_LPG "var comments" UWORD udf_CM_16626 0 0.0 0.0 1.999969005584717 LAYOUT COLUMN_DIR MATRIX_DIM 17 ECU_ADDRESS 0x4000031C /end MEASUREMENT
/begin MEASUREMENT FuelPumpDiagEnb "var comments" UBYTE udf_CM_17382 0 0.0 0.0 255.0 ECU_ADDRESS 0x40002FDC /end MEASUREMENT
/begin MEASUREMENT FuelPumpSLFailMet "var comments" UBYTE udf_CM_17410 0 0.0 0.0 255.0 ECU_ADDRESS 0x40002FDE /end MEASUREMENT
/begin MEASUREMENT FuelPumpSLTestComp "var comments" UBYTE udf_CM_17424 0 0.0 0.0 255.0 ECU_ADDRESS 0x40002FDF /end MEASUREMENT
/begin MEASUREMENT FuelPumpSLTestFail "var comments" UBYTE udf_CM_17431 0 0.0 0.0 255.0 ECU_ADDRESS 0x40002FE1 /end MEASUREMENT
/begin MEASUREMENT FuelPumpSLFailCount "var comments" UWORD udf_CM_17389 0 0.0 0.0 65535.0 ECU_ADDRESS 0x40002FE2 /end MEASUREMENT
/begin MEASUREMENT FuelPumpSLPassCount "var comments" UWORD udf_CM_17417 0 0.0 0.0 65535.0 ECU_ADDRESS 0x40002FE6 /end MEASUREMENT
/begin MEASUREMENT FuelPumpSHFailMet "var comments" UBYTE udf_CM_17410 0 0.0 0.0 255.0 ECU_ADDRESS 0x40002FDD /end MEASUREMENT
/begin MEASUREMENT FuelPumpSHTestComp "var comments" UBYTE udf_CM_17424 0 0.0 0.0 255.0 ECU_ADDRESS 0x40002FE0 /end MEASUREMENT
/begin MEASUREMENT FuelPumpSHTestFail "var comments" UBYTE udf_CM_17431 0 0.0 0.0 255.0 ECU_ADDRESS 0x40002FEA /end MEASUREMENT
/begin MEASUREMENT FuelPumpSHFailCount "var comments" UWORD udf_CM_17389 0 0.0 0.0 65535.0 ECU_ADDRESS 0x40002FE4 /end MEASUREMENT
/begin MEASUREMENT FuelPumpSHPassCount "var comments" UWORD udf_CM_17417 0 0.0 0.0 65535.0 ECU_ADDRESS 0x40002FE8 /end MEASUREMENT
/begin MEASUREMENT FuelPumpRunEnb "var comments" UBYTE udf_CM_16619 0 0.0 0.0 255.0 ECU_ADDRESS 0x4000278F /end MEASUREMENT
/begin MEASUREMENT FuelPumpDC "var comments" UWORD udf_CM_16598 0 0.0 0.0 199.9969482421875 ECU_ADDRESS 0x40002792 /end MEASUREMENT
/begin MEASUREMENT FuelPumpPPDsrd "var comments" UBYTE udf_CM_19244 0 0.0 0.0 255.0 ECU_ADDRESS 0x4000279F /end MEASUREMENT
/begin MEASUREMENT FuelPumpPrmEnb "var comments" UBYTE udf_CM_16612 0 0.0 0.0 255.0 ECU_ADDRESS 0x4000278E /end MEASUREMENT
/begin MEASUREMENT FuelVoltCorr "var comments" UWORD udf_CM_16626 0 0.0 0.0 1.999969005584717 ECU_ADDRESS 0x40002784 /end MEASUREMENT
/begin MEASUREMENT FuelPressureCorr "var comments" UWORD udf_CM_16627 0 0.0 0.0 3.99993896484375 ECU_ADDRESS 0x40002786 /end MEASUREMENT
/begin MEASUREMENT FinalFPWCyl1 "var comments" UWORD udf_CM_16283 0 0.0 0.0 1023.984375 DISPLAY_IDENTIFIER FinalFPWCyl[0] ECU_ADDRESS 0x40002776 /end MEASUREMENT
/begin MEASUREMENT FinalFPWCyl2 "var comments" UWORD udf_CM_16290 0 0.0 0.0 1023.984375 DISPLAY_IDENTIFIER FinalFPWCyl[1] ECU_ADDRESS 0x40002778 /end MEASUREMENT
/begin MEASUREMENT FinalFPWCyl3 "var comments" UWORD udf_CM_16290 0 0.0 0.0 1023.984375 DISPLAY_IDENTIFIER FinalFPWCyl[2] ECU_ADDRESS 0x4000277A /end MEASUREMENT
/begin MEASUREMENT FinalFPWCyl4 "var comments" UWORD udf_CM_16290 0 0.0 0.0 1023.984375 DISPLAY_IDENTIFIER FinalFPWCyl[3] ECU_ADDRESS 0x4000277C /end MEASUREMENT
/begin MEASUREMENT O2HtAccFuelMassPrevious "var comments" UWORD udf_CM_17466 0 0.0 0.0 7.9998779296875 ECU_ADDRESS 0x400026BE /end MEASUREMENT
/begin MEASUREMENT O2HtAccFuelMass "var comments" UWORD udf_CM_17459 0 0.0 0.0 7.9998779296875 ECU_ADDRESS 0x400026BC /end MEASUREMENT
/begin MEASUREMENT O2HeaterDC "var comments" UWORD udf_CM_17438 0 0.0 0.0 199.9969482421875 DISPLAY_IDENTIFIER O2HeaterDutyCycle ECU_ADDRESS 0x40002C16 /end MEASUREMENT
/begin MEASUREMENT O2HtAccFuelMassThresh "var comments" UWORD udf_CM_17473 0 0.0 0.0 7.9998779296875 ECU_ADDRESS 0x400026C0 /end MEASUREMENT
/begin MEASUREMENT AEDecayFactor "var comments" UWORD udf_CM_15261 0 0.0 0.0 0.9999849796295166 ECU_ADDRESS 0x400027A8 /end MEASUREMENT
/begin MEASUREMENT AECancelled "var comments" UBYTE udf_CM_15254 0 0.0 0.0 255.0 ECU_ADDRESS 0x400027AE /end MEASUREMENT
/begin MEASUREMENT AEFuelCyl1 "var comments" UWORD udf_CM_15268 0 0.0 0.0 7.9998779296875 DISPLAY_IDENTIFIER AEFuelCyl ECU_ADDRESS 0x400027A0 /end MEASUREMENT
/begin MEASUREMENT AccEnrich "var comments" UBYTE udf_CM_15240 0 0.0 0.0 255.0 ECU_ADDRESS 0x400027AC /end MEASUREMENT
/begin MEASUREMENT DEDecayFactor "var comments" UWORD udf_CM_15961 0 0.0 0.0 0.9999849796295166 ECU_ADDRESS 0x400027AA /end MEASUREMENT
/begin MEASUREMENT DEFuelCyl1 "var comments" UWORD udf_CM_15968 0 0.0 0.0 7.9998779296875 DISPLAY_IDENTIFIER DEFuelCyl ECU_ADDRESS 0x400027A2 /end MEASUREMENT
/begin MEASUREMENT DECancelled "var comments" UBYTE udf_CM_15947 0 0.0 0.0 255.0 ECU_ADDRESS 0x400027AF /end MEASUREMENT
/begin MEASUREMENT DecEnlean "var comments" UBYTE udf_CM_15954 0 0.0 0.0 255.0 ECU_ADDRESS 0x400027AD /end MEASUREMENT
/begin MEASUREMENT DeltaFuelCyl1 "var comments" UWORD udf_CM_15975 0 0.0 0.0 0.9999849796295166 DISPLAY_IDENTIFIER DeltaFuelCyl ECU_ADDRESS 0x400027A6 /end MEASUREMENT
/begin MEASUREMENT TranFuelDltCyl1 "var comments" SWORD udf_CM_18908 0 0.0 -8.0 7.999755859375 DISPLAY_IDENTIFIER TranFuelDltCyl ECU_ADDRESS 0x400027A4 /end MEASUREMENT
/begin MEASUREMENT FuelCutOff "var comments" UBYTE udf_CM_16451 0 0.0 0.0 255.0 ECU_ADDRESS 0x4000270A /end MEASUREMENT
/begin MEASUREMENT SparkCutOff "var comments" UBYTE udf_CM_16451 0 0.0 0.0 255.0 ECU_ADDRESS 0x4000270B /end MEASUREMENT
/begin MEASUREMENT VbFUEL_ClearFloodEnbl "var comments" UBYTE udf_CM_15723 0 0.0 0.0 255.0 ECU_ADDRESS 0x0 /end MEASUREMENT
/begin MEASUREMENT DFCO_TPS_Thrsh "var comments" UWORD udf_CM_16871 0 0.0 0.0 199.9969482421875 ECU_ADDRESS 0x0 /end MEASUREMENT
/begin MEASUREMENT DFCO_FuelCritMet "var comments" UBYTE udf_CM_15723 0 0.0 0.0 255.0 ECU_ADDRESS 0x4000270C /end MEASUREMENT
/begin MEASUREMENT DFCO_FuelEnabled "var comments" UBYTE udf_CM_15723 0 0.0 0.0 255.0 ECU_ADDRESS 0x4000270D /end MEASUREMENT
/begin MEASUREMENT DFCO_FuelExitEnbl "var comments" UBYTE udf_CM_15723 0 0.0 0.0 255.0 ECU_ADDRESS 0x4000270E /end MEASUREMENT
/begin MEASUREMENT DFCO_FuelRampOutEn "var comments" UBYTE udf_CM_15723 0 0.0 0.0 255.0 ECU_ADDRESS 0x4000270F /end MEASUREMENT
/begin MEASUREMENT DFCO_SparkCritMet "var comments" UBYTE udf_CM_15723 0 0.0 0.0 255.0 ECU_ADDRESS 0x40002710 /end MEASUREMENT
/begin MEASUREMENT DFCO_SparkEnabled "var comments" UBYTE udf_CM_15723 0 0.0 0.0 255.0 ECU_ADDRESS 0x40002711 /end MEASUREMENT
/begin MEASUREMENT DFCO_EM_Disable "var comments" UBYTE udf_CM_15723 0 0.0 0.0 255.0 ECU_ADDRESS 0x40002706 /end MEASUREMENT
/begin MEASUREMENT DFCO_MAPThrsh "var comments" UWORD udf_CM_15401 0 0.0 0.0 255.99609375 ECU_ADDRESS 0x40002702 /end MEASUREMENT
/begin MEASUREMENT DFCO_FuelRampoutFact "var comments" UWORD udf_CM_16626 0 0.0 0.0 1.999969005584717 ECU_ADDRESS 0x40002712 /end MEASUREMENT
/begin MEASUREMENT DFCO_ExitFuel "var comments" UWORD udf_CM_16283 0 0.0 0.0 1023.984375 ECU_ADDRESS 0x40002714 /end MEASUREMENT
/begin MEASUREMENT FuelConsump "var comments" UWORD udf_CM_16444 0 0.0 0.0 15.999755859375 ECU_ADDRESS 0x400026CC /end MEASUREMENT
/begin MEASUREMENT FuelConsumpTotal "var comments" ULONG udf_CM_16446 0 0.0 0.0 2147483647.5 ECU_ADDRESS 0x400002D0 /end MEASUREMENT
/begin MEASUREMENT FuelCurSum "var comments" ULONG udf_CM_16447 0 0.0 0.0 1048575.999755859 ECU_ADDRESS 0x400026D8 /end MEASUREMENT
/begin MEASUREMENT FuelRate "var comments" UWORD udf_CM_16445 0 0.0 0.0 4095.9375 ECU_ADDRESS 0x400026E4 /end MEASUREMENT
/begin MEASUREMENT InjectorFlow "var comments" UWORD udf_CM_16444 0 0.0 0.0 15.999755859375 ECU_ADDRESS 0x40002D46 /end MEASUREMENT
/begin MEASUREMENT FuelDlvMode "var comments" UBYTE udf_CM_16458 0 0.0 0.0 255.0 ECU_ADDRESS 0x40002774 /end MEASUREMENT
/begin MEASUREMENT BLM_LrnActive "var comments" UBYTE udf_CM_17158 0 0.0 0.0 255.0 ECU_ADDRESS 0x40002850 /end MEASUREMENT
/begin MEASUREMENT BLM_Updated "var comments" UBYTE udf_CM_17158 0 0.0 0.0 255.0 ECU_ADDRESS 0x40002851 /end MEASUREMENT
/begin MEASUREMENT BLM_LrnAllowed "var comments" UBYTE udf_CM_17158 0 0.0 0.0 255.0 ECU_ADDRESS 0x40002852 /end MEASUREMENT
/begin MEASUREMENT BLM_RPM_DeltaMet "var comments" UBYTE udf_CM_17158 0 0.0 0.0 255.0 ECU_ADDRESS 0x40002853 /end MEASUREMENT
/begin MEASUREMENT BLM_AirFlowDeltaMet "var comments" UBYTE udf_CM_17158 0 0.0 0.0 255.0 ECU_ADDRESS 0x40002854 /end MEASUREMENT
/begin MEASUREMENT BLM_EngSpeedFilt "var comments" UWORD udf_CM_16185 0 0.0 0.0 16383.75 ECU_ADDRESS 0x40002858 /end MEASUREMENT
/begin MEASUREMENT BLM_EngSpeedDelta "var comments" UWORD udf_CM_16185 0 0.0 0.0 16383.75 ECU_ADDRESS 0x400027E8 /end MEASUREMENT
/begin MEASUREMENT BLM_AirFlowFilt "var comments" UWORD udf_CM_15534 0 0.0 0.0 511.9921875 ECU_ADDRESS 0x40002856 /end MEASUREMENT
/begin MEASUREMENT BLM_AirFlowDelta "var comments" UWORD udf_CM_15534 0 0.0 0.0 511.9921875 ECU_ADDRESS 0x400027E6 /end MEASUREMENT
/begin MEASUREMENT FUEL_BLM_Base "var comments" UWORD udf_CM_16626 0 0.0 0.0 1.999969005584717 ECU_ADDRESS 0x400027E2 /end MEASUREMENT
/begin MEASUREMENT FUEL_BLM_FCV "var comments" UWORD udf_CM_16626 0 0.0 0.0 1.999969005584717 ECU_ADDRESS 0x400027E4 /end MEASUREMENT
/begin MEASUREMENT BLM_CellChange "var comments" UBYTE udf_CM_17158 0 0.0 0.0 255.0 ECU_ADDRESS 0x400027DF /end MEASUREMENT
/begin MEASUREMENT BLM_CellChangeLrnDly "var comments" UBYTE udf_CM_17158 0 0.0 0.0 255.0 ECU_ADDRESS 0x400027E0 /end MEASUREMENT
/begin MEASUREMENT BLM_CellRow "var comments" UBYTE udf_CM_15247 0 0.0 0.0 255.0 ECU_ADDRESS 0x400027D9 /end MEASUREMENT
/begin MEASUREMENT BLM_CellCol "var comments" UBYTE udf_CM_15247 0 0.0 0.0 255.0 ECU_ADDRESS 0x400027DB /end MEASUREMENT
/begin MEASUREMENT BLM_Cell_Petrol "var comments" UWORD udf_CM_16626 0 0.0 0.0 1.999969005584717 LAYOUT COLUMN_DIR MATRIX_DIM 17 3 ECU_ADDRESS 0x4000019A /end MEASUREMENT
/begin MEASUREMENT BLM_Cell_NG "var comments" UWORD udf_CM_16626 0 0.0 0.0 1.999969005584717 LAYOUT COLUMN_DIR MATRIX_DIM 17 3 ECU_ADDRESS 0x40000200 /end MEASUREMENT
/begin MEASUREMENT BLM_Cell_LPG "var comments" UWORD udf_CM_16626 0 0.0 0.0 1.999969005584717 LAYOUT COLUMN_DIR MATRIX_DIM 17 3 ECU_ADDRESS 0x40000266 /end MEASUREMENT
/begin MEASUREMENT L9960_OCH1 "var comments" UBYTE udf_CM_15247 0 0.0 0.0 255.0 ECU_ADDRESS 0x40000AC8 /end MEASUREMENT
/begin MEASUREMENT L9960_OCH0 "var comments" UBYTE udf_CM_15247 0 0.0 0.0 255.0 ECU_ADDRESS 0x40000AC9 /end MEASUREMENT
/begin MEASUREMENT L9960_OCL1 "var comments" UBYTE udf_CM_15247 0 0.0 0.0 255.0 ECU_ADDRESS 0x40000ACA /end MEASUREMENT
/begin MEASUREMENT L9960_OCL0 "var comments" UBYTE udf_CM_15247 0 0.0 0.0 255.0 ECU_ADDRESS 0x40000ACB /end MEASUREMENT
/begin MEASUREMENT L9960_CL_ECHO "var comments" UBYTE udf_CM_15247 0 0.0 0.0 255.0 ECU_ADDRESS 0x40000ACC /end MEASUREMENT
/begin MEASUREMENT L9960_NOSR_ECHO "var comments" UBYTE udf_CM_15247 0 0.0 0.0 255.0 ECU_ADDRESS 0x40000ACD /end MEASUREMENT
/begin MEASUREMENT L9960_ISR_ECHO "var comments" UBYTE udf_CM_15247 0 0.0 0.0 255.0 ECU_ADDRESS 0x40000ACE /end MEASUREMENT
/begin MEASUREMENT L9960_VSR_ECHO "var comments" UBYTE udf_CM_15247 0 0.0 0.0 255.0 ECU_ADDRESS 0x40000ACF /end MEASUREMENT
/begin MEASUREMENT L9960_TDIAG1_ECHO "var comments" UBYTE udf_CM_15247 0 0.0 0.0 255.0 ECU_ADDRESS 0x40000AD0 /end MEASUREMENT
/begin MEASUREMENT L9960_TSW_LOW_CURRENT_ECHO "var comments" UBYTE udf_CM_15247 0 0.0 0.0 255.0 ECU_ADDRESS 0x40000AD1 /end MEASUREMENT
/begin MEASUREMENT L9960_DIAG_CLR_EN "var comments" UBYTE udf_CM_15247 0 0.0 0.0 255.0 ECU_ADDRESS 0x40000AD2 /end MEASUREMENT
/begin MEASUREMENT L9960_IN1_IN2_IF_ECHO "var comments" UBYTE udf_CM_15247 0 0.0 0.0 255.0 ECU_ADDRESS 0x40000AD3 /end MEASUREMENT
/begin MEASUREMENT L9960_IN1_IN2_IF_LATCH "var comments" UBYTE udf_CM_15247 0 0.0 0.0 255.0 ECU_ADDRESS 0x40000AD4 /end MEASUREMENT
/begin MEASUREMENT L9960_OT_SD_THR_VAR_ECHO "var comments" UBYTE udf_CM_15247 0 0.0 0.0 255.0 ECU_ADDRESS 0x40000AD5 /end MEASUREMENT
/begin MEASUREMENT L9960_OTWARN_THR_VAR_ECHO "var comments" UBYTE udf_CM_15247 0 0.0 0.0 255.0 ECU_ADDRESS 0x40000AD6 /end MEASUREMENT
/begin MEASUREMENT L9960_UV_PROT_EN_ECHO "var comments" UBYTE udf_CM_15247 0 0.0 0.0 255.0 ECU_ADDRESS 0x40000AD7 /end MEASUREMENT
/begin MEASUREMENT L9960_NSPREAD_ECHO "var comments" UBYTE udf_CM_15247 0 0.0 0.0 255.0 ECU_ADDRESS 0x40000AD8 /end MEASUREMENT
/begin MEASUREMENT L9960_UV_WIN_ECHO "var comments" UBYTE udf_CM_15247 0 0.0 0.0 255.0 ECU_ADDRESS 0x40000AD9 /end MEASUREMENT
/begin MEASUREMENT L9960_WLMODE_ECHO "var comments" UBYTE udf_CM_15247 0 0.0 0.0 255.0 ECU_ADDRESS 0x40000ADA /end MEASUREMENT
/begin MEASUREMENT L9960_TVVL_ECHO "var comments" UBYTE udf_CM_15247 0 0.0 0.0 255.0 ECU_ADDRESS 0x40000ADB /end MEASUREMENT
/begin MEASUREMENT L9960_OTWARN_TSEC_EN_ECHO "var comments" UBYTE udf_CM_15247 0 0.0 0.0 255.0 ECU_ADDRESS 0x40000ADC /end MEASUREMENT
/begin MEASUREMENT L9960_TDSR_ECHO "var comments" UBYTE udf_CM_15247 0 0.0 0.0 255.0 ECU_ADDRESS 0x40000ADD /end MEASUREMENT
/begin MEASUREMENT L9960_POR_STATUS "var comments" UBYTE udf_CM_15247 0 0.0 0.0 255.0 ECU_ADDRESS 0x40000ADE /end MEASUREMENT
/begin MEASUREMENT L9960_CONFIG_CC_STATUS_ECHO "var comments" UBYTE udf_CM_15247 0 0.0 0.0 255.0 ECU_ADDRESS 0x40000ADF /end MEASUREMENT
/begin MEASUREMENT L9960_CC_LATCH_STATE "var comments" UBYTE udf_CM_15247 0 0.0 0.0 255.0 ECU_ADDRESS 0x40000AE0 /end MEASUREMENT
/begin MEASUREMENT L9960_NDIS_STATUS "var comments" UBYTE udf_CM_15247 0 0.0 0.0 255.0 ECU_ADDRESS 0x40000AE1 /end MEASUREMENT
/begin MEASUREMENT L9960_DIS_STATUS "var comments" UBYTE udf_CM_15247 0 0.0 0.0 255.0 ECU_ADDRESS 0x40000AE2 /end MEASUREMENT
/begin MEASUREMENT L9960_BRIDGE_EN "var comments" UBYTE udf_CM_15247 0 0.0 0.0 255.0 ECU_ADDRESS 0x40000AE3 /end MEASUREMENT
/begin MEASUREMENT L9960_HWSC_LBIST_STATUS "var comments" UBYTE udf_CM_15247 0 0.0 0.0 255.0 ECU_ADDRESS 0x40000AE4 /end MEASUREMENT
/begin MEASUREMENT L9960_VPS_UV_REG "var comments" UBYTE udf_CM_15247 0 0.0 0.0 255.0 ECU_ADDRESS 0x40000AE5 /end MEASUREMENT
/begin MEASUREMENT L9960_NGFAIL "var comments" UBYTE udf_CM_15247 0 0.0 0.0 255.0 ECU_ADDRESS 0x40000AE6 /end MEASUREMENT
/begin MEASUREMENT L9960_ILIM_REG "var comments" UBYTE udf_CM_15247 0 0.0 0.0 255.0 ECU_ADDRESS 0x40000AE7 /end MEASUREMENT
/begin MEASUREMENT L9960_VDD_OV_REG "var comments" UBYTE udf_CM_15247 0 0.0 0.0 255.0 ECU_ADDRESS 0x40000AE8 /end MEASUREMENT
/begin MEASUREMENT L9960_VDD_UV_REG "var comments" UBYTE udf_CM_15247 0 0.0 0.0 255.0 ECU_ADDRESS 0x40000AE9 /end MEASUREMENT
/begin MEASUREMENT L9960_VPS_UV "var comments" UBYTE udf_CM_15247 0 0.0 0.0 255.0 ECU_ADDRESS 0x40000AEA /end MEASUREMENT
/begin MEASUREMENT L9960_OTSDCNT "var comments" UBYTE udf_CM_15247 0 0.0 0.0 255.0 ECU_ADDRESS 0x40000AEB /end MEASUREMENT
/begin MEASUREMENT L9960_OTWARN "var comments" UBYTE udf_CM_15247 0 0.0 0.0 255.0 ECU_ADDRESS 0x40000AEC /end MEASUREMENT
/begin MEASUREMENT L9960_OTWARN_REG "var comments" UBYTE udf_CM_15247 0 0.0 0.0 255.0 ECU_ADDRESS 0x40000AED /end MEASUREMENT
/begin MEASUREMENT L9960_NOTSD "var comments" UBYTE udf_CM_15247 0 0.0 0.0 255.0 ECU_ADDRESS 0x40000AEE /end MEASUREMENT
/begin MEASUREMENT L9960_NOTSD_REG "var comments" UBYTE udf_CM_15247 0 0.0 0.0 255.0 ECU_ADDRESS 0x40000AEF /end MEASUREMENT
/begin MEASUREMENT L9960_OL_ON_STATUS "var comments" UBYTE udf_CM_15247 0 0.0 0.0 255.0 ECU_ADDRESS 0x40000AF0 /end MEASUREMENT
/begin MEASUREMENT L9960_UV_CNT_REACHED "var comments" UBYTE udf_CM_15247 0 0.0 0.0 255.0 ECU_ADDRESS 0x40000AF1 /end MEASUREMENT
/begin MEASUREMENT L9960_ERROR_COUNT "var comments" UBYTE udf_CM_15247 0 0.0 0.0 255.0 ECU_ADDRESS 0x40000AF2 /end MEASUREMENT
/begin MEASUREMENT L9960_DIAG_OFF "var comments" UBYTE udf_CM_15247 0 0.0 0.0 255.0 ECU_ADDRESS 0x40000AF3 /end MEASUREMENT
/begin MEASUREMENT L9960_VDD_OV_L "var comments" UBYTE udf_CM_15247 0 0.0 0.0 255.0 ECU_ADDRESS 0x40000AF4 /end MEASUREMENT
/begin MEASUREMENT L9960_VDD_OV "var comments" UBYTE udf_CM_15247 0 0.0 0.0 255.0 ECU_ADDRESS 0x40000AF5 /end MEASUREMENT
/begin MEASUREMENT L9960_VDD_UV "var comments" UBYTE udf_CM_15247 0 0.0 0.0 255.0 ECU_ADDRESS 0x40000AF6 /end MEASUREMENT
/begin MEASUREMENT VECyl1 "var comments" UWORD udf_CM_19398 0 0.0 0.0 199.9969482421875 DISPLAY_IDENTIFIER VECyl[0] ECU_ADDRESS 0x4000266E /end MEASUREMENT
/begin MEASUREMENT VECyl2 "var comments" UWORD udf_CM_19398 0 0.0 0.0 199.9969482421875 DISPLAY_IDENTIFIER VECyl[1] ECU_ADDRESS 0x40002670 /end MEASUREMENT
/begin MEASUREMENT VECyl3 "var comments" UWORD udf_CM_19398 0 0.0 0.0 199.9969482421875 DISPLAY_IDENTIFIER VECyl[2] ECU_ADDRESS 0x40002672 /end MEASUREMENT
/begin MEASUREMENT VECyl4 "var comments" UWORD udf_CM_19398 0 0.0 0.0 199.9969482421875 DISPLAY_IDENTIFIER VECyl[3] ECU_ADDRESS 0x40002674 /end MEASUREMENT
/begin MEASUREMENT AirPerCyl1 "var comments" UWORD udf_CM_15548 0 0.0 0.0 3.99993896484375 DISPLAY_IDENTIFIER AirPerCyl[0] ECU_ADDRESS 0x40002654 /end MEASUREMENT
/begin MEASUREMENT AirPerCyl2 "var comments" UWORD udf_CM_15555 0 0.0 0.0 3.99993896484375 DISPLAY_IDENTIFIER AirPerCyl[1] ECU_ADDRESS 0x40002656 /end MEASUREMENT
/begin MEASUREMENT IDLEMoveDirct "var comments" UBYTE udf_CM_16668 0 0.0 0.0 2.0 ECU_ADDRESS 0x40002D52 /end MEASUREMENT
/begin MEASUREMENT IDLEMode "var comments" UBYTE udf_CM_16640 0 0.0 0.0 255.0 ECU_ADDRESS 0x40002941 /end MEASUREMENT
/begin MEASUREMENT IDLEMotorState "var comments" UBYTE udf_CM_16661 0 0.0 0.0 3.0 ECU_ADDRESS 0x40002D58 /end MEASUREMENT
/begin MEASUREMENT ActIDLEPosition "var comments" UBYTE udf_CM_15247 0 0.0 0.0 255.0 ECU_ADDRESS 0x40002D56 /end MEASUREMENT
/begin MEASUREMENT IdlDerivTerm "var comments" SWORD udf_CM_16773 0 0.0 -200.0 199.993896484375 ECU_ADDRESS 0x4000291A /end MEASUREMENT
/begin MEASUREMENT IdlDerivTermEnh "var comments" SWORD udf_CM_16773 0 0.0 -200.0 199.993896484375 ECU_ADDRESS 0x40002918 /end MEASUREMENT
/begin MEASUREMENT IdlDsrdSpdStOfst "var comments" UWORD udf_CM_16801 0 0.0 0.0 16383.75 ECU_ADDRESS 0x4000295A /end MEASUREMENT
/begin MEASUREMENT IdlEngSpdHigh "var comments" UBYTE udf_CM_16850 0 0.0 0.0 255.0 ECU_ADDRESS 0x40002959 /end MEASUREMENT
/begin MEASUREMENT IdlINTDelta "var comments" UWORD udf_CM_16864 0 0.0 0.0 199.9969482421875 ECU_ADDRESS 0x4000291E /end MEASUREMENT
/begin MEASUREMENT IdlINTTerm "var comments" UWORD udf_CM_16871 0 0.0 0.0 199.9969482421875 ECU_ADDRESS 0x40002916 /end MEASUREMENT
/begin MEASUREMENT NrmIdlDlyTmr "var comments" UWORD udf_CM_17368 0 0.0 0.0 1023.984375 ECU_ADDRESS 0x40002950 /end MEASUREMENT
/begin MEASUREMENT IdlPropTerm "var comments" SWORD udf_CM_16885 0 0.0 -200.0 199.993896484375 ECU_ADDRESS 0x40002920 /end MEASUREMENT
/begin MEASUREMENT IdlDsrdEngSpd "var comments" UWORD udf_CM_16780 0 0.0 0.0 16383.75 ECU_ADDRESS 0x40002956 /end MEASUREMENT
/begin MEASUREMENT IdlEngSpdError "var comments" UWORD udf_CM_16843 0 0.0 0.0 16383.75 ECU_ADDRESS 0x4000295C /end MEASUREMENT
/begin MEASUREMENT IACVResetInProg "var comments" UBYTE udf_CM_16682 0 0.0 0.0 255.0 ECU_ADDRESS 0x400029CC /end MEASUREMENT
/begin MEASUREMENT DsrdIACV_MtrPstn "var comments" UBYTE udf_CM_15247 0 0.0 0.0 255.0 ECU_ADDRESS 0x40002D7E /end MEASUREMENT
/begin MEASUREMENT IACVResetCmplt "var comments" UBYTE udf_CM_16675 0 0.0 0.0 255.0 ECU_ADDRESS 0x400029D2 /end MEASUREMENT
/begin MEASUREMENT IACVMotorLost "var comments" UBYTE udf_CM_16647 0 0.0 0.0 255.0 ECU_ADDRESS 0x400029CF /end MEASUREMENT
/begin MEASUREMENT IACVMotorReset "var comments" UBYTE udf_CM_16654 0 0.0 0.0 255.0 ECU_ADDRESS 0x400029CE /end MEASUREMENT
/begin MEASUREMENT IACVOLFlow "var comments" UWORD udf_CM_16808 0 0.0 0.0 199.9969482421875 ECU_ADDRESS 0x400029BA /end MEASUREMENT
/begin MEASUREMENT IACVCLFlow "var comments" UWORD udf_CM_16808 0 0.0 0.0 199.9969482421875 ECU_ADDRESS 0x40002974 /end MEASUREMENT
/begin MEASUREMENT IACVFlow "var comments" UWORD udf_CM_16808 0 0.0 0.0 199.9969482421875 ECU_ADDRESS 0x4000297C /end MEASUREMENT
/begin MEASUREMENT IACVFlowCoolOffset "var comments" UWORD udf_CM_16808 0 0.0 0.0 199.9969482421875 ECU_ADDRESS 0x400029AE /end MEASUREMENT
/begin MEASUREMENT IACVFlowCoolOffsetMax "var comments" UWORD udf_CM_16808 0 0.0 0.0 199.9969482421875 ECU_ADDRESS 0x400029B0 /end MEASUREMENT
/begin MEASUREMENT IACVFlowCrankOffset "var comments" UWORD udf_CM_16808 0 0.0 0.0 199.9969482421875 ECU_ADDRESS 0x400029AC /end MEASUREMENT
/begin MEASUREMENT IACVFlowTFOffset "var comments" UWORD udf_CM_16808 0 0.0 0.0 199.9969482421875 ECU_ADDRESS 0x400029BC /end MEASUREMENT
/begin MEASUREMENT IACVFlowBattOffset "var comments" UWORD udf_CM_16808 0 0.0 0.0 199.9969482421875 ECU_ADDRESS 0x400029B2 /end MEASUREMENT
/begin MEASUREMENT IACVFlowDsrdTF "var comments" UWORD udf_CM_16808 0 0.0 0.0 199.9969482421875 ECU_ADDRESS 0x400029BE /end MEASUREMENT
/begin MEASUREMENT IACVFlowCoolFactor "var comments" UWORD udf_CM_15261 0 0.0 0.0 0.9999849796295166 ECU_ADDRESS 0x400029B8 /end MEASUREMENT
/begin MEASUREMENT IACVFlowCoolantDecayTime "var comments" UWORD udf_CM_16507 0 0.0 0.0 1023.984375 ECU_ADDRESS 0x400029B4 /end MEASUREMENT
/begin MEASUREMENT IACVAlternatorLoadStat "var comments" UBYTE udf_CM_16423 0 0.0 0.0 255.0 ECU_ADDRESS 0x400029B6 /end MEASUREMENT
/begin MEASUREMENT IACVCLCondMet "var comments" UBYTE udf_CM_16857 0 0.0 0.0 255.0 ECU_ADDRESS 0x400029A5 /end MEASUREMENT
/begin MEASUREMENT IACVMode "var comments" UBYTE udf_CM_16640 0 0.0 0.0 255.0 ECU_ADDRESS 0x400029A4 /end MEASUREMENT
/begin MEASUREMENT ActIACVPosition "var comments" UBYTE udf_CM_15247 0 0.0 0.0 255.0 ECU_ADDRESS 0x40002D71 /end MEASUREMENT
/begin MEASUREMENT IACVMoveDirct "var comments" UBYTE udf_CM_16668 0 0.0 0.0 2.0 ECU_ADDRESS 0x40002D70 /end MEASUREMENT
/begin MEASUREMENT IACVMotorState "var comments" UBYTE udf_CM_16661 0 0.0 0.0 3.0 ECU_ADDRESS 0x40002D75 /end MEASUREMENT
/begin MEASUREMENT IACVDerivTerm "var comments" SWORD udf_CM_16773 0 0.0 -200.0 199.993896484375 ECU_ADDRESS 0x40002970 /end MEASUREMENT
/begin MEASUREMENT IACVDsrdSpdStOfst "var comments" UWORD udf_CM_16801 0 0.0 0.0 16383.75 ECU_ADDRESS 0x400029C0 /end MEASUREMENT
/begin MEASUREMENT IACVEngSpdHigh "var comments" UBYTE udf_CM_16850 0 0.0 0.0 255.0 ECU_ADDRESS 0x400029C5 /end MEASUREMENT
/begin MEASUREMENT IACVINTDelta "var comments" UWORD udf_CM_16864 0 0.0 0.0 199.9969482421875 ECU_ADDRESS 0x40002966 /end MEASUREMENT
/begin MEASUREMENT IACVINTTerm "var comments" UWORD udf_CM_16871 0 0.0 0.0 199.9969482421875 ECU_ADDRESS 0x40002962 /end MEASUREMENT
/begin MEASUREMENT NrmIACVDlyTmr "var comments" UWORD udf_CM_17368 0 0.0 0.0 1023.984375 ECU_ADDRESS 0x400029A6 /end MEASUREMENT
/begin MEASUREMENT IACVPropTerm "var comments" SWORD udf_CM_16885 0 0.0 -200.0 199.993896484375 ECU_ADDRESS 0x40002972 /end MEASUREMENT
/begin MEASUREMENT IACVDsrdEngSpd "var comments" UWORD udf_CM_16780 0 0.0 0.0 16383.75 ECU_ADDRESS 0x400029C6 /end MEASUREMENT
/begin MEASUREMENT IACVEngSpdError "var comments" UWORD udf_CM_16843 0 0.0 0.0 16383.75 ECU_ADDRESS 0x400029CA /end MEASUREMENT
/begin MEASUREMENT BSTPDsrd "var comments" UWORD udf_CM_15562 0 0.0 0.0 255.99609375 ECU_ADDRESS 0x400026AA /end MEASUREMENT
/begin MEASUREMENT BSTPError "var comments" UWORD udf_CM_15562 0 0.0 0.0 255.99609375 ECU_ADDRESS 0x400026A0 /end MEASUREMENT
/begin MEASUREMENT BSTPHi2Dsr "var comments" UBYTE udf_CM_16850 0 0.0 0.0 255.0 ECU_ADDRESS 0x400026A4 /end MEASUREMENT
/begin MEASUREMENT BSTPCLTerm "var comments" SWORD udf_CM_16885 0 0.0 -200.0 199.993896484375 ECU_ADDRESS 0x400026A6 /end MEASUREMENT
/begin MEASUREMENT BSTPINTTerm "var comments" SWORD udf_CM_16885 0 0.0 -200.0 199.993896484375 ECU_ADDRESS 0x4000269E /end MEASUREMENT
/begin MEASUREMENT BSTPPropTerm "var comments" SWORD udf_CM_16885 0 0.0 -200.0 199.993896484375 ECU_ADDRESS 0x400026B0 /end MEASUREMENT
/begin MEASUREMENT BSTPOLTerm "var comments" UWORD udf_CM_16808 0 0.0 0.0 199.9969482421875 ECU_ADDRESS 0x400026A8 /end MEASUREMENT
/begin MEASUREMENT BSTPBstTotal "var comments" UWORD udf_CM_16808 0 0.0 0.0 199.9969482421875 ECU_ADDRESS 0x400026A2 /end MEASUREMENT
/begin MEASUREMENT BSTPINTDelta "var comments" UWORD udf_CM_16864 0 0.0 0.0 199.9969482421875 ECU_ADDRESS 0x400026AC /end MEASUREMENT
/begin MEASUREMENT BSTPActual "var comments" UWORD udf_CM_17291 0 0.0 0.0 255.99609375 ECU_ADDRESS 0x40002DC8 /end MEASUREMENT
/begin MEASUREMENT BSTPUnfilt "var comments" UWORD udf_CM_17291 0 0.0 0.0 255.99609375 ECU_ADDRESS 0x40002DCA /end MEASUREMENT
/begin MEASUREMENT BSTP_DC "var comments" UWORD udf_CM_18726 0 0.0 0.0 199.9969482421875 ECU_ADDRESS 0x400026AE /end MEASUREMENT
/begin MEASUREMENT ACLoadMet "var comments" UBYTE udf_CM_17214 0 0.0 0.0 255.0 ECU_ADDRESS 0x40002D3E /end MEASUREMENT
/begin MEASUREMENT GenDCCurrent "var comments" UWORD udf_CM_17294 0 0.0 0.0 255.99609375 ECU_ADDRESS 0x40002D3C /end MEASUREMENT
/begin MEASUREMENT IATSHTestFail "var comments" UBYTE udf_CM_16724 0 0.0 0.0 255.0 ECU_ADDRESS 0x40002F0B /end MEASUREMENT
/begin MEASUREMENT IATSHFailCount "var comments" UWORD udf_CM_16703 0 0.0 0.0 65535.0 ECU_ADDRESS 0x40002F12 /end MEASUREMENT
/begin MEASUREMENT IATSHFailMet "var comments" UBYTE udf_CM_16710 0 0.0 0.0 255.0 ECU_ADDRESS 0x40002F03 /end MEASUREMENT
/begin MEASUREMENT IATSHPassCount "var comments" UWORD udf_CM_16717 0 0.0 0.0 65535.0 ECU_ADDRESS 0x40002F14 /end MEASUREMENT
/begin MEASUREMENT IATSTDiagEnb "var comments" UBYTE udf_CM_16731 0 0.0 0.0 255.0 ECU_ADDRESS 0x40002F04 /end MEASUREMENT
/begin MEASUREMENT IATOHDiagEnb "var comments" UBYTE udf_CM_16731 0 0.0 0.0 255.0 ECU_ADDRESS 0x40002F05 /end MEASUREMENT
/begin MEASUREMENT IATSLFailCount "var comments" UWORD udf_CM_16738 0 0.0 0.0 65535.0 ECU_ADDRESS 0x40002F0E /end MEASUREMENT
/begin MEASUREMENT IATSLFailMet "var comments" UBYTE udf_CM_16745 0 0.0 0.0 255.0 ECU_ADDRESS 0x40002F02 /end MEASUREMENT
/begin MEASUREMENT IATSLPassCount "var comments" UWORD udf_CM_16752 0 0.0 0.0 65535.0 ECU_ADDRESS 0x40002F10 /end MEASUREMENT
/begin MEASUREMENT IATSLTestFail "var comments" UBYTE udf_CM_16759 0 0.0 0.0 255.0 ECU_ADDRESS 0x40002F0A /end MEASUREMENT
/begin MEASUREMENT IATOH1FailCount "var comments" UWORD udf_CM_16738 0 0.0 0.0 65535.0 ECU_ADDRESS 0x40002F16 /end MEASUREMENT
/begin MEASUREMENT IATOH1FailMet "var comments" UBYTE udf_CM_16745 0 0.0 0.0 255.0 ECU_ADDRESS 0x40002F00 /end MEASUREMENT
/begin MEASUREMENT IATOH1PassCount "var comments" UWORD udf_CM_16752 0 0.0 0.0 65535.0 ECU_ADDRESS 0x40002F18 /end MEASUREMENT
/begin MEASUREMENT IATOH1TestFail "var comments" UBYTE udf_CM_16759 0 0.0 0.0 255.0 ECU_ADDRESS 0x40002F0C /end MEASUREMENT
/begin MEASUREMENT IATOH2FailCount "var comments" UWORD udf_CM_16738 0 0.0 0.0 65535.0 ECU_ADDRESS 0x40002F1A /end MEASUREMENT
/begin MEASUREMENT IATOH2FailMet "var comments" UBYTE udf_CM_16745 0 0.0 0.0 255.0 ECU_ADDRESS 0x40002F01 /end MEASUREMENT
/begin MEASUREMENT IATOH2PassCount "var comments" UWORD udf_CM_16752 0 0.0 0.0 65535.0 ECU_ADDRESS 0x40002F1C /end MEASUREMENT
/begin MEASUREMENT IATOH2TestFail "var comments" UBYTE udf_CM_16759 0 0.0 0.0 255.0 ECU_ADDRESS 0x40002F0D /end MEASUREMENT
/begin MEASUREMENT COSTestFail "var comments" UBYTE udf_CM_16724 0 0.0 0.0 255.0 ECU_ADDRESS 0x40003116 /end MEASUREMENT
/begin MEASUREMENT COSFailCount "var comments" UWORD udf_CM_16703 0 0.0 0.0 65535.0 ECU_ADDRESS 0x4000311A /end MEASUREMENT
/begin MEASUREMENT COSFailMet "var comments" UBYTE udf_CM_16710 0 0.0 0.0 255.0 ECU_ADDRESS 0x40003117 /end MEASUREMENT
/begin MEASUREMENT COSPassCount "var comments" UWORD udf_CM_16717 0 0.0 0.0 65535.0 ECU_ADDRESS 0x40003118 /end MEASUREMENT
/begin MEASUREMENT COSDiagEnb "var comments" UBYTE udf_CM_16731 0 0.0 0.0 255.0 ECU_ADDRESS 0x40003114 /end MEASUREMENT
/begin MEASUREMENT COATestFail "var comments" UBYTE udf_CM_16724 0 0.0 0.0 255.0 ECU_ADDRESS 0x4000311E /end MEASUREMENT
/begin MEASUREMENT COAFailCount "var comments" UWORD udf_CM_16703 0 0.0 0.0 65535.0 ECU_ADDRESS 0x40003122 /end MEASUREMENT
/begin MEASUREMENT COAFailMet "var comments" UBYTE udf_CM_16710 0 0.0 0.0 255.0 ECU_ADDRESS 0x4000311F /end MEASUREMENT
/begin MEASUREMENT COAPassCount "var comments" UWORD udf_CM_16717 0 0.0 0.0 65535.0 ECU_ADDRESS 0x40003120 /end MEASUREMENT
/begin MEASUREMENT COADiagEnb "var comments" UBYTE udf_CM_16731 0 0.0 0.0 255.0 ECU_ADDRESS 0x4000311C /end MEASUREMENT
/begin MEASUREMENT SCISHTestFail "var comments" UBYTE udf_CM_16724 0 0.0 0.0 255.0 ECU_ADDRESS 0x40002F22 /end MEASUREMENT
/begin MEASUREMENT SCISHFailCount "var comments" UWORD udf_CM_16703 0 0.0 0.0 65535.0 ECU_ADDRESS 0x40002F28 /end MEASUREMENT
/begin MEASUREMENT SCISHFailMet "var comments" UBYTE udf_CM_16710 0 0.0 0.0 255.0 ECU_ADDRESS 0x40002F2C /end MEASUREMENT
/begin MEASUREMENT SCISHPassCount "var comments" UWORD udf_CM_16717 0 0.0 0.0 65535.0 ECU_ADDRESS 0x40002F2A /end MEASUREMENT
/begin MEASUREMENT SCIDiagEnb "var comments" UBYTE udf_CM_16731 0 0.0 0.0 255.0 ECU_ADDRESS 0x40002F1E /end MEASUREMENT
/begin MEASUREMENT SCISLFailCount "var comments" UWORD udf_CM_16738 0 0.0 0.0 65535.0 ECU_ADDRESS 0x40002F24 /end MEASUREMENT
/begin MEASUREMENT SCISLFailMet "var comments" UBYTE udf_CM_16745 0 0.0 0.0 255.0 ECU_ADDRESS 0x40002F23 /end MEASUREMENT
/begin MEASUREMENT SCISLPassCount "var comments" UWORD udf_CM_16752 0 0.0 0.0 65535.0 ECU_ADDRESS 0x40002F26 /end MEASUREMENT
/begin MEASUREMENT SCISLTestFail "var comments" UBYTE udf_CM_16759 0 0.0 0.0 255.0 ECU_ADDRESS 0x40002F21 /end MEASUREMENT
/begin MEASUREMENT ACSSLFailMet "var comments" UBYTE udf_CM_16710 0 0.0 0.0 255.0 ECU_ADDRESS 0x400030F9 /end MEASUREMENT
/begin MEASUREMENT ACSSHFailMet "var comments" UBYTE udf_CM_16710 0 0.0 0.0 255.0 ECU_ADDRESS 0x40003102 /end MEASUREMENT
/begin MEASUREMENT ACSSLTestFail "var comments" UBYTE udf_CM_16759 0 0.0 0.0 255.0 ECU_ADDRESS 0x400030F7 /end MEASUREMENT
/begin MEASUREMENT ACSSHTestFail "var comments" UBYTE udf_CM_16759 0 0.0 0.0 255.0 ECU_ADDRESS 0x400030F8 /end MEASUREMENT
/begin MEASUREMENT ACSSLFailCount "var comments" UWORD udf_CM_16717 0 0.0 0.0 65535.0 ECU_ADDRESS 0x400030FA /end MEASUREMENT
/begin MEASUREMENT ACSSLPassCount "var comments" UWORD udf_CM_16717 0 0.0 0.0 65535.0 ECU_ADDRESS 0x400030FC /end MEASUREMENT
/begin MEASUREMENT ACSSHFailCount "var comments" UWORD udf_CM_16717 0 0.0 0.0 65535.0 ECU_ADDRESS 0x400030FE /end MEASUREMENT
/begin MEASUREMENT ACSSHPassCount "var comments" UWORD udf_CM_16717 0 0.0 0.0 65535.0 ECU_ADDRESS 0x40003100 /end MEASUREMENT
/begin MEASUREMENT ACSShrtDiagEnb "var comments" UBYTE udf_CM_16731 0 0.0 0.0 255.0 ECU_ADDRESS 0x400030F4 /end MEASUREMENT
/begin MEASUREMENT WPSSLFailMet "var comments" UBYTE udf_CM_16710 0 0.0 0.0 255.0 ECU_ADDRESS 0x0 /end MEASUREMENT
/begin MEASUREMENT WPSSHFailMet "var comments" UBYTE udf_CM_16710 0 0.0 0.0 255.0 ECU_ADDRESS 0x0 /end MEASUREMENT
/begin MEASUREMENT WPSSLTestFail "var comments" UBYTE udf_CM_16759 0 0.0 0.0 255.0 ECU_ADDRESS 0x0 /end MEASUREMENT
/begin MEASUREMENT WPSSHTestFail "var comments" UBYTE udf_CM_16759 0 0.0 0.0 255.0 ECU_ADDRESS 0x0 /end MEASUREMENT
/begin MEASUREMENT WPSSLFailCount "var comments" UWORD udf_CM_16717 0 0.0 0.0 65535.0 ECU_ADDRESS 0x0 /end MEASUREMENT
/begin MEASUREMENT WPSSLPassCount "var comments" UWORD udf_CM_16717 0 0.0 0.0 65535.0 ECU_ADDRESS 0x0 /end MEASUREMENT
/begin MEASUREMENT WPSSHFailCount "var comments" UWORD udf_CM_16717 0 0.0 0.0 65535.0 ECU_ADDRESS 0x0 /end MEASUREMENT
/begin MEASUREMENT WPSSHPassCount "var comments" UWORD udf_CM_16717 0 0.0 0.0 65535.0 ECU_ADDRESS 0x0 /end MEASUREMENT
/begin MEASUREMENT WPSShrtHDiagEnb "var comments" UBYTE udf_CM_16731 0 0.0 0.0 255.0 ECU_ADDRESS 0x0 /end MEASUREMENT
/begin MEASUREMENT WPSShrtLDiagEnb "var comments" UBYTE udf_CM_16731 0 0.0 0.0 255.0 ECU_ADDRESS 0x0 /end MEASUREMENT
/begin MEASUREMENT VbCCPS_CCPEnable "var comments" UBYTE udf_CM_16857 0 0.0 0.0 255.0 ECU_ADDRESS 0x0 /end MEASUREMENT
/begin MEASUREMENT VfCCPS_Pct_CCPDutyCycle "var comments" UWORD udf_CM_16808 0 0.0 0.0 199.9969482421875 ECU_ADDRESS 0x0 /end MEASUREMENT
/begin MEASUREMENT IdleFlow "var comments" UWORD udf_CM_16836 0 0.0 0.0 199.9969482421875 ECU_ADDRESS 0x4000292A /end MEASUREMENT
/begin MEASUREMENT IdleCLFlow "var comments" UWORD udf_CM_16808 0 0.0 0.0 199.9969482421875 ECU_ADDRESS 0x40002926 /end MEASUREMENT
/begin MEASUREMENT IDLECondMet "var comments" UBYTE udf_CM_16815 0 0.0 0.0 255.0 ECU_ADDRESS 0x40002928 /end MEASUREMENT
/begin MEASUREMENT IdleSwitch "var comments" UBYTE udf_CM_16857 0 0.0 0.0 255.0 ECU_ADDRESS 0x4000294D /end MEASUREMENT
/begin MEASUREMENT FL_UpHillFlag "var comments" UBYTE udf_CM_16857 0 0.0 0.0 255.0 ECU_ADDRESS 0x0 /end MEASUREMENT
/begin MEASUREMENT Inj1SHFailMet "var comments" UBYTE udf_CM_16962 0 0.0 0.0 255.0 DISPLAY_IDENTIFIER InjSHFailMet[0] ECU_ADDRESS 0x4000301C /end MEASUREMENT
/begin MEASUREMENT Inj1SHTestComp "var comments" UBYTE udf_CM_16976 0 0.0 0.0 255.0 DISPLAY_IDENTIFIER InjSHTestComp[0] ECU_ADDRESS 0x40003024 /end MEASUREMENT
/begin MEASUREMENT Inj1SHTestFail "var comments" UBYTE udf_CM_16983 0 0.0 0.0 255.0 DISPLAY_IDENTIFIER InjSHTestFail[0] ECU_ADDRESS 0x4000304C /end MEASUREMENT
/begin MEASUREMENT Inj1SHFailCount "var comments" UWORD udf_CM_16941 0 0.0 0.0 65535.0 DISPLAY_IDENTIFIER InjSHFailCount[0] ECU_ADDRESS 0x40003038 /end MEASUREMENT
/begin MEASUREMENT Inj1SHPassCount "var comments" UWORD udf_CM_16969 0 0.0 0.0 65535.0 DISPLAY_IDENTIFIER InjSHPassCount[0] ECU_ADDRESS 0x40003040 /end MEASUREMENT
/begin MEASUREMENT Inj1SLFailMet "var comments" UBYTE udf_CM_16962 0 0.0 0.0 255.0 DISPLAY_IDENTIFIER InjSLFailMet[0] ECU_ADDRESS 0x40003018 /end MEASUREMENT
/begin MEASUREMENT Inj1SLTestComp "var comments" UBYTE udf_CM_16976 0 0.0 0.0 255.0 DISPLAY_IDENTIFIER InjSLTestComp[0] ECU_ADDRESS 0x40003020 /end MEASUREMENT
/begin MEASUREMENT Inj1SLTestFail "var comments" UBYTE udf_CM_16983 0 0.0 0.0 255.0 DISPLAY_IDENTIFIER InjSLTestFail[0] ECU_ADDRESS 0x40003048 /end MEASUREMENT
/begin MEASUREMENT Inj1SLFailCount "var comments" UWORD udf_CM_16941 0 0.0 0.0 65535.0 DISPLAY_IDENTIFIER InjSLFailCount[0] ECU_ADDRESS 0x40003028 /end MEASUREMENT
/begin MEASUREMENT Inj1SLPassCount "var comments" UWORD udf_CM_16969 0 0.0 0.0 65535.0 DISPLAY_IDENTIFIER InjSLPassCount[0] ECU_ADDRESS 0x40003030 /end MEASUREMENT
/begin MEASUREMENT Inj2SHFailMet "var comments" UBYTE udf_CM_16962 0 0.0 0.0 255.0 DISPLAY_IDENTIFIER InjSHFailMet[1] ECU_ADDRESS 0x4000301D /end MEASUREMENT
/begin MEASUREMENT Inj2SHTestComp "var comments" UBYTE udf_CM_16976 0 0.0 0.0 255.0 DISPLAY_IDENTIFIER InjSHTestComp[1] ECU_ADDRESS 0x40003025 /end MEASUREMENT
/begin MEASUREMENT Inj2SHTestFail "var comments" UBYTE udf_CM_16983 0 0.0 0.0 255.0 DISPLAY_IDENTIFIER InjSHTestFail[1] ECU_ADDRESS 0x4000304D /end MEASUREMENT
/begin MEASUREMENT Inj2SHFailCount "var comments" UWORD udf_CM_16941 0 0.0 0.0 65535.0 DISPLAY_IDENTIFIER InjSHFailCount[1] ECU_ADDRESS 0x4000303A /end MEASUREMENT
/begin MEASUREMENT Inj2SHPassCount "var comments" UWORD udf_CM_16969 0 0.0 0.0 65535.0 DISPLAY_IDENTIFIER InjSHPassCount[1] ECU_ADDRESS 0x40003042 /end MEASUREMENT
/begin MEASUREMENT Inj2SLFailMet "var comments" UBYTE udf_CM_16962 0 0.0 0.0 255.0 DISPLAY_IDENTIFIER InjSLFailMet[1] ECU_ADDRESS 0x40003019 /end MEASUREMENT
/begin MEASUREMENT Inj2SLTestComp "var comments" UBYTE udf_CM_16976 0 0.0 0.0 255.0 DISPLAY_IDENTIFIER InjSLTestComp[1] ECU_ADDRESS 0x40003021 /end MEASUREMENT
/begin MEASUREMENT Inj2SLTestFail "var comments" UBYTE udf_CM_16983 0 0.0 0.0 255.0 DISPLAY_IDENTIFIER InjSLTestFail[1] ECU_ADDRESS 0x40003049 /end MEASUREMENT
/begin MEASUREMENT Inj2SLFailCount "var comments" UWORD udf_CM_16941 0 0.0 0.0 65535.0 DISPLAY_IDENTIFIER InjSLFailCount[1] ECU_ADDRESS 0x4000302A /end MEASUREMENT
/begin MEASUREMENT Inj2SLPassCount "var comments" UWORD udf_CM_16969 0 0.0 0.0 65535.0 DISPLAY_IDENTIFIER InjSLPassCount[1] ECU_ADDRESS 0x40003032 /end MEASUREMENT
/begin MEASUREMENT Inj3SHFailMet "var comments" UBYTE udf_CM_16962 0 0.0 0.0 255.0 DISPLAY_IDENTIFIER InjSHFailMet[2] ECU_ADDRESS 0x4000301E /end MEASUREMENT
/begin MEASUREMENT Inj3SHTestComp "var comments" UBYTE udf_CM_16976 0 0.0 0.0 255.0 DISPLAY_IDENTIFIER InjSHTestComp[2] ECU_ADDRESS 0x40003026 /end MEASUREMENT
/begin MEASUREMENT Inj3SHTestFail "var comments" UBYTE udf_CM_16983 0 0.0 0.0 255.0 DISPLAY_IDENTIFIER InjSHTestFail[2] ECU_ADDRESS 0x4000304E /end MEASUREMENT
/begin MEASUREMENT Inj3SHFailCount "var comments" UWORD udf_CM_16941 0 0.0 0.0 65535.0 DISPLAY_IDENTIFIER InjSHFailCount[2] ECU_ADDRESS 0x4000303C /end MEASUREMENT
/begin MEASUREMENT Inj3SHPassCount "var comments" UWORD udf_CM_16969 0 0.0 0.0 65535.0 DISPLAY_IDENTIFIER InjSHPassCount[2] ECU_ADDRESS 0x40003044 /end MEASUREMENT
/begin MEASUREMENT Inj3SLFailMet "var comments" UBYTE udf_CM_16962 0 0.0 0.0 255.0 DISPLAY_IDENTIFIER InjSLFailMet[2] ECU_ADDRESS 0x4000301A /end MEASUREMENT
/begin MEASUREMENT Inj3SLTestComp "var comments" UBYTE udf_CM_16976 0 0.0 0.0 255.0 DISPLAY_IDENTIFIER InjSLTestComp[2] ECU_ADDRESS 0x40003022 /end MEASUREMENT
/begin MEASUREMENT Inj3SLTestFail "var comments" UBYTE udf_CM_16983 0 0.0 0.0 255.0 DISPLAY_IDENTIFIER InjSLTestFail[2] ECU_ADDRESS 0x4000304A /end MEASUREMENT
/begin MEASUREMENT Inj3SLFailCount "var comments" UWORD udf_CM_16941 0 0.0 0.0 65535.0 DISPLAY_IDENTIFIER InjSLFailCount[2] ECU_ADDRESS 0x4000302C /end MEASUREMENT
/begin MEASUREMENT Inj3SLPassCount "var comments" UWORD udf_CM_16969 0 0.0 0.0 65535.0 DISPLAY_IDENTIFIER InjSLPassCount[2] ECU_ADDRESS 0x40003034 /end MEASUREMENT
/begin MEASUREMENT Inj4SHFailMet "var comments" UBYTE udf_CM_16962 0 0.0 0.0 255.0 DISPLAY_IDENTIFIER InjSHFailMet[3] ECU_ADDRESS 0x4000301F /end MEASUREMENT
/begin MEASUREMENT Inj4SHTestComp "var comments" UBYTE udf_CM_16976 0 0.0 0.0 255.0 DISPLAY_IDENTIFIER InjSHTestComp[3] ECU_ADDRESS 0x40003027 /end MEASUREMENT
/begin MEASUREMENT Inj4SHTestFail "var comments" UBYTE udf_CM_16983 0 0.0 0.0 255.0 DISPLAY_IDENTIFIER InjSHTestFail[3] ECU_ADDRESS 0x4000304F /end MEASUREMENT
/begin MEASUREMENT Inj4SHFailCount "var comments" UWORD udf_CM_16941 0 0.0 0.0 65535.0 DISPLAY_IDENTIFIER InjSHFailCount[3] ECU_ADDRESS 0x4000303E /end MEASUREMENT
/begin MEASUREMENT Inj4SHPassCount "var comments" UWORD udf_CM_16969 0 0.0 0.0 65535.0 DISPLAY_IDENTIFIER InjSHPassCount[3] ECU_ADDRESS 0x40003046 /end MEASUREMENT
/begin MEASUREMENT Inj4SLFailMet "var comments" UBYTE udf_CM_16962 0 0.0 0.0 255.0 DISPLAY_IDENTIFIER InjSLFailMet[3] ECU_ADDRESS 0x4000301B /end MEASUREMENT
/begin MEASUREMENT Inj4SLTestComp "var comments" UBYTE udf_CM_16976 0 0.0 0.0 255.0 DISPLAY_IDENTIFIER InjSLTestComp[3] ECU_ADDRESS 0x40003023 /end MEASUREMENT
/begin MEASUREMENT Inj4SLTestFail "var comments" UBYTE udf_CM_16983 0 0.0 0.0 255.0 DISPLAY_IDENTIFIER InjSLTestFail[3] ECU_ADDRESS 0x4000304B /end MEASUREMENT
/begin MEASUREMENT Inj4SLFailCount "var comments" UWORD udf_CM_16941 0 0.0 0.0 65535.0 DISPLAY_IDENTIFIER InjSLFailCount[3] ECU_ADDRESS 0x4000302E /end MEASUREMENT
/begin MEASUREMENT Inj4SLPassCount "var comments" UWORD udf_CM_16969 0 0.0 0.0 65535.0 DISPLAY_IDENTIFIER InjSLPassCount[3] ECU_ADDRESS 0x40003036 /end MEASUREMENT
/begin MEASUREMENT OSWPFilt "var comments" UWORD udf_CM_18726 0 0.0 0.0 199.9969482421875 ECU_ADDRESS 0x40002D4A /end MEASUREMENT
/begin MEASUREMENT WPOutRawSignal "var comments" UWORD udf_CM_18005 0 0.0 0.0 99.99847412109375 ECU_ADDRESS 0x0 /end MEASUREMENT
/begin MEASUREMENT PCodeActive "var comments" UWORD udf_CM_17592 0 0.0 0.0 65535.0 ECU_ADDRESS 0x40002DCE /end MEASUREMENT
/begin MEASUREMENT MAPDiagEnb "var comments" UBYTE udf_CM_17214 0 0.0 0.0 255.0 ECU_ADDRESS 0x40002F30 /end MEASUREMENT
/begin MEASUREMENT MAPSHFailCount "var comments" UWORD udf_CM_17221 0 0.0 0.0 65535.0 ECU_ADDRESS 0x40002F3C /end MEASUREMENT
/begin MEASUREMENT MAPSHFailMet "var comments" UBYTE udf_CM_17228 0 0.0 0.0 255.0 ECU_ADDRESS 0x40002F32 /end MEASUREMENT
/begin MEASUREMENT MAPSHPassCount "var comments" UWORD udf_CM_17242 0 0.0 0.0 65535.0 ECU_ADDRESS 0x40002F3E /end MEASUREMENT
/begin MEASUREMENT MAPSHTestFail "var comments" UBYTE udf_CM_17249 0 0.0 0.0 255.0 ECU_ADDRESS 0x40002F36 /end MEASUREMENT
/begin MEASUREMENT MAPSLFailCount "var comments" UWORD udf_CM_17263 0 0.0 0.0 65535.0 ECU_ADDRESS 0x40002F38 /end MEASUREMENT
/begin MEASUREMENT MAPSLFailMet "var comments" UBYTE udf_CM_17270 0 0.0 0.0 255.0 ECU_ADDRESS 0x40002F31 /end MEASUREMENT
/begin MEASUREMENT MAPSLPassCount "var comments" UWORD udf_CM_17277 0 0.0 0.0 65535.0 ECU_ADDRESS 0x40002F3A /end MEASUREMENT
/begin MEASUREMENT MAPSLTestFail "var comments" UBYTE udf_CM_17284 0 0.0 0.0 255.0 ECU_ADDRESS 0x40002F35 /end MEASUREMENT
/begin MEASUREMENT BSTPDiagEnb "var comments" UBYTE udf_CM_17214 0 0.0 0.0 255.0 ECU_ADDRESS 0x40003104 /end MEASUREMENT
/begin MEASUREMENT BSTPSHFailCount "var comments" UWORD udf_CM_17221 0 0.0 0.0 65535.0 ECU_ADDRESS 0x4000310E /end MEASUREMENT
/begin MEASUREMENT BSTPSHFailMet "var comments" UBYTE udf_CM_17228 0 0.0 0.0 255.0 ECU_ADDRESS 0x40003112 /end MEASUREMENT
/begin MEASUREMENT BSTPSHPassCount "var comments" UWORD udf_CM_17242 0 0.0 0.0 65535.0 ECU_ADDRESS 0x40003110 /end MEASUREMENT
/begin MEASUREMENT BSTPSHTestFail "var comments" UBYTE udf_CM_17249 0 0.0 0.0 255.0 ECU_ADDRESS 0x40003108 /end MEASUREMENT
/begin MEASUREMENT BSTPSLFailCount "var comments" UWORD udf_CM_17263 0 0.0 0.0 65535.0 ECU_ADDRESS 0x4000310A /end MEASUREMENT
/begin MEASUREMENT BSTPSLFailMet "var comments" UBYTE udf_CM_17270 0 0.0 0.0 255.0 ECU_ADDRESS 0x40003109 /end MEASUREMENT
/begin MEASUREMENT BSTPSLPassCount "var comments" UWORD udf_CM_17277 0 0.0 0.0 65535.0 ECU_ADDRESS 0x4000310C /end MEASUREMENT
/begin MEASUREMENT BSTPSLTestFail "var comments" UBYTE udf_CM_17284 0 0.0 0.0 255.0 ECU_ADDRESS 0x40003107 /end MEASUREMENT
/begin MEASUREMENT MtrMovDlyCnt "var comments" UBYTE udf_CM_18166 0 0.0 0.0 255.0 DISPLAY_IDENTIFIER IDLE_Motor_StartMoveDelayCount ECU_ADDRESS 0x40002D53 /end MEASUREMENT
/begin MEASUREMENT MtrPauseCnt "var comments" UBYTE udf_CM_18159 0 0.0 0.0 255.0 DISPLAY_IDENTIFIER IDLE_Motor_PauseDelayCount ECU_ADDRESS 0x40002D5E /end MEASUREMENT
/begin MEASUREMENT MtrStartSteps "var comments" UBYTE udf_CM_18173 0 0.0 0.0 255.0 DISPLAY_IDENTIFIER IDLE_Motor_StartMoveSteps ECU_ADDRESS 0x40002D57 /end MEASUREMENT
/begin MEASUREMENT O2HtDiagEnb "var comments" UBYTE udf_CM_17382 0 0.0 0.0 255.0 ECU_ADDRESS 0x40002FEE /end MEASUREMENT
/begin MEASUREMENT O2HtSLFailMet "var comments" UBYTE udf_CM_17410 0 0.0 0.0 255.0 ECU_ADDRESS 0x40002FEF /end MEASUREMENT
/begin MEASUREMENT O2HtSLTestComp "var comments" UBYTE udf_CM_17424 0 0.0 0.0 255.0 ECU_ADDRESS 0x40002FF1 /end MEASUREMENT
/begin MEASUREMENT O2HtSLTestFail "var comments" UBYTE udf_CM_17431 0 0.0 0.0 255.0 ECU_ADDRESS 0x40002FF3 /end MEASUREMENT
/begin MEASUREMENT O2HtSLFailCount "var comments" UWORD udf_CM_17389 0 0.0 0.0 65535.0 ECU_ADDRESS 0x40002FF4 /end MEASUREMENT
/begin MEASUREMENT O2HtSLPassCount "var comments" UWORD udf_CM_17417 0 0.0 0.0 65535.0 ECU_ADDRESS 0x40002FF8 /end MEASUREMENT
/begin MEASUREMENT O2HtSHFailMet "var comments" UBYTE udf_CM_17410 0 0.0 0.0 255.0 ECU_ADDRESS 0x40002FF0 /end MEASUREMENT
/begin MEASUREMENT O2HtSHTestComp "var comments" UBYTE udf_CM_17424 0 0.0 0.0 255.0 ECU_ADDRESS 0x40002FF2 /end MEASUREMENT
/begin MEASUREMENT O2HtSHTestFail "var comments" UBYTE udf_CM_17431 0 0.0 0.0 255.0 ECU_ADDRESS 0x40002FFC /end MEASUREMENT
/begin MEASUREMENT O2HtSHFailCount "var comments" UWORD udf_CM_17389 0 0.0 0.0 65535.0 ECU_ADDRESS 0x40002FF6 /end MEASUREMENT
/begin MEASUREMENT O2HtSHPassCount "var comments" UWORD udf_CM_17417 0 0.0 0.0 65535.0 ECU_ADDRESS 0x40002FFA /end MEASUREMENT
/begin MEASUREMENT RO2Ht1DiagEnb "var comments" UBYTE udf_CM_17382 0 0.0 0.0 255.0 ECU_ADDRESS 0x40003000 /end MEASUREMENT
/begin MEASUREMENT RO2Ht1SLFailMet "var comments" UBYTE udf_CM_17410 0 0.0 0.0 255.0 ECU_ADDRESS 0x40003001 /end MEASUREMENT
/begin MEASUREMENT RO2Ht1SLTestComp "var comments" UBYTE udf_CM_17424 0 0.0 0.0 255.0 ECU_ADDRESS 0x40003003 /end MEASUREMENT
/begin MEASUREMENT RO2Ht1SLTestFail "var comments" UBYTE udf_CM_17431 0 0.0 0.0 255.0 ECU_ADDRESS 0x40003005 /end MEASUREMENT
/begin MEASUREMENT RO2Ht1SLFailCount "var comments" UWORD udf_CM_17389 0 0.0 0.0 65535.0 ECU_ADDRESS 0x40003006 /end MEASUREMENT
/begin MEASUREMENT RO2Ht1SLPassCount "var comments" UWORD udf_CM_17417 0 0.0 0.0 65535.0 ECU_ADDRESS 0x4000300A /end MEASUREMENT
/begin MEASUREMENT RO2Ht1SHFailMet "var comments" UBYTE udf_CM_17410 0 0.0 0.0 255.0 ECU_ADDRESS 0x40003002 /end MEASUREMENT
/begin MEASUREMENT RO2Ht1SHTestComp "var comments" UBYTE udf_CM_17424 0 0.0 0.0 255.0 ECU_ADDRESS 0x40003004 /end MEASUREMENT
/begin MEASUREMENT RO2Ht1SHTestFail "var comments" UBYTE udf_CM_17431 0 0.0 0.0 255.0 ECU_ADDRESS 0x4000300E /end MEASUREMENT
/begin MEASUREMENT RO2Ht1SHFailCount "var comments" UWORD udf_CM_17389 0 0.0 0.0 65535.0 ECU_ADDRESS 0x40003008 /end MEASUREMENT
/begin MEASUREMENT RO2Ht1SHPassCount "var comments" UWORD udf_CM_17417 0 0.0 0.0 65535.0 ECU_ADDRESS 0x4000300C /end MEASUREMENT
/begin MEASUREMENT BSTCDiagEnb "var comments" UBYTE udf_CM_17382 0 0.0 0.0 255.0 ECU_ADDRESS 0x4000308C /end MEASUREMENT
/begin MEASUREMENT BSTCSLFailMet "var comments" UBYTE udf_CM_17410 0 0.0 0.0 255.0 ECU_ADDRESS 0x4000308D /end MEASUREMENT
/begin MEASUREMENT BSTCSLTestComp "var comments" UBYTE udf_CM_17424 0 0.0 0.0 255.0 ECU_ADDRESS 0x4000308F /end MEASUREMENT
/begin MEASUREMENT BSTCSLTestFail "var comments" UBYTE udf_CM_17431 0 0.0 0.0 255.0 ECU_ADDRESS 0x40003091 /end MEASUREMENT
/begin MEASUREMENT BSTCSLFailCount "var comments" UWORD udf_CM_17389 0 0.0 0.0 65535.0 ECU_ADDRESS 0x40003092 /end MEASUREMENT
/begin MEASUREMENT BSTCSLPassCount "var comments" UWORD udf_CM_17417 0 0.0 0.0 65535.0 ECU_ADDRESS 0x40003096 /end MEASUREMENT
/begin MEASUREMENT BSTCSHFailMet "var comments" UBYTE udf_CM_17410 0 0.0 0.0 255.0 ECU_ADDRESS 0x4000308E /end MEASUREMENT
/begin MEASUREMENT BSTCSHTestComp "var comments" UBYTE udf_CM_17424 0 0.0 0.0 255.0 ECU_ADDRESS 0x40003090 /end MEASUREMENT
/begin MEASUREMENT BSTCSHTestFail "var comments" UBYTE udf_CM_17431 0 0.0 0.0 255.0 ECU_ADDRESS 0x4000309A /end MEASUREMENT
/begin MEASUREMENT BSTCSHFailCount "var comments" UWORD udf_CM_17389 0 0.0 0.0 65535.0 ECU_ADDRESS 0x40003094 /end MEASUREMENT
/begin MEASUREMENT BSTCSHPassCount "var comments" UWORD udf_CM_17417 0 0.0 0.0 65535.0 ECU_ADDRESS 0x40003098 /end MEASUREMENT
/begin MEASUREMENT REF1DiagEnb "var comments" UBYTE udf_CM_17382 0 0.0 0.0 255.0 ECU_ADDRESS 0x4000309E /end MEASUREMENT
/begin MEASUREMENT REF1SLFailMet "var comments" UBYTE udf_CM_17410 0 0.0 0.0 255.0 ECU_ADDRESS 0x4000309F /end MEASUREMENT
/begin MEASUREMENT REF1SLTestComp "var comments" UBYTE udf_CM_17424 0 0.0 0.0 255.0 ECU_ADDRESS 0x400030A1 /end MEASUREMENT
/begin MEASUREMENT REF1SLTestFail "var comments" UBYTE udf_CM_17431 0 0.0 0.0 255.0 ECU_ADDRESS 0x400030A3 /end MEASUREMENT
/begin MEASUREMENT REF1SLFailCount "var comments" UWORD udf_CM_17389 0 0.0 0.0 65535.0 ECU_ADDRESS 0x400030A4 /end MEASUREMENT
/begin MEASUREMENT REF1SLPassCount "var comments" UWORD udf_CM_17417 0 0.0 0.0 65535.0 ECU_ADDRESS 0x400030A8 /end MEASUREMENT
/begin MEASUREMENT REF1SHFailMet "var comments" UBYTE udf_CM_17410 0 0.0 0.0 255.0 ECU_ADDRESS 0x400030A0 /end MEASUREMENT
/begin MEASUREMENT REF1SHTestComp "var comments" UBYTE udf_CM_17424 0 0.0 0.0 255.0 ECU_ADDRESS 0x400030A2 /end MEASUREMENT
/begin MEASUREMENT REF1SHTestFail "var comments" UBYTE udf_CM_17431 0 0.0 0.0 255.0 ECU_ADDRESS 0x400030AC /end MEASUREMENT
/begin MEASUREMENT REF1SHFailCount "var comments" UWORD udf_CM_17389 0 0.0 0.0 65535.0 ECU_ADDRESS 0x400030A6 /end MEASUREMENT
/begin MEASUREMENT REF1SHPassCount "var comments" UWORD udf_CM_17417 0 0.0 0.0 65535.0 ECU_ADDRESS 0x400030AA /end MEASUREMENT
/begin MEASUREMENT REF2DiagEnb "var comments" UBYTE udf_CM_17382 0 0.0 0.0 255.0 ECU_ADDRESS 0x400030B0 /end MEASUREMENT
/begin MEASUREMENT REF2SLFailMet "var comments" UBYTE udf_CM_17410 0 0.0 0.0 255.0 ECU_ADDRESS 0x400030B1 /end MEASUREMENT
/begin MEASUREMENT REF2SLTestComp "var comments" UBYTE udf_CM_17424 0 0.0 0.0 255.0 ECU_ADDRESS 0x400030B3 /end MEASUREMENT
/begin MEASUREMENT REF2SLTestFail "var comments" UBYTE udf_CM_17431 0 0.0 0.0 255.0 ECU_ADDRESS 0x400030B5 /end MEASUREMENT
/begin MEASUREMENT REF2SLFailCount "var comments" UWORD udf_CM_17389 0 0.0 0.0 65535.0 ECU_ADDRESS 0x400030B6 /end MEASUREMENT
/begin MEASUREMENT REF2SLPassCount "var comments" UWORD udf_CM_17417 0 0.0 0.0 65535.0 ECU_ADDRESS 0x400030BA /end MEASUREMENT
/begin MEASUREMENT REF2SHFailMet "var comments" UBYTE udf_CM_17410 0 0.0 0.0 255.0 ECU_ADDRESS 0x400030B2 /end MEASUREMENT
/begin MEASUREMENT REF2SHTestComp "var comments" UBYTE udf_CM_17424 0 0.0 0.0 255.0 ECU_ADDRESS 0x400030B4 /end MEASUREMENT
/begin MEASUREMENT REF2SHTestFail "var comments" UBYTE udf_CM_17431 0 0.0 0.0 255.0 ECU_ADDRESS 0x400030BE /end MEASUREMENT
/begin MEASUREMENT REF2SHFailCount "var comments" UWORD udf_CM_17389 0 0.0 0.0 65535.0 ECU_ADDRESS 0x400030B8 /end MEASUREMENT
/begin MEASUREMENT REF2SHPassCount "var comments" UWORD udf_CM_17417 0 0.0 0.0 65535.0 ECU_ADDRESS 0x400030BC /end MEASUREMENT
/begin MEASUREMENT BLM_TrimDiagEnb "var comments" UBYTE udf_CM_17382 0 0.0 0.0 255.0 ECU_ADDRESS 0x40002F6E /end MEASUREMENT
/begin MEASUREMENT BLM_TrimLoFailMet "var comments" UBYTE udf_CM_17410 0 0.0 0.0 255.0 ECU_ADDRESS 0x40002F71 /end MEASUREMENT
/begin MEASUREMENT BLM_TrimLoTestComp "var comments" UBYTE udf_CM_17424 0 0.0 0.0 255.0 ECU_ADDRESS 0x40002F6C /end MEASUREMENT
/begin MEASUREMENT BLM_TrimLoTestFail "var comments" UBYTE udf_CM_17431 0 0.0 0.0 255.0 ECU_ADDRESS 0x40002F6F /end MEASUREMENT
/begin MEASUREMENT BLM_TrimLoFailCount "var comments" UWORD udf_CM_17389 0 0.0 0.0 65535.0 ECU_ADDRESS 0x40002F72 /end MEASUREMENT
/begin MEASUREMENT BLM_TrimLoPassCount "var comments" UWORD udf_CM_17417 0 0.0 0.0 65535.0 ECU_ADDRESS 0x40002F74 /end MEASUREMENT
/begin MEASUREMENT BLM_TrimHiFailMet "var comments" UBYTE udf_CM_17410 0 0.0 0.0 255.0 ECU_ADDRESS 0x40002F7A /end MEASUREMENT
/begin MEASUREMENT BLM_TrimHiTestComp "var comments" UBYTE udf_CM_17424 0 0.0 0.0 255.0 ECU_ADDRESS 0x40002F6D /end MEASUREMENT
/begin MEASUREMENT BLM_TrimHiTestFail "var comments" UBYTE udf_CM_17431 0 0.0 0.0 255.0 ECU_ADDRESS 0x40002F70 /end MEASUREMENT
/begin MEASUREMENT BLM_TrimHiFailCount "var comments" UWORD udf_CM_17389 0 0.0 0.0 65535.0 ECU_ADDRESS 0x40002F76 /end MEASUREMENT
/begin MEASUREMENT BLM_TrimHiPassCount "var comments" UWORD udf_CM_17417 0 0.0 0.0 65535.0 ECU_ADDRESS 0x40002F78 /end MEASUREMENT
/begin MEASUREMENT BLM_TrimLoCellCnt "var comments" UWORD udf_CM_17417 0 0.0 0.0 65535.0 ECU_ADDRESS 0x40002F7C /end MEASUREMENT
/begin MEASUREMENT BLM_TrimHiCellCnt "var comments" UWORD udf_CM_17417 0 0.0 0.0 65535.0 ECU_ADDRESS 0x40002F7E /end MEASUREMENT
/begin MEASUREMENT FCV1DiagEnb "var comments" UBYTE udf_CM_17382 0 0.0 0.0 255.0 ECU_ADDRESS 0x40003056 /end MEASUREMENT
/begin MEASUREMENT FCV1SLFailMet "var comments" UBYTE udf_CM_17410 0 0.0 0.0 255.0 ECU_ADDRESS 0x40003057 /end MEASUREMENT
/begin MEASUREMENT FCV1SLTestComp "var comments" UBYTE udf_CM_17424 0 0.0 0.0 255.0 ECU_ADDRESS 0x40003059 /end MEASUREMENT
/begin MEASUREMENT FCV1SLTestFail "var comments" UBYTE udf_CM_17431 0 0.0 0.0 255.0 ECU_ADDRESS 0x4000305B /end MEASUREMENT
/begin MEASUREMENT FCV1SLFailCount "var comments" UWORD udf_CM_17389 0 0.0 0.0 65535.0 ECU_ADDRESS 0x4000305C /end MEASUREMENT
/begin MEASUREMENT FCV1SLPassCount "var comments" UWORD udf_CM_17417 0 0.0 0.0 65535.0 ECU_ADDRESS 0x40003060 /end MEASUREMENT
/begin MEASUREMENT FCV1SHFailMet "var comments" UBYTE udf_CM_17410 0 0.0 0.0 255.0 ECU_ADDRESS 0x40003058 /end MEASUREMENT
/begin MEASUREMENT FCV1SHTestComp "var comments" UBYTE udf_CM_17424 0 0.0 0.0 255.0 ECU_ADDRESS 0x4000305A /end MEASUREMENT
/begin MEASUREMENT FCV1SHTestFail "var comments" UBYTE udf_CM_17431 0 0.0 0.0 255.0 ECU_ADDRESS 0x40003064 /end MEASUREMENT
/begin MEASUREMENT FCV1SHFailCount "var comments" UWORD udf_CM_17389 0 0.0 0.0 65535.0 ECU_ADDRESS 0x4000305E /end MEASUREMENT
/begin MEASUREMENT FCV1SHPassCount "var comments" UWORD udf_CM_17417 0 0.0 0.0 65535.0 ECU_ADDRESS 0x40003062 /end MEASUREMENT
/begin MEASUREMENT FCV2DiagEnb "var comments" UBYTE udf_CM_17382 0 0.0 0.0 255.0 ECU_ADDRESS 0x40003068 /end MEASUREMENT
/begin MEASUREMENT FCV2SLFailMet "var comments" UBYTE udf_CM_17410 0 0.0 0.0 255.0 ECU_ADDRESS 0x40003069 /end MEASUREMENT
/begin MEASUREMENT FCV2SLTestComp "var comments" UBYTE udf_CM_17424 0 0.0 0.0 255.0 ECU_ADDRESS 0x4000306B /end MEASUREMENT
/begin MEASUREMENT FCV2SLTestFail "var comments" UBYTE udf_CM_17431 0 0.0 0.0 255.0 ECU_ADDRESS 0x4000306D /end MEASUREMENT
/begin MEASUREMENT FCV2SLFailCount "var comments" UWORD udf_CM_17389 0 0.0 0.0 65535.0 ECU_ADDRESS 0x4000306E /end MEASUREMENT
/begin MEASUREMENT FCV2SLPassCount "var comments" UWORD udf_CM_17417 0 0.0 0.0 65535.0 ECU_ADDRESS 0x40003072 /end MEASUREMENT
/begin MEASUREMENT FCV2SHFailMet "var comments" UBYTE udf_CM_17410 0 0.0 0.0 255.0 ECU_ADDRESS 0x4000306A /end MEASUREMENT
/begin MEASUREMENT FCV2SHTestComp "var comments" UBYTE udf_CM_17424 0 0.0 0.0 255.0 ECU_ADDRESS 0x4000306C /end MEASUREMENT
/begin MEASUREMENT FCV2SHTestFail "var comments" UBYTE udf_CM_17431 0 0.0 0.0 255.0 ECU_ADDRESS 0x40003076 /end MEASUREMENT
/begin MEASUREMENT FCV2SHFailCount "var comments" UWORD udf_CM_17389 0 0.0 0.0 65535.0 ECU_ADDRESS 0x40003070 /end MEASUREMENT
/begin MEASUREMENT FCV2SHPassCount "var comments" UWORD udf_CM_17417 0 0.0 0.0 65535.0 ECU_ADDRESS 0x40003074 /end MEASUREMENT
/begin MEASUREMENT IACVDiagEnb "var comments" UBYTE udf_CM_17382 0 0.0 0.0 255.0 ECU_ADDRESS 0x4000307A /end MEASUREMENT
/begin MEASUREMENT IACVSLFailMet "var comments" UBYTE udf_CM_17410 0 0.0 0.0 255.0 ECU_ADDRESS 0x4000307B /end MEASUREMENT
/begin MEASUREMENT IACVSLTestComp "var comments" UBYTE udf_CM_17424 0 0.0 0.0 255.0 ECU_ADDRESS 0x4000307D /end MEASUREMENT
/begin MEASUREMENT IACVSLTestFail "var comments" UBYTE udf_CM_17431 0 0.0 0.0 255.0 ECU_ADDRESS 0x4000307F /end MEASUREMENT
/begin MEASUREMENT IACVSLFailCount "var comments" UWORD udf_CM_17389 0 0.0 0.0 65535.0 ECU_ADDRESS 0x40003080 /end MEASUREMENT
/begin MEASUREMENT IACVSLPassCount "var comments" UWORD udf_CM_17417 0 0.0 0.0 65535.0 ECU_ADDRESS 0x40003084 /end MEASUREMENT
/begin MEASUREMENT IACVSHFailMet "var comments" UBYTE udf_CM_17410 0 0.0 0.0 255.0 ECU_ADDRESS 0x4000307C /end MEASUREMENT
/begin MEASUREMENT IACVSHTestComp "var comments" UBYTE udf_CM_17424 0 0.0 0.0 255.0 ECU_ADDRESS 0x4000307E /end MEASUREMENT
/begin MEASUREMENT IACVSHTestFail "var comments" UBYTE udf_CM_17431 0 0.0 0.0 255.0 ECU_ADDRESS 0x40003088 /end MEASUREMENT
/begin MEASUREMENT IACVSHFailCount "var comments" UWORD udf_CM_17389 0 0.0 0.0 65535.0 ECU_ADDRESS 0x40003082 /end MEASUREMENT
/begin MEASUREMENT IACVSHPassCount "var comments" UWORD udf_CM_17417 0 0.0 0.0 65535.0 ECU_ADDRESS 0x40003086 /end MEASUREMENT
/begin MEASUREMENT DCMDiagEnb "var comments" UBYTE udf_CM_17382 0 0.0 0.0 255.0 ECU_ADDRESS 0x40002F86 /end MEASUREMENT
/begin MEASUREMENT DCMSLFailMet "var comments" UBYTE udf_CM_17410 0 0.0 0.0 255.0 ECU_ADDRESS 0x40002F87 /end MEASUREMENT
/begin MEASUREMENT DCMSLTestComp "var comments" UBYTE udf_CM_17424 0 0.0 0.0 255.0 ECU_ADDRESS 0x40002F89 /end MEASUREMENT
/begin MEASUREMENT DCMSLTestFail "var comments" UBYTE udf_CM_17431 0 0.0 0.0 255.0 ECU_ADDRESS 0x40002F8B /end MEASUREMENT
/begin MEASUREMENT DCMSLFailCount "var comments" UWORD udf_CM_17389 0 0.0 0.0 65535.0 ECU_ADDRESS 0x40002F8C /end MEASUREMENT
/begin MEASUREMENT DCMSLPassCount "var comments" UWORD udf_CM_17417 0 0.0 0.0 65535.0 ECU_ADDRESS 0x40002F90 /end MEASUREMENT
/begin MEASUREMENT DCMSHFailMet "var comments" UBYTE udf_CM_17410 0 0.0 0.0 255.0 ECU_ADDRESS 0x40002F88 /end MEASUREMENT
/begin MEASUREMENT DCMSHTestComp "var comments" UBYTE udf_CM_17424 0 0.0 0.0 255.0 ECU_ADDRESS 0x40002F8A /end MEASUREMENT
/begin MEASUREMENT DCMSHTestFail "var comments" UBYTE udf_CM_17431 0 0.0 0.0 255.0 ECU_ADDRESS 0x40002F94 /end MEASUREMENT
/begin MEASUREMENT DCMSHFailCount "var comments" UWORD udf_CM_17389 0 0.0 0.0 65535.0 ECU_ADDRESS 0x40002F8E /end MEASUREMENT
/begin MEASUREMENT DCMSHPassCount "var comments" UWORD udf_CM_17417 0 0.0 0.0 65535.0 ECU_ADDRESS 0x40002F92 /end MEASUREMENT
/begin MEASUREMENT CCPDiagEnb "var comments" UBYTE udf_CM_17382 0 0.0 0.0 255.0 ECU_ADDRESS 0x0 /end MEASUREMENT
/begin MEASUREMENT CCPSLFailMet "var comments" UBYTE udf_CM_17410 0 0.0 0.0 255.0 ECU_ADDRESS 0x0 /end MEASUREMENT
/begin MEASUREMENT CCPSLTestComp "var comments" UBYTE udf_CM_17424 0 0.0 0.0 255.0 ECU_ADDRESS 0x0 /end MEASUREMENT
/begin MEASUREMENT CCPSLTestFail "var comments" UBYTE udf_CM_17431 0 0.0 0.0 255.0 ECU_ADDRESS 0x0 /end MEASUREMENT
/begin MEASUREMENT CCPSLFailCount "var comments" UWORD udf_CM_17389 0 0.0 0.0 65535.0 ECU_ADDRESS 0x0 /end MEASUREMENT
/begin MEASUREMENT CCPSLPassCount "var comments" UWORD udf_CM_17417 0 0.0 0.0 65535.0 ECU_ADDRESS 0x0 /end MEASUREMENT
/begin MEASUREMENT CCPSHFailMet "var comments" UBYTE udf_CM_17410 0 0.0 0.0 255.0 ECU_ADDRESS 0x0 /end MEASUREMENT
/begin MEASUREMENT CCPSHTestComp "var comments" UBYTE udf_CM_17424 0 0.0 0.0 255.0 ECU_ADDRESS 0x0 /end MEASUREMENT
/begin MEASUREMENT CCPSHTestFail "var comments" UBYTE udf_CM_17431 0 0.0 0.0 255.0 ECU_ADDRESS 0x0 /end MEASUREMENT
/begin MEASUREMENT CCPSHFailCount "var comments" UWORD udf_CM_17389 0 0.0 0.0 65535.0 ECU_ADDRESS 0x0 /end MEASUREMENT
/begin MEASUREMENT CCPSHPassCount "var comments" UWORD udf_CM_17417 0 0.0 0.0 65535.0 ECU_ADDRESS 0x0 /end MEASUREMENT
/begin MEASUREMENT OutDiagComEnbKeyOn "var comments" UBYTE udf_CM_17557 0 0.0 0.0 255.0 ECU_ADDRESS 0x40002F82 /end MEASUREMENT
/begin MEASUREMENT OutDiagComEnbRun "var comments" UBYTE udf_CM_17564 0 0.0 0.0 255.0 ECU_ADDRESS 0x40002F83 /end MEASUREMENT
/begin MEASUREMENT KeyonToCrankMet "var comments" UBYTE udf_CM_17074 0 0.0 0.0 255.0 ECU_ADDRESS 0x40002C0C /end MEASUREMENT
/begin MEASUREMENT PowerDownDelay "var comments" UBYTE udf_CM_17606 0 0.0 0.0 255.0 ECU_ADDRESS 0x40002C08 /end MEASUREMENT
/begin MEASUREMENT EOL_Init "var comments" UBYTE udf_CM_17634 0 0.0 0.0 255.0 ECU_ADDRESS 0x40000198 /end MEASUREMENT
/begin MEASUREMENT PPCrtMet "var comments" UBYTE udf_CM_17627 0 0.0 0.0 255.0 ECU_ADDRESS 0x4000279A /end MEASUREMENT
/begin MEASUREMENT PPComplete "var comments" UBYTE udf_CM_17620 0 0.0 0.0 255.0 ECU_ADDRESS 0x4000279B /end MEASUREMENT
/begin MEASUREMENT PPDisable "var comments" UBYTE udf_CM_17634 0 0.0 0.0 255.0 ECU_ADDRESS 0x400002CC /end MEASUREMENT
/begin MEASUREMENT PrimePulseWidth "var comments" UWORD udf_CM_17641 0 0.0 0.0 1023.984375 ECU_ADDRESS 0x4000279C /end MEASUREMENT
/begin MEASUREMENT RefPeriodHiRes "var comments" ULONG udf_CM_17662 0 0.0 0.0 4294967295 DISPLAY_IDENTIFIER RefPeriod_HiRes ECU_ADDRESS 0x40002CEC /end MEASUREMENT
/begin MEASUREMENT ToothTime_HighRes "var comments" ULONG udf_CM_17662 0 0.0 0.0 4294967295 ECU_ADDRESS 0x40001D54 /end MEASUREMENT
/begin MEASUREMENT TimeBetweenRefEvent1 "var comments" UBYTE udf_CM_15247 0 0.0 0.0 255.0 DISPLAY_IDENTIFIER TimeBetweenRefEvents[0] ECU_ADDRESS 0x40001D70 /end MEASUREMENT
/begin MEASUREMENT ReferencePeriod_HighRes1 "var comments" ULONG udf_CM_17662 0 0.0 0.0 4294967295 DISPLAY_IDENTIFIER ReferencePeriod_HighRes[0] ECU_ADDRESS 0x40001818 /end MEASUREMENT
/begin MEASUREMENT RunToCrankMet "var comments" UBYTE udf_CM_17697 0 0.0 0.0 255.0 ECU_ADDRESS 0x40002C0B /end MEASUREMENT
/begin MEASUREMENT RunCylCount "var comments" UBYTE udf_CM_19377 0 0.0 0.0 255.0 ECU_ADDRESS 0x40002C0F /end MEASUREMENT
/begin MEASUREMENT RunModeCount "var comments" UBYTE udf_CM_19384 0 0.0 0.0 255.0 ECU_ADDRESS 0x40002C10 /end MEASUREMENT
/begin MEASUREMENT RunTime "var comments" UWORD udf_CM_17683 0 0.0 0.0 65535.0 ECU_ADDRESS 0x40000090 /end MEASUREMENT
/begin MEASUREMENT RunTimeTotal "var comments" ULONG udf_CM_17663 0 0.0 0.0 4294967295 ECU_ADDRESS 0x40000094 /end MEASUREMENT
/begin MEASUREMENT ETCM_TPSHi2Dsr "var comments" UBYTE udf_CM_16353 0 0.0 0.0 255.0 ECU_ADDRESS 0x40002A0C /end MEASUREMENT
/begin MEASUREMENT ETCM_TPSHi2Ref "var comments" UBYTE udf_CM_16353 0 0.0 0.0 255.0 ECU_ADDRESS 0x40002A14 /end MEASUREMENT
/begin MEASUREMENT ETCM_UnpwrdRefLearned "var comments" UBYTE udf_CM_16353 0 0.0 0.0 255.0 ECU_ADDRESS 0x40002A0D /end MEASUREMENT
/begin MEASUREMENT ETCM_ThrotMtrDir "var comments" UBYTE udf_CM_16353 0 0.0 0.0 255.0 ECU_ADDRESS 0x40002A07 /end MEASUREMENT
/begin MEASUREMENT ETCM_DutyLimited "var comments" UBYTE udf_CM_16353 0 0.0 0.0 255.0 ECU_ADDRESS 0x40002A08 /end MEASUREMENT
/begin MEASUREMENT ETCM_UnpwrdRefThrotPstn "var comments" UWORD udf_CM_18726 0 0.0 0.0 199.9969482421875 ECU_ADDRESS 0x40002A12 /end MEASUREMENT
/begin MEASUREMENT ETCM_UnlimitedDutyCycle "var comments" UWORD udf_CM_18726 0 0.0 0.0 199.9969482421875 ECU_ADDRESS 0x40002A1E /end MEASUREMENT
/begin MEASUREMENT ETCM_LimitedDutyCycle "var comments" UWORD udf_CM_18726 0 0.0 0.0 199.9969482421875 ECU_ADDRESS 0x40002A22 /end MEASUREMENT
/begin MEASUREMENT ETCM_INTDelta "var comments" UWORD udf_CM_18726 0 0.0 0.0 199.9969482421875 ECU_ADDRESS 0x40002A20 /end MEASUREMENT
/begin MEASUREMENT ETCM_TPSErr2Dsr "var comments" UWORD udf_CM_18726 0 0.0 0.0 199.9969482421875 ECU_ADDRESS 0x40002A10 /end MEASUREMENT
/begin MEASUREMENT ETCM_DesireTPSHi2Ref "var comments" UBYTE udf_CM_16353 0 0.0 0.0 255.0 ECU_ADDRESS 0x40002A06 /end MEASUREMENT
/begin MEASUREMENT ETCM_DesireTPSErr2Ref "var comments" UWORD udf_CM_18726 0 0.0 0.0 199.9969482421875 ECU_ADDRESS 0x40002A1A /end MEASUREMENT
/begin MEASUREMENT ETCM_CompositeTerm "var comments" SWORD udf_CM_16773 0 0.0 -200.0 199.993896484375 ECU_ADDRESS 0x40002A1C /end MEASUREMENT
/begin MEASUREMENT ETCM_SprTerm "var comments" SWORD udf_CM_16773 0 0.0 -200.0 199.993896484375 ECU_ADDRESS 0x40002A16 /end MEASUREMENT
/begin MEASUREMENT ETCM_INTTerm "var comments" SWORD udf_CM_16773 0 0.0 -200.0 199.993896484375 ECU_ADDRESS 0x40002A0A /end MEASUREMENT
/begin MEASUREMENT ETCM_PropTerm "var comments" SWORD udf_CM_16773 0 0.0 -200.0 199.993896484375 ECU_ADDRESS 0x40002A18 /end MEASUREMENT
/begin MEASUREMENT ETCM2_TPSHi2Dsr "var comments" UBYTE udf_CM_16353 0 0.0 0.0 255.0 ECU_ADDRESS 0x0 /end MEASUREMENT
/begin MEASUREMENT ETCM2_TPSHi2Ref "var comments" UBYTE udf_CM_16353 0 0.0 0.0 255.0 ECU_ADDRESS 0x0 /end MEASUREMENT
/begin MEASUREMENT ETCM2_UnpwrdRefLearned "var comments" UBYTE udf_CM_16353 0 0.0 0.0 255.0 ECU_ADDRESS 0x0 /end MEASUREMENT
/begin MEASUREMENT ETCM2_ThrotMtrDir "var comments" UBYTE udf_CM_16353 0 0.0 0.0 255.0 ECU_ADDRESS 0x0 /end MEASUREMENT
/begin MEASUREMENT ETCM2_DutyLimited "var comments" UBYTE udf_CM_16353 0 0.0 0.0 255.0 ECU_ADDRESS 0x0 /end MEASUREMENT
/begin MEASUREMENT ETCM2_UnpwrdRefThrotPstn "var comments" UWORD udf_CM_18726 0 0.0 0.0 199.9969482421875 ECU_ADDRESS 0x0 /end MEASUREMENT
/begin MEASUREMENT ETCM2_UnlimitedDutyCycle "var comments" UWORD udf_CM_18726 0 0.0 0.0 199.9969482421875 ECU_ADDRESS 0x0 /end MEASUREMENT
/begin MEASUREMENT ETCM2_LimitedDutyCycle "var comments" UWORD udf_CM_18726 0 0.0 0.0 199.9969482421875 ECU_ADDRESS 0x0 /end MEASUREMENT
/begin MEASUREMENT ETCM2_INTDelta "var comments" UWORD udf_CM_18726 0 0.0 0.0 199.9969482421875 ECU_ADDRESS 0x0 /end MEASUREMENT
/begin MEASUREMENT ETCM2_TPSErr2Dsr "var comments" UWORD udf_CM_18726 0 0.0 0.0 199.9969482421875 ECU_ADDRESS 0x0 /end MEASUREMENT
/begin MEASUREMENT ETCM2_DesireTPSHi2Ref "var comments" UBYTE udf_CM_16353 0 0.0 0.0 255.0 ECU_ADDRESS 0x0 /end MEASUREMENT
/begin MEASUREMENT ETCM2_DesireTPSErr2Ref "var comments" UWORD udf_CM_18726 0 0.0 0.0 199.9969482421875 ECU_ADDRESS 0x0 /end MEASUREMENT
/begin MEASUREMENT ETCM2_CompositeTerm "var comments" SWORD udf_CM_16773 0 0.0 -200.0 199.993896484375 ECU_ADDRESS 0x0 /end MEASUREMENT
/begin MEASUREMENT ETCM2_SprTerm "var comments" SWORD udf_CM_16773 0 0.0 -200.0 199.993896484375 ECU_ADDRESS 0x0 /end MEASUREMENT
/begin MEASUREMENT ETCM2_INTTerm "var comments" SWORD udf_CM_16773 0 0.0 -200.0 199.993896484375 ECU_ADDRESS 0x0 /end MEASUREMENT
/begin MEASUREMENT ETCM2_PropTerm "var comments" SWORD udf_CM_16773 0 0.0 -200.0 199.993896484375 ECU_ADDRESS 0x0 /end MEASUREMENT
/begin MEASUREMENT GENV1Filt "var comments" UWORD udf_CM_16928 0 0.0 0.0 1023.984375 ECU_ADDRESS 0x0 /end MEASUREMENT
/begin MEASUREMENT GENV2Filt "var comments" UWORD udf_CM_16928 0 0.0 0.0 1023.984375 ECU_ADDRESS 0x0 /end MEASUREMENT
/begin MEASUREMENT GENV3Filt "var comments" UWORD udf_CM_16928 0 0.0 0.0 1023.984375 ECU_ADDRESS 0x0 /end MEASUREMENT
/begin MEASUREMENT GENV_VOLTErr2Dsr "var comments" UWORD udf_CM_16928 0 0.0 0.0 1023.984375 ECU_ADDRESS 0x0 /end MEASUREMENT
/begin MEASUREMENT GENV_VOLTHi2Dsr "var comments" UBYTE udf_CM_16353 0 0.0 0.0 255.0 ECU_ADDRESS 0x0 /end MEASUREMENT
/begin MEASUREMENT GENV_PWM_Out_En "var comments" UBYTE udf_CM_16353 0 0.0 0.0 255.0 ECU_ADDRESS 0x0 /end MEASUREMENT
/begin MEASUREMENT GENV_CompositeTerm "var comments" SWORD udf_CM_16773 0 0.0 -200.0 199.993896484375 ECU_ADDRESS 0x0 /end MEASUREMENT
/begin MEASUREMENT GENV_INTTerm "var comments" SWORD udf_CM_16773 0 0.0 -200.0 199.993896484375 ECU_ADDRESS 0x0 /end MEASUREMENT
/begin MEASUREMENT GENV_PropTerm "var comments" SWORD udf_CM_16773 0 0.0 -200.0 199.993896484375 ECU_ADDRESS 0x0 /end MEASUREMENT
/begin MEASUREMENT GENV_INTDelta "var comments" UWORD udf_CM_18726 0 0.0 0.0 199.9969482421875 ECU_ADDRESS 0x0 /end MEASUREMENT
/begin MEASUREMENT WPGOV_Err2Dsr "var comments" UWORD udf_CM_17292 0 0.0 0.0 15.999755859375 ECU_ADDRESS 0x0 /end MEASUREMENT
/begin MEASUREMENT WPGOVDesired "var comments" UWORD udf_CM_17292 0 0.0 0.0 15.999755859375 ECU_ADDRESS 0x0 /end MEASUREMENT
/begin MEASUREMENT WPGOV_Hi2Dsr "var comments" UBYTE udf_CM_16353 0 0.0 0.0 255.0 ECU_ADDRESS 0x0 /end MEASUREMENT
/begin MEASUREMENT WPGOV_CL_En "var comments" UBYTE udf_CM_16353 0 0.0 0.0 255.0 ECU_ADDRESS 0x0 /end MEASUREMENT
/begin MEASUREMENT WPGOV_CompositeTerm "var comments" SWORD udf_CM_16773 0 0.0 -200.0 199.993896484375 ECU_ADDRESS 0x0 /end MEASUREMENT
/begin MEASUREMENT WPGOV_INTTerm "var comments" SWORD udf_CM_16773 0 0.0 -200.0 199.993896484375 ECU_ADDRESS 0x0 /end MEASUREMENT
/begin MEASUREMENT WPGOV_PropTerm "var comments" SWORD udf_CM_16773 0 0.0 -200.0 199.993896484375 ECU_ADDRESS 0x0 /end MEASUREMENT
/begin MEASUREMENT WPGOV_INTDelta "var comments" UWORD udf_CM_18726 0 0.0 0.0 199.9969482421875 ECU_ADDRESS 0x0 /end MEASUREMENT
/begin MEASUREMENT PWRGOV_Hi2Dsr "var comments" UBYTE udf_CM_16353 0 0.0 0.0 255.0 ECU_ADDRESS 0x400029E0 /end MEASUREMENT
/begin MEASUREMENT PWRGOV_En "var comments" UBYTE udf_CM_16353 0 0.0 0.0 255.0 ECU_ADDRESS 0x400029E1 /end MEASUREMENT
/begin MEASUREMENT PWRGOV_Err2Dsr "var comments" UWORD udf_CM_15534 0 0.0 0.0 511.9921875 ECU_ADDRESS 0x400029E2 /end MEASUREMENT
/begin MEASUREMENT PWRGOV_CompTerm "var comments" SWORD udf_CM_16773 0 0.0 -200.0 199.993896484375 ECU_ADDRESS 0x400029E4 /end MEASUREMENT
/begin MEASUREMENT PWRGOV_INTTerm "var comments" SWORD udf_CM_16773 0 0.0 -200.0 199.993896484375 ECU_ADDRESS 0x400029DC /end MEASUREMENT
/begin MEASUREMENT PWRGOV_INTDelta "var comments" UWORD udf_CM_18726 0 0.0 0.0 199.9969482421875 ECU_ADDRESS 0x400029DE /end MEASUREMENT
/begin MEASUREMENT SABaseRun "var comments" SWORD udf_CM_17711 0 0.0 -256.0 255.9921875 ECU_ADDRESS 0x40002A6A /end MEASUREMENT
/begin MEASUREMENT SACrank "var comments" SWORD udf_CM_17718 0 0.0 -256.0 255.9921875 ECU_ADDRESS 0x40002A9A /end MEASUREMENT
/begin MEASUREMENT SAFinalCyl1 "var comments" SWORD udf_CM_17725 0 0.0 -256.0 255.9921875 DISPLAY_IDENTIFIER SAFinalCyl[0] ECU_ADDRESS 0x40002A52 /end MEASUREMENT
/begin MEASUREMENT SAFinalDlvCyl1 "var comments" SWORD udf_CM_17739 0 0.0 -256.0 255.9921875 DISPLAY_IDENTIFIER SAFinalDlvCyl[0] ECU_ADDRESS 0x40002A5E /end MEASUREMENT
/begin MEASUREMENT SAFinalCyl2 "var comments" SWORD udf_CM_17732 0 0.0 -256.0 255.9921875 DISPLAY_IDENTIFIER SAFinalCyl[1] ECU_ADDRESS 0x40002A54 /end MEASUREMENT
/begin MEASUREMENT SAFinalDlvCyl2 "var comments" SWORD udf_CM_17746 0 0.0 -256.0 255.9921875 DISPLAY_IDENTIFIER SAFinalDlvCyl[1] ECU_ADDRESS 0x40002A60 /end MEASUREMENT
/begin MEASUREMENT SAGlobal "var comments" SWORD udf_CM_17767 0 0.0 -256.0 255.9921875 ECU_ADDRESS 0x40002A76 /end MEASUREMENT
/begin MEASUREMENT SAMain "var comments" SWORD udf_CM_17767 0 0.0 -256.0 255.9921875 ECU_ADDRESS 0x40002A74 /end MEASUREMENT
/begin MEASUREMENT SAPE "var comments" SWORD udf_CM_17781 0 0.0 -256.0 255.9921875 ECU_ADDRESS 0x40002A94 /end MEASUREMENT
/begin MEASUREMENT SAPECorr "var comments" SWORD udf_CM_17711 0 0.0 -256.0 255.9921875 ECU_ADDRESS 0x40002A72 /end MEASUREMENT
/begin MEASUREMENT SAIdleCorr "var comments" SWORD udf_CM_17711 0 0.0 -256.0 255.9921875 ECU_ADDRESS 0x40002A6E /end MEASUREMENT
/begin MEASUREMENT SAIdleDyna "var comments" SWORD udf_CM_17711 0 0.0 -256.0 255.9921875 ECU_ADDRESS 0x40002A68 /end MEASUREMENT
/begin MEASUREMENT SAIdleBase "var comments" SWORD udf_CM_17718 0 0.0 -256.0 255.9921875 ECU_ADDRESS 0x40002A98 /end MEASUREMENT
/begin MEASUREMENT SARampSelect "var comments" UBYTE udf_CM_16822 0 0.0 0.0 255.0 ECU_ADDRESS 0x40002A78 /end MEASUREMENT
/begin MEASUREMENT SAGovCompositeTerm "var comments" SWORD udf_CM_16773 0 0.0 -200.0 199.993896484375 ECU_ADDRESS 0x40002AA2 /end MEASUREMENT
/begin MEASUREMENT SAGovPropTerm "var comments" SWORD udf_CM_16773 0 0.0 -200.0 199.993896484375 ECU_ADDRESS 0x40002AA0 /end MEASUREMENT
/begin MEASUREMENT SAGovDerivTerm "var comments" SWORD udf_CM_16773 0 0.0 -200.0 199.993896484375 ECU_ADDRESS 0x40002A9C /end MEASUREMENT
/begin MEASUREMENT SAGovernor "var comments" SWORD udf_CM_17711 0 0.0 -256.0 255.9921875 ECU_ADDRESS 0x40002AA6 /end MEASUREMENT
/begin MEASUREMENT SAGovDerivEnb "var comments" UBYTE udf_CM_16822 0 0.0 0.0 255.0 ECU_ADDRESS 0x40002AA8 /end MEASUREMENT
/begin MEASUREMENT SAGovDerivLoopCnt "var comments" UBYTE udf_CM_16829 0 0.0 0.0 255.0 ECU_ADDRESS 0x40002AA4 /end MEASUREMENT
/begin MEASUREMENT SAGovMaxLimit "var comments" SWORD udf_CM_17711 0 0.0 -256.0 255.9921875 ECU_ADDRESS 0x40002AAC /end MEASUREMENT
/begin MEASUREMENT SAGovMinLimit "var comments" SWORD udf_CM_17711 0 0.0 -256.0 255.9921875 ECU_ADDRESS 0x40002AAA /end MEASUREMENT
/begin MEASUREMENT SAMaxLimit "var comments" SWORD udf_CM_17711 0 0.0 -256.0 255.9921875 ECU_ADDRESS 0x40002A5A /end MEASUREMENT
/begin MEASUREMENT SAMinLimit "var comments" SWORD udf_CM_17711 0 0.0 -256.0 255.9921875 ECU_ADDRESS 0x40002A5C /end MEASUREMENT
/begin MEASUREMENT SpdCntlDervEnb "var comments" UBYTE udf_CM_16822 0 0.0 0.0 255.0 ECU_ADDRESS 0x40002923 /end MEASUREMENT
/begin MEASUREMENT SpdCntlDervLoopCnt "var comments" UBYTE udf_CM_16829 0 0.0 0.0 255.0 ECU_ADDRESS 0x4000291D /end MEASUREMENT
/begin MEASUREMENT KNKS_CH1 "var comments" UWORD CM_Count1 0 0.0 0.0 65535.0 DISPLAY_IDENTIFIER KNKS_CH[0] ECU_ADDRESS 0x40000B6C /end MEASUREMENT
/begin MEASUREMENT KNKS_CH2 "var comments" UWORD CM_Count1 0 0.0 0.0 65535.0 DISPLAY_IDENTIFIER KNKS_CH[1] ECU_ADDRESS 0x40000B6E /end MEASUREMENT
/begin MEASUREMENT KNK_WB "var comments" SWORD udf_CM_17718 0 0.0 -256.0 255.9921875 ECU_ADDRESS 0x40002AB4 /end MEASUREMENT
/begin MEASUREMENT KNK_WD "var comments" SWORD udf_CM_17718 0 0.0 -256.0 255.9921875 ECU_ADDRESS 0x40002AB6 /end MEASUREMENT
/begin MEASUREMENT KNK_CMD_FIL_FREQ "var comments" UBYTE CM_KNK_HZ 0 0.0 0.0 64.0 ECU_ADDRESS 0x40002AB9 /end MEASUREMENT
/begin MEASUREMENT KNK_CMD_GAIN "var comments" UBYTE CM_KNK_GAIN 0 0.0 0.0 64.0 ECU_ADDRESS 0x40002AB8 /end MEASUREMENT
/begin MEASUREMENT KNK_CMD_INT "var comments" UBYTE CM_KNK_INT 0 0.0 0.0 32.0 ECU_ADDRESS 0x40002ABA /end MEASUREMENT
/begin MEASUREMENT OPSWSTTestComp "var comments" UBYTE udf_CM_17816 0 0.0 0.0 255.0 ECU_ADDRESS 0x40002F64 /end MEASUREMENT
/begin MEASUREMENT OPSWSTDiagEnb "var comments" UBYTE udf_CM_17494 0 0.0 0.0 255.0 ECU_ADDRESS 0x40002F6A /end MEASUREMENT
/begin MEASUREMENT OPSWSTTestFail "var comments" UBYTE udf_CM_17508 0 0.0 0.0 255.0 ECU_ADDRESS 0x40002F6B /end MEASUREMENT
/begin MEASUREMENT OPSWSTFailCount "var comments" UWORD udf_CM_17515 0 0.0 0.0 65535.0 ECU_ADDRESS 0x40002F66 /end MEASUREMENT
/begin MEASUREMENT OPSWSTFailMet "var comments" UBYTE udf_CM_17522 0 0.0 0.0 255.0 ECU_ADDRESS 0x40002F65 /end MEASUREMENT
/begin MEASUREMENT OPSWSTPassCount "var comments" UWORD udf_CM_17501 0 0.0 0.0 65535.0 ECU_ADDRESS 0x40002F68 /end MEASUREMENT
/begin MEASUREMENT FPFBNCTComp "var comments" UBYTE udf_CM_17816 0 0.0 0.0 255.0 ECU_ADDRESS 0x40002EE6 /end MEASUREMENT
/begin MEASUREMENT FPFBNCTEnb "var comments" UBYTE udf_CM_17494 0 0.0 0.0 255.0 DISPLAY_IDENTIFIER FPFBNCTEnbMet ECU_ADDRESS 0x40002EE4 /end MEASUREMENT
/begin MEASUREMENT FPFBNCTFail "var comments" UBYTE udf_CM_17508 0 0.0 0.0 255.0 ECU_ADDRESS 0x40002EE7 /end MEASUREMENT
/begin MEASUREMENT FPFBNCTFC "var comments" UWORD udf_CM_17515 0 0.0 0.0 65535.0 ECU_ADDRESS 0x40002EE8 /end MEASUREMENT
/begin MEASUREMENT FPFBNCTFMet "var comments" UBYTE udf_CM_17522 0 0.0 0.0 255.0 ECU_ADDRESS 0x40002EE5 /end MEASUREMENT
/begin MEASUREMENT FPFBNCTPC "var comments" UWORD udf_CM_17501 0 0.0 0.0 65535.0 ECU_ADDRESS 0x40002EEA /end MEASUREMENT
/begin MEASUREMENT ShutDownCmplt "var comments" UBYTE udf_CM_17963 0 0.0 0.0 255.0 ECU_ADDRESS 0x40002C0E /end MEASUREMENT
/begin MEASUREMENT IdleMetPrev "var comments" UBYTE udf_CM_17837 0 0.0 0.0 255.0 DISPLAY_IDENTIFIER SbIDLE_IdleCondsMet_Prev ECU_ADDRESS 0x40002A79 /end MEASUREMENT
/begin MEASUREMENT TPSCntrTestComp "var comments" UBYTE udf_CM_18215 0 0.0 0.0 255.0 ECU_ADDRESS 0x40002EF2 /end MEASUREMENT
/begin MEASUREMENT TPSErrorDynThresh "var comments" UWORD udf_CM_18180 0 0.0 0.0 199.9969482421875 ECU_ADDRESS 0x40002EF0 /end MEASUREMENT
/begin MEASUREMENT TPSCntrDiagEnb "var comments" UBYTE udf_CM_18187 0 0.0 0.0 255.0 ECU_ADDRESS 0x40002EEE /end MEASUREMENT
/begin MEASUREMENT TPSCntrErrorThresh "var comments" UWORD udf_CM_18236 0 0.0 0.0 199.9969482421875 ECU_ADDRESS 0x40002EF8 /end MEASUREMENT
/begin MEASUREMENT TPSCntrTestFail "var comments" UBYTE udf_CM_18222 0 0.0 0.0 255.0 ECU_ADDRESS 0x40002EF3 /end MEASUREMENT
/begin MEASUREMENT TPSCntrFailCount "var comments" UWORD udf_CM_18194 0 0.0 0.0 65535.0 ECU_ADDRESS 0x40002EF6 /end MEASUREMENT
/begin MEASUREMENT TPSCntrFailMet "var comments" UBYTE udf_CM_18201 0 0.0 0.0 255.0 ECU_ADDRESS 0x40002EEF /end MEASUREMENT
/begin MEASUREMENT TPSCntrPassCount "var comments" UWORD udf_CM_18208 0 0.0 0.0 65535.0 ECU_ADDRESS 0x40002EF4 /end MEASUREMENT
/begin MEASUREMENT TPSCntrError "var comments" UWORD udf_CM_18229 0 0.0 0.0 199.9969482421875 ECU_ADDRESS 0x40002EFC /end MEASUREMENT
/begin MEASUREMENT FCVPSCntrTestComp "var comments" UBYTE udf_CM_18215 0 0.0 0.0 255.0 ECU_ADDRESS 0x40002ED8 /end MEASUREMENT
/begin MEASUREMENT FCVPSErrorDynThresh "var comments" UWORD udf_CM_18180 0 0.0 0.0 199.9969482421875 ECU_ADDRESS 0x40002ED6 /end MEASUREMENT
/begin MEASUREMENT FCVPSCntrDiagEnb "var comments" UBYTE udf_CM_18187 0 0.0 0.0 255.0 ECU_ADDRESS 0x40002ED4 /end MEASUREMENT
/begin MEASUREMENT FCVPSCntrErrorThresh "var comments" UWORD udf_CM_18236 0 0.0 0.0 199.9969482421875 ECU_ADDRESS 0x40002EDE /end MEASUREMENT
/begin MEASUREMENT FCVPSCntrTestFail "var comments" UBYTE udf_CM_18222 0 0.0 0.0 255.0 ECU_ADDRESS 0x40002ED9 /end MEASUREMENT
/begin MEASUREMENT FCVPSCntrFailCount "var comments" UWORD udf_CM_18194 0 0.0 0.0 65535.0 ECU_ADDRESS 0x40002EDC /end MEASUREMENT
/begin MEASUREMENT FCVPSCntrFailMet "var comments" UBYTE udf_CM_18201 0 0.0 0.0 255.0 ECU_ADDRESS 0x40002ED5 /end MEASUREMENT
/begin MEASUREMENT FCVPSCntrPassCount "var comments" UWORD udf_CM_18208 0 0.0 0.0 65535.0 ECU_ADDRESS 0x40002EDA /end MEASUREMENT
/begin MEASUREMENT FCVPSCntrError "var comments" UWORD udf_CM_18229 0 0.0 0.0 199.9969482421875 ECU_ADDRESS 0x40002EE2 /end MEASUREMENT
/begin MEASUREMENT SpdCntlLvl "var comments" UBYTE udf_CM_18012 0 0.0 0.0 255.0 DISPLAY_IDENTIFIER SpeedControlLvl ECU_ADDRESS 0x40002940 /end MEASUREMENT
/begin MEASUREMENT SpeedControlInput "var comments" UWORD udf_CM_18005 0 0.0 0.0 99.99847412109375 ECU_ADDRESS 0x40002942 /end MEASUREMENT
/begin MEASUREMENT SparkDwell "var comments" UWORD udf_CM_17991 0 0.0 0.0 1023.984375 ECU_ADDRESS 0x40002A2E /end MEASUREMENT
/begin MEASUREMENT SparkMode "var comments" UBYTE udf_CM_17998 0 0.0 0.0 255.0 ECU_ADDRESS 0x40002A66 /end MEASUREMENT
/begin MEASUREMENT StallToCrankMet "var comments" UBYTE udf_CM_18138 0 0.0 0.0 255.0 ECU_ADDRESS 0x40002C0D /end MEASUREMENT
/begin MEASUREMENT ThrFlowAtTPSMax "var comments" UWORD udf_CM_18677 0 0.0 0.0 511.9921875 ECU_ADDRESS 0x40002D66 /end MEASUREMENT
/begin MEASUREMENT ThrFlowAtTPSMin "var comments" UWORD udf_CM_18684 0 0.0 0.0 511.9921875 ECU_ADDRESS 0x40002D5A /end MEASUREMENT
/begin MEASUREMENT TPSMinimum "var comments" UWORD udf_CM_18810 0 0.0 0.0 199.9969482421875 ECU_ADDRESS 0x40002D68 /end MEASUREMENT
/begin MEASUREMENT TPSMinLnCNT "var comments" UBYTE udf_CM_18824 0 0.0 0.0 255.0 ECU_ADDRESS 0x40002D5F /end MEASUREMENT
/begin MEASUREMENT TPSMinLrned "var comments" UBYTE udf_CM_18817 0 0.0 0.0 255.0 ECU_ADDRESS 0x40002D4F /end MEASUREMENT
/begin MEASUREMENT DsrdFuelFlow "var comments" UWORD udf_CM_15982 0 0.0 0.0 511.9921875 ECU_ADDRESS 0x40002D88 /end MEASUREMENT
/begin MEASUREMENT FCVPSMinimum "var comments" UWORD udf_CM_18810 0 0.0 0.0 199.9969482421875 ECU_ADDRESS 0x40002D9E /end MEASUREMENT
/begin MEASUREMENT FCVPSMinLnCNT "var comments" UBYTE udf_CM_18824 0 0.0 0.0 255.0 ECU_ADDRESS 0x40002D91 /end MEASUREMENT
/begin MEASUREMENT FCVPSMinLrned "var comments" UBYTE udf_CM_18817 0 0.0 0.0 255.0 ECU_ADDRESS 0x40002D9B /end MEASUREMENT
/begin MEASUREMENT DesireFCVPS "var comments" UWORD udf_CM_15989 0 0.0 0.0 199.9969482421875 ECU_ADDRESS 0x40002D8E /end MEASUREMENT
/begin MEASUREMENT FCVMotorState "var comments" UBYTE udf_CM_16661 0 0.0 0.0 3.0 ECU_ADDRESS 0x40002D94 /end MEASUREMENT
/begin MEASUREMENT ActFCVPosition "var comments" UBYTE udf_CM_15247 0 0.0 0.0 255.0 ECU_ADDRESS 0x40002D8D /end MEASUREMENT
/begin MEASUREMENT FCVMoveDirct "var comments" UBYTE udf_CM_16668 0 0.0 0.0 2.0 ECU_ADDRESS 0x40002D8C /end MEASUREMENT
/begin MEASUREMENT FCVPS "var comments" UWORD udf_CM_18726 0 0.0 0.0 199.9969482421875 ECU_ADDRESS 0x40002DAA /end MEASUREMENT
/begin MEASUREMENT FCVPSRawSignal "var comments" UWORD udf_CM_18838 0 0.0 0.0 65535.0 ECU_ADDRESS 0x40002DA8 /end MEASUREMENT
/begin MEASUREMENT FCVPSDelta "var comments" UWORD udf_CM_18733 0 0.0 0.0 199.9969482421875 ECU_ADDRESS 0x40002DB0 /end MEASUREMENT
/begin MEASUREMENT FCV_FP_CorrForFCVPS "var comments" UWORD udf_CM_15415 0 0.0 0.0 1.999969005584717 ECU_ADDRESS 0x40002DA2 /end MEASUREMENT
/begin MEASUREMENT FCV_Baro_CorrForFCVPS "var comments" UWORD udf_CM_15415 0 0.0 0.0 1.999969005584717 ECU_ADDRESS 0x40002DA4 /end MEASUREMENT
/begin MEASUREMENT VbSMTR_Rotate_Active "var comments" UBYTE udf_CM_16710 0 0.0 0.0 255.0 ECU_ADDRESS 0x400029EF /end MEASUREMENT
/begin MEASUREMENT VbSMTR_Rotate_Command "var comments" UBYTE udf_CM_16710 0 0.0 0.0 255.0 ECU_ADDRESS 0x400029EA /end MEASUREMENT
/begin MEASUREMENT VbSMTR_Rotate_Enable "var comments" UBYTE udf_CM_16710 0 0.0 0.0 255.0 ECU_ADDRESS 0x400029EE /end MEASUREMENT
/begin MEASUREMENT VbSMTR_Rotate_Execute "var comments" UBYTE udf_CM_16710 0 0.0 0.0 255.0 ECU_ADDRESS 0x400029EB /end MEASUREMENT
/begin MEASUREMENT VbSMTR_IGN_StartEn "var comments" UBYTE udf_CM_16710 0 0.0 0.0 255.0 ECU_ADDRESS 0x400029ED /end MEASUREMENT
/begin MEASUREMENT VcSMTR_c_Attempt "var comments" UBYTE udf_CM_18824 0 0.0 0.0 255.0 ECU_ADDRESS 0x400029E9 /end MEASUREMENT
/begin MEASUREMENT TPSShrtDiagEnb "var comments" UBYTE udf_CM_18859 0 0.0 0.0 255.0 ECU_ADDRESS 0x400030CA /end MEASUREMENT
/begin MEASUREMENT TPSSHFailCount "var comments" UWORD udf_CM_18845 0 0.0 0.0 65535.0 ECU_ADDRESS 0x400030D2 /end MEASUREMENT
/begin MEASUREMENT TPSSHFailMet "var comments" UBYTE udf_CM_18852 0 0.0 0.0 255.0 ECU_ADDRESS 0x400030C9 /end MEASUREMENT
/begin MEASUREMENT TPSSHTestFail "var comments" UBYTE udf_CM_18873 0 0.0 0.0 255.0 ECU_ADDRESS 0x400030CD /end MEASUREMENT
/begin MEASUREMENT TPSSLFailCount "var comments" UWORD udf_CM_18880 0 0.0 0.0 65535.0 ECU_ADDRESS 0x400030D0 /end MEASUREMENT
/begin MEASUREMENT TPSSLFailMet "var comments" UBYTE udf_CM_18887 0 0.0 0.0 255.0 ECU_ADDRESS 0x400030C8 /end MEASUREMENT
/begin MEASUREMENT TPSSLTestFail "var comments" UBYTE udf_CM_18894 0 0.0 0.0 255.0 ECU_ADDRESS 0x400030CC /end MEASUREMENT
/begin MEASUREMENT TPSShrtPassCount "var comments" UWORD udf_CM_18866 0 0.0 0.0 65535.0 ECU_ADDRESS 0x400030CE /end MEASUREMENT
/begin MEASUREMENT FCVPSDiagEnb "var comments" UBYTE udf_CM_17382 0 0.0 0.0 255.0 ECU_ADDRESS 0x400030D8 /end MEASUREMENT
/begin MEASUREMENT FCVPSSLFailMet "var comments" UBYTE udf_CM_17410 0 0.0 0.0 255.0 ECU_ADDRESS 0x400030DD /end MEASUREMENT
/begin MEASUREMENT FCVPSSLTestComp "var comments" UBYTE udf_CM_17424 0 0.0 0.0 255.0 ECU_ADDRESS 0x400030D9 /end MEASUREMENT
/begin MEASUREMENT FCVPSSLTestFail "var comments" UBYTE udf_CM_17431 0 0.0 0.0 255.0 ECU_ADDRESS 0x400030DB /end MEASUREMENT
/begin MEASUREMENT FCVPSSLFailCount "var comments" UWORD udf_CM_17389 0 0.0 0.0 65535.0 ECU_ADDRESS 0x400030DE /end MEASUREMENT
/begin MEASUREMENT FCVPSSLPassCount "var comments" UWORD udf_CM_17417 0 0.0 0.0 65535.0 ECU_ADDRESS 0x400030E0 /end MEASUREMENT
/begin MEASUREMENT FCVPSSHFailMet "var comments" UBYTE udf_CM_17410 0 0.0 0.0 255.0 ECU_ADDRESS 0x400030E6 /end MEASUREMENT
/begin MEASUREMENT FCVPSSHTestComp "var comments" UBYTE udf_CM_17424 0 0.0 0.0 255.0 ECU_ADDRESS 0x400030DA /end MEASUREMENT
/begin MEASUREMENT FCVPSSHTestFail "var comments" UBYTE udf_CM_17431 0 0.0 0.0 255.0 ECU_ADDRESS 0x400030DC /end MEASUREMENT
/begin MEASUREMENT FCVPSSHFailCount "var comments" UWORD udf_CM_17389 0 0.0 0.0 65535.0 ECU_ADDRESS 0x400030E2 /end MEASUREMENT
/begin MEASUREMENT FCVPSSHPassCount "var comments" UWORD udf_CM_17417 0 0.0 0.0 65535.0 ECU_ADDRESS 0x400030E4 /end MEASUREMENT
/begin MEASUREMENT AFCCell1 "var comments" UWORD udf_CM_15275 0 0.0 0.0 1.999969005584717 DISPLAY_IDENTIFIER AFCCell[0] ECU_ADDRESS 0x400002D8 /end MEASUREMENT
/begin MEASUREMENT AFCCell2 "var comments" UWORD udf_CM_15324 0 0.0 0.0 1.999969005584717 DISPLAY_IDENTIFIER AFCCell[1] ECU_ADDRESS 0x400002DA /end MEASUREMENT
/begin MEASUREMENT AFCCell11 "var comments" UWORD udf_CM_15282 0 0.0 0.0 1.999969005584717 DISPLAY_IDENTIFIER AFCCell[10] ECU_ADDRESS 0x400002EC /end MEASUREMENT
/begin MEASUREMENT AFCCell12 "var comments" UWORD udf_CM_15289 0 0.0 0.0 1.999969005584717 DISPLAY_IDENTIFIER AFCCell[11] ECU_ADDRESS 0x400002EE /end MEASUREMENT
/begin MEASUREMENT AFCCell13 "var comments" UWORD udf_CM_15296 0 0.0 0.0 1.999969005584717 DISPLAY_IDENTIFIER AFCCell[12] ECU_ADDRESS 0x400002F0 /end MEASUREMENT
/begin MEASUREMENT AFCCell14 "var comments" UWORD udf_CM_15303 0 0.0 0.0 1.999969005584717 DISPLAY_IDENTIFIER AFCCell[13] ECU_ADDRESS 0x400002F2 /end MEASUREMENT
/begin MEASUREMENT AFCCell15 "var comments" UWORD udf_CM_15310 0 0.0 0.0 1.999969005584717 DISPLAY_IDENTIFIER AFCCell[14] ECU_ADDRESS 0x400002F4 /end MEASUREMENT
/begin MEASUREMENT AFCCell16 "var comments" UWORD udf_CM_15317 0 0.0 0.0 1.999969005584717 DISPLAY_IDENTIFIER AFCCell[15] ECU_ADDRESS 0x400002F6 /end MEASUREMENT
/begin MEASUREMENT AFCCell3 "var comments" UWORD udf_CM_15331 0 0.0 0.0 1.999969005584717 DISPLAY_IDENTIFIER AFCCell[2] ECU_ADDRESS 0x400002DC /end MEASUREMENT
/begin MEASUREMENT AFCCell4 "var comments" UWORD udf_CM_15338 0 0.0 0.0 1.999969005584717 DISPLAY_IDENTIFIER AFCCell[3] ECU_ADDRESS 0x400002DE /end MEASUREMENT
/begin MEASUREMENT AFCCell5 "var comments" UWORD udf_CM_15345 0 0.0 0.0 1.999969005584717 DISPLAY_IDENTIFIER AFCCell[4] ECU_ADDRESS 0x400002E0 /end MEASUREMENT
/begin MEASUREMENT AFCCell6 "var comments" UWORD udf_CM_15352 0 0.0 0.0 1.999969005584717 DISPLAY_IDENTIFIER AFCCell[5] ECU_ADDRESS 0x400002E2 /end MEASUREMENT
/begin MEASUREMENT AFCCell7 "var comments" UWORD udf_CM_15359 0 0.0 0.0 1.999969005584717 DISPLAY_IDENTIFIER AFCCell[6] ECU_ADDRESS 0x400002E4 /end MEASUREMENT
/begin MEASUREMENT AFCCell8 "var comments" UWORD udf_CM_15366 0 0.0 0.0 1.999969005584717 DISPLAY_IDENTIFIER AFCCell[7] ECU_ADDRESS 0x400002E6 /end MEASUREMENT
/begin MEASUREMENT AFCCell9 "var comments" UWORD udf_CM_15373 0 0.0 0.0 1.999969005584717 DISPLAY_IDENTIFIER AFCCell[8] ECU_ADDRESS 0x400002E8 /end MEASUREMENT
/begin MEASUREMENT AFCCell10 "var comments" UWORD udf_CM_15380 0 0.0 0.0 1.999969005584717 DISPLAY_IDENTIFIER AFCCell[9] ECU_ADDRESS 0x400002EA /end MEASUREMENT
/begin MEASUREMENT AFCCellNum "var comments" UBYTE udf_CM_15387 0 0.0 0.0 255.0 ECU_ADDRESS 0x40002BD2 /end MEASUREMENT
/begin MEASUREMENT FILE_NVM_Failure "var comments" UBYTE udf_CM_15667 0 0.0 0.0 255.0 ECU_ADDRESS 0x400026B7 /end MEASUREMENT
/begin MEASUREMENT AFCFiltExpMAPMult "var comments" UWORD udf_CM_15394 0 0.0 0.0 1.999969005584717 ECU_ADDRESS 0x40002BD4 /end MEASUREMENT
/begin MEASUREMENT AFCFiltMAP "var comments" UWORD udf_CM_15401 0 0.0 0.0 255.99609375 ECU_ADDRESS 0x40002BDA /end MEASUREMENT
/begin MEASUREMENT AFCLMet "var comments" UBYTE udf_CM_15408 0 0.0 0.0 255.0 ECU_ADDRESS 0x40002BD8 /end MEASUREMENT
/begin MEASUREMENT AFCMult "var comments" UWORD udf_CM_15415 0 0.0 0.0 1.999969005584717 ECU_ADDRESS 0x40002BD6 /end MEASUREMENT
/begin MEASUREMENT Baro "var comments" UWORD udf_CM_15562 0 0.0 0.0 255.99609375 ECU_ADDRESS 0x40002BDC /end MEASUREMENT
/begin MEASUREMENT NominalBaro "var comments" UWORD udf_CM_15562 0 0.0 0.0 255.99609375 ECU_ADDRESS 0x40002C54 /end MEASUREMENT
/begin MEASUREMENT BaroReadCrtMet "var comments" UBYTE udf_CM_15576 0 0.0 0.0 255.0 ECU_ADDRESS 0x40002BE9 /end MEASUREMENT
/begin MEASUREMENT BaroOffset "var comments" UWORD udf_CM_15569 0 0.0 0.0 255.99609375 ECU_ADDRESS 0x40002BE6 /end MEASUREMENT
/begin MEASUREMENT BaroReadTthNum "var comments" UWORD udf_CM_15583 0 0.0 0.0 65535.0 ECU_ADDRESS 0x40002BEC /end MEASUREMENT
/begin MEASUREMENT FinalPulseWidth1 "var comments" UWORD udf_CM_16304 0 0.0 0.0 1023.984375 DISPLAY_IDENTIFIER FinalPulseWidth[0] ECU_ADDRESS 0x40002CB6 /end MEASUREMENT
/begin MEASUREMENT FinalPulseWidth2 "var comments" UWORD udf_CM_16297 0 0.0 0.0 1023.984375 DISPLAY_IDENTIFIER FinalPulseWidth[1] ECU_ADDRESS 0x40002CB8 /end MEASUREMENT
/begin MEASUREMENT CoolTemp "var comments" SWORD udf_CM_15751 0 0.0 -256.0 255.9921875 DISPLAY_IDENTIFIER CoolTemp[0] ECU_ADDRESS 0x40002BFE /end MEASUREMENT
/begin MEASUREMENT CoolTempFilt "var comments" SWORD udf_CM_15758 0 0.0 -256.0 255.9921875 DISPLAY_IDENTIFIER CoolTempFilt[0] ECU_ADDRESS 0x40002C00 /end MEASUREMENT
/begin MEASUREMENT CoolTemp2 "var comments" SWORD udf_CM_15751 0 0.0 -256.0 255.9921875 DISPLAY_IDENTIFIER CoolTemp[1] ECU_ADDRESS 0x40002C00 /end MEASUREMENT
/begin MEASUREMENT CoolTempFilt2 "var comments" SWORD udf_CM_15758 0 0.0 -256.0 255.9921875 DISPLAY_IDENTIFIER CoolTempFilt[1] ECU_ADDRESS 0x40002C02 /end MEASUREMENT
/begin MEASUREMENT CoolTemp3 "var comments" SWORD udf_CM_15751 0 0.0 -256.0 255.9921875 DISPLAY_IDENTIFIER CoolTemp[2] ECU_ADDRESS 0x40002C02 /end MEASUREMENT
/begin MEASUREMENT CoolTempFilt3 "var comments" SWORD udf_CM_15758 0 0.0 -256.0 255.9921875 DISPLAY_IDENTIFIER CoolTempFilt[2] ECU_ADDRESS 0x40002C04 /end MEASUREMENT
/begin MEASUREMENT CoolTemp4 "var comments" SWORD udf_CM_15751 0 0.0 -256.0 255.9921875 DISPLAY_IDENTIFIER CoolTemp[3] ECU_ADDRESS 0x40002C04 /end MEASUREMENT
/begin MEASUREMENT CoolTempFilt4 "var comments" SWORD udf_CM_15758 0 0.0 -256.0 255.9921875 DISPLAY_IDENTIFIER CoolTempFilt[3] ECU_ADDRESS 0x40002C06 /end MEASUREMENT
/begin MEASUREMENT CoolTemp5 "var comments" SWORD udf_CM_15751 0 0.0 -256.0 255.9921875 DISPLAY_IDENTIFIER CoolTemp[4] ECU_ADDRESS 0x40002C06 /end MEASUREMENT
/begin MEASUREMENT CoolTempFilt5 "var comments" SWORD udf_CM_15758 0 0.0 -256.0 255.9921875 DISPLAY_IDENTIFIER CoolTempFilt[4] ECU_ADDRESS 0x40002C08 /end MEASUREMENT
/begin MEASUREMENT CoolTemp6 "var comments" SWORD udf_CM_15751 0 0.0 -256.0 255.9921875 DISPLAY_IDENTIFIER CoolTemp[5] ECU_ADDRESS 0x40002C08 /end MEASUREMENT
/begin MEASUREMENT CoolTempFilt6 "var comments" SWORD udf_CM_15758 0 0.0 -256.0 255.9921875 DISPLAY_IDENTIFIER CoolTempFilt[5] ECU_ADDRESS 0x40002C0A /end MEASUREMENT
/begin MEASUREMENT ClTStartup "var comments" SWORD udf_CM_15744 0 0.0 -256.0 255.9921875 ECU_ADDRESS 0x40002C04 /end MEASUREMENT
/begin MEASUREMENT CIDFailCount "var comments" UWORD udf_CM_15653 0 0.0 0.0 65535.0 ECU_ADDRESS 0x40002BF2 /end MEASUREMENT
/begin MEASUREMENT CIDSucceed "var comments" UBYTE udf_CM_15667 0 0.0 0.0 255.0 ECU_ADDRESS 0x40002BEE /end MEASUREMENT
/begin MEASUREMENT SeqPhase_Cyl1 "var comments" UWORD udf_CM_15667 0 0.0 0.0 65535.0 DISPLAY_IDENTIFIER CylPhase[0] ECU_ADDRESS 0x40001D68 /end MEASUREMENT
/begin MEASUREMENT SeqPhase_Cyl2 "var comments" UWORD udf_CM_15667 0 0.0 0.0 65535.0 DISPLAY_IDENTIFIER CylPhase[1] ECU_ADDRESS 0x40001D6A /end MEASUREMENT
/begin MEASUREMENT SeqPhase_Cyl3 "var comments" UWORD udf_CM_15667 0 0.0 0.0 65535.0 DISPLAY_IDENTIFIER CylPhase[2] ECU_ADDRESS 0x40001D6C /end MEASUREMENT
/begin MEASUREMENT SeqPhase_Cyl4 "var comments" UWORD udf_CM_15667 0 0.0 0.0 65535.0 DISPLAY_IDENTIFIER CylPhase[3] ECU_ADDRESS 0x40001D6E /end MEASUREMENT
/begin MEASUREMENT MAP_EVENT_TOOTH "var comments" UBYTE udf_CM_15667 0 0.0 0.0 255.0 ECU_ADDRESS 0x40001E10 /end MEASUREMENT
/begin MEASUREMENT Map_Event_Tooth_Count "var comments" UBYTE udf_CM_15667 0 0.0 0.0 255.0 ECU_ADDRESS 0x40001E11 /end MEASUREMENT
/begin MEASUREMENT BdcTooth "var comments" UBYTE udf_CM_15667 0 0.0 0.0 255.0 DISPLAY_IDENTIFIER BDC_TOOTH[0] ECU_ADDRESS 0x400017E4 /end MEASUREMENT
/begin MEASUREMENT SyncTooth "var comments" UBYTE udf_CM_15667 0 0.0 0.0 255.0 DISPLAY_IDENTIFIER SYNCHRONIZATION_EVENT_TOOTH ECU_ADDRESS 0x40001D42 /end MEASUREMENT
/begin MEASUREMENT Ref1Tooth_Cyl1 "var comments" UBYTE udf_CM_15667 0 0.0 0.0 255.0 DISPLAY_IDENTIFIER REFERENCE_EVENT1_TOOTH[0] ECU_ADDRESS 0x40001D37 /end MEASUREMENT
/begin MEASUREMENT Ref1Tooth_Cyl2 "var comments" UBYTE udf_CM_15667 0 0.0 0.0 255.0 DISPLAY_IDENTIFIER REFERENCE_EVENT1_TOOTH[1] ECU_ADDRESS 0x40001D38 /end MEASUREMENT
/begin MEASUREMENT Ref1Tooth_Cyl3 "var comments" UBYTE udf_CM_15667 0 0.0 0.0 255.0 DISPLAY_IDENTIFIER REFERENCE_EVENT1_TOOTH[2] ECU_ADDRESS 0x40001D39 /end MEASUREMENT
/begin MEASUREMENT Ref1Tooth_Cyl4 "var comments" UBYTE udf_CM_15667 0 0.0 0.0 255.0 DISPLAY_IDENTIFIER REFERENCE_EVENT1_TOOTH[3] ECU_ADDRESS 0x40001D3A /end MEASUREMENT
/begin MEASUREMENT Ref2Tooth_Cyl1 "var comments" UBYTE udf_CM_15667 0 0.0 0.0 255.0 DISPLAY_IDENTIFIER REFERENCE_EVENT2_TOOTH[0] ECU_ADDRESS 0x40001D3E /end MEASUREMENT
/begin MEASUREMENT Ref2Tooth_Cyl2 "var comments" UBYTE udf_CM_15667 0 0.0 0.0 255.0 DISPLAY_IDENTIFIER REFERENCE_EVENT2_TOOTH[1] ECU_ADDRESS 0x40001D3F /end MEASUREMENT
/begin MEASUREMENT Ref2Tooth_Cyl3 "var comments" UBYTE udf_CM_15667 0 0.0 0.0 255.0 DISPLAY_IDENTIFIER REFERENCE_EVENT2_TOOTH[2] ECU_ADDRESS 0x40001D40 /end MEASUREMENT
/begin MEASUREMENT Ref2Tooth_Cyl4 "var comments" UBYTE udf_CM_15667 0 0.0 0.0 255.0 DISPLAY_IDENTIFIER REFERENCE_EVENT2_TOOTH[3] ECU_ADDRESS 0x40001D41 /end MEASUREMENT
/begin MEASUREMENT FuelTooth_Cyl1 "var comments" UBYTE udf_CM_15667 0 0.0 0.0 255.0 DISPLAY_IDENTIFIER FUEL_EVENT_TOOTH[0] ECU_ADDRESS 0x40001DF0 /end MEASUREMENT
/begin MEASUREMENT FuelTooth_Cyl2 "var comments" UBYTE udf_CM_15667 0 0.0 0.0 255.0 DISPLAY_IDENTIFIER FUEL_EVENT_TOOTH[1] ECU_ADDRESS 0x40001DF1 /end MEASUREMENT
/begin MEASUREMENT FuelTooth_Cyl3 "var comments" UBYTE udf_CM_15667 0 0.0 0.0 255.0 DISPLAY_IDENTIFIER FUEL_EVENT_TOOTH[2] ECU_ADDRESS 0x40001DF2 /end MEASUREMENT
/begin MEASUREMENT FuelTooth_Cyl4 "var comments" UBYTE udf_CM_15667 0 0.0 0.0 255.0 DISPLAY_IDENTIFIER FUEL_EVENT_TOOTH[3] ECU_ADDRESS 0x40001DF3 /end MEASUREMENT
/begin MEASUREMENT TrimTooth_Cyl1 "var comments" UBYTE udf_CM_15667 0 0.0 0.0 255.0 DISPLAY_IDENTIFIER TRIM_EVENT_TOOTH[0] ECU_ADDRESS 0x40001DF4 /end MEASUREMENT
/begin MEASUREMENT TrimTooth_Cyl2 "var comments" UBYTE udf_CM_15667 0 0.0 0.0 255.0 DISPLAY_IDENTIFIER TRIM_EVENT_TOOTH[1] ECU_ADDRESS 0x40001DF5 /end MEASUREMENT
/begin MEASUREMENT TrimTooth_Cyl3 "var comments" UBYTE udf_CM_15667 0 0.0 0.0 255.0 DISPLAY_IDENTIFIER TRIM_EVENT_TOOTH[2] ECU_ADDRESS 0x40001DF6 /end MEASUREMENT
/begin MEASUREMENT TrimTooth_Cyl4 "var comments" UBYTE udf_CM_15667 0 0.0 0.0 255.0 DISPLAY_IDENTIFIER TRIM_EVENT_TOOTH[3] ECU_ADDRESS 0x40001DF7 /end MEASUREMENT
/begin MEASUREMENT TrimCutOffTooth_Cyl1 "var comments" UBYTE udf_CM_15667 0 0.0 0.0 255.0 DISPLAY_IDENTIFIER TRIM_CUT_OFF_EVENT_TOOTH[0] ECU_ADDRESS 0x40001DF8 /end MEASUREMENT
/begin MEASUREMENT TrimCutOffTooth_Cyl2 "var comments" UBYTE udf_CM_15667 0 0.0 0.0 255.0 DISPLAY_IDENTIFIER TRIM_CUT_OFF_EVENT_TOOTH[1] ECU_ADDRESS 0x40001DF9 /end MEASUREMENT
/begin MEASUREMENT TrimCutOffTooth_Cyl3 "var comments" UBYTE udf_CM_15667 0 0.0 0.0 255.0 DISPLAY_IDENTIFIER TRIM_CUT_OFF_EVENT_TOOTH[2] ECU_ADDRESS 0x40001DFA /end MEASUREMENT
/begin MEASUREMENT TrimCutOffTooth_Cyl4 "var comments" UBYTE udf_CM_15667 0 0.0 0.0 255.0 DISPLAY_IDENTIFIER TRIM_CUT_OFF_EVENT_TOOTH[3] ECU_ADDRESS 0x40001DFB /end MEASUREMENT
/begin MEASUREMENT ToothPeriod "var comments" UWORD udf_CM_15660 0 0.0 0.0 65535.0 ECU_ADDRESS 0x40001D3C /end MEASUREMENT
/begin MEASUREMENT ToothDuration "var comments" UWORD udf_CM_15660 0 0.0 0.0 65535.0 ECU_ADDRESS 0x40001D34 /end MEASUREMENT
/begin MEASUREMENT ToothNoiseDuration "var comments" UWORD udf_CM_15660 0 0.0 0.0 65535.0 ECU_ADDRESS 0x40001D08 /end MEASUREMENT
/begin MEASUREMENT ToothNoiseCount "var comments" UBYTE udf_CM_15667 0 0.0 0.0 255.0 ECU_ADDRESS 0x40001D0A /end MEASUREMENT
/begin MEASUREMENT TooFewTeeth "var comments" UBYTE udf_CM_15667 0 0.0 0.0 255.0 ECU_ADDRESS 0x4000180F /end MEASUREMENT
/begin MEASUREMENT TooManyTeeth "var comments" UBYTE udf_CM_15667 0 0.0 0.0 255.0 ECU_ADDRESS 0x4000180E /end MEASUREMENT
/begin MEASUREMENT ToothErrCnt "var comments" UBYTE udf_CM_15667 0 0.0 0.0 255.0 ECU_ADDRESS 0x40001810 /end MEASUREMENT
/begin MEASUREMENT EST1_HiCur_Count "var comments" UBYTE udf_CM_15667 0 0.0 0.0 255.0 ECU_ADDRESS 0x40001ED4 /end MEASUREMENT
/begin MEASUREMENT EST2_HiCur_Count "var comments" UBYTE udf_CM_15667 0 0.0 0.0 255.0 ECU_ADDRESS 0x40001ED5 /end MEASUREMENT
/begin MEASUREMENT SeqSparkEnb "var comments" UBYTE udf_CM_17921 0 0.0 0.0 255.0 ECU_ADDRESS 0x40002BEF /end MEASUREMENT
/begin MEASUREMENT CIDSuccCount "var comments" UWORD udf_CM_15660 0 0.0 0.0 65535.0 ECU_ADDRESS 0x40002BF0 /end MEASUREMENT
/begin MEASUREMENT MAPExpAltCmpd "var comments" UWORD udf_CM_17123 0 0.0 0.0 255.99609375 ECU_ADDRESS 0x40002C3E /end MEASUREMENT
/begin MEASUREMENT CLT_DefaultInUse "var comments" UBYTE udf_CM_16689 0 0.0 0.0 255.0 DISPLAY_IDENTIFIER CLT_DefaultInUse[0] ECU_ADDRESS 0x40002C02 /end MEASUREMENT
/begin MEASUREMENT CLT_DefaultInUse2 "var comments" UBYTE udf_CM_16689 0 0.0 0.0 255.0 DISPLAY_IDENTIFIER CLT_DefaultInUse[1] ECU_ADDRESS 0x40002C03 /end MEASUREMENT
/begin MEASUREMENT CLT_DefaultInUse3 "var comments" UBYTE udf_CM_16689 0 0.0 0.0 255.0 DISPLAY_IDENTIFIER CLT_DefaultInUse[2] ECU_ADDRESS 0x40002C04 /end MEASUREMENT
/begin MEASUREMENT CLT_DefaultInUse4 "var comments" UBYTE udf_CM_16689 0 0.0 0.0 255.0 DISPLAY_IDENTIFIER CLT_DefaultInUse[3] ECU_ADDRESS 0x40002C05 /end MEASUREMENT
/begin MEASUREMENT CLT_DefaultInUse5 "var comments" UBYTE udf_CM_16689 0 0.0 0.0 255.0 DISPLAY_IDENTIFIER CLT_DefaultInUse[4] ECU_ADDRESS 0x40002C06 /end MEASUREMENT
/begin MEASUREMENT CLT_DefaultInUse6 "var comments" UBYTE udf_CM_16689 0 0.0 0.0 255.0 DISPLAY_IDENTIFIER CLT_DefaultInUse[5] ECU_ADDRESS 0x40002C07 /end MEASUREMENT
/begin MEASUREMENT IntakeAirTemp "var comments" SWORD udf_CM_17053 0 0.0 -256.0 255.9921875 ECU_ADDRESS 0x40002C18 /end MEASUREMENT
/begin MEASUREMENT IATDfltUsed "var comments" UBYTE udf_CM_16689 0 0.0 0.0 255.0 ECU_ADDRESS 0x40002C1E /end MEASUREMENT
/begin MEASUREMENT IntkAirTempFilt "var comments" SWORD udf_CM_17060 0 0.0 -256.0 255.9921875 ECU_ADDRESS 0x40002C1A /end MEASUREMENT
/begin MEASUREMENT IATStartup "var comments" SWORD udf_CM_16766 0 0.0 -256.0 255.9921875 ECU_ADDRESS 0x40002C1C /end MEASUREMENT
/begin MEASUREMENT IGNVolt "var comments" UWORD udf_CM_16913 0 0.0 0.0 31.99951171875 ECU_ADDRESS 0x40002C22 /end MEASUREMENT
/begin MEASUREMENT IGNVoltFilt "var comments" UWORD udf_CM_16927 0 0.0 0.0 31.99951171875 ECU_ADDRESS 0x40002C20 /end MEASUREMENT
/begin MEASUREMENT BattLvl "var comments" UWORD udf_CM_18726 0 0.0 0.0 199.9969482421875 ECU_ADDRESS 0x40002C2C /end MEASUREMENT
/begin MEASUREMENT IGNOff "var comments" UBYTE udf_CM_16892 0 0.0 0.0 255.0 ECU_ADDRESS 0x40002C27 /end MEASUREMENT
/begin MEASUREMENT IGNRawSignal "var comments" UWORD udf_CM_16899 0 0.0 0.0 65535.0 ECU_ADDRESS 0x40002C24 /end MEASUREMENT
/begin MEASUREMENT IGNState "var comments" UBYTE udf_CM_16906 0 0.0 0.0 255.0 ECU_ADDRESS 0x40002C26 /end MEASUREMENT
/begin MEASUREMENT SystVoltPassCount "var comments" UWORD udf_CM_18299 0 0.0 0.0 65535.0 ECU_ADDRESS 0x400030F0 /end MEASUREMENT
/begin MEASUREMENT SystVoltDiagEnb "var comments" UBYTE udf_CM_18250 0 0.0 0.0 255.0 ECU_ADDRESS 0x400030E8 /end MEASUREMENT
/begin MEASUREMENT SystVoltHFailMet "var comments" UBYTE udf_CM_18264 0 0.0 0.0 255.0 ECU_ADDRESS 0x400030EA /end MEASUREMENT
/begin MEASUREMENT SystVoltHFailCount "var comments" UWORD udf_CM_18257 0 0.0 0.0 65535.0 ECU_ADDRESS 0x400030EE /end MEASUREMENT
/begin MEASUREMENT SystVoltHTestFail "var comments" UBYTE udf_CM_18271 0 0.0 0.0 255.0 ECU_ADDRESS 0x400030ED /end MEASUREMENT
/begin MEASUREMENT SystVoltLFailMet "var comments" UBYTE udf_CM_18285 0 0.0 0.0 255.0 ECU_ADDRESS 0x400030E9 /end MEASUREMENT
/begin MEASUREMENT SystVoltLFailCount "var comments" UWORD udf_CM_18278 0 0.0 0.0 65535.0 ECU_ADDRESS 0x400030F2 /end MEASUREMENT
/begin MEASUREMENT SystVoltLTestFail "var comments" UBYTE udf_CM_18292 0 0.0 0.0 255.0 ECU_ADDRESS 0x400030EC /end MEASUREMENT
/begin MEASUREMENT GENVPassCount "var comments" UWORD udf_CM_18299 0 0.0 0.0 65535.0 ECU_ADDRESS 0x0 /end MEASUREMENT
/begin MEASUREMENT GENVDiagEnb "var comments" UBYTE udf_CM_18250 0 0.0 0.0 255.0 ECU_ADDRESS 0x0 /end MEASUREMENT
/begin MEASUREMENT GENVHFailMet "var comments" UBYTE udf_CM_18264 0 0.0 0.0 255.0 ECU_ADDRESS 0x0 /end MEASUREMENT
/begin MEASUREMENT GENVHFailCount "var comments" UWORD udf_CM_18257 0 0.0 0.0 65535.0 ECU_ADDRESS 0x0 /end MEASUREMENT
/begin MEASUREMENT GENVHTestFail "var comments" UBYTE udf_CM_18271 0 0.0 0.0 255.0 ECU_ADDRESS 0x0 /end MEASUREMENT
/begin MEASUREMENT GENVLFailMet "var comments" UBYTE udf_CM_18285 0 0.0 0.0 255.0 ECU_ADDRESS 0x0 /end MEASUREMENT
/begin MEASUREMENT GENVLFailCount "var comments" UWORD udf_CM_18278 0 0.0 0.0 65535.0 ECU_ADDRESS 0x0 /end MEASUREMENT
/begin MEASUREMENT GENVLTestFail "var comments" UBYTE udf_CM_18292 0 0.0 0.0 255.0 ECU_ADDRESS 0x0 /end MEASUREMENT
/begin MEASUREMENT MAPActual "var comments" UWORD udf_CM_17081 0 0.0 0.0 255.99609375 ECU_ADDRESS 0x40002C42 /end MEASUREMENT
/begin MEASUREMENT MAPAltComp "var comments" UWORD udf_CM_17088 0 0.0 0.0 255.99609375 ECU_ADDRESS 0x40002C32 /end MEASUREMENT
/begin MEASUREMENT MAPDfltUsed "var comments" UBYTE udf_CM_17102 0 0.0 0.0 255.0 ECU_ADDRESS 0x40002BDE /end MEASUREMENT
/begin MEASUREMENT MAPEstCorr "var comments" UWORD udf_CM_17109 0 0.0 0.0 255.99609375 ECU_ADDRESS 0x40002C5E /end MEASUREMENT
/begin MEASUREMENT MAPEstimated "var comments" UWORD udf_CM_17116 0 0.0 0.0 255.99609375 ECU_ADDRESS 0x40002C50 /end MEASUREMENT
/begin MEASUREMENT MAPExpected "var comments" UWORD udf_CM_17137 0 0.0 0.0 255.99609375 ECU_ADDRESS 0x40002C44 /end MEASUREMENT
/begin MEASUREMENT MAPExpDiff "var comments" UWORD udf_CM_17130 0 0.0 0.0 255.99609375 ECU_ADDRESS 0x40002C60 /end MEASUREMENT
/begin MEASUREMENT MAPExpIncrs "var comments" UBYTE udf_CM_17144 0 0.0 0.0 255.0 ECU_ADDRESS 0x40002C34 /end MEASUREMENT
/begin MEASUREMENT MAPExpPrev "var comments" UWORD udf_CM_17151 0 0.0 0.0 255.99609375 ECU_ADDRESS 0x40002C4E /end MEASUREMENT
/begin MEASUREMENT VACExpected "var comments" UWORD udf_CM_19027 0 0.0 0.0 255.99609375 ECU_ADDRESS 0x40002C36 /end MEASUREMENT
/begin MEASUREMENT MAPFiltLow "var comments" UWORD udf_CM_17165 0 0.0 0.0 255.99609375 ECU_ADDRESS 0x40002C48 /end MEASUREMENT
/begin MEASUREMENT MAPFiltLowAvg "var comments" UWORD udf_CM_17172 0 0.0 0.0 255.99609375 ECU_ADDRESS 0x40002C4A /end MEASUREMENT
/begin MEASUREMENT MAPFiltLowDlt "var comments" UWORD udf_CM_17179 0 0.0 0.0 255.99609375 ECU_ADDRESS 0x40002C38 /end MEASUREMENT
/begin MEASUREMENT MAPFiltLowPrv "var comments" UWORD udf_CM_17186 0 0.0 0.0 255.99609375 ECU_ADDRESS 0x40002C5A /end MEASUREMENT
/begin MEASUREMENT VACActual "var comments" UWORD udf_CM_19020 0 0.0 0.0 255.99609375 ECU_ADDRESS 0x40002C58 /end MEASUREMENT
/begin MEASUREMENT BaroNorminal "var comments" UWORD udf_CM_19503 0 0.0 0.0 255.99609375 DISPLAY_IDENTIFIER VfVIOS_p_NominalBaro ECU_ADDRESS 0x0 /end MEASUREMENT
/begin MEASUREMENT MAPReadAngle "var comments" UWORD udf_CM_17193 0 0.0 0.0 1023.984375 ECU_ADDRESS 0x40002C4C /end MEASUREMENT
/begin MEASUREMENT MAPReadCmplt "var comments" UBYTE udf_CM_17207 0 0.0 0.0 255.0 ECU_ADDRESS 0x40002C3C /end MEASUREMENT
/begin MEASUREMENT MAPReadAngleDel "var comments" UWORD udf_CM_17200 0 0.0 0.0 1023.984375 ECU_ADDRESS 0x40002C46 /end MEASUREMENT
/begin MEASUREMENT MAPReadErr "var comments" UBYTE udf_CM_19335 0 0.0 0.0 255.0 DISPLAY_IDENTIFIER VbVIOS_MAPReadError ECU_ADDRESS 0x40002C3B /end MEASUREMENT
/begin MEASUREMENT MAPUnfilt "var comments" UWORD udf_CM_17291 0 0.0 0.0 255.99609375 ECU_ADDRESS 0x40002C52 /end MEASUREMENT
/begin MEASUREMENT FuelPressureRelative "var comments" SWORD udf_CM_17293 0 0.0 -256 255.9921875 ECU_ADDRESS 0x40002DBC /end MEASUREMENT
/begin MEASUREMENT FPPetrol "var comments" UWORD CM_kpa_0to1024_1 0 0.0 0.0 1023.984375 ECU_ADDRESS 0x40002DBE /end MEASUREMENT
/begin MEASUREMENT FuelPressureUnfilt "var comments" SWORD udf_CM_17293 0 0.0 -256 255.9921875 ECU_ADDRESS 0x40002DC0 /end MEASUREMENT
/begin MEASUREMENT FPGasRawSig "var comments" UWORD udf_CM_18005 0 0.0 0.0 99.99847412109375 ECU_ADDRESS 0x40002DB6 /end MEASUREMENT
/begin MEASUREMENT FPFiltCoef "var comments" UWORD CM_FiltCoef 0 0.0 0.0 0.9999847412109375 ECU_ADDRESS 0x40002DC6 /end MEASUREMENT
/begin MEASUREMENT WPInFilt "var comments" UWORD udf_CM_17292 0 0.0 0.0 15.999755859375 ECU_ADDRESS 0x0 /end MEASUREMENT
/begin MEASUREMENT WPOutFilt "var comments" UWORD udf_CM_17292 0 0.0 0.0 15.999755859375 ECU_ADDRESS 0x0 /end MEASUREMENT
/begin MEASUREMENT WPPCurrFilt "var comments" UWORD udf_CM_17294 0 0.0 0.0 511.9921875 ECU_ADDRESS 0x0 /end MEASUREMENT
/begin MEASUREMENT WPPForceClean "var comments" UBYTE udf_CM_18796 0 0.0 0.0 255.0 ECU_ADDRESS 0x0 /end MEASUREMENT
/begin MEASUREMENT O2Volt "var comments" UWORD udf_CM_17536 0 0.0 0.0 1023.984375 ECU_ADDRESS 0x40002CA6 /end MEASUREMENT
/begin MEASUREMENT O2VoltPrev "var comments" UWORD udf_CM_17543 0 0.0 0.0 1023.984375 ECU_ADDRESS 0x40002CAA /end MEASUREMENT
/begin MEASUREMENT RO2_1_Volt "var comments" UWORD udf_CM_17536 0 0.0 0.0 1023.984375 ECU_ADDRESS 0x40002CA8 /end MEASUREMENT
/begin MEASUREMENT FuelMode "var comments" UBYTE udf_CM_16528 0 0.0 0.0 255.0 ECU_ADDRESS 0x40002CB1 /end MEASUREMENT
/begin MEASUREMENT RefPeriod "var comments" UWORD udf_CM_17655 0 0.0 0.0 1023.984375 ECU_ADDRESS 0x40002D16 /end MEASUREMENT
/begin MEASUREMENT RefPulseSeen "var comments" UBYTE udf_CM_17676 0 0.0 0.0 255.0 ECU_ADDRESS 0x40002CF5 /end MEASUREMENT
/begin MEASUREMENT IACV_RefToothCount "var comments" UWORD udf_CM_19370 0 0.0 0.0 65535.0 ECU_ADDRESS 0x40002C68 /end MEASUREMENT
/begin MEASUREMENT FCV_RefToothCount "var comments" UWORD udf_CM_19370 0 0.0 0.0 65535.0 ECU_ADDRESS 0x40002C66 /end MEASUREMENT
/begin MEASUREMENT MAPExpRealUsed "var comments" UBYTE udf_CM_17158 0 0.0 0.0 255.0 ECU_ADDRESS 0x40002C40 /end MEASUREMENT
/begin MEASUREMENT EngineSpeed "var comments" UWORD udf_CM_16185 0 0.0 0.0 16383.75 ECU_ADDRESS 0x40002CE0 /end MEASUREMENT
/begin MEASUREMENT EngSpdDelta "var comments" UWORD udf_CM_16206 0 0.0 0.0 16383.75 ECU_ADDRESS 0x40002CC6 /end MEASUREMENT
/begin MEASUREMENT EngSpdSAGovDelta "var comments" UWORD udf_CM_16206 0 0.0 0.0 16383.75 ECU_ADDRESS 0x40002CC8 /end MEASUREMENT
/begin MEASUREMENT EngSpdErrF2UF "var comments" UWORD udf_CM_16213 0 0.0 0.0 16383.75 ECU_ADDRESS 0x40002CC2 /end MEASUREMENT
/begin MEASUREMENT EngSpdFilt "var comments" UWORD udf_CM_16220 0 0.0 0.0 16383.75 ECU_ADDRESS 0x40002CC0 /end MEASUREMENT
/begin MEASUREMENT EngSpdIncrs "var comments" UBYTE udf_CM_16227 0 0.0 0.0 255.0 ECU_ADDRESS 0x40002CC4 /end MEASUREMENT
/begin MEASUREMENT EngSpdState "var comments" UBYTE udf_CM_16234 0 0.0 0.0 255.0 ECU_ADDRESS 0x40002CC5 /end MEASUREMENT
/begin MEASUREMENT RunModeTran "var comments" UBYTE udf_CM_19412 0 0.0 0.0 255.0 DISPLAY_IDENTIFIER VeVIOS_RunModeTran ECU_ADDRESS 0x40002C07 /end MEASUREMENT
/begin MEASUREMENT SprkDlvMode "var comments" UBYTE udf_CM_18131 0 0.0 0.0 255.0 ECU_ADDRESS 0x40002BF4 /end MEASUREMENT
/begin MEASUREMENT VSS_DUTY "var comments" UWORD udf_CM_18726 0 0.0 0.0 199.9969482421875 DISPLAY_IDENTIFIER FI_Current_Duty[0] ECU_ADDRESS 0x40000B80 /end MEASUREMENT
/begin MEASUREMENT DIAG_DUTY "var comments" UWORD udf_CM_18726 0 0.0 0.0 199.9969482421875 DISPLAY_IDENTIFIER FI_Current_Duty[1] ECU_ADDRESS 0x40000B82 /end MEASUREMENT
/begin MEASUREMENT DCEN_DUTY "var comments" UWORD udf_CM_18726 0 0.0 0.0 199.9969482421875 DISPLAY_IDENTIFIER FI_Current_Duty[2] ECU_ADDRESS 0x40000B84 /end MEASUREMENT
/begin MEASUREMENT HDLPS "var comments" UWORD udf_CM_18726 0 0.0 0.0 199.9969482421875 ECU_ADDRESS 0x0 /end MEASUREMENT
/begin MEASUREMENT HDLPSGearLow "var comments" UBYTE udf_CM_18796 0 0.0 0.0 255.0 ECU_ADDRESS 0x0 /end MEASUREMENT
/begin MEASUREMENT TPS "var comments" UWORD udf_CM_18726 0 0.0 0.0 199.9969482421875 ECU_ADDRESS 0x40002D1E /end MEASUREMENT
/begin MEASUREMENT TPSIncreaseFlag "var comments" UBYTE udf_CM_18796 0 0.0 0.0 255.0 ECU_ADDRESS 0x40002D1C /end MEASUREMENT
/begin MEASUREMENT TPSDelta "var comments" UWORD udf_CM_18733 0 0.0 0.0 199.9969482421875 ECU_ADDRESS 0x40002D30 /end MEASUREMENT
/begin MEASUREMENT TPSIACCompstd "var comments" UWORD udf_CM_18789 0 0.0 0.0 199.9969482421875 ECU_ADDRESS 0x40002C56 /end MEASUREMENT
/begin MEASUREMENT TPSPrev "var comments" UWORD udf_CM_18831 0 0.0 0.0 199.9969482421875 ECU_ADDRESS 0x40002D28 /end MEASUREMENT
/begin MEASUREMENT TPSRawSignal "var comments" UWORD udf_CM_18838 0 0.0 0.0 65535.0 ECU_ADDRESS 0x40002D20 /end MEASUREMENT
/begin MEASUREMENT TPSDiffAE "var comments" SWORD udf_CM_18747 0 0.0 -200.0 199.993896484375 ECU_ADDRESS 0x40002D32 /end MEASUREMENT
/begin MEASUREMENT TPSFiltAE "var comments" UWORD udf_CM_18775 0 0.0 0.0 199.9969482421875 ECU_ADDRESS 0x40002D22 /end MEASUREMENT
/begin MEASUREMENT TPSDiffF2UF "var comments" SWORD udf_CM_18761 0 0.0 -200.0 199.993896484375 ECU_ADDRESS 0x40002D2C /end MEASUREMENT
/begin MEASUREMENT TPSDiffDE "var comments" SWORD udf_CM_18754 0 0.0 -200.0 199.993896484375 ECU_ADDRESS 0x40002D34 /end MEASUREMENT
/begin MEASUREMENT TPSDfltUsed "var comments" UBYTE udf_CM_18740 0 0.0 0.0 255.0 ECU_ADDRESS 0x40002D26 /end MEASUREMENT
/begin MEASUREMENT TPSFiltDE "var comments" UWORD udf_CM_18782 0 0.0 0.0 199.9969482421875 ECU_ADDRESS 0x40002D24 /end MEASUREMENT
/begin MEASUREMENT TPSFilt "var comments" UWORD udf_CM_18768 0 0.0 0.0 199.9969482421875 ECU_ADDRESS 0x40002D2A /end MEASUREMENT
/begin MEASUREMENT TPSIncrs "var comments" UBYTE udf_CM_18803 0 0.0 0.0 255.0 ECU_ADDRESS 0x40002D27 /end MEASUREMENT
/begin MEASUREMENT TPS2 "var comments" UWORD udf_CM_18726 0 0.0 0.0 199.9969482421875 ECU_ADDRESS 0x0 /end MEASUREMENT
/begin MEASUREMENT TPS2DfltUsed "var comments" UBYTE udf_CM_18740 0 0.0 0.0 255.0 ECU_ADDRESS 0x0 /end MEASUREMENT
/begin COMPU_METHOD udf_CM_15240 "Ax + B" RAT_FUNC "%4.4" "boolean" COEFFS 0 1 0 0 0 1 /end COMPU_METHOD
/begin COMPU_METHOD udf_CM_15247 "Ax + B" RAT_FUNC "%4.0" "counts" COEFFS 0 1 0 0 0 1 /end COMPU_METHOD
/begin COMPU_METHOD udf_CM_15254 "Ax + B" RAT_FUNC "%4.0" "boolean" COEFFS 0 1 0 0 0 1 /end COMPU_METHOD
/begin COMPU_METHOD udf_CM_15261 "Ax + B" RAT_FUNC "%4.4" "ratio" COEFFS 0.0 65536.00026843546 0.0 0.0 0.0 1.0 /end COMPU_METHOD
/begin COMPU_METHOD udf_CM_15268 "Ax + B" RAT_FUNC "%4.4" "gm" COEFFS 0.0 8192.000033554432 0.0 0.0 0.0 1.0 /end COMPU_METHOD
/begin COMPU_METHOD udf_CM_15275 "Ax + B" RAT_FUNC "%4.4" "ratio" COEFFS 0.0 32768.00013421773 0.0 0.0 0.0 1.0 /end COMPU_METHOD
/begin COMPU_METHOD udf_CM_15282 "Ax + B" RAT_FUNC "%4.4" "ratio" COEFFS 0.0 32768.00013421773 0.0 0.0 0.0 1.0 /end COMPU_METHOD
/begin COMPU_METHOD udf_CM_15289 "Ax + B" RAT_FUNC "%4.4" "ratio" COEFFS 0.0 32768.00013421773 0.0 0.0 0.0 1.0 /end COMPU_METHOD
/begin COMPU_METHOD udf_CM_15296 "Ax + B" RAT_FUNC "%4.4" "ratio" COEFFS 0.0 32768.00013421773 0.0 0.0 0.0 1.0 /end COMPU_METHOD
/begin COMPU_METHOD udf_CM_15303 "Ax + B" RAT_FUNC "%4.4" "ratio" COEFFS 0.0 32768.00013421773 0.0 0.0 0.0 1.0 /end COMPU_METHOD
/begin COMPU_METHOD udf_CM_15310 "Ax + B" RAT_FUNC "%4.4" "ratio" COEFFS 0.0 32768.00013421773 0.0 0.0 0.0 1.0 /end COMPU_METHOD
/begin COMPU_METHOD udf_CM_15317 "Ax + B" RAT_FUNC "%4.4" "ratio" COEFFS 0.0 32768.00013421773 0.0 0.0 0.0 1.0 /end COMPU_METHOD
/begin COMPU_METHOD udf_CM_15324 "Ax + B" RAT_FUNC "%4.4" "ratio" COEFFS 0.0 32768.00013421773 0.0 0.0 0.0 1.0 /end COMPU_METHOD
/begin COMPU_METHOD udf_CM_15331 "Ax + B" RAT_FUNC "%4.4" "ratio" COEFFS 0.0 32768.00013421773 0.0 0.0 0.0 1.0 /end COMPU_METHOD
/begin COMPU_METHOD udf_CM_15338 "Ax + B" RAT_FUNC "%4.4" "ratio" COEFFS 0.0 32768.00013421773 0.0 0.0 0.0 1.0 /end COMPU_METHOD
/begin COMPU_METHOD udf_CM_15345 "Ax + B" RAT_FUNC "%4.4" "ratio" COEFFS 0.0 32768.00013421773 0.0 0.0 0.0 1.0 /end COMPU_METHOD
/begin COMPU_METHOD udf_CM_15352 "Ax + B" RAT_FUNC "%4.4" "ratio" COEFFS 0.0 32768.00013421773 0.0 0.0 0.0 1.0 /end COMPU_METHOD
/begin COMPU_METHOD udf_CM_15359 "Ax + B" RAT_FUNC "%4.4" "ratio" COEFFS 0.0 32768.00013421773 0.0 0.0 0.0 1.0 /end COMPU_METHOD
/begin COMPU_METHOD udf_CM_15366 "Ax + B" RAT_FUNC "%4.4" "ratio" COEFFS 0.0 32768.00013421773 0.0 0.0 0.0 1.0 /end COMPU_METHOD
/begin COMPU_METHOD udf_CM_15373 "Ax + B" RAT_FUNC "%4.4" "ratio" COEFFS 0.0 32768.00013421773 0.0 0.0 0.0 1.0 /end COMPU_METHOD
/begin COMPU_METHOD udf_CM_15380 "Ax + B" RAT_FUNC "%4.4" "ratio" COEFFS 0.0 32768.00013421773 0.0 0.0 0.0 1.0 /end COMPU_METHOD
/begin COMPU_METHOD udf_CM_15387 "Ax + B" RAT_FUNC "%4.0" "count" COEFFS 0 1 0 0 0 1 /end COMPU_METHOD
/begin COMPU_METHOD udf_CM_15394 "Ax + B" RAT_FUNC "%4.4" "ratio" COEFFS 0.0 32768.00013421773 0.0 0.0 0.0 1.0 /end COMPU_METHOD
/begin COMPU_METHOD udf_CM_15401 "Ax + B" RAT_FUNC "%4.4" "kpa" COEFFS 0.0 256.0 0.0 0.0 0.0 1.0 /end COMPU_METHOD
/begin COMPU_METHOD udf_CM_15408 "Ax + B" RAT_FUNC "%4.0" "boolean" COEFFS 0 1 0 0 0 1 /end COMPU_METHOD
/begin COMPU_METHOD udf_CM_15415 "Ax + B" RAT_FUNC "%4.4" "ratio" COEFFS 0.0 32768.00013421773 0.0 0.0 0.0 1.0 /end COMPU_METHOD
/begin COMPU_METHOD udf_CM_15534 "Ax + B" RAT_FUNC "%4.4" "gm/sec" COEFFS 0.0 128.0 0.0 0.0 0.0 1.0 /end COMPU_METHOD
/begin COMPU_METHOD udf_CM_15548 "Ax + B" RAT_FUNC "%4.4" "grams" COEFFS 0.0 16384.00006710886 0.0 0.0 0.0 1.0 /end COMPU_METHOD
/begin COMPU_METHOD udf_CM_15555 "Ax + B" RAT_FUNC "%4.4" "grams" COEFFS 0.0 16384.00006710886 0.0 0.0 0.0 1.0 /end COMPU_METHOD
/begin COMPU_METHOD udf_CM_15562 "Ax + B" RAT_FUNC "%4.4" "kpa" COEFFS 0.0 256.0 0.0 0.0 0.0 1.0 /end COMPU_METHOD
/begin COMPU_METHOD udf_CM_15569 "Ax + B" RAT_FUNC "%4.4" "kpa" COEFFS 0.0 256.0 0.0 0.0 0.0 1.0 /end COMPU_METHOD
/begin COMPU_METHOD udf_CM_15576 "Ax + B" RAT_FUNC "%4.0" "boolean" COEFFS 0 1 0 0 0 1 /end COMPU_METHOD
/begin COMPU_METHOD udf_CM_15583 "Ax + B" RAT_FUNC "%4.0" "None" COEFFS 0 1 0 0 0 1 /end COMPU_METHOD
/begin COMPU_METHOD udf_CM_15653 "Ax + B" RAT_FUNC "%4.0" "counts" COEFFS 0 1 0 0 0 1 /end COMPU_METHOD
/begin COMPU_METHOD udf_CM_15660 "Ax + B" RAT_FUNC "%4.0" "counts" COEFFS 0 1 0 0 0 1 /end COMPU_METHOD
/begin COMPU_METHOD udf_CM_15667 "Ax + B" RAT_FUNC "%4.0" "None" COEFFS 0 1 0 0 0 1 /end COMPU_METHOD
/begin COMPU_METHOD udf_CM_15723 "Ax + B" RAT_FUNC "%4.0" "None" COEFFS 0 1 0 0 0 1 /end COMPU_METHOD
/begin COMPU_METHOD udf_CM_15744 "Ax + B" RAT_FUNC "%4.4" "degC" COEFFS 0.0 128.0 0.0 0.0 0.0 1.0 /end COMPU_METHOD
/begin COMPU_METHOD udf_CM_15751 "Ax + B" RAT_FUNC "%4.4" "degC" COEFFS 0.0 128.0 0.0 0.0 0.0 1.0 /end COMPU_METHOD
/begin COMPU_METHOD udf_CM_15758 "Ax + B" RAT_FUNC "%4.4" "degC" COEFFS 0.0 128.0 0.0 0.0 0.0 1.0 /end COMPU_METHOD
/begin COMPU_METHOD CM_Count1 "" RAT_FUNC "%3.0" "count" COEFFS 0 1 0 0 0 1 /end COMPU_METHOD
/begin COMPU_METHOD CM_KNK_HZ "" TAB_VERB "%4.0" "" COMPU_TAB_REF CM_KNK_HZ_TAB /end COMPU_METHOD
/begin COMPU_METHOD CM_KNK_GAIN "" TAB_VERB "%4.0" "" COMPU_TAB_REF CM_KNK_GAIN_TAB /end COMPU_METHOD
/begin COMPU_METHOD CM_KNK_INT "" TAB_VERB "%4.0" "" COMPU_TAB_REF CM_KNK_INT_TAB /end COMPU_METHOD
/begin COMPU_METHOD udf_CM_15947 "Ax + B" RAT_FUNC "%4.0" "boolean" COEFFS 0 1 0 0 0 1 /end COMPU_METHOD
/begin COMPU_METHOD udf_CM_15954 "Ax + B" RAT_FUNC "%4.4" "boolean" COEFFS 0 1 0 0 0 1 /end COMPU_METHOD
/begin COMPU_METHOD udf_CM_15961 "Ax + B" RAT_FUNC "%4.4" "ratio" COEFFS 0.0 65536.00026843546 0.0 0.0 0.0 1.0 /end COMPU_METHOD
/begin COMPU_METHOD udf_CM_15968 "Ax + B" RAT_FUNC "%4.4" "gm" COEFFS 0.0 8192.000033554432 0.0 0.0 0.0 1.0 /end COMPU_METHOD
/begin COMPU_METHOD udf_CM_15975 "Ax + B" RAT_FUNC "%4.4" "gm" COEFFS 0.0 65536.00026843546 0.0 0.0 0.0 1.0 /end COMPU_METHOD
/begin COMPU_METHOD udf_CM_15982 "Ax + B" RAT_FUNC "%4.4" "Gram" COEFFS 0.0 128.0 0.0 0.0 0.0 1.0 /end COMPU_METHOD
/begin COMPU_METHOD udf_CM_15989 "Ax + B" RAT_FUNC "%4.4" "percent" COEFFS 0.0 327.6800000536871 0.0 0.0 0.0 1.0 /end COMPU_METHOD
/begin COMPU_METHOD udf_CM_16185 "Ax + B" RAT_FUNC "%4.4" "rpm" COEFFS 0.0 4.0 0.0 0.0 0.0 1.0 /end COMPU_METHOD
/begin COMPU_METHOD udf_CM_16206 "Ax + B" RAT_FUNC "%4.4" "rpm" COEFFS 0.0 4.0 0.0 0.0 0.0 1.0 /end COMPU_METHOD
/begin COMPU_METHOD udf_CM_16213 "Ax + B" RAT_FUNC "%4.4" "rpm" COEFFS 0.0 4.0 0.0 0.0 0.0 1.0 /end COMPU_METHOD
/begin COMPU_METHOD udf_CM_16220 "Ax + B" RAT_FUNC "%4.4" "rpm" COEFFS 0.0 4.0 0.0 0.0 0.0 1.0 /end COMPU_METHOD
/begin COMPU_METHOD udf_CM_16227 "Ax + B" RAT_FUNC "%4.0" "none" COEFFS 0 1 0 0 0 1 /end COMPU_METHOD
/begin COMPU_METHOD udf_CM_16234 "Ax + B" RAT_FUNC "%4.0" "boolean" COEFFS 0 1 0 0 0 1 /end COMPU_METHOD
/begin COMPU_METHOD udf_CM_16269 "Ax + B" RAT_FUNC "%4.0" "boolean" COEFFS 0 1 0 0 0 1 /end COMPU_METHOD
/begin COMPU_METHOD udf_CM_16283 "Ax + B" RAT_FUNC "%4.4" "msec" COEFFS 0.0 64.0 0.0 0.0 0.0 1.0 /end COMPU_METHOD
/begin COMPU_METHOD udf_CM_16290 "Ax + B" RAT_FUNC "%4.4" "msec" COEFFS 0.0 64.0 0.0 0.0 0.0 1.0 /end COMPU_METHOD
/begin COMPU_METHOD udf_CM_16297 "Ax + B" RAT_FUNC "%4.4" "msec" COEFFS 0.0 64.0 0.0 0.0 0.0 1.0 /end COMPU_METHOD
/begin COMPU_METHOD udf_CM_16304 "Ax + B" RAT_FUNC "%4.4" "msec" COEFFS 0.0 64.0 0.0 0.0 0.0 1.0 /end COMPU_METHOD
/begin COMPU_METHOD udf_CM_16311 "" TAB_VERB "%10.4" "" COMPU_TAB_REF udf_CV_19716 /end COMPU_METHOD
/begin COMPU_METHOD udf_CM_16325 "Ax + B" RAT_FUNC "%4.4" "millivolt" COEFFS 0.0 64.0 0.0 0.0 0.0 1.0 /end COMPU_METHOD
/begin COMPU_METHOD udf_CM_16332 "" TAB_VERB "%10.4" "" COMPU_TAB_REF udf_CV_19722 /end COMPU_METHOD
/begin COMPU_METHOD udf_CM_16339 "Ax + B" RAT_FUNC "%4.0" "boolean" COEFFS 0 1 0 0 0 1 /end COMPU_METHOD
/begin COMPU_METHOD udf_CM_16346 "" TAB_VERB "%10.4" "" COMPU_TAB_REF udf_CV_19728 /end COMPU_METHOD
/begin COMPU_METHOD udf_CM_16353 "Ax + B" RAT_FUNC "%4.0" "boolean" COEFFS 0 1 0 0 0 1 /end COMPU_METHOD
/begin COMPU_METHOD udf_CM_16360 "Ax + B" RAT_FUNC "%4.4" "millivolt" COEFFS 0.0 64.0 0.0 0.0 0.0 1.0 /end COMPU_METHOD
/begin COMPU_METHOD udf_CM_16423 "Ax + B" RAT_FUNC "%4.0" "boolean" COEFFS 0 1 0 0 0 1 /end COMPU_METHOD
/begin COMPU_METHOD udf_CM_16444 "Ax + B" RAT_FUNC "%4.4" "grm" COEFFS 0.0 4096.0 0.0 0.0 0.0 1.0 /end COMPU_METHOD
/begin COMPU_METHOD udf_CM_16445 "Ax + B" RAT_FUNC "%4.4" "l/h" COEFFS 0.0 16.0 0.0 0.0 0.0 1.0 /end COMPU_METHOD
/begin COMPU_METHOD udf_CM_16446 "Ax + B" RAT_FUNC "%4.4" "L" COEFFS 0.0 2.0 0.0 0.0 0.0 1.0 /end COMPU_METHOD
/begin COMPU_METHOD udf_CM_16447 "Ax + B" RAT_FUNC "%7.4" "grams" COEFFS 0.0 4096.0 0.0 0.0 0.0 1.0 /end COMPU_METHOD
/begin COMPU_METHOD udf_CM_16451 "Ax + B" RAT_FUNC "%4.0" "boolean" COEFFS 0 1 0 0 0 1 /end COMPU_METHOD
/begin COMPU_METHOD udf_CM_16458 "Ax + B" RAT_FUNC "%4.0" "None" COEFFS 0 1 0 0 0 1 /end COMPU_METHOD
/begin COMPU_METHOD udf_CM_16465 "Ax + B" RAT_FUNC "%4.4" "angle" COEFFS 0.0 64.0 0.0 0.0 0.0 1.0 /end COMPU_METHOD
/begin COMPU_METHOD udf_CM_16472 "Ax + B" RAT_FUNC "%4.4" "angle" COEFFS 0.0 64.0 0.0 0.0 0.0 1.0 /end COMPU_METHOD
/begin COMPU_METHOD udf_CM_16479 "Ax + B" RAT_FUNC "%4.4" "angle" COEFFS 0.0 64.0 0.0 0.0 0.0 1.0 /end COMPU_METHOD
/begin COMPU_METHOD udf_CM_16486 "Ax + B" RAT_FUNC "%4.0" "boolean" COEFFS 0 1 0 0 0 1 /end COMPU_METHOD
/begin COMPU_METHOD udf_CM_16493 "Ax + B" RAT_FUNC "%4.0" "boolean" COEFFS 0 1 0 0 0 1 /end COMPU_METHOD
/begin COMPU_METHOD udf_CM_16507 "Ax + B" RAT_FUNC "%4.4" "msec" COEFFS 0.0 64.0 0.0 0.0 0.0 1.0 /end COMPU_METHOD
/begin COMPU_METHOD udf_CM_16528 "Ax + B" RAT_FUNC "%4.0" "None" COEFFS 0 1 0 0 0 1 /end COMPU_METHOD
/begin COMPU_METHOD udf_CM_16598 "Ax + B" RAT_FUNC "%4.4" "percent" COEFFS 0.0 327.6800000536871 0.0 0.0 0.0 1.0 /end COMPU_METHOD
/begin COMPU_METHOD udf_CM_16605 "Ax + B" RAT_FUNC "%4.0" "None" COEFFS 0 1 0 0 0 1 /end COMPU_METHOD
/begin COMPU_METHOD udf_CM_16612 "Ax + B" RAT_FUNC "%4.0" "None" COEFFS 0 1 0 0 0 1 /end COMPU_METHOD
/begin COMPU_METHOD udf_CM_16619 "Ax + B" RAT_FUNC "%4.0" "None" COEFFS 0 1 0 0 0 1 /end COMPU_METHOD
/begin COMPU_METHOD udf_CM_16626 "Ax + B" RAT_FUNC "%4.4" "ratio" COEFFS 0.0 32768.00013421773 0.0 0.0 0.0 1.0 /end COMPU_METHOD
/begin COMPU_METHOD udf_CM_16627 "Ax + B" RAT_FUNC "%4.4" "ratio" COEFFS 0.0 16384 0.0 0.0 0.0 1.0 /end COMPU_METHOD
/begin COMPU_METHOD udf_CM_16640 "Ax + B" RAT_FUNC "%4.0" "IAC_Mode" COEFFS 0 1 0 0 0 1 /end COMPU_METHOD
/begin COMPU_METHOD udf_CM_16647 "Ax + B" RAT_FUNC "%4.0" "boolean" COEFFS 0 1 0 0 0 1 /end COMPU_METHOD
/begin COMPU_METHOD udf_CM_16654 "Ax + B" RAT_FUNC "%4.0" "boolean" COEFFS 0 1 0 0 0 1 /end COMPU_METHOD
/begin COMPU_METHOD udf_CM_16661 "" TAB_VERB "%10.4" "" COMPU_TAB_REF udf_CV_19734 /end COMPU_METHOD
/begin COMPU_METHOD udf_CM_16668 "" TAB_VERB "%10.4" "" COMPU_TAB_REF udf_CV_19740 /end COMPU_METHOD
/begin COMPU_METHOD udf_CM_16675 "Ax + B" RAT_FUNC "%4.0" "boolean" COEFFS 0 1 0 0 0 1 /end COMPU_METHOD
/begin COMPU_METHOD udf_CM_16682 "Ax + B" RAT_FUNC "%4.0" "boolean" COEFFS 0 1 0 0 0 1 /end COMPU_METHOD
/begin COMPU_METHOD udf_CM_16689 "Ax + B" RAT_FUNC "%4.0" "boolean" COEFFS 0 1 0 0 0 1 /end COMPU_METHOD
/begin COMPU_METHOD udf_CM_16703 "Ax + B" RAT_FUNC "%4.0" "Counts" COEFFS 0 1 0 0 0 1 /end COMPU_METHOD
/begin COMPU_METHOD udf_CM_16710 "Ax + B" RAT_FUNC "%4.0" "None" COEFFS 0 1 0 0 0 1 /end COMPU_METHOD
/begin COMPU_METHOD udf_CM_16717 "Ax + B" RAT_FUNC "%4.0" "Counts" COEFFS 0 1 0 0 0 1 /end COMPU_METHOD
/begin COMPU_METHOD udf_CM_16724 "Ax + B" RAT_FUNC "%4.0" "None" COEFFS 0 1 0 0 0 1 /end COMPU_METHOD
/begin COMPU_METHOD udf_CM_16731 "Ax + B" RAT_FUNC "%4.0" "None" COEFFS 0 1 0 0 0 1 /end COMPU_METHOD
/begin COMPU_METHOD udf_CM_16738 "Ax + B" RAT_FUNC "%4.0" "Counts" COEFFS 0 1 0 0 0 1 /end COMPU_METHOD
/begin COMPU_METHOD udf_CM_16745 "Ax + B" RAT_FUNC "%4.0" "None" COEFFS 0 1 0 0 0 1 /end COMPU_METHOD
/begin COMPU_METHOD udf_CM_16752 "Ax + B" RAT_FUNC "%4.0" "Counts" COEFFS 0 1 0 0 0 1 /end COMPU_METHOD
/begin COMPU_METHOD udf_CM_16759 "Ax + B" RAT_FUNC "%4.0" "None" COEFFS 0 1 0 0 0 1 /end COMPU_METHOD
/begin COMPU_METHOD udf_CM_16766 "Ax + B" RAT_FUNC "%4.4" "degC" COEFFS 0.0 128.0 0.0 0.0 0.0 1.0 /end COMPU_METHOD
/begin COMPU_METHOD udf_CM_16773 "Ax + B" RAT_FUNC "%4.4" "percent" COEFFS 0.0 163.84 0.0 0.0 0.0 1.0 /end COMPU_METHOD
/begin COMPU_METHOD udf_CM_16780 "Ax + B" RAT_FUNC "%4.4" "rpm" COEFFS 0.0 4.0 0.0 0.0 0.0 1.0 /end COMPU_METHOD
/begin COMPU_METHOD udf_CM_16801 "Ax + B" RAT_FUNC "%4.4" "rpm" COEFFS 0.0 4.0 0.0 0.0 0.0 1.0 /end COMPU_METHOD
/begin COMPU_METHOD udf_CM_16808 "Ax + B" RAT_FUNC "%4.4" "percent" COEFFS 0.0 327.6800000536871 0.0 0.0 0.0 1.0 /end COMPU_METHOD
/begin COMPU_METHOD udf_CM_16815 "Ax + B" RAT_FUNC "%4.0" "boolean" COEFFS 0 1 0 0 0 1 /end COMPU_METHOD
/begin COMPU_METHOD udf_CM_16822 "Ax + B" RAT_FUNC "%4.0" "boolean" COEFFS 0 1 0 0 0 1 /end COMPU_METHOD
/begin COMPU_METHOD udf_CM_16829 "Ax + B" RAT_FUNC "%4.0" "count" COEFFS 0 1 0 0 0 1 /end COMPU_METHOD
/begin COMPU_METHOD udf_CM_16836 "Ax + B" RAT_FUNC "%4.4" "percent" COEFFS 0.0 327.6800000536871 0.0 0.0 0.0 1.0 /end COMPU_METHOD
/begin COMPU_METHOD udf_CM_16843 "Ax + B" RAT_FUNC "%4.4" "rpm" COEFFS 0.0 4.0 0.0 0.0 0.0 1.0 /end COMPU_METHOD
/begin COMPU_METHOD udf_CM_16850 "Ax + B" RAT_FUNC "%4.0" "boolean" COEFFS 0 1 0 0 0 1 /end COMPU_METHOD
/begin COMPU_METHOD udf_CM_16857 "Ax + B" RAT_FUNC "%4.0" "boolean" COEFFS 0 1 0 0 0 1 /end COMPU_METHOD
/begin COMPU_METHOD udf_CM_16864 "Ax + B" RAT_FUNC "%4.4" "percent" COEFFS 0.0 327.6800000536871 0.0 0.0 0.0 1.0 /end COMPU_METHOD
/begin COMPU_METHOD udf_CM_16871 "Ax + B" RAT_FUNC "%4.4" "percent" COEFFS 0.0 327.6800000536871 0.0 0.0 0.0 1.0 /end COMPU_METHOD
/begin COMPU_METHOD udf_CM_16885 "Ax + B" RAT_FUNC "%4.4" "percent" COEFFS 0.0 163.84 0.0 0.0 0.0 1.0 /end COMPU_METHOD
/begin COMPU_METHOD udf_CM_16892 "Ax + B" RAT_FUNC "%4.0" "boolean" COEFFS 0 1 0 0 0 1 /end COMPU_METHOD
/begin COMPU_METHOD udf_CM_16899 "Ax + B" RAT_FUNC "%4.4" "counts" COEFFS 0 1 0 0 0 1 /end COMPU_METHOD
/begin COMPU_METHOD udf_CM_16906 "Ax + B" RAT_FUNC "%4.0" "boolean" COEFFS 0 1 0 0 0 1 /end COMPU_METHOD
/begin COMPU_METHOD udf_CM_16913 "Ax + B" RAT_FUNC "%4.4" "volt" COEFFS 0.0 2048.0 0.0 0.0 0.0 1.0 /end COMPU_METHOD
/begin COMPU_METHOD udf_CM_16927 "Ax + B" RAT_FUNC "%4.4" "volt" COEFFS 0.0 2048.0 0.0 0.0 0.0 1.0 /end COMPU_METHOD
/begin COMPU_METHOD udf_CM_16928 "Ax + B" RAT_FUNC "%4.4" "volt" COEFFS 0.0 64.0 0.0 0.0 0.0 1.0 /end COMPU_METHOD
/begin COMPU_METHOD udf_CM_16941 "Ax + B" RAT_FUNC "%4.0" "Counts" COEFFS 0 1 0 0 0 1 /end COMPU_METHOD
/begin COMPU_METHOD udf_CM_16962 "Ax + B" RAT_FUNC "%4.0" "None" COEFFS 0 1 0 0 0 1 /end COMPU_METHOD
/begin COMPU_METHOD udf_CM_16969 "Ax + B" RAT_FUNC "%4.0" "Counts" COEFFS 0 1 0 0 0 1 /end COMPU_METHOD
/begin COMPU_METHOD udf_CM_16976 "Ax + B" RAT_FUNC "%4.0" "None" COEFFS 0 1 0 0 0 1 /end COMPU_METHOD
/begin COMPU_METHOD udf_CM_16983 "Ax + B" RAT_FUNC "%4.0" "None" COEFFS 0 1 0 0 0 1 /end COMPU_METHOD
/begin COMPU_METHOD udf_CM_17046 "Ax + B" RAT_FUNC "%4.4" "msec" COEFFS 0.0 64.0 0.0 0.0 0.0 1.0 /end COMPU_METHOD
/begin COMPU_METHOD udf_CM_17053 "Ax + B" RAT_FUNC "%4.4" "degC" COEFFS 0.0 128.0 0.0 0.0 0.0 1.0 /end COMPU_METHOD
/begin COMPU_METHOD udf_CM_17060 "Ax + B" RAT_FUNC "%4.4" "degC" COEFFS 0.0 128.0 0.0 0.0 0.0 1.0 /end COMPU_METHOD
/begin COMPU_METHOD udf_CM_17074 "Ax + B" RAT_FUNC "%4.0" "None" COEFFS 0 1 0 0 0 1 /end COMPU_METHOD
/begin COMPU_METHOD udf_CM_17081 "Ax + B" RAT_FUNC "%4.4" "kpa" COEFFS 0.0 256.0 0.0 0.0 0.0 1.0 /end COMPU_METHOD
/begin COMPU_METHOD udf_CM_17088 "Ax + B" RAT_FUNC "%4.4" "kpa" COEFFS 0.0 256.0 0.0 0.0 0.0 1.0 /end COMPU_METHOD
/begin COMPU_METHOD udf_CM_17102 "Ax + B" RAT_FUNC "%4.0" "boolean" COEFFS 0 1 0 0 0 1 /end COMPU_METHOD
/begin COMPU_METHOD udf_CM_17109 "Ax + B" RAT_FUNC "%4.4" "kpa" COEFFS 0.0 256.0 0.0 0.0 0.0 1.0 /end COMPU_METHOD
/begin COMPU_METHOD udf_CM_17116 "Ax + B" RAT_FUNC "%4.4" "kpa" COEFFS 0.0 256.0 0.0 0.0 0.0 1.0 /end COMPU_METHOD
/begin COMPU_METHOD udf_CM_17123 "Ax + B" RAT_FUNC "%4.4" "kpa" COEFFS 0.0 256.0 0.0 0.0 0.0 1.0 /end COMPU_METHOD
/begin COMPU_METHOD udf_CM_17130 "Ax + B" RAT_FUNC "%4.4" "kpa" COEFFS 0.0 256.0 0.0 0.0 0.0 1.0 /end COMPU_METHOD
/begin COMPU_METHOD udf_CM_17137 "Ax + B" RAT_FUNC "%4.4" "kpa" COEFFS 0.0 256.0 0.0 0.0 0.0 1.0 /end COMPU_METHOD
/begin COMPU_METHOD udf_CM_17144 "Ax + B" RAT_FUNC "%4.0" "boolean" COEFFS 0 1 0 0 0 1 /end COMPU_METHOD
/begin COMPU_METHOD udf_CM_17151 "Ax + B" RAT_FUNC "%4.4" "kpa" COEFFS 0.0 256.0 0.0 0.0 0.0 1.0 /end COMPU_METHOD
/begin COMPU_METHOD udf_CM_17158 "Ax + B" RAT_FUNC "%4.0" "boolean" COEFFS 0 1 0 0 0 1 /end COMPU_METHOD
/begin COMPU_METHOD udf_CM_17165 "Ax + B" RAT_FUNC "%4.4" "kpa" COEFFS 0.0 256.0 0.0 0.0 0.0 1.0 /end COMPU_METHOD
/begin COMPU_METHOD udf_CM_17172 "Ax + B" RAT_FUNC "%4.4" "kpa" COEFFS 0.0 256.0 0.0 0.0 0.0 1.0 /end COMPU_METHOD
/begin COMPU_METHOD udf_CM_17179 "Ax + B" RAT_FUNC "%4.4" "kpa" COEFFS 0.0 256.0 0.0 0.0 0.0 1.0 /end COMPU_METHOD
/begin COMPU_METHOD udf_CM_17186 "Ax + B" RAT_FUNC "%4.4" "kpa" COEFFS 0.0 256.0 0.0 0.0 0.0 1.0 /end COMPU_METHOD
/begin COMPU_METHOD udf_CM_17193 "Ax + B" RAT_FUNC "%4.4" "angle" COEFFS 0.0 64.0 0.0 0.0 0.0 1.0 /end COMPU_METHOD
/begin COMPU_METHOD udf_CM_17200 "Ax + B" RAT_FUNC "%4.4" "angle" COEFFS 0.0 64.0 0.0 0.0 0.0 1.0 /end COMPU_METHOD
/begin COMPU_METHOD udf_CM_17207 "Ax + B" RAT_FUNC "%4.0" "boolean" COEFFS 0 1 0 0 0 1 /end COMPU_METHOD
/begin COMPU_METHOD udf_CM_17214 "Ax + B" RAT_FUNC "%4.0" "None" COEFFS 0 1 0 0 0 1 /end COMPU_METHOD
/begin COMPU_METHOD udf_CM_17221 "Ax + B" RAT_FUNC "%4.0" "Counts" COEFFS 0 1 0 0 0 1 /end COMPU_METHOD
/begin COMPU_METHOD udf_CM_17228 "Ax + B" RAT_FUNC "%4.0" "None" COEFFS 0 1 0 0 0 1 /end COMPU_METHOD
/begin COMPU_METHOD udf_CM_17242 "Ax + B" RAT_FUNC "%4.0" "Counts" COEFFS 0 1 0 0 0 1 /end COMPU_METHOD
/begin COMPU_METHOD udf_CM_17249 "Ax + B" RAT_FUNC "%4.0" "None" COEFFS 0 1 0 0 0 1 /end COMPU_METHOD
/begin COMPU_METHOD udf_CM_17263 "Ax + B" RAT_FUNC "%4.0" "Counts" COEFFS 0 1 0 0 0 1 /end COMPU_METHOD
/begin COMPU_METHOD udf_CM_17270 "Ax + B" RAT_FUNC "%4.0" "None" COEFFS 0 1 0 0 0 1 /end COMPU_METHOD
/begin COMPU_METHOD udf_CM_17277 "Ax + B" RAT_FUNC "%4.0" "Counts" COEFFS 0 1 0 0 0 1 /end COMPU_METHOD
/begin COMPU_METHOD udf_CM_17284 "Ax + B" RAT_FUNC "%4.0" "None" COEFFS 0 1 0 0 0 1 /end COMPU_METHOD
/begin COMPU_METHOD udf_CM_17291 "Ax + B" RAT_FUNC "%4.4" "kpa" COEFFS 0.0 256.0 0.0 0.0 0.0 1.0 /end COMPU_METHOD
/begin COMPU_METHOD udf_CM_17292 "Ax + B" RAT_FUNC "%4.4" "mpa" COEFFS 0.0 4096.0 0.0 0.0 0.0 1.0 /end COMPU_METHOD
/begin COMPU_METHOD udf_CM_17293 "Ax + B" RAT_FUNC "%4.4" "kpa" COEFFS 0.0 128.0 0.0 0.0 0.0 1.0 /end COMPU_METHOD
/begin COMPU_METHOD udf_CM_17294 "Ax + B" RAT_FUNC "%4.4" "amps" COEFFS 0.0 128.0 0.0 0.0 0.0 1.0 /end COMPU_METHOD
/begin COMPU_METHOD udf_CM_17368 "Ax + B" RAT_FUNC "%4.4" "msec" COEFFS 0.0 64.0 0.0 0.0 0.0 1.0 /end COMPU_METHOD
/begin COMPU_METHOD udf_CM_17382 "Ax + B" RAT_FUNC "%4.0" "None" COEFFS 0 1 0 0 0 1 /end COMPU_METHOD
/begin COMPU_METHOD udf_CM_17389 "Ax + B" RAT_FUNC "%4.0" "Counts" COEFFS 0 1 0 0 0 1 /end COMPU_METHOD
/begin COMPU_METHOD udf_CM_17410 "Ax + B" RAT_FUNC "%4.0" "None" COEFFS 0 1 0 0 0 1 /end COMPU_METHOD
/begin COMPU_METHOD udf_CM_17417 "Ax + B" RAT_FUNC "%4.0" "Counts" COEFFS 0 1 0 0 0 1 /end COMPU_METHOD
/begin COMPU_METHOD udf_CM_17424 "Ax + B" RAT_FUNC "%4.0" "None" COEFFS 0 1 0 0 0 1 /end COMPU_METHOD
/begin COMPU_METHOD udf_CM_17431 "Ax + B" RAT_FUNC "%4.0" "None" COEFFS 0 1 0 0 0 1 /end COMPU_METHOD
/begin COMPU_METHOD udf_CM_17438 "Ax + B" RAT_FUNC "%4.4" "percent" COEFFS 0.0 327.6800000536871 0.0 0.0 0.0 1.0 /end COMPU_METHOD
/begin COMPU_METHOD udf_CM_17445 "Ax + B" RAT_FUNC "%4.0" "boolean" COEFFS 0 1 0 0 0 1 /end COMPU_METHOD
/begin COMPU_METHOD udf_CM_17452 "Ax + B" RAT_FUNC "%4.0" "boolean" COEFFS 0 1 0 0 0 1 /end COMPU_METHOD
/begin COMPU_METHOD udf_CM_17459 "Ax + B" RAT_FUNC "%4.4" "grams" COEFFS 0.0 8192.000033554432 0.0 0.0 0.0 1.0 /end COMPU_METHOD
/begin COMPU_METHOD udf_CM_17466 "Ax + B" RAT_FUNC "%4.4" "grams" COEFFS 0.0 8192.000033554432 0.0 0.0 0.0 1.0 /end COMPU_METHOD
/begin COMPU_METHOD udf_CM_17473 "Ax + B" RAT_FUNC "%4.4" "grams" COEFFS 0.0 8192.000033554432 0.0 0.0 0.0 1.0 /end COMPU_METHOD
/begin COMPU_METHOD udf_CM_17494 "Ax + B" RAT_FUNC "%4.0" "None" COEFFS 0 1 0 0 0 1 /end COMPU_METHOD
/begin COMPU_METHOD udf_CM_17501 "Ax + B" RAT_FUNC "%4.0" "counts" COEFFS 0 1 0 0 0 1 /end COMPU_METHOD
/begin COMPU_METHOD udf_CM_17508 "Ax + B" RAT_FUNC "%4.0" "None" COEFFS 0 1 0 0 0 1 /end COMPU_METHOD
/begin COMPU_METHOD udf_CM_17515 "Ax + B" RAT_FUNC "%4.0" "counts" COEFFS 0 1 0 0 0 1 /end COMPU_METHOD
/begin COMPU_METHOD udf_CM_17522 "Ax + B" RAT_FUNC "%4.0" "None" COEFFS 0 1 0 0 0 1 /end COMPU_METHOD
/begin COMPU_METHOD udf_CM_17536 "Ax + B" RAT_FUNC "%4.4" "millivolt" COEFFS 0.0 64.0 0.0 0.0 0.0 1.0 /end COMPU_METHOD
/begin COMPU_METHOD udf_CM_17543 "Ax + B" RAT_FUNC "%4.4" "millivolt" COEFFS 0.0 64.0 0.0 0.0 0.0 1.0 /end COMPU_METHOD
/begin COMPU_METHOD udf_CM_17557 "Ax + B" RAT_FUNC "%4.0" "None" COEFFS 0 1 0 0 0 1 /end COMPU_METHOD
/begin COMPU_METHOD udf_CM_17564 "Ax + B" RAT_FUNC "%4.0" "None" COEFFS 0 1 0 0 0 1 /end COMPU_METHOD
/begin COMPU_METHOD udf_CM_17592 "Ax + B" RAT_FUNC "%4.0" "" COEFFS 0 1 0 0 0 1 /end COMPU_METHOD
/begin COMPU_METHOD udf_CM_17606 "Ax + B" RAT_FUNC "%4.0" "None" COEFFS 0 1 0 0 0 1 /end COMPU_METHOD
/begin COMPU_METHOD udf_CM_17613 "Ax + B" RAT_FUNC "%4.0" "boolean" COEFFS 0 1 0 0 0 1 /end COMPU_METHOD
/begin COMPU_METHOD udf_CM_17620 "Ax + B" RAT_FUNC "%4.0" "None" COEFFS 0 1 0 0 0 1 /end COMPU_METHOD
/begin COMPU_METHOD udf_CM_17627 "Ax + B" RAT_FUNC "%4.0" "None" COEFFS 0 1 0 0 0 1 /end COMPU_METHOD
/begin COMPU_METHOD udf_CM_17634 "Ax + B" RAT_FUNC "%4.0" "None" COEFFS 0 1 0 0 0 1 /end COMPU_METHOD
/begin COMPU_METHOD udf_CM_17641 "Ax + B" RAT_FUNC "%4.4" "msec" COEFFS 0.0 64.0 0.0 0.0 0.0 1.0 /end COMPU_METHOD
/begin COMPU_METHOD udf_CM_17655 "Ax + B" RAT_FUNC "%4.4" "msec" COEFFS 0.0 64.0 0.0 0.0 0.0 1.0 /end COMPU_METHOD
/begin COMPU_METHOD udf_CM_17662 "Ax + B" RAT_FUNC "%4.0" "usec" COEFFS 0.0 1.0 0.0 0.0 0.0 1.0 /end COMPU_METHOD
/begin COMPU_METHOD udf_CM_17663 "Ax + B" RAT_FUNC "%4.4" "sec" COEFFS 0.0 1.0 0.0 0.0 0.0 1.0 /end COMPU_METHOD
/begin COMPU_METHOD udf_CM_17676 "Ax + B" RAT_FUNC "%4.0" "boolean" COEFFS 0 1 0 0 0 1 /end COMPU_METHOD
/begin COMPU_METHOD udf_CM_17683 "Ax + B" RAT_FUNC "%4.0" "None" COEFFS 0 1 0 0 0 1 /end COMPU_METHOD
/begin COMPU_METHOD udf_CM_17697 "Ax + B" RAT_FUNC "%4.0" "None" COEFFS 0 1 0 0 0 1 /end COMPU_METHOD
/begin COMPU_METHOD udf_CM_17704 "Ax + B" RAT_FUNC "%4.4" "percent" COEFFS 0.0 327.6800000536871 0.0 0.0 0.0 1.0 /end COMPU_METHOD
/begin COMPU_METHOD udf_CM_17711 "Ax + B" RAT_FUNC "%4.4" "angle" COEFFS 0.0 128.0 0.0 0.0 0.0 1.0 /end COMPU_METHOD
/begin COMPU_METHOD udf_CM_17718 "Ax + B" RAT_FUNC "%4.4" "angle" COEFFS 0.0 128.0 0.0 0.0 0.0 1.0 /end COMPU_METHOD
/begin COMPU_METHOD udf_CM_17725 "Ax + B" RAT_FUNC "%4.4" "angle" COEFFS 0.0 128.0 0.0 0.0 0.0 1.0 /end COMPU_METHOD
/begin COMPU_METHOD udf_CM_17732 "Ax + B" RAT_FUNC "%4.4" "angle" COEFFS 0.0 128.0 0.0 0.0 0.0 1.0 /end COMPU_METHOD
/begin COMPU_METHOD udf_CM_17739 "Ax + B" RAT_FUNC "%4.4" "angle" COEFFS 0.0 128.0 0.0 0.0 0.0 1.0 /end COMPU_METHOD
/begin COMPU_METHOD udf_CM_17746 "Ax + B" RAT_FUNC "%4.4" "angle" COEFFS 0.0 128.0 0.0 0.0 0.0 1.0 /end COMPU_METHOD
/begin COMPU_METHOD udf_CM_17767 "Ax + B" RAT_FUNC "%4.4" "angle" COEFFS 0.0 128.0 0.0 0.0 0.0 1.0 /end COMPU_METHOD
/begin COMPU_METHOD udf_CM_17781 "Ax + B" RAT_FUNC "%4.4" "angle" COEFFS 0.0 128.0 0.0 0.0 0.0 1.0 /end COMPU_METHOD
/begin COMPU_METHOD udf_CM_17788 "Hex No Scale" RAT_FUNC "%4.4" "none" COEFFS 0 1 0 0 0 1 /end COMPU_METHOD
/begin COMPU_METHOD udf_CM_17816 "Ax + B" RAT_FUNC "%4.0" "None" COEFFS 0 1 0 0 0 1 /end COMPU_METHOD
/begin COMPU_METHOD udf_CM_17837 "Ax + B" RAT_FUNC "%4.4" "none" COEFFS 0 1 0 0 0 1 /end COMPU_METHOD
/begin COMPU_METHOD udf_CM_17921 "Ax + B" RAT_FUNC "%4.0" "boolean" COEFFS 0 1 0 0 0 1 /end COMPU_METHOD
/begin COMPU_METHOD udf_CM_17963 "Ax + B" RAT_FUNC "%4.0" "None" COEFFS 0 1 0 0 0 1 /end COMPU_METHOD
/begin COMPU_METHOD udf_CM_17991 "Ax + B" RAT_FUNC "%4.4" "msec" COEFFS 0.0 64.0 0.0 0.0 0.0 1.0 /end COMPU_METHOD
/begin COMPU_METHOD udf_CM_17998 "Ax + B" RAT_FUNC "%4.0" "None" COEFFS 0 1 0 0 0 1 /end COMPU_METHOD
/begin COMPU_METHOD udf_CM_18005 "Ax + B" RAT_FUNC "%4.4" "percent" COEFFS 0.0 655.3600001073743 0.0 0.0 0.0 1.0 /end COMPU_METHOD
/begin COMPU_METHOD udf_CM_18012 "Ax + B" RAT_FUNC "%4.0" "count" COEFFS 0 1 0 0 0 1 /end COMPU_METHOD
/begin COMPU_METHOD udf_CM_18033 "Ax + B" RAT_FUNC "%4.0" "None" COEFFS 0 1 0 0 0 1 /end COMPU_METHOD
/begin COMPU_METHOD udf_CM_18040 "Ax + B" RAT_FUNC "%4.0" "None" COEFFS 0 1 0 0 0 1 /end COMPU_METHOD
/begin COMPU_METHOD udf_CM_18075 "Ax + B" RAT_FUNC "%4.0" "None" COEFFS 0 1 0 0 0 1 /end COMPU_METHOD
/begin COMPU_METHOD udf_CM_18082 "Ax + B" RAT_FUNC "%4.0" "Counts" COEFFS 0 1 0 0 0 1 /end COMPU_METHOD
/begin COMPU_METHOD udf_CM_18089 "Ax + B" RAT_FUNC "%4.0" "None" COEFFS 0 1 0 0 0 1 /end COMPU_METHOD
/begin COMPU_METHOD udf_CM_18096 "Ax + B" RAT_FUNC "%4.0" "None" COEFFS 0 1 0 0 0 1 /end COMPU_METHOD
/begin COMPU_METHOD udf_CM_18103 "Ax + B" RAT_FUNC "%4.0" "None" COEFFS 0 1 0 0 0 1 /end COMPU_METHOD
/begin COMPU_METHOD udf_CM_18110 "Ax + B" RAT_FUNC "%4.0" "Counts" COEFFS 0 1 0 0 0 1 /end COMPU_METHOD
/begin COMPU_METHOD udf_CM_18117 "Ax + B" RAT_FUNC "%4.0" "None" COEFFS 0 1 0 0 0 1 /end COMPU_METHOD
/begin COMPU_METHOD udf_CM_18124 "Ax + B" RAT_FUNC "%4.0" "None" COEFFS 0 1 0 0 0 1 /end COMPU_METHOD
/begin COMPU_METHOD udf_CM_18131 "Ax + B" RAT_FUNC "%4.0" "None" COEFFS 0 1 0 0 0 1 /end COMPU_METHOD
/begin COMPU_METHOD udf_CM_18138 "Ax + B" RAT_FUNC "%4.0" "None" COEFFS 0 1 0 0 0 1 /end COMPU_METHOD
/begin COMPU_METHOD udf_CM_18159 "Ax + B" RAT_FUNC "%4.0" "counts" COEFFS 0 1 0 0 0 1 /end COMPU_METHOD
/begin COMPU_METHOD udf_CM_18166 "Ax + B" RAT_FUNC "%4.0" "counts" COEFFS 0 1 0 0 0 1 /end COMPU_METHOD
/begin COMPU_METHOD udf_CM_18173 "Ax + B" RAT_FUNC "%4.0" "counts" COEFFS 0 1 0 0 0 1 /end COMPU_METHOD
/begin COMPU_METHOD udf_CM_18180 "Ax + B" RAT_FUNC "%4.4" "percent" COEFFS 0.0 327.6800000536871 0.0 0.0 0.0 1.0 /end COMPU_METHOD
/begin COMPU_METHOD udf_CM_18187 "Ax + B" RAT_FUNC "%4.0" "None" COEFFS 0 1 0 0 0 1 /end COMPU_METHOD
/begin COMPU_METHOD udf_CM_18194 "Ax + B" RAT_FUNC "%4.0" "Counts" COEFFS 0 1 0 0 0 1 /end COMPU_METHOD
/begin COMPU_METHOD udf_CM_18201 "Ax + B" RAT_FUNC "%4.0" "None" COEFFS 0 1 0 0 0 1 /end COMPU_METHOD
/begin COMPU_METHOD udf_CM_18208 "Ax + B" RAT_FUNC "%4.0" "Counts" COEFFS 0 1 0 0 0 1 /end COMPU_METHOD
/begin COMPU_METHOD udf_CM_18215 "Ax + B" RAT_FUNC "%4.0" "None" COEFFS 0 1 0 0 0 1 /end COMPU_METHOD
/begin COMPU_METHOD udf_CM_18222 "Ax + B" RAT_FUNC "%4.0" "None" COEFFS 0 1 0 0 0 1 /end COMPU_METHOD
/begin COMPU_METHOD udf_CM_18229 "Ax + B" RAT_FUNC "%4.4" "percent" COEFFS 0.0 327.6800000536871 0.0 0.0 0.0 1.0 /end COMPU_METHOD
/begin COMPU_METHOD udf_CM_18236 "Ax + B" RAT_FUNC "%4.4" "percent" COEFFS 0.0 327.6800000536871 0.0 0.0 0.0 1.0 /end COMPU_METHOD
/begin COMPU_METHOD udf_CM_18250 "Ax + B" RAT_FUNC "%4.0" "None" COEFFS 0 1 0 0 0 1 /end COMPU_METHOD
/begin COMPU_METHOD udf_CM_18257 "Ax + B" RAT_FUNC "%4.0" "Counts" COEFFS 0 1 0 0 0 1 /end COMPU_METHOD
/begin COMPU_METHOD udf_CM_18264 "Ax + B" RAT_FUNC "%4.0" "None" COEFFS 0 1 0 0 0 1 /end COMPU_METHOD
/begin COMPU_METHOD udf_CM_18271 "Ax + B" RAT_FUNC "%4.0" "None" COEFFS 0 1 0 0 0 1 /end COMPU_METHOD
/begin COMPU_METHOD udf_CM_18278 "Ax + B" RAT_FUNC "%4.0" "Counts" COEFFS 0 1 0 0 0 1 /end COMPU_METHOD
/begin COMPU_METHOD udf_CM_18285 "Ax + B" RAT_FUNC "%4.0" "None" COEFFS 0 1 0 0 0 1 /end COMPU_METHOD
/begin COMPU_METHOD udf_CM_18292 "Ax + B" RAT_FUNC "%4.0" "None" COEFFS 0 1 0 0 0 1 /end COMPU_METHOD
/begin COMPU_METHOD udf_CM_18299 "Ax + B" RAT_FUNC "%4.0" "Couints" COEFFS 0 1 0 0 0 1 /end COMPU_METHOD
/begin COMPU_METHOD CM_EnumFaultType "" RAT_FUNC "%1.0" "enum" COEFFS 0 1 0 0 0 1 /end COMPU_METHOD
/begin COMPU_METHOD CM_FiltCoef "" RAT_FUNC "%7.6" "coef" COEFFS 0.0 65536.00026843546 0.0 0.0 0.0 1.0 /end COMPU_METHOD
/begin COMPU_METHOD CM_FactorRatio_N1to1 "" RAT_FUNC "%7.6" "ratio" COEFFS 0.0 32768.00013421773 0.0 0.0 0.0 1.0 /end COMPU_METHOD
/begin COMPU_METHOD CM_Seconds "" RAT_FUNC "%4.1" "seconds" COEFFS 0.0 2.0 0.0 0.0 0.0 1.0 /end COMPU_METHOD
/begin COMPU_METHOD CM_Ratio_0to4 "" RAT_FUNC "%6.5" "ratio" COEFFS 0.0 16384.00006710886 0.0 0.0 0.0 1.0 /end COMPU_METHOD
/begin COMPU_METHOD CM_Ratio_n512to512 "" RAT_FUNC "%7.4" "kpa" COEFFS 0.0 64.0 0.0 0.0 0.0 1.0 /end COMPU_METHOD
/begin COMPU_METHOD CM_kpa_0to1024_1 "" RAT_FUNC "%7.4" "kpa" COEFFS 0.0 64.0 0.0 0.0 0.0 1.0 /end COMPU_METHOD
/begin COMPU_METHOD CM_Second_0to64 "" RAT_FUNC "%4.2" "milliseconds" COEFFS 0.0 4.0 0.0 0.0 0.0 1.0 /end COMPU_METHOD
/begin COMPU_METHOD CM_CrankAngle_0to1024_1 "" RAT_FUNC "%7.3" "" COEFFS 0.0 64.0 0.0 0.0 0.0 1.0 /end COMPU_METHOD
/begin COMPU_METHOD CM_Volt_0to32_2 "" RAT_FUNC "%6.4" "volts" COEFFS 0.0 2048.001048576537 0.0 0.0 0.0 1.0 /end COMPU_METHOD
/begin COMPU_METHOD udf_CM_18677 "Ax + B" RAT_FUNC "%4.4" "Gram" COEFFS 0.0 128.0 0.0 0.0 0.0 1.0 /end COMPU_METHOD
/begin COMPU_METHOD udf_CM_18684 "Ax + B" RAT_FUNC "%4.4" "Gram" COEFFS 0.0 128.0 0.0 0.0 0.0 1.0 /end COMPU_METHOD
/begin COMPU_METHOD CM_CrankAngle_0to512 "" RAT_FUNC "%7.4" "degrees" COEFFS 0.0 128.0 0.0 0.0 0.0 1.0 /end COMPU_METHOD
/begin COMPU_METHOD udf_CM_18726 "Ax + B" RAT_FUNC "%4.4" "percent" COEFFS 0.0 327.6800000536871 0.0 0.0 0.0 1.0 /end COMPU_METHOD
/begin COMPU_METHOD udf_CM_18733 "Ax + B" RAT_FUNC "%4.4" "percent" COEFFS 0.0 327.6800000536871 0.0 0.0 0.0 1.0 /end COMPU_METHOD
/begin COMPU_METHOD udf_CM_18740 "Ax + B" RAT_FUNC "%4.0" "boolean" COEFFS 0 1 0 0 0 1 /end COMPU_METHOD
/begin COMPU_METHOD udf_CM_18747 "Ax + B" RAT_FUNC "%4.4" "percent" COEFFS 0.0 163.84 0.0 0.0 0.0 1.0 /end COMPU_METHOD
/begin COMPU_METHOD udf_CM_18754 "Ax + B" RAT_FUNC "%4.4" "percent" COEFFS 0.0 163.84 0.0 0.0 0.0 1.0 /end COMPU_METHOD
/begin COMPU_METHOD udf_CM_18761 "Ax + B" RAT_FUNC "%4.4" "percent" COEFFS 0.0 163.84 0.0 0.0 0.0 1.0 /end COMPU_METHOD
/begin COMPU_METHOD udf_CM_18768 "Ax + B" RAT_FUNC "%4.4" "percent" COEFFS 0.0 327.6800000536871 0.0 0.0 0.0 1.0 /end COMPU_METHOD
/begin COMPU_METHOD udf_CM_18775 "Ax + B" RAT_FUNC "%4.4" "percent" COEFFS 0.0 327.6800000536871 0.0 0.0 0.0 1.0 /end COMPU_METHOD
/begin COMPU_METHOD udf_CM_18782 "Ax + B" RAT_FUNC "%4.4" "percent" COEFFS 0.0 327.6800000536871 0.0 0.0 0.0 1.0 /end COMPU_METHOD
/begin COMPU_METHOD udf_CM_18789 "Ax + B" RAT_FUNC "%4.4" "percent" COEFFS 0.0 327.6800000536871 0.0 0.0 0.0 1.0 /end COMPU_METHOD
/begin COMPU_METHOD udf_CM_18796 "Ax + B" RAT_FUNC "%4.0" "boolean" COEFFS 0 1 0 0 0 1 /end COMPU_METHOD
/begin COMPU_METHOD udf_CM_18803 "Ax + B" RAT_FUNC "%4.0" "none" COEFFS 0 1 0 0 0 1 /end COMPU_METHOD
/begin COMPU_METHOD udf_CM_18810 "Ax + B" RAT_FUNC "%4.4" "percent" COEFFS 0.0 327.6800000536871 0.0 0.0 0.0 1.0 /end COMPU_METHOD
/begin COMPU_METHOD udf_CM_18817 "Ax + B" RAT_FUNC "%4.0" "boolean" COEFFS 0 1 0 0 0 1 /end COMPU_METHOD
/begin COMPU_METHOD udf_CM_18824 "Ax + B" RAT_FUNC "%4.0" "counts" COEFFS 0 1 0 0 0 1 /end COMPU_METHOD
/begin COMPU_METHOD udf_CM_18831 "Ax + B" RAT_FUNC "%4.4" "percent" COEFFS 0.0 327.6800000536871 0.0 0.0 0.0 1.0 /end COMPU_METHOD
/begin COMPU_METHOD udf_CM_18838 "Ax + B" RAT_FUNC "%4.0" "None" COEFFS 0 1 0 0 0 1 /end COMPU_METHOD
/begin COMPU_METHOD udf_CM_18845 "Ax + B" RAT_FUNC "%4.0" "Counts" COEFFS 0 1 0 0 0 1 /end COMPU_METHOD
/begin COMPU_METHOD udf_CM_18852 "Ax + B" RAT_FUNC "%4.0" "None" COEFFS 0 1 0 0 0 1 /end COMPU_METHOD
/begin COMPU_METHOD udf_CM_18859 "Ax + B" RAT_FUNC "%4.0" "None" COEFFS 0 1 0 0 0 1 /end COMPU_METHOD
/begin COMPU_METHOD udf_CM_18866 "Ax + B" RAT_FUNC "%4.0" "Counts" COEFFS 0 1 0 0 0 1 /end COMPU_METHOD
/begin COMPU_METHOD udf_CM_18873 "Ax + B" RAT_FUNC "%4.0" "None" COEFFS 0 1 0 0 0 1 /end COMPU_METHOD
/begin COMPU_METHOD udf_CM_18880 "Ax + B" RAT_FUNC "%4.0" "Counts" COEFFS 0 1 0 0 0 1 /end COMPU_METHOD
/begin COMPU_METHOD udf_CM_18887 "Ax + B" RAT_FUNC "%4.0" "None" COEFFS 0 1 0 0 0 1 /end COMPU_METHOD
/begin COMPU_METHOD udf_CM_18894 "Ax + B" RAT_FUNC "%4.0" "None" COEFFS 0 1 0 0 0 1 /end COMPU_METHOD
/begin COMPU_METHOD udf_CM_18901 "Ax + B" RAT_FUNC "%4.4" "percent" COEFFS 0.0 327.6800000536871 0.0 0.0 0.0 1.0 /end COMPU_METHOD
/begin COMPU_METHOD udf_CM_18908 "Ax + B" RAT_FUNC "%4.4" "gm" COEFFS 0.0 4096.0 0.0 0.0 0.0 1.0 /end COMPU_METHOD
/begin COMPU_METHOD udf_CM_19006 "" RAT_FUNC "%4.3" "second" COEFFS 0.0 32.0 0.0 0.0 0.0 1.0 /end COMPU_METHOD
/begin COMPU_METHOD udf_CM_19020 "Ax + B" RAT_FUNC "%4.4" "kpa" COEFFS 0.0 256.0 0.0 0.0 0.0 1.0 /end COMPU_METHOD
/begin COMPU_METHOD udf_CM_19027 "Ax + B" RAT_FUNC "%4.4" "kpa" COEFFS 0.0 256.0 0.0 0.0 0.0 1.0 /end COMPU_METHOD
/begin COMPU_METHOD udf_CM_19174 "Ax + B" RAT_FUNC "%4.4" "msec" COEFFS 0.0 16.0 0.0 0.0 0.0 1.0 /end COMPU_METHOD
/begin COMPU_METHOD udf_CM_19244 "Ax + B" RAT_FUNC "%4.0" "None" COEFFS 0 1 0 0 0 1 /end COMPU_METHOD
/begin COMPU_METHOD udf_CM_19335 "Ax + B" RAT_FUNC "%4.0" "boolean" COEFFS 0 1 0 0 0 1 /end COMPU_METHOD
/begin COMPU_METHOD udf_CM_19370 "Ax + B" RAT_FUNC "%4.0" "count" COEFFS 0 1 0 0 0 1 /end COMPU_METHOD
/begin COMPU_METHOD udf_CM_19377 "Ax + B" RAT_FUNC "%4.0" "Counts" COEFFS 0 1 0 0 0 1 /end COMPU_METHOD
/begin COMPU_METHOD udf_CM_19384 "Ax + B" RAT_FUNC "%4.0" "None" COEFFS 0 1 0 0 0 1 /end COMPU_METHOD
/begin COMPU_METHOD udf_CM_19398 "Ax + B" RAT_FUNC "%4.4" "percent" COEFFS 0.0 327.6800000536871 0.0 0.0 0.0 1.0 /end COMPU_METHOD
/begin COMPU_METHOD udf_CM_19412 "Ax + B" RAT_FUNC "%4.0" "None" COEFFS 0 1 0 0 0 1 /end COMPU_METHOD
/begin COMPU_METHOD udf_CM_19503 "Ax + B" RAT_FUNC "%4.4" "kpa" COEFFS 0.0 256.0 0.0 0.0 0.0 1.0 /end COMPU_METHOD
/begin COMPU_VTAB CM_KNK_HZ_TAB "" TAB_VERB 64 0 "1.22KHz" 1 "1.26KHz" 2 "1.31KHz" 3 "1.35KHz" 4 "1.40KHz" 5 "1.45KHz" 6 "1.51KHz" 7 "1.57KHz" 8 "1.63KHz" 9 "1.71KHz" 10 "1.78KHz" 11 "1.87KHz" 12 "1.96KHz" 13 "2.07KHz" 14 "2.18KHz" 15 "2.31KHz" 16 "2.46KHz" 17 "2.54KHz" 18 "2.62KHz" 19 "2.71KHz" 20 "2.81KHz" 21 "2.92KHz" 22 "3.03KHz" 23 "3.15KHz" 24 "3.28KHz" 25 "3.43KHz" 26 "3.59KHz" 27 "3.76KHz" 28 "3.95KHz" 29 "4.16KHz" 30 "4.39KHz" 31 "4.66KHz" 32 "4.95KHz" 33 "5.12KHz" 34 "5.29KHz" 35 "5.48KHz" 36 "5.68KHz" 37 "5.90KHz" 38 "6.12KHz" 39 "6.37KHz" 40 "6.64KHz" 41 "6.94KHz" 42 "7.27KHz" 43 "7.63KHz" 44 "8.02KHz" 45 "8.46KHz" 46 "8.95KHz" 47 "9.50KHz" 48 "10.12KHz" 49 "10.46KHz" 50 "10.83KHz" 51 "11.22KHz" 52 "11.65KHz" 53 "12.10KHz" 54 "12.60KHz" 55 "13.14KHz" 56 "13.72KHz" 57 "14.36KHz" 58 "15.07KHz" 59 "15.84KHz" 60 "16.71KHz" 61 "17.67KHz" 62 "18.76KHz" 63 "19.98KHz" /end COMPU_VTAB
/begin COMPU_VTAB CM_KNK_GAIN_TAB "" TAB_VERB 64 0 "2.000" 1 "1.882" 2 "1.778" 3 "1.684" 4 "1.600" 5 "1.523" 6 "1.455" 7 "1.391" 8 "1.333" 9 "1.280" 10 "1.231" 11 "1.185" 12 "1.143" 13 "1.063" 14 "1.0" 15 "0.944" 16 "0.895" 17 "0.850" 18 "0.810" 19 "0.773" 20 "0.739" 21 "0.708" 22 "0.680" 23 "0.654" 24 "0.630" 25 "0.607" 26 "0.586" 27 "0.567" 28 "0.548" 29 "0.500" 30 "0.471" 31 "0.444" 32 "0.421" 33 "0.400" 34 "0.381" 35 "0.364" 36 "0.348" 37 "0.333" 38 "0.320" 39 "0.308" 40 "0.296" 41 "0.286" 42 "0.276" 43 "0.267" 44 "0.258" 45 "0.250" 46 "0.236" 47 "0.222" 48 "0.211" 49 "0.200" 50 "0.190" 51 "0.182" 52 "0.174" 53 "0.167" 54 "0.160" 55 "0.154" 56 "0.148" 57 "0.143" 58 "0.138" 59 "0.133" 60 "0.129" 61 "0.125" 62 "0.118" 63 "0.111" /end COMPU_VTAB
/begin COMPU_VTAB CM_KNK_INT_TAB "" TAB_VERB 32 0 "40us" 1 "45us" 2 "50us" 3 "55us" 4 "60us" 5 "65us" 6 "70us" 7 "75us" 8 "80us" 9 "90us" 10 "100us" 11 "110us" 12 "120us" 13 "130us" 14 "140us" 15 "150us" 16 "160us" 17 "180us" 18 "200us" 19 "220us" 20 "240us" 21 "260us" 22 "280us" 23 "300us" 24 "320us" 25 "360us" 26 "400us" 27 "440us" 28 "480us" 29 "520us" 30 "560us" 31 "600us" /end COMPU_VTAB
/begin COMPU_TAB DFLT_LIN_TAB "" TAB_INTP 1 1 1.0 /end COMPU_TAB
/begin COMPU_VTAB udf_CV_19716 "" TAB_VERB 2 0 "LEAN" 1 "RICH" /end COMPU_VTAB
/begin COMPU_VTAB udf_CV_19722 "" TAB_VERB 2 0 "LEAN" 1 "RICH" /end COMPU_VTAB
/begin COMPU_VTAB udf_CV_19728 "" TAB_VERB 2 0 "LEAN" 1 "RICH" /end COMPU_VTAB
/begin COMPU_VTAB udf_CV_19734 "" TAB_VERB 4 0 "NotMovingSt" 1 "ThrottleCloseSt" 2 "PauseSt" 3 "ThrottleOpenSt" /end COMPU_VTAB
/begin COMPU_VTAB udf_CV_19740 "" TAB_VERB 3 0 "ThrottleStable" 1 "ThrottleOpen" 2 "ThrottleClose" /end COMPU_VTAB
/begin RECORD_LAYOUT Scalar_UL FNC_VALUES 1 ULONG COLUMN_DIR DIRECT ALIGNMENT_WORD 1 ALIGNMENT_LONG 2 /end RECORD_LAYOUT
/end MODULE
/end PROJECT
