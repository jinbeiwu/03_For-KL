ASAP2_VERSION 1 40
/begin PROJECT RS19_Prod ""
/begin HEADER "" VERSION "" /end HEADER
/begin MODULE RS19_Prod ""
/begin MOD_COMMON "" BYTE_ORDER MSB_FIRST ALIGNMENT_BYTE 1 ALIGNMENT_WORD 1 ALIGNMENT_LONG 2 ALIGNMENT_FLOAT32_IEEE 4 ALIGNMENT_FLOAT64_IEEE 8 /end MOD_COMMON
/begin CHARACTERISTIC CT_FPWCorrFactorForFPVoltGas "cal comments" CURVE 0x926E 2D_Array_UB 0.0 CM_Mult0_to_2_ratio 0.0 1.9921875
 /begin AXIS_DESCR FIX_AXIS NO_INPUT_QUANTITY CM_Equaloutput1 9 6.400000095367432 19.20000076293945 MAX_GRAD 0.0 /begin FIX_AXIS_PAR_LIST 6.4 8 9.6 11.2 12.8 14.4 16 17.6 19.2 /end FIX_AXIS_PAR_LIST /end AXIS_DESCR
/end CHARACTERISTIC
/begin CHARACTERISTIC CT_FPWCorrFactorForFuelPressure_NG "cal comments" MAP 0x927A 3D_Array_UB 0.0 CM_Mult0_to_4_ratio 0.0 3.984375
 /begin AXIS_DESCR COM_AXIS NO_INPUT_QUANTITY CM_kpa_0to256_1 9 0.0 255.99609375 AXIS_PTS_REF CA_MAP9Step1 MAX_GRAD 0.0 /end AXIS_DESCR
 /begin AXIS_DESCR COM_AXIS NO_INPUT_QUANTITY CM_kpa_n256to256_1 8 -256 255.9921875 AXIS_PTS_REF CA_MAP8Step1 MAX_GRAD 0.0 /end AXIS_DESCR
/end CHARACTERISTIC
/begin CHARACTERISTIC CT_FPWCorrFactorForFuelPressure_LPG "cal comments" MAP 0x92C5 3D_Array_UB 0.0 CM_Mult0_to_4_ratio 0.0 3.984375
 /begin AXIS_DESCR COM_AXIS NO_INPUT_QUANTITY CM_kpa_0to256_1 9 0.0 255.99609375 AXIS_PTS_REF CA_MAP9Step1 MAX_GRAD 0.0 /end AXIS_DESCR
 /begin AXIS_DESCR COM_AXIS NO_INPUT_QUANTITY CM_kpa_n256to256_1 8 -256 255.9921875 AXIS_PTS_REF CA_MAP8Step1 MAX_GRAD 0.0 /end AXIS_DESCR
/end CHARACTERISTIC
/begin CHARACTERISTIC CT_FuelCLEnbCoolTempThrsh "cal comments" CURVE 0x9870 2D_Array_SW 0.0 CM_DegC_N256to256 -256.0 255.9921875
 /begin AXIS_DESCR FIX_AXIS NO_INPUT_QUANTITY CM_Equaloutput1 17 -28.0 164.0 MAX_GRAD 0.0 /begin FIX_AXIS_PAR_LIST -28 -16 -4 8 20 32 44 56 68 80 92 104 116 128 140 152 164 /end FIX_AXIS_PAR_LIST /end AXIS_DESCR
/end CHARACTERISTIC
/begin CHARACTERISTIC CT_FuelCLIntDelayO2ErrMult "cal comments" CURVE 0x992C 2D_Array_UB 0.0 CM_Mult_0to1_2 0.0 0.99609375
 /begin AXIS_DESCR FIX_AXIS NO_INPUT_QUANTITY CM_Equaloutput1 6 0.0 347.5 MAX_GRAD 0.0 /begin FIX_AXIS_PAR_LIST 0 69.5 139 208.5 278 347.5 /end FIX_AXIS_PAR_LIST /end AXIS_DESCR
/end CHARACTERISTIC
/begin CHARACTERISTIC CT_FuelCLIntLearningDelay "cal comments" CURVE 0x9926 2D_Array_UB 0.0 CM_Second_0to4 0.0 3.984375
 /begin AXIS_DESCR COM_AXIS NO_INPUT_QUANTITY CM_RPM_0to16384 4 0.0 16383.75 AXIS_PTS_REF CA_EngSpd4Step1 MAX_GRAD 0.0 /end AXIS_DESCR
/end CHARACTERISTIC
/begin CHARACTERISTIC C_FuelEOICrank "cal comments" VALUE 0x9246 Scalar_UW 0.0 CM_CrankAngle_0to1024 0.0 1023.984375 /end CHARACTERISTIC
/begin CHARACTERISTIC CT_FuelEOIRun "cal comments" CURVE 0x924A 2D_Array_UW 0.0 CM_CrankAngle_0to1024 0.0 1023.984375
 /begin AXIS_DESCR COM_AXIS NO_INPUT_QUANTITY CM_RPM_0to16384 6 0.0 16383.75 AXIS_PTS_REF CA_EngSpd6Step2 MAX_GRAD 0.0 /end AXIS_DESCR
/end CHARACTERISTIC
/begin CHARACTERISTIC C_FuelEOITrimPulse "cal comments" VALUE 0x9A88 Scalar_UW 0.0 CM_CrankAngle_0to1024 0.0 1023.984375 /end CHARACTERISTIC
/begin CHARACTERISTIC C_TrimPulseBeforeCIDsucceed "cal comments" VALUE 0x9A8A Scalar_UB 0.0 CM_Boolean1 0.0 1.0 /end CHARACTERISTIC
/begin CHARACTERISTIC C_TrimPulseEnbTPSThresh "cal comments" VALUE 0x9A8C Scalar_UW 0.0 CM_Percent_0to200_2 0.0 199.9969024658203 /end CHARACTERISTIC
/begin CHARACTERISTIC CT_FuelO2RichLeanThreshBase "cal comments" MAP 0x98A3 3D_Array_UB 0.0 CM_mVolt 0.0 1016.0
 /begin AXIS_DESCR COM_AXIS NO_INPUT_QUANTITY CM_kpa_0to256_1 9 0.0 255.99609375 AXIS_PTS_REF CA_MAP9Step3 MAX_GRAD 0.0 /end AXIS_DESCR
 /begin AXIS_DESCR COM_AXIS NO_INPUT_QUANTITY CM_RPM_0to16384 4 0.0 16383.75 AXIS_PTS_REF CA_EngSpd4Step1 MAX_GRAD 0.0 /end AXIS_DESCR
/end CHARACTERISTIC
/begin CHARACTERISTIC CT_FuelO2RichLeanThreshBase_NG "cal comments" MAP 0x98CA 3D_Array_UB 0.0 CM_mVolt 0.0 1016.0
 /begin AXIS_DESCR COM_AXIS NO_INPUT_QUANTITY CM_kpa_0to256_1 9 0.0 255.99609375 AXIS_PTS_REF CA_MAP9Step3 MAX_GRAD 0.0 /end AXIS_DESCR
 /begin AXIS_DESCR COM_AXIS NO_INPUT_QUANTITY CM_RPM_0to16384 4 0.0 16383.75 AXIS_PTS_REF CA_EngSpd4Step1 MAX_GRAD 0.0 /end AXIS_DESCR
/end CHARACTERISTIC
/begin CHARACTERISTIC CT_FuelO2RichLeanThreshBase_LPG "cal comments" MAP 0x98F1 3D_Array_UB 0.0 CM_mVolt 0.0 1016.0
 /begin AXIS_DESCR COM_AXIS NO_INPUT_QUANTITY CM_kpa_0to256_1 9 0.0 255.99609375 AXIS_PTS_REF CA_MAP9Step3 MAX_GRAD 0.0 /end AXIS_DESCR
 /begin AXIS_DESCR COM_AXIS NO_INPUT_QUANTITY CM_RPM_0to16384 4 0.0 16383.75 AXIS_PTS_REF CA_EngSpd4Step1 MAX_GRAD 0.0 /end AXIS_DESCR
/end CHARACTERISTIC
/begin CHARACTERISTIC CT_FuelPropLeanToRich "cal comments" MAP 0x9982 3D_Array_UB 0.0 CM_Percent_0to100 0.0 99.609375
 /begin AXIS_DESCR COM_AXIS NO_INPUT_QUANTITY CM_kpa_0to256_1 9 0.0 255.99609375 AXIS_PTS_REF CA_MAP9Step3 MAX_GRAD 0.0 /end AXIS_DESCR
 /begin AXIS_DESCR COM_AXIS NO_INPUT_QUANTITY CM_RPM_0to16384 4 0.0 16383.75 AXIS_PTS_REF CA_EngSpd4Step1 MAX_GRAD 0.0 /end AXIS_DESCR
/end CHARACTERISTIC
/begin CHARACTERISTIC CT_FuelPropMinDuration "cal comments" CURVE 0x99AA 2D_Array_UB 0.0 CM_Second_0to4 0.0 3.984375
 /begin AXIS_DESCR COM_AXIS NO_INPUT_QUANTITY CM_RPM_0to16384 4 0.0 16383.75 AXIS_PTS_REF CA_EngSpd4Step1 MAX_GRAD 0.0 /end AXIS_DESCR
/end CHARACTERISTIC
/begin CHARACTERISTIC CT_FuelPropO2ErrMult "cal comments" CURVE 0x993C 2D_Array_UW 0.0 CM_FactorRatio 0.0 0.9999847412109375
 /begin AXIS_DESCR FIX_AXIS NO_INPUT_QUANTITY CM_Equaloutput1 6 0.0 347.5 MAX_GRAD 0.0 /begin FIX_AXIS_PAR_LIST 0 69.5 139 208.5 278 347.5 /end FIX_AXIS_PAR_LIST /end AXIS_DESCR
/end CHARACTERISTIC
/begin CHARACTERISTIC CT_FuelPropRichBiasHoldTimeGain "cal comments" CURVE 0x99B0 2D_Array_UB 0.0 CM_Mult0_to_2_ratio 0.0 1.9921875
 /begin AXIS_DESCR COM_AXIS NO_INPUT_QUANTITY CM_RPM_0to16384 4 0.0 16383.75 AXIS_PTS_REF CA_EngSpd4Step1 MAX_GRAD 0.0 /end AXIS_DESCR
/end CHARACTERISTIC
/begin CHARACTERISTIC CT_FuelPropRichToLean "cal comments" MAP 0x995B 3D_Array_UB 0.0 CM_Percent_0to100 0.0 99.609375
 /begin AXIS_DESCR COM_AXIS NO_INPUT_QUANTITY CM_kpa_0to256_1 9 0.0 255.99609375 AXIS_PTS_REF CA_MAP9Step3 MAX_GRAD 0.0 /end AXIS_DESCR
 /begin AXIS_DESCR COM_AXIS NO_INPUT_QUANTITY CM_RPM_0to16384 4 0.0 16383.75 AXIS_PTS_REF CA_EngSpd4Step1 MAX_GRAD 0.0 /end AXIS_DESCR
/end CHARACTERISTIC
/begin CHARACTERISTIC CT_FuelPumpDutyCycle "cal comments" CURVE 0x9224 2D_Array_UW 0.0 CM_Percent_0to200_2 0.0 199.9969024658203
 /begin AXIS_DESCR FIX_AXIS NO_INPUT_QUANTITY CM_Equaloutput1 17 6.0 18.79999923706055 MAX_GRAD 0.0
  /begin FIX_AXIS_PAR_LIST 6 6.8 7.6 8.4 9.199999999999999 10 10.8 11.6 12.4 13.2 14 14.8 15.6 16.4 17.2 18 18.8 /end FIX_AXIS_PAR_LIST
 /end AXIS_DESCR
/end CHARACTERISTIC
/begin CHARACTERISTIC CT_FuelPumpWorkTimeForPP "cal comments" CURVE 0x9180 2D_Array_UW 0.0 CM_Second_0to512 0.0 511.9921875
 /begin AXIS_DESCR FIX_AXIS NO_INPUT_QUANTITY CM_Equaloutput1 17 -28.0 164.0 MAX_GRAD 0.0 /begin FIX_AXIS_PAR_LIST -28 -16 -4 8 20 32 44 56 68 80 92 104 116 128 140 152 164 /end FIX_AXIS_PAR_LIST /end AXIS_DESCR
/end CHARACTERISTIC
/begin CHARACTERISTIC C_BLM_Enb "cal comments" VALUE 0x980A Scalar_UB 0.0 CM_Boolean4 0.0 1.0 /end CHARACTERISTIC
/begin CHARACTERISTIC C_BLM_FCV_Enb "cal comments" VALUE 0x980B Scalar_UB 0.0 CM_Boolean4 0.0 1.0 /end CHARACTERISTIC
/begin CHARACTERISTIC C_BLM_CellRst "cal comments" VALUE 0x980C Scalar_UB 0.0 CM_Boolean4 0.0 1.0 /end CHARACTERISTIC
/begin CHARACTERISTIC C_BLM_AllRst "cal comments" VALUE 0x980D Scalar_UB 0.0 CM_Boolean4 0.0 1.0 /end CHARACTERISTIC
/begin CHARACTERISTIC C_BLM_RstValue "cal comments" VALUE 0x980E Scalar_UW 0.0 CM_Ratio_0to2_2 0.0 1.999969482421875 /end CHARACTERISTIC
/begin CHARACTERISTIC C_BLM_CoolTempMin "cal comments" VALUE 0x9824 Scalar_SW 0.0 CM_DegC_N256to256 -256.0 255.9921875 /end CHARACTERISTIC
/begin CHARACTERISTIC C_BLM_CoolTempMax "cal comments" VALUE 0x9826 Scalar_SW 0.0 CM_DegC_N256to256 -256.0 255.9921875 /end CHARACTERISTIC
/begin CHARACTERISTIC C_BLM_LrnLeanThrsh "cal comments" VALUE 0x9828 Scalar_SW 0.0 CM_SignedWord_n32768to32768_2 -32768.0 32766.0 /end CHARACTERISTIC
/begin CHARACTERISTIC C_BLM_LrnRichThrsh "cal comments" VALUE 0x982A Scalar_SW 0.0 CM_SignedWord_n32768to32768_2 -32768.0 32766.0 /end CHARACTERISTIC
/begin CHARACTERISTIC C_BLM_LrnStep "cal comments" VALUE 0x982C Scalar_UW 0.0 CM_Ratio_0to2_2 0.0 1.999969482421875 /end CHARACTERISTIC
/begin CHARACTERISTIC C_BLM_LrnMax "cal comments" VALUE 0x982E Scalar_UW 0.0 CM_Ratio_0to2_2 0.0 1.999969482421875 /end CHARACTERISTIC
/begin CHARACTERISTIC C_BLM_LrnMin "cal comments" VALUE 0x9830 Scalar_UW 0.0 CM_Ratio_0to2_2 0.0 1.999969482421875 /end CHARACTERISTIC
/begin CHARACTERISTIC C_BLM_RowDiffMax "cal comments" VALUE 0x9846 Scalar_UW 0.0 CM_Ratio_0to2_2 0.0 1.999969482421875 /end CHARACTERISTIC
/begin CHARACTERISTIC CT_BLM_ColDiffMax "cal comments" CURVE 0x9848 Scalar_UW 0.0 CM_Ratio_0to2_2 0.0 1.999969482421875
 /begin AXIS_DESCR FIX_AXIS NO_INPUT_QUANTITY CM_Equaloutput1 16 0.0 16.0 MAX_GRAD 0.0 /begin FIX_AXIS_PAR_LIST 0 1 2 3 4 5 6 7 8 9 10 11 12 13 14 15 /end FIX_AXIS_PAR_LIST /end AXIS_DESCR
/end CHARACTERISTIC
/begin CHARACTERISTIC C_BLM_AirFlowMin "cal comments" VALUE 0x9810 Scalar_UW 0.0 CM_GramPerSecond_1 0.0 511.9921875 /end CHARACTERISTIC
/begin CHARACTERISTIC C_BLM_AirFlowMax "cal comments" VALUE 0x9812 Scalar_UW 0.0 CM_GramPerSecond_1 0.0 511.9921875 /end CHARACTERISTIC
/begin CHARACTERISTIC C_BLM_AirFlowHyst "cal comments" VALUE 0x9814 Scalar_UW 0.0 CM_GramPerSecond_1 0.0 511.9921875 /end CHARACTERISTIC
/begin CHARACTERISTIC C_BLM_AirFlowDelta "cal comments" VALUE 0x9816 Scalar_UW 0.0 CM_GramPerSecond_1 0.0 511.9921875 /end CHARACTERISTIC
/begin CHARACTERISTIC C_BLM_EngSpeedMin "cal comments" VALUE 0x981A Scalar_UW 0.0 CM_RPM_0to16384 0.0 16383.75 /end CHARACTERISTIC
/begin CHARACTERISTIC C_BLM_EngSpeedMax "cal comments" VALUE 0x981C Scalar_UW 0.0 CM_RPM_0to16384 0.0 16383.75 /end CHARACTERISTIC
/begin CHARACTERISTIC C_BLM_EngSpeedHyst "cal comments" VALUE 0x981E Scalar_UW 0.0 CM_RPM_0to16384 0.0 16383.75 /end CHARACTERISTIC
/begin CHARACTERISTIC C_BLM_EngSpeedDelta "cal comments" VALUE 0x9820 Scalar_UW 0.0 CM_RPM_0to16384 0.0 16383.75 /end CHARACTERISTIC
/begin CHARACTERISTIC C_BLM_AirFlowCoef "cal comments" VALUE 0x9818 Scalar_UW 0.0 CM_FiltCoef 0.0 0.9999847412109375 /end CHARACTERISTIC
/begin CHARACTERISTIC C_BLM_EngSpeedCoef "cal comments" VALUE 0x9822 Scalar_UW 0.0 CM_FiltCoef 0.0 0.9999847412109375 /end CHARACTERISTIC
/begin CHARACTERISTIC CT_BLM_LrnDelay "cal comments" CURVE 0x9834 Scalar_UW 0.0 CM_Second_0to4096 0.0 4095.9375
 /begin AXIS_DESCR FIX_AXIS NO_INPUT_QUANTITY CM_Equaloutput1 9 0 32 MAX_GRAD 0.0 /begin FIX_AXIS_PAR_LIST 0 4 8 12 16 20 24 28 32 /end FIX_AXIS_PAR_LIST /end AXIS_DESCR
/end CHARACTERISTIC
/begin CHARACTERISTIC CT_IdleAirflowColdOffset "cal comments" CURVE 0x9D72 2D_Array_UB 0.0 CM_Percent_0to100 0.0 99.609375
 /begin AXIS_DESCR FIX_AXIS NO_INPUT_QUANTITY CM_Equaloutput1 17 -28.0 164.0 MAX_GRAD 0.0 /begin FIX_AXIS_PAR_LIST -28 -16 -4 8 20 32 44 56 68 80 92 104 116 128 140 152 164 /end FIX_AXIS_PAR_LIST /end AXIS_DESCR
/end CHARACTERISTIC
/begin CHARACTERISTIC CT_IdleDerivEngSpdHigh "cal comments" CURVE 0x2 2D_Array_UB 0.0 CM_Percent_0to100 0.0 99.609375
 /begin AXIS_DESCR FIX_AXIS NO_INPUT_QUANTITY CM_Equaloutput1 17 0.0 128.0 MAX_GRAD 0.0 /begin FIX_AXIS_PAR_LIST 0 8 16 24 32 40 48 56 64 72 80 88 96 104 112 120 128 /end FIX_AXIS_PAR_LIST /end AXIS_DESCR
/end CHARACTERISTIC
/begin CHARACTERISTIC CT_IdleDerivEngSpdLow "cal comments" CURVE 0x2 2D_Array_UB 0.0 CM_Percent_0to100 0.0 99.609375
 /begin AXIS_DESCR FIX_AXIS NO_INPUT_QUANTITY CM_Equaloutput1 17 0.0 128.0 MAX_GRAD 0.0 /begin FIX_AXIS_PAR_LIST 0 8 16 24 32 40 48 56 64 72 80 88 96 104 112 120 128 /end FIX_AXIS_PAR_LIST /end AXIS_DESCR
/end CHARACTERISTIC
/begin CHARACTERISTIC C_IdleDesireSpdStartup "cal comments" VALUE 0x9CEE Scalar_UW 0.0 udf_CM_18586 0.0 16383.75 /end CHARACTERISTIC
/begin CHARACTERISTIC CT_IdleIntGainEngSpdHigh "cal comments" CURVE 0x2 2D_Array_UB 0.0 CM_Mult0_to_2_ratio1 0.0 1.9921875
 /begin AXIS_DESCR COM_AXIS NO_INPUT_QUANTITY CM_RPM_0to16384 11 0.0 16383.75 AXIS_PTS_REF CA_EngSpd11Step2 MAX_GRAD 0.0 /end AXIS_DESCR
/end CHARACTERISTIC
/begin CHARACTERISTIC CT_IdleIntGainEngSpdLow "cal comments" CURVE 0x2 2D_Array_UB 0.0 CM_Mult0_to_2_ratio1 0.0 1.9921875
 /begin AXIS_DESCR COM_AXIS NO_INPUT_QUANTITY CM_RPM_0to16384 11 0.0 16383.75 AXIS_PTS_REF CA_EngSpd11Step2 MAX_GRAD 0.0 /end AXIS_DESCR
/end CHARACTERISTIC
/begin CHARACTERISTIC CT_IdlePropEngSpdHigh "cal comments" CURVE 0x2 2D_Array_UB 0.0 CM_Percent_0to100 0.0 99.609375
 /begin AXIS_DESCR COM_AXIS NO_INPUT_QUANTITY CM_RPM_0to16384 17 0.0 16383.75 AXIS_PTS_REF CA_EngSpd17Step4 MAX_GRAD 0.0 /end AXIS_DESCR
/end CHARACTERISTIC
/begin CHARACTERISTIC CT_IdlePropEngSpdLow "cal comments" CURVE 0x2 2D_Array_UB 0.0 CM_Percent_0to100 0.0 99.609375
 /begin AXIS_DESCR COM_AXIS NO_INPUT_QUANTITY CM_RPM_0to16384 17 0.0 16383.75 AXIS_PTS_REF CA_EngSpd17Step4 MAX_GRAD 0.0 /end AXIS_DESCR
/end CHARACTERISTIC
/begin CHARACTERISTIC CT_InjectorOffset "cal comments" CURVE 0x9258 2D_Array_UB 0.0 CM_msec_0to4 0.0 3.984375
 /begin AXIS_DESCR FIX_AXIS NO_INPUT_QUANTITY CM_Equaloutput1 9 6.400000095367432 19.20000076293945 MAX_GRAD 0.0 /begin FIX_AXIS_PAR_LIST 6.4 8 9.6 11.2 12.8 14.4 16 17.6 19.2 /end FIX_AXIS_PAR_LIST /end AXIS_DESCR
/end CHARACTERISTIC
/begin CHARACTERISTIC CT_IntakeAirTemp "cal comments" CURVE 0xB548 2D_Array_SW 0.0 CM_DegC_N256to256 -256.0 255.9921875
 /begin AXIS_DESCR FIX_AXIS NO_INPUT_QUANTITY CM_Equaloutput1 33 0.0 100.0 MAX_GRAD 0.0
  /begin FIX_AXIS_PAR_LIST 0 3.125 6.25 9.375 12.5 15.625 18.75 21.875 25 28.125 31.25 34.375 37.5 40.625 43.75 46.875 50 53.125 56.25 59.375 62.5 65.625 68.75 71.875 75 78.125 81.25 84.375 87.5 90.625 93.75 96.875 100 /end FIX_AXIS_PAR_LIST
 /end AXIS_DESCR
/end CHARACTERISTIC
/begin CHARACTERISTIC CT_MAPCIDEnableMAPThresh "cal comments" CURVE 0xB5D0 2D_Array_UB 0.0 CM_kpa_8bit 0.0 127.5
 /begin AXIS_DESCR FIX_AXIS NO_INPUT_QUANTITY CM_Equaloutput1 17 0.0 12800.0 MAX_GRAD 0.0
  /begin FIX_AXIS_PAR_LIST 0 800 1600 2400 3200 4000 4800 5600 6400 7200 8000 8800 9600 10400 11200 12000 12800 /end FIX_AXIS_PAR_LIST
 /end AXIS_DESCR
/end CHARACTERISTIC
/begin CHARACTERISTIC CT_MAPDefault "cal comments" CURVE 0xB62E 2D_Array_UW 0.0 CM_kpa_0to256_1 0.0 255.99609375
 /begin AXIS_DESCR FIX_AXIS NO_INPUT_QUANTITY CM_Equaloutput1 11 55.0 105.0 MAX_GRAD 0.0 /begin FIX_AXIS_PAR_LIST 55 60 65 70 75 80 85 90 95 100 105 /end FIX_AXIS_PAR_LIST /end AXIS_DESCR
/end CHARACTERISTIC
/begin CHARACTERISTIC CT_MAPEstimateMain "cal comments" MAP 0xB287 3D_Array_UB 0.0 CM_kpa_8bit 0.0 127.5
 /begin AXIS_DESCR COM_AXIS NO_INPUT_QUANTITY CM_RPM_0to16384 17 0.0 16383.75 AXIS_PTS_REF CA_EngSpd17Step2 MAX_GRAD 0.0 /end AXIS_DESCR
 /begin AXIS_DESCR FIX_AXIS NO_INPUT_QUANTITY CM_Equaloutput1 33 0.0 100.0 MAX_GRAD 0.0
  /begin FIX_AXIS_PAR_LIST 0 3.125 6.25 9.375 12.5 15.625 18.75 21.875 25 28.125 31.25 34.375 37.5 40.625 43.75 46.875 50 53.125 56.25 59.375 62.5 65.625 68.75 71.875 75 78.125 81.25 84.375 87.5 90.625 93.75 96.875 100 /end FIX_AXIS_PAR_LIST
 /end AXIS_DESCR
/end CHARACTERISTIC
/begin CHARACTERISTIC CT_MAPReadAngleMain "cal comments" MAP 0xB1E2 3D_Array_UW 0.0 CM_CrankAngle_0to1024 0.0 1023.984375
 /begin AXIS_DESCR COM_AXIS NO_INPUT_QUANTITY CM_kpa_0to256_1 9 0.0 255.99609375 AXIS_PTS_REF CA_MAP9Step1 MAX_GRAD 0.0 /end AXIS_DESCR
 /begin AXIS_DESCR COM_AXIS NO_INPUT_QUANTITY CM_RPM_0to16384 9 0.0 16383.75 AXIS_PTS_REF CA_EngSpd9Step1 MAX_GRAD 0.0 /end AXIS_DESCR
/end CHARACTERISTIC
/begin CHARACTERISTIC CT_O2ErrorCalcOffset "cal comments" CURVE 0x991E 2D_Array_UB 0.0 CM_mVolt 0.0 1016.0
 /begin AXIS_DESCR COM_AXIS NO_INPUT_QUANTITY CM_RPM_0to16384 4 0.0 16383.75 AXIS_PTS_REF CA_EngSpd4Step1 MAX_GRAD 0.0 /end AXIS_DESCR
/end CHARACTERISTIC
/begin CHARACTERISTIC CT_O2HeaterAccFuelMassThresh "cal comments" CURVE 0x9150 2D_Array_UW 0.0 CM_Grams0to8_1 0.0 7.999755859375
 /begin AXIS_DESCR FIX_AXIS NO_INPUT_QUANTITY CM_Equaloutput1 17 -28.0 164.0 MAX_GRAD 0.0 /begin FIX_AXIS_PAR_LIST -28 -16 -4 8 20 32 44 56 68 80 92 104 116 128 140 152 164 /end FIX_AXIS_PAR_LIST /end AXIS_DESCR
/end CHARACTERISTIC
/begin CHARACTERISTIC CT_O2HeaterDutyCycleMain "cal comments" CURVE 0xB1A8 2D_Array_UW 0.0 CM_Percent_0to200_2 0.0 199.9969024658203
 /begin AXIS_DESCR FIX_AXIS NO_INPUT_QUANTITY CM_Equaloutput1 17 -28.0 164.0 MAX_GRAD 0.0 /begin FIX_AXIS_PAR_LIST -28 -16 -4 8 20 32 44 56 68 80 92 104 116 128 140 152 164 /end FIX_AXIS_PAR_LIST /end AXIS_DESCR
/end CHARACTERISTIC
/begin CHARACTERISTIC CT_O2SignalFiltCoef "cal comments" CURVE 0x989A 2D_Array_UB 0.0 CM_FiltCoef_1 0.0 0.99609375
 /begin AXIS_DESCR COM_AXIS NO_INPUT_QUANTITY CM_RPM_0to16384 4 0.0 16383.75 AXIS_PTS_REF CA_EngSpd4Step1 MAX_GRAD 0.0 /end AXIS_DESCR
/end CHARACTERISTIC
/begin CHARACTERISTIC CT_PowerEnrichDelayTime "cal comments" CURVE 0x94F4 2D_Array_UW 0.0 CM_Second_0to1024 0.0 1023.984375
 /begin AXIS_DESCR FIX_AXIS NO_INPUT_QUANTITY CM_Equaloutput1 17 0.0 12800.0 MAX_GRAD 0.0
  /begin FIX_AXIS_PAR_LIST 0 800 1600 2400 3200 4000 4800 5600 6400 7200 8000 8800 9600 10400 11200 12000 12800 /end FIX_AXIS_PAR_LIST
 /end AXIS_DESCR
/end CHARACTERISTIC
/begin CHARACTERISTIC CT_PowerEnrichEnbTPSThresh "cal comments" CURVE 0x9A2A 2D_Array_UB 0.0 CM_Percent_0to200_3 0.0 199.21875
 /begin AXIS_DESCR COM_AXIS NO_INPUT_QUANTITY CM_RPM_0to16384 17 0.0 16383.75 AXIS_PTS_REF CA_EngSpd17Step1 MAX_GRAD 0.0 /end AXIS_DESCR
/end CHARACTERISTIC
/begin CHARACTERISTIC CT_PowerEnrichExitDelay "cal comments" CURVE 0x962C 2D_Array_UW 0.0 CM_Second_0to1024 0.0 1023.984375
 /begin AXIS_DESCR FIX_AXIS NO_INPUT_QUANTITY CM_Equaloutput1 17 0.0 12800.0 MAX_GRAD 0.0
  /begin FIX_AXIS_PAR_LIST 0 800 1600 2400 3200 4000 4800 5600 6400 7200 8000 8800 9600 10400 11200 12000 12800 /end FIX_AXIS_PAR_LIST
 /end AXIS_DESCR
/end CHARACTERISTIC
/begin CHARACTERISTIC CT_PrimePulseBaroMult "cal comments" CURVE 0x921C 2D_Array_UB 0.0 CM_Mult0_to_2_ratio 0.0 1.9921875
 /begin AXIS_DESCR FIX_AXIS NO_INPUT_QUANTITY CM_Equaloutput1 6 55.0 105.0 MAX_GRAD 0.0 /begin FIX_AXIS_PAR_LIST 55 65 75 85 95 105 /end FIX_AXIS_PAR_LIST /end AXIS_DESCR
/end CHARACTERISTIC
/begin CHARACTERISTIC CT_PrimePulseDelay "cal comments" CURVE 0x91E4 2D_Array_UB 0.0 CM_Mult0_to_2_second 0.0 1.9921875
 /begin AXIS_DESCR FIX_AXIS NO_INPUT_QUANTITY CM_Equaloutput1 17 -28.0 164.0 MAX_GRAD 0.0 /begin FIX_AXIS_PAR_LIST -28 -16 -4 8 20 32 44 56 68 80 92 104 116 128 140 152 164 /end FIX_AXIS_PAR_LIST /end AXIS_DESCR
/end CHARACTERISTIC
/begin CHARACTERISTIC CT_PrimePulseWidth "cal comments" CURVE 0x966C 2D_Array_UW 0.0 CM_msec_0to1024 0.0 1023.984375
 /begin AXIS_DESCR FIX_AXIS NO_INPUT_QUANTITY CM_Equaloutput1 17 -28.0 164.0 MAX_GRAD 0.0 /begin FIX_AXIS_PAR_LIST -28 -16 -4 8 20 32 44 56 68 80 92 104 116 128 140 152 164 /end FIX_AXIS_PAR_LIST /end AXIS_DESCR
/end CHARACTERISTIC
/begin CHARACTERISTIC CT_PrimePulseWidth_NG "cal comments" CURVE 0x9690 2D_Array_UW 0.0 CM_msec_0to1024 0.0 1023.984375
 /begin AXIS_DESCR FIX_AXIS NO_INPUT_QUANTITY CM_Equaloutput1 17 -28.0 164.0 MAX_GRAD 0.0 /begin FIX_AXIS_PAR_LIST -28 -16 -4 8 20 32 44 56 68 80 92 104 116 128 140 152 164 /end FIX_AXIS_PAR_LIST /end AXIS_DESCR
/end CHARACTERISTIC
/begin CHARACTERISTIC CT_PrimePulseWidth_LPG "cal comments" CURVE 0x96B4 2D_Array_UW 0.0 CM_msec_0to1024 0.0 1023.984375
 /begin AXIS_DESCR FIX_AXIS NO_INPUT_QUANTITY CM_Equaloutput1 17 -28.0 164.0 MAX_GRAD 0.0 /begin FIX_AXIS_PAR_LIST -28 -16 -4 8 20 32 44 56 68 80 92 104 116 128 140 152 164 /end FIX_AXIS_PAR_LIST /end AXIS_DESCR
/end CHARACTERISTIC
/begin CHARACTERISTIC CT_RunTimeThreshToEnbNextPrimePulse "cal comments" CURVE 0x91F8 2D_Array_UW 0.0 CM_Second_0to512 0.0 511.9921875
 /begin AXIS_DESCR FIX_AXIS NO_INPUT_QUANTITY CM_Equaloutput1 17 -28.0 164.0 MAX_GRAD 0.0 /begin FIX_AXIS_PAR_LIST -28 -16 -4 8 20 32 44 56 68 80 92 104 116 128 140 152 164 /end FIX_AXIS_PAR_LIST /end AXIS_DESCR
/end CHARACTERISTIC
/begin CHARACTERISTIC CT_SACoolTempOfst "cal comments" MAP 0xA2D7 D_Array_SB 0.0 CM_Angle_8bit -64.0 63.5
 /begin AXIS_DESCR FIX_AXIS NO_INPUT_QUANTITY CM_Equaloutput1 17 -28.0 164.0 MAX_GRAD 0.0 /begin FIX_AXIS_PAR_LIST -28 -16 -4 8 20 32 44 56 68 80 92 104 116 128 140 152 164 /end FIX_AXIS_PAR_LIST /end AXIS_DESCR
 /begin AXIS_DESCR FIX_AXIS NO_INPUT_QUANTITY CM_Equaloutput1 9 15.0 115.0 MAX_GRAD 0.0 /begin FIX_AXIS_PAR_LIST 15 27.5 40 52.5 65 77.5 90 102.5 115 /end FIX_AXIS_PAR_LIST /end AXIS_DESCR
/end CHARACTERISTIC
/begin CHARACTERISTIC CT_SACrankBaroOffset "cal comments" CURVE 0xADE3 2D_Array_SB 0.0 CM_Angle_8bit -64.0 63.5
 /begin AXIS_DESCR FIX_AXIS NO_INPUT_QUANTITY CM_Equaloutput1 11 55.0 105.0 MAX_GRAD 0.0 /begin FIX_AXIS_PAR_LIST 55 60 65 70 75 80 85 90 95 100 105 /end FIX_AXIS_PAR_LIST /end AXIS_DESCR
/end CHARACTERISTIC
/begin CHARACTERISTIC CT_SACrankMain "cal comments" CURVE 0xADBD 2D_Array_SB 0.0 CM_Angle_8bit -64.0 63.5
 /begin AXIS_DESCR FIX_AXIS NO_INPUT_QUANTITY CM_Equaloutput1 17 -28.0 164.0 MAX_GRAD 0.0 /begin FIX_AXIS_PAR_LIST -28 -16 -4 8 20 32 44 56 68 80 92 104 116 128 140 152 164 /end FIX_AXIS_PAR_LIST /end AXIS_DESCR
/end CHARACTERISTIC
/begin CHARACTERISTIC CT_SAIntakeAirTempOfst "cal comments" MAP 0xA23B D_Array_SB 0.0 CM_Angle_8bit -64.0 63.5
 /begin AXIS_DESCR FIX_AXIS NO_INPUT_QUANTITY CM_Equaloutput1 17 -28.0 164.0 MAX_GRAD 0.0 /begin FIX_AXIS_PAR_LIST -28 -16 -4 8 20 32 44 56 68 80 92 104 116 128 140 152 164 /end FIX_AXIS_PAR_LIST /end AXIS_DESCR
 /begin AXIS_DESCR FIX_AXIS NO_INPUT_QUANTITY CM_Equaloutput1 9 15.0 115.0 MAX_GRAD 0.0 /begin FIX_AXIS_PAR_LIST 15 27.5 40 52.5 65 77.5 90 102.5 115 /end FIX_AXIS_PAR_LIST /end AXIS_DESCR
/end CHARACTERISTIC
/begin CHARACTERISTIC CT_SparkAdvanceMain "cal comments" MAP 0xA373 D_Array_SB 0.0 CM_Angle_8bit -64.0 63.5
 /begin AXIS_DESCR COM_AXIS NO_INPUT_QUANTITY CM_kpa_0to256_1 18 0.0 255.99609375 AXIS_PTS_REF CA_MAP18Step1 MAX_GRAD 0.0 /end AXIS_DESCR
 /begin AXIS_DESCR COM_AXIS NO_INPUT_QUANTITY CM_RPM_0to16384 17 0.0 16383.75 AXIS_PTS_REF CA_EngSpd17Step1 MAX_GRAD 0.0 /end AXIS_DESCR
/end CHARACTERISTIC
/begin CHARACTERISTIC CT_SparkAdvanceCyl2Offset2Main "cal comments" MAP 0xA4A8 D_Array_SB 0.0 CM_Angle_8bit -64.0 63.5
 /begin AXIS_DESCR COM_AXIS NO_INPUT_QUANTITY CM_kpa_0to256_1 18 0.0 255.99609375 AXIS_PTS_REF CA_MAP18Step1 MAX_GRAD 0.0 /end AXIS_DESCR
 /begin AXIS_DESCR COM_AXIS NO_INPUT_QUANTITY CM_RPM_0to16384 17 0.0 16383.75 AXIS_PTS_REF CA_EngSpd17Step1 MAX_GRAD 0.0 /end AXIS_DESCR
/end CHARACTERISTIC
/begin CHARACTERISTIC CT_SparkAdvanceCyl3Offset2Main "cal comments" MAP 0xA5DD D_Array_SB 0.0 CM_Angle_8bit -64.0 63.5
 /begin AXIS_DESCR COM_AXIS NO_INPUT_QUANTITY CM_kpa_0to256_1 18 0.0 255.99609375 AXIS_PTS_REF CA_MAP18Step1 MAX_GRAD 0.0 /end AXIS_DESCR
 /begin AXIS_DESCR COM_AXIS NO_INPUT_QUANTITY CM_RPM_0to16384 17 0.0 16383.75 AXIS_PTS_REF CA_EngSpd17Step1 MAX_GRAD 0.0 /end AXIS_DESCR
/end CHARACTERISTIC
/begin CHARACTERISTIC CT_SparkAdvanceCyl4Offset2Main "cal comments" MAP 0xA712 D_Array_SB 0.0 CM_Angle_8bit -64.0 63.5
 /begin AXIS_DESCR COM_AXIS NO_INPUT_QUANTITY CM_kpa_0to256_1 18 0.0 255.99609375 AXIS_PTS_REF CA_MAP18Step1 MAX_GRAD 0.0 /end AXIS_DESCR
 /begin AXIS_DESCR COM_AXIS NO_INPUT_QUANTITY CM_RPM_0to16384 17 0.0 16383.75 AXIS_PTS_REF CA_EngSpd17Step1 MAX_GRAD 0.0 /end AXIS_DESCR
/end CHARACTERISTIC
/begin CHARACTERISTIC CT_SparkAdvanceSub "cal comments" MAP 0xA847 D_Array_SB 0.0 CM_Angle_8bit -64.0 63.5
 /begin AXIS_DESCR COM_AXIS NO_INPUT_QUANTITY CM_kpa_0to256_1 18 0.0 255.99609375 AXIS_PTS_REF CA_MAP18Step1 MAX_GRAD 0.0 /end AXIS_DESCR
 /begin AXIS_DESCR COM_AXIS NO_INPUT_QUANTITY CM_RPM_0to16384 17 0.0 16383.75 AXIS_PTS_REF CA_EngSpd17Step1 MAX_GRAD 0.0 /end AXIS_DESCR
/end CHARACTERISTIC
/begin CHARACTERISTIC CT_SparkAdvanceCyl2Offset2Sub "cal comments" MAP 0xA97C D_Array_SB 0.0 CM_Angle_8bit -64.0 63.5
 /begin AXIS_DESCR COM_AXIS NO_INPUT_QUANTITY CM_kpa_0to256_1 18 0.0 255.99609375 AXIS_PTS_REF CA_MAP18Step1 MAX_GRAD 0.0 /end AXIS_DESCR
 /begin AXIS_DESCR COM_AXIS NO_INPUT_QUANTITY CM_RPM_0to16384 17 0.0 16383.75 AXIS_PTS_REF CA_EngSpd17Step1 MAX_GRAD 0.0 /end AXIS_DESCR
/end CHARACTERISTIC
/begin CHARACTERISTIC CT_SparkAdvanceCyl3Offset2Sub "cal comments" MAP 0xAAB1 D_Array_SB 0.0 CM_Angle_8bit -64.0 63.5
 /begin AXIS_DESCR COM_AXIS NO_INPUT_QUANTITY CM_kpa_0to256_1 18 0.0 255.99609375 AXIS_PTS_REF CA_MAP18Step1 MAX_GRAD 0.0 /end AXIS_DESCR
 /begin AXIS_DESCR COM_AXIS NO_INPUT_QUANTITY CM_RPM_0to16384 17 0.0 16383.75 AXIS_PTS_REF CA_EngSpd17Step1 MAX_GRAD 0.0 /end AXIS_DESCR
/end CHARACTERISTIC
/begin CHARACTERISTIC CT_SparkAdvanceCyl4Offset2Sub "cal comments" MAP 0xABE6 D_Array_SB 0.0 CM_Angle_8bit -64.0 63.5
 /begin AXIS_DESCR COM_AXIS NO_INPUT_QUANTITY CM_kpa_0to256_1 18 0.0 255.99609375 AXIS_PTS_REF CA_MAP18Step1 MAX_GRAD 0.0 /end AXIS_DESCR
 /begin AXIS_DESCR COM_AXIS NO_INPUT_QUANTITY CM_RPM_0to16384 17 0.0 16383.75 AXIS_PTS_REF CA_EngSpd17Step1 MAX_GRAD 0.0 /end AXIS_DESCR
/end CHARACTERISTIC
/begin CHARACTERISTIC C_PickupTooth2TDCAngle "cal comments" VALUE 0x802C Scalar_SW 0.0 CM_SparkAngle_N256to256 -256.0 255.9921875 /end CHARACTERISTIC
/begin CHARACTERISTIC CT_SAIdleMain "cal comments" CURVE 0xADD0 2D_Array_SB 0.0 CM_Angle_8bit -64.0 63.5
 /begin AXIS_DESCR FIX_AXIS NO_INPUT_QUANTITY CM_Equaloutput1 17 -28.0 164.0 MAX_GRAD 0.0 /begin FIX_AXIS_PAR_LIST -28 -16 -4 8 20 32 44 56 68 80 92 104 116 128 140 152 164 /end FIX_AXIS_PAR_LIST /end AXIS_DESCR
/end CHARACTERISTIC
/begin CHARACTERISTIC CT_SAIdleLimit "cal comments" CURVE 0xAD1A 2D_Array_SB 0.0 CM_Angle_8bit -64.0 63.5
 /begin AXIS_DESCR COM_AXIS NO_INPUT_QUANTITY CM_RPM_0to16384 6 0.0 16383.75 AXIS_PTS_REF CA_EngSpd6Step1 MAX_GRAD 0.0 /end AXIS_DESCR
/end CHARACTERISTIC
/begin CHARACTERISTIC CT_SAIdleRPMoffset "cal comments" CURVE 0xAD7A 2D_Array_SB 0.0 CM_Angle_8bit -64.0 63.5
 /begin AXIS_DESCR COM_AXIS NO_INPUT_QUANTITY CM_RPM_0to16384 6 0.0 16383.75 AXIS_PTS_REF CA_EngSpd6Step1 MAX_GRAD 0.0 /end AXIS_DESCR
/end CHARACTERISTIC
/begin CHARACTERISTIC CT_SAIdleBaroComp "cal comments" CURVE 0xAD22 2D_Array_SB 0.0 CM_Angle_8bit -64.0 63.5
 /begin AXIS_DESCR FIX_AXIS NO_INPUT_QUANTITY CM_Equaloutput1 11 55.0 105.0 MAX_GRAD 0.0 /begin FIX_AXIS_PAR_LIST 55 60 65 70 75 80 85 90 95 100 105 /end FIX_AXIS_PAR_LIST /end AXIS_DESCR
/end CHARACTERISTIC
/begin CHARACTERISTIC CT_SAIdleBattComp "cal comments" CURVE 0xAD2F 2D_Array_SB 0.0 CM_Angle_8bit -64.0 63.5
 /begin AXIS_DESCR FIX_AXIS NO_INPUT_QUANTITY CM_Equaloutput1 17 6.0 18.79999923706055 MAX_GRAD 0.0
  /begin FIX_AXIS_PAR_LIST 6 6.8 7.6 8.4 9.199999999999999 10 10.8 11.6 12.4 13.2 14 14.8 15.6 16.4 17.2 18 18.8 /end FIX_AXIS_PAR_LIST
 /end AXIS_DESCR
/end CHARACTERISTIC
/begin CHARACTERISTIC CT_SAIdleDyn "cal comments" CURVE 0xAD42 2D_Array_SB 0.0 CM_Angle_8bit -64.0 63.5
 /begin AXIS_DESCR FIX_AXIS NO_INPUT_QUANTITY CM_Equaloutput1 33 -512.0 512.0 MAX_GRAD 0.0
  /begin FIX_AXIS_PAR_LIST -512 -480 -448 -416 -384 -352 -320 -288 -256 -224 -192 -160 -128 -96 -64 -32 0 32 64 96 128 160 192 224 256 288 320 352 384 416 448 480 512 /end FIX_AXIS_PAR_LIST
 /end AXIS_DESCR
/end CHARACTERISTIC
/begin CHARACTERISTIC C_SPRK_t_CtoIDLE_DelayTime "cal comments" VALUE 0xAD64 Scalar_UW 0.0 CM_Seconds_1 0.0 2047.96875 /end CHARACTERISTIC
/begin CHARACTERISTIC C_SPRK_t_RtoIDLE_DelayTime "cal comments" VALUE 0xAD66 Scalar_UW 0.0 CM_Seconds_1 0.0 2047.96875 /end CHARACTERISTIC
/begin CHARACTERISTIC CT_SparkDwellIntakeAirTempMult "cal comments" CURVE 0xAD82 2D_Array_UB 0.0 CM_Mult0_to_2_ratio 0.0 1.9921875
 /begin AXIS_DESCR FIX_AXIS NO_INPUT_QUANTITY CM_Equaloutput1 9 -28.0 36.0 MAX_GRAD 0.0 /begin FIX_AXIS_PAR_LIST -28 -20 -12 -4 4 12 20 28 36 /end FIX_AXIS_PAR_LIST /end AXIS_DESCR
/end CHARACTERISTIC
/begin CHARACTERISTIC CT_SparkDwellMain "cal comments" MAP 0xA19F 3D_Array_UB 0.0 CM_msec 0.0 15.9375
 /begin AXIS_DESCR FIX_AXIS NO_INPUT_QUANTITY CM_Equaloutput1 17 6.0 18.79999923706055 MAX_GRAD 0.0
  /begin FIX_AXIS_PAR_LIST 6 6.8 7.6 8.4 9.199999999999999 10 10.8 11.6 12.4 13.2 14 14.8 15.6 16.4 17.2 18 18.8 /end FIX_AXIS_PAR_LIST
 /end AXIS_DESCR
 /begin AXIS_DESCR FIX_AXIS NO_INPUT_QUANTITY CM_Equaloutput1 9 0.0 12800.0 MAX_GRAD 0.0 /begin FIX_AXIS_PAR_LIST 0 1600 3200 4800 6400 8000 9600 11200 12800 /end FIX_AXIS_PAR_LIST /end AXIS_DESCR
/end CHARACTERISTIC
/begin CHARACTERISTIC CT_SparkDwellMaxLimit "cal comments" CURVE 0xAD6A 2D_Array_UB 0.0 CM_msec 0.0 15.9375
 /begin AXIS_DESCR FIX_AXIS NO_INPUT_QUANTITY CM_Equaloutput1 9 0.0 12800.0 MAX_GRAD 0.0 /begin FIX_AXIS_PAR_LIST 0 1600 3200 4800 6400 8000 9600 11200 12800 /end FIX_AXIS_PAR_LIST /end AXIS_DESCR
/end CHARACTERISTIC
/begin CHARACTERISTIC CT_KNK_WB_NG "cal comments" MAP 0x3 D_Array_SB 0.0 CM_Angle_8bit -64.0 63.5
 /begin AXIS_DESCR COM_AXIS NO_INPUT_QUANTITY udf_CM_18705 9 0.0 511.9921875 AXIS_PTS_REF CA_AirGramStep9 MAX_GRAD 0.0 /end AXIS_DESCR
 /begin AXIS_DESCR COM_AXIS NO_INPUT_QUANTITY CM_RPM_0to16384 4 0.0 16383.75 AXIS_PTS_REF CA_EngSpd4Step1 MAX_GRAD 0.0 /end AXIS_DESCR
/end CHARACTERISTIC
/begin CHARACTERISTIC CT_KNK_WB_LPG "cal comments" MAP 0x3 D_Array_SB 0.0 CM_Angle_8bit -64.0 63.5
 /begin AXIS_DESCR COM_AXIS NO_INPUT_QUANTITY udf_CM_18705 9 0.0 511.9921875 AXIS_PTS_REF CA_AirGramStep9 MAX_GRAD 0.0 /end AXIS_DESCR
 /begin AXIS_DESCR COM_AXIS NO_INPUT_QUANTITY CM_RPM_0to16384 4 0.0 16383.75 AXIS_PTS_REF CA_EngSpd4Step1 MAX_GRAD 0.0 /end AXIS_DESCR
/end CHARACTERISTIC
/begin CHARACTERISTIC CT_KNK_WD_NG "cal comments" MAP 0x3 D_Array_SB 0.0 CM_Angle_8bit -64.0 63.5
 /begin AXIS_DESCR COM_AXIS NO_INPUT_QUANTITY udf_CM_18705 9 0.0 511.9921875 AXIS_PTS_REF CA_AirGramStep9 MAX_GRAD 0.0 /end AXIS_DESCR
 /begin AXIS_DESCR COM_AXIS NO_INPUT_QUANTITY CM_RPM_0to16384 4 0.0 16383.75 AXIS_PTS_REF CA_EngSpd4Step1 MAX_GRAD 0.0 /end AXIS_DESCR
/end CHARACTERISTIC
/begin CHARACTERISTIC CT_KNK_WD_LPG "cal comments" MAP 0x3 D_Array_SB 0.0 CM_Angle_8bit -64.0 63.5
 /begin AXIS_DESCR COM_AXIS NO_INPUT_QUANTITY udf_CM_18705 9 0.0 511.9921875 AXIS_PTS_REF CA_AirGramStep9 MAX_GRAD 0.0 /end AXIS_DESCR
 /begin AXIS_DESCR COM_AXIS NO_INPUT_QUANTITY CM_RPM_0to16384 4 0.0 16383.75 AXIS_PTS_REF CA_EngSpd4Step1 MAX_GRAD 0.0 /end AXIS_DESCR
/end CHARACTERISTIC
/begin CHARACTERISTIC CT_KNK_GAIN "cal comments" MAP 0x3 2D_Array_UB 0.0 CM_KNK_GAIN 0.0 63.0
 /begin AXIS_DESCR COM_AXIS NO_INPUT_QUANTITY udf_CM_18705 9 0.0 511.9921875 AXIS_PTS_REF CA_AirGramStep9 MAX_GRAD 0.0 /end AXIS_DESCR
 /begin AXIS_DESCR COM_AXIS NO_INPUT_QUANTITY CM_RPM_0to16384 4 0.0 16383.75 AXIS_PTS_REF CA_EngSpd4Step1 MAX_GRAD 0.0 /end AXIS_DESCR
/end CHARACTERISTIC
/begin CHARACTERISTIC CT_KNK_FIL_FREQ "cal comments" MAP 0x3 2D_Array_UB 0.0 CM_KNK_HZ 0.0 63.0
 /begin AXIS_DESCR COM_AXIS NO_INPUT_QUANTITY udf_CM_18705 9 0.0 511.9921875 AXIS_PTS_REF CA_AirGramStep9 MAX_GRAD 0.0 /end AXIS_DESCR
 /begin AXIS_DESCR COM_AXIS NO_INPUT_QUANTITY CM_RPM_0to16384 4 0.0 16383.75 AXIS_PTS_REF CA_EngSpd4Step1 MAX_GRAD 0.0 /end AXIS_DESCR
/end CHARACTERISTIC
/begin CHARACTERISTIC CT_KNK_INT "cal comments" MAP 0x3 2D_Array_UB 0.0 CM_KNK_INT 0.0 31.0
 /begin AXIS_DESCR COM_AXIS NO_INPUT_QUANTITY udf_CM_18705 9 0.0 511.9921875 AXIS_PTS_REF CA_AirGramStep9 MAX_GRAD 0.0 /end AXIS_DESCR
 /begin AXIS_DESCR COM_AXIS NO_INPUT_QUANTITY CM_RPM_0to16384 4 0.0 16383.75 AXIS_PTS_REF CA_EngSpd4Step1 MAX_GRAD 0.0 /end AXIS_DESCR
/end CHARACTERISTIC
/begin CHARACTERISTIC CT_SpeedControlFlowBaroMult "cal comments" CURVE 0x9D85 2D_Array_UB 0.0 CM_Mult_0to8 0.0 7.96875
 /begin AXIS_DESCR FIX_AXIS NO_INPUT_QUANTITY CM_Equaloutput1 6 55.0 105.0 MAX_GRAD 0.0 /begin FIX_AXIS_PAR_LIST 55 65 75 85 95 105 /end FIX_AXIS_PAR_LIST /end AXIS_DESCR
/end CHARACTERISTIC
/begin CHARACTERISTIC CT_ThrottleFlow "cal comments" CURVE 0x9CF8 2D_Array_UW 0.0 udf_CM_18698 0.0 511.9921875
 /begin AXIS_DESCR COM_AXIS NO_INPUT_QUANTITY CM_Percent_0to200_2 21 0.0 199.9969024658203 AXIS_PTS_REF CA_PercentStep21 MAX_GRAD 0.0 /end AXIS_DESCR
/end CHARACTERISTIC
/begin CHARACTERISTIC CT_ThrottleFlow_Reverse "cal comments" CURVE 0x9D24 2D_Array_UW 0.0 CM_Percent_0to200_2 0.0 199.9969024658203
 /begin AXIS_DESCR COM_AXIS NO_INPUT_QUANTITY udf_CM_18705 21 0.0 511.9921875 AXIS_PTS_REF CA_GramStep21 MAX_GRAD 0.0 /end AXIS_DESCR
/end CHARACTERISTIC
/begin CHARACTERISTIC CT_TimpPulseWidthMult "cal comments" MAP 0x9A43 3D_Array_UB 0.0 CM_Mult_0to8 0.0 7.96875
 /begin AXIS_DESCR FIX_AXIS NO_INPUT_QUANTITY CM_Equaloutput1 9 -28.0 164.0 MAX_GRAD 0.0 /begin FIX_AXIS_PAR_LIST -28 -4 20 44 68 92 116 140 164 /end FIX_AXIS_PAR_LIST /end AXIS_DESCR
 /begin AXIS_DESCR FIX_AXIS NO_INPUT_QUANTITY CM_Equaloutput1 6 800.0 2800.0 MAX_GRAD 0.0 /begin FIX_AXIS_PAR_LIST 800 1200 1600 2000 2400 2800 /end FIX_AXIS_PAR_LIST /end AXIS_DESCR
/end CHARACTERISTIC
/begin CHARACTERISTIC CT_VEAltCorrFactor "cal comments" MAP 0x8EF7 3D_Array_UB 0.0 CM_Mult0_to_2_ratio 0.0 1.9921875
 /begin AXIS_DESCR COM_AXIS NO_INPUT_QUANTITY CM_kpa_0to256_1 6 0.0 255.99609375 AXIS_PTS_REF CA_VELoad6Step MAX_GRAD 0.0 /end AXIS_DESCR
 /begin AXIS_DESCR FIX_AXIS NO_INPUT_QUANTITY CM_Equaloutput1 11 55.0 105.0 MAX_GRAD 0.0 /begin FIX_AXIS_PAR_LIST 55 60 65 70 75 80 85 90 95 100 105 /end FIX_AXIS_PAR_LIST /end AXIS_DESCR
/end CHARACTERISTIC
/begin CHARACTERISTIC CT_VEMainHighLoadCyl1 "cal comments" MAP 0x8336 3D_Array_UW 0.0 CM_Percent_0to200_2 0.0 199.9969024658203
 /begin AXIS_DESCR COM_AXIS NO_INPUT_QUANTITY CM_kpa_0to256_1 22 0.0 255.99609375 AXIS_PTS_REF CA_MAP22Step1 MAX_GRAD 0.0 /end AXIS_DESCR
 /begin AXIS_DESCR COM_AXIS NO_INPUT_QUANTITY CM_RPM_0to16384 17 0.0 16383.75 AXIS_PTS_REF CA_EngSpd17Step1 MAX_GRAD 0.0 /end AXIS_DESCR
/end CHARACTERISTIC
/begin CHARACTERISTIC CT_VEMainHighLoadCyl2 "cal comments" MAP 0x8626 3D_Array_UW 0.0 CM_Percent_0to200_2 0.0 199.9969024658203
 /begin AXIS_DESCR COM_AXIS NO_INPUT_QUANTITY CM_kpa_0to256_1 22 0.0 255.99609375 AXIS_PTS_REF CA_MAP22Step1 MAX_GRAD 0.0 /end AXIS_DESCR
 /begin AXIS_DESCR COM_AXIS NO_INPUT_QUANTITY CM_RPM_0to16384 17 0.0 16383.75 AXIS_PTS_REF CA_EngSpd17Step1 MAX_GRAD 0.0 /end AXIS_DESCR
/end CHARACTERISTIC
/begin CHARACTERISTIC CT_VEMainHighLoadCyl3 "cal comments" MAP 0x8916 3D_Array_UW 0.0 CM_Percent_0to200_2 0.0 199.9969024658203
 /begin AXIS_DESCR COM_AXIS NO_INPUT_QUANTITY CM_kpa_0to256_1 22 0.0 255.99609375 AXIS_PTS_REF CA_MAP22Step1 MAX_GRAD 0.0 /end AXIS_DESCR
 /begin AXIS_DESCR COM_AXIS NO_INPUT_QUANTITY CM_RPM_0to16384 17 0.0 16383.75 AXIS_PTS_REF CA_EngSpd17Step1 MAX_GRAD 0.0 /end AXIS_DESCR
/end CHARACTERISTIC
/begin CHARACTERISTIC CT_VEMainHighLoadCyl4 "cal comments" MAP 0x8C06 3D_Array_UW 0.0 CM_Percent_0to200_2 0.0 199.9969024658203
 /begin AXIS_DESCR COM_AXIS NO_INPUT_QUANTITY CM_kpa_0to256_1 22 0.0 255.99609375 AXIS_PTS_REF CA_MAP22Step1 MAX_GRAD 0.0 /end AXIS_DESCR
 /begin AXIS_DESCR COM_AXIS NO_INPUT_QUANTITY CM_RPM_0to16384 17 0.0 16383.75 AXIS_PTS_REF CA_EngSpd17Step1 MAX_GRAD 0.0 /end AXIS_DESCR
/end CHARACTERISTIC
/begin CHARACTERISTIC C_VESynForCalEn "cal comments" VALUE 0x8EF2 Scalar_UB 0.0 CM_Boolean6 0.0 255.0 /end CHARACTERISTIC
/begin CHARACTERISTIC C_VETriFuelEn "cal comments" VALUE 0x8EF3 Scalar_UB 0.0 CM_Boolean6 0.0 255.0 /end CHARACTERISTIC
/begin CHARACTERISTIC CT_VirtualTPS "cal comments" CURVE 0xB1D4 2D_Array_UB 0.0 CM_Percent_0to200_3 0.0 199.21875
 /begin AXIS_DESCR COM_AXIS NO_INPUT_QUANTITY CM_kpa_0to256_1 10 0.0 255.99609375 AXIS_PTS_REF CA_MAP10Step1 MAX_GRAD 0.0 /end AXIS_DESCR
/end CHARACTERISTIC
/begin CHARACTERISTIC D_BatVoltDiagPassTimeThrsh "cal comments" VALUE 0xC082 Scalar_UW 0.0 CM_Count_0to65535_2 0.0 65535.0 /end CHARACTERISTIC
/begin CHARACTERISTIC D_BatVoltEnb "cal comments" VALUE 0xC088 Scalar_UB 0.0 CM_Boolean6 0.0 255.0 /end CHARACTERISTIC
/begin CHARACTERISTIC D_BatVoltHighFailTimeThrsh "cal comments" VALUE 0xC080 Scalar_UW 0.0 CM_Count_0to65535_2 0.0 65535.0 /end CHARACTERISTIC
/begin CHARACTERISTIC D_BatVoltLowFailTimeThrsh "cal comments" VALUE 0xC07E Scalar_UW 0.0 CM_Count_0to65535_2 0.0 65535.0 /end CHARACTERISTIC
/begin CHARACTERISTIC D_BatVoltRangeThreshHi "cal comments" VALUE 0xC086 Scalar_UW 0.0 CM_Volt_0to32_1 0.0 31.99900627136231 /end CHARACTERISTIC
/begin CHARACTERISTIC D_BatVoltRangeThreshLo "cal comments" VALUE 0xC084 Scalar_UW 0.0 CM_Volt_0to32_1 0.0 31.99900627136231 /end CHARACTERISTIC
/begin CHARACTERISTIC D_GENVDiagPassTimeThrsh "cal comments" VALUE 0x0 Scalar_UW 0.0 CM_Count_0to65535_2 0.0 65535.0 /end CHARACTERISTIC
/begin CHARACTERISTIC D_GENVEnb "cal comments" VALUE 0x0 Scalar_UB 0.0 CM_Boolean6 0.0 255.0 /end CHARACTERISTIC
/begin CHARACTERISTIC D_GENVHighFailTimeThrsh "cal comments" VALUE 0x0 Scalar_UW 0.0 CM_Count_0to65535_2 0.0 65535.0 /end CHARACTERISTIC
/begin CHARACTERISTIC D_GENVLowFailTimeThrsh "cal comments" VALUE 0x0 Scalar_UW 0.0 CM_Count_0to65535_2 0.0 65535.0 /end CHARACTERISTIC
/begin CHARACTERISTIC D_GENVRangeThreshHi "cal comments" VALUE 0x0 Scalar_UW 0.0 CM_Volt_0to1024_1 0.0 1023.984375 /end CHARACTERISTIC
/begin CHARACTERISTIC D_GENVRangeThreshLo "cal comments" VALUE 0x0 Scalar_UW 0.0 CM_Volt_0to1024_1 0.0 1023.984375 /end CHARACTERISTIC
/begin CHARACTERISTIC D_COSEnb "cal comments" VALUE 0xC076 Scalar_UB 0.0 CM_Boolean6 0.0 255.0 /end CHARACTERISTIC
/begin CHARACTERISTIC D_COSFailTimeThrsh "cal comments" VALUE 0xC070 Scalar_UW 0.0 CM_Count_0to65535_2 0.0 65535.0 /end CHARACTERISTIC
/begin CHARACTERISTIC D_COSPassTimeThrsh "cal comments" VALUE 0xC072 Scalar_UW 0.0 CM_Count_0to65535_2 0.0 65535.0 /end CHARACTERISTIC
/begin CHARACTERISTIC D_COSThreshHi "cal comments" VALUE 0xC074 Scalar_UW 0.0 CM_RPM_0to16384 0.0 16383.75 /end CHARACTERISTIC
/begin CHARACTERISTIC D_COAFailTimeThrsh "cal comments" VALUE 0xC079 Scalar_UB 0.0 CM_Count3 0.0 255.0 /end CHARACTERISTIC
/begin CHARACTERISTIC D_COAPassTimeThrsh "cal comments" VALUE 0xC07A Scalar_UB 0.0 CM_Count3 0.0 255.0 /end CHARACTERISTIC
/begin CHARACTERISTIC D_COAEnb "cal comments" VALUE 0xC07B Scalar_UB 0.0 CM_Boolean6 0.0 255.0 /end CHARACTERISTIC
/begin CHARACTERISTIC D_CoolTempShortEnb "cal comments" VALUE 0xBED6 Scalar_UB 0.0 CM_Boolean6 0.0 255.0 /end CHARACTERISTIC
/begin CHARACTERISTIC D_CoolTempFailTimeThrsh "cal comments" VALUE 0xBEC4 Scalar_UW 0.0 CM_Count_0to65535_1 0.0 65535.0 /end CHARACTERISTIC
/begin CHARACTERISTIC D_CoolTempPassTimeThrsh "cal comments" VALUE 0xBEC6 Scalar_UW 0.0 CM_Count_0to65535_1 0.0 65535.0 /end CHARACTERISTIC
/begin CHARACTERISTIC D_CoolTempOH1FailTimeThrsh "cal comments" VALUE 0xBEC8 Scalar_UB 0.0 CM_Count3 0.0 255.0 /end CHARACTERISTIC
/begin CHARACTERISTIC D_CoolTempOH1PassTimeThrsh "cal comments" VALUE 0xBEC9 Scalar_UB 0.0 CM_Count3 0.0 255.0 /end CHARACTERISTIC
/begin CHARACTERISTIC D_CoolTempOH2FailTimeThrsh "cal comments" VALUE 0xBECA Scalar_UB 0.0 CM_Count3 0.0 255.0 /end CHARACTERISTIC
/begin CHARACTERISTIC D_CoolTempOH2PassTimeThrsh "cal comments" VALUE 0xBECB Scalar_UB 0.0 CM_Count3 0.0 255.0 /end CHARACTERISTIC
/begin CHARACTERISTIC D_CoolTempShortRangeThreshHi "cal comments" VALUE 0xBECC Scalar_UW 0.0 CM_Percent_0to100_1 0.0 99.9984130859375 /end CHARACTERISTIC
/begin CHARACTERISTIC D_CoolTempShortRangeThreshLo "cal comments" VALUE 0xBECE Scalar_UW 0.0 CM_Percent_0to100_1 0.0 99.9984130859375 /end CHARACTERISTIC
/begin CHARACTERISTIC D_CoolTempOHDiagRunTimeThrsh "cal comments" VALUE 0xBED0 Scalar_UB 0.0 CM_Count3 0.0 255.0 /end CHARACTERISTIC
/begin CHARACTERISTIC D_CoolTempOH1Thresh "cal comments" VALUE 0xBED2 Scalar_SW 0.0 CM_DegC_N256to256 -256.0 255.9921875 /end CHARACTERISTIC
/begin CHARACTERISTIC D_CoolTempOH2Thresh "cal comments" VALUE 0xBED4 Scalar_SW 0.0 CM_DegC_N256to256 -256.0 255.9921875 /end CHARACTERISTIC
/begin CHARACTERISTIC D_FPShortEnb "cal comments" VALUE 0xBF62 Scalar_UB 0.0 CM_Boolean6 0.0 255.0 /end CHARACTERISTIC
/begin CHARACTERISTIC D_FPShrtFailTimeThrsh "cal comments" VALUE 0xBF56 Scalar_UB 0.0 CM_Count3 0.0 255.0 /end CHARACTERISTIC
/begin CHARACTERISTIC D_FPHLFailTimeThrsh "cal comments" VALUE 0xBF57 Scalar_UB 0.0 CM_Count3 0.0 255.0 /end CHARACTERISTIC
/begin CHARACTERISTIC D_FPPassTimeThrsh "cal comments" VALUE 0xBF58 Scalar_UB 0.0 CM_Count3 0.0 255.0 /end CHARACTERISTIC
/begin CHARACTERISTIC D_FPShortRangeThreshHi "cal comments" VALUE 0xBF5A Scalar_UW 0.0 CM_Percent_0to100_1 0.0 99.9984130859375 /end CHARACTERISTIC
/begin CHARACTERISTIC D_FPShortRangeThreshLo "cal comments" VALUE 0xBF5C Scalar_UW 0.0 CM_Percent_0to100_1 0.0 99.9984130859375 /end CHARACTERISTIC
/begin CHARACTERISTIC D_FPRangeThreshHi "cal comments" VALUE 0xBF5E Scalar_SW 0.0 CM_kpa_n256to256_1 -256 255.9921875 /end CHARACTERISTIC
/begin CHARACTERISTIC D_FPRangeThreshLo "cal comments" VALUE 0xBF60 Scalar_SW 0.0 CM_kpa_n256to256_1 -256 255.9921875 /end CHARACTERISTIC
/begin CHARACTERISTIC D_CrankNoisySignalFailTimeThrsh "cal comments" VALUE 0xBF1C Scalar_UW 0.0 CM_Count_0to65535 0.0 65535.0 /end CHARACTERISTIC
/begin CHARACTERISTIC D_CrankNoisySignalPassTimeThrsh "cal comments" VALUE 0xBF1E Scalar_UW 0.0 CM_Count_0to65535 0.0 65535.0 /end CHARACTERISTIC
/begin CHARACTERISTIC D_CrankNoSignalDeltaMAPThrsh "cal comments" VALUE 0xBF20 Scalar_UW 0.0 CM_kpa_0to256_1 0.0 255.99609375 /end CHARACTERISTIC
/begin CHARACTERISTIC D_CrankNoSignalFailTimeThrsh "cal comments" VALUE 0xBF22 Scalar_UW 0.0 CM_Second_0to512_1 0.0 511.9921875 /end CHARACTERISTIC
/begin CHARACTERISTIC D_CrankNoSignalPassTimeThrsh "cal comments" VALUE 0xBF24 Scalar_UW 0.0 CM_Second_0to512_1 0.0 511.9921875 /end CHARACTERISTIC
/begin CHARACTERISTIC D_CrankNoSignalCountThresh "cal comments" VALUE 0xBF26 Scalar_UB 0.0 CM_Count1 0.0 255.0 /end CHARACTERISTIC
/begin CHARACTERISTIC D_CrankNosignalMAPCoef "cal comments" VALUE 0xBF28 Scalar_UW 0.0 CM_FiltCoef 0.0 0.9999847412109375 /end CHARACTERISTIC
/begin CHARACTERISTIC D_CrankSignalEnb "cal comments" VALUE 0xBF2A Scalar_UB 0.0 CM_Boolean6 0.0 255.0 /end CHARACTERISTIC
/begin CHARACTERISTIC D_FuelPumpShortEnb "cal comments" VALUE 0xBF46 Scalar_UB 0.0 CM_Boolean6 0.0 255.0 /end CHARACTERISTIC
/begin CHARACTERISTIC D_FuelPumpShortLoThresh "cal comments" VALUE 0xBF48 Scalar_UW 0.0 CM_Count_0to65535_1 0.0 65535.0 /end CHARACTERISTIC
/begin CHARACTERISTIC D_FuelPumpShortFailThresh "cal comments" VALUE 0xBF4A Scalar_UB 0.0 CM_Count1 0.0 255.0 /end CHARACTERISTIC
/begin CHARACTERISTIC D_FuelPumpShortPassThresh "cal comments" VALUE 0xBF4B Scalar_UB 0.0 CM_Count1 0.0 255.0 /end CHARACTERISTIC
/begin CHARACTERISTIC D_DCMShortEnb "cal comments" VALUE 0xBEB0 Scalar_UB 0.0 CM_Boolean6 0.0 255.0 /end CHARACTERISTIC
/begin CHARACTERISTIC D_DCMShortFailTimeThrsh "cal comments" VALUE 0xBEB1 Scalar_UB 0.0 CM_Count1 0.0 255.0 /end CHARACTERISTIC
/begin CHARACTERISTIC D_DCMShortPassTimeThrsh "cal comments" VALUE 0xBEB2 Scalar_UB 0.0 CM_Count1 0.0 255.0 /end CHARACTERISTIC
/begin CHARACTERISTIC D_CCPShortEnb "cal comments" VALUE 0x0 Scalar_UB 0.0 CM_Boolean6 0.0 255.0 /end CHARACTERISTIC
/begin CHARACTERISTIC D_CCPShortFailThresh "cal comments" VALUE 0x0 Scalar_UB 0.0 CM_Count1 0.0 255.0 /end CHARACTERISTIC
/begin CHARACTERISTIC D_CCPShortPassThresh "cal comments" VALUE 0x0 Scalar_UB 0.0 CM_Count1 0.0 255.0 /end CHARACTERISTIC
/begin CHARACTERISTIC D_IgnitionCoilEnb "cal comments" CURVE 0xBF32 2D_Array_UB 0.0 CM_Count1 0.0 1.0
 /begin AXIS_DESCR FIX_AXIS NO_INPUT_QUANTITY CM_EOI 4 0.0 4.0 MAX_GRAD 0.0 /begin FIX_AXIS_PAR_LIST 0 1 2 3 /end FIX_AXIS_PAR_LIST /end AXIS_DESCR
/end CHARACTERISTIC
/begin CHARACTERISTIC D_InjCyShortFailThresh "cal comments" CURVE 0xC042 2D_Array_UB 0.0 CM_Count1 0.0 255.0
 /begin AXIS_DESCR FIX_AXIS NO_INPUT_QUANTITY CM_EOI 4 0.0 4.0 MAX_GRAD 0.0 /begin FIX_AXIS_PAR_LIST 0 1 2 3 /end FIX_AXIS_PAR_LIST /end AXIS_DESCR
/end CHARACTERISTIC
/begin CHARACTERISTIC D_InjCyShortPassThresh "cal comments" CURVE 0xC046 2D_Array_UB 0.0 CM_Count1 0.0 255.0
 /begin AXIS_DESCR FIX_AXIS NO_INPUT_QUANTITY CM_EOI 4 0.0 4.0 MAX_GRAD 0.0 /begin FIX_AXIS_PAR_LIST 0 1 2 3 /end FIX_AXIS_PAR_LIST /end AXIS_DESCR
/end CHARACTERISTIC
/begin CHARACTERISTIC D_InjectorCylEnb "cal comments" CURVE 0xC00B 2D_Array_UB 0.0 CM_Count1 0.0 1.0
 /begin AXIS_DESCR FIX_AXIS NO_INPUT_QUANTITY CM_EOI 4 0.0 4.0 MAX_GRAD 0.0 /begin FIX_AXIS_PAR_LIST 0 1 2 3 /end FIX_AXIS_PAR_LIST /end AXIS_DESCR
/end CHARACTERISTIC
/begin CHARACTERISTIC D_IntakeAirTempShortEnb "cal comments" VALUE 0xBFD0 Scalar_UB 0.0 CM_Boolean6 0.0 255.0 /end CHARACTERISTIC
/begin CHARACTERISTIC D_IntakeAirTempFailTimeThrsh "cal comments" VALUE 0xBFC1 Scalar_UB 0.0 CM_Count3 0.0 255.0 /end CHARACTERISTIC
/begin CHARACTERISTIC D_IntakeAirTempOH1FailTimeThrsh "cal comments" VALUE 0xBFC3 Scalar_UB 0.0 CM_Count3 0.0 255.0 /end CHARACTERISTIC
/begin CHARACTERISTIC D_IntakeAirTempOH2FailTimeThrsh "cal comments" VALUE 0xBFC4 Scalar_UB 0.0 CM_Count3 0.0 255.0 /end CHARACTERISTIC
/begin CHARACTERISTIC D_IntakeAirTempOH1PassTimeThrsh "cal comments" VALUE 0xBFC5 Scalar_UB 0.0 CM_Count3 0.0 255.0 /end CHARACTERISTIC
/begin CHARACTERISTIC D_IntakeAirTempOH2PassTimeThrsh "cal comments" VALUE 0xBFC6 Scalar_UB 0.0 CM_Count3 0.0 255.0 /end CHARACTERISTIC
/begin CHARACTERISTIC D_IntakeAirTempPassTimeThrsh "cal comments" VALUE 0xBFC2 Scalar_UB 0.0 CM_Count3 0.0 255.0 /end CHARACTERISTIC
/begin CHARACTERISTIC D_IntakeAirTempOHDiagRunTimeThrsh "cal comments" VALUE 0xBFC0 Scalar_UB 0.0 CM_Count3 0.0 255.0 /end CHARACTERISTIC
/begin CHARACTERISTIC D_IntakeAirTempShortRangeThreshHi "cal comments" VALUE 0xBFC8 Scalar_UW 0.0 CM_Percent_0to100_1 0.0 99.9984130859375 /end CHARACTERISTIC
/begin CHARACTERISTIC D_IntakeAirTempShortRangeThreshLo "cal comments" VALUE 0xBFCA Scalar_UW 0.0 CM_Percent_0to100_1 0.0 99.9984130859375 /end CHARACTERISTIC
/begin CHARACTERISTIC D_IntakeAirTempOH1Thresh "cal comments" VALUE 0xBFCC Scalar_SW 0.0 CM_DegC_N256to256 -256.0 255.9921875 /end CHARACTERISTIC
/begin CHARACTERISTIC D_IntakeAirTempOH2Thresh "cal comments" VALUE 0xBFCE Scalar_SW 0.0 CM_DegC_N256to256 -256.0 255.9921875 /end CHARACTERISTIC
/begin CHARACTERISTIC D_SCIShortEnb "cal comments" VALUE 0xBFE2 Scalar_UB 0.0 CM_Boolean6 0.0 255.0 /end CHARACTERISTIC
/begin CHARACTERISTIC D_SCIFailTimeThrsh "cal comments" VALUE 0xBFDA Scalar_UW 0.0 CM_Count_0to65535_1 0.0 65535.0 /end CHARACTERISTIC
/begin CHARACTERISTIC D_SCIPassTimeThrsh "cal comments" VALUE 0xBFDC Scalar_UW 0.0 CM_Count_0to65535_3 0.0 65535.0 /end CHARACTERISTIC
/begin CHARACTERISTIC D_SCIShortRangeThreshHi "cal comments" VALUE 0xBFDE Scalar_UW 0.0 CM_Percent_0to100_1 0.0 99.9984130859375 /end CHARACTERISTIC
/begin CHARACTERISTIC D_SCIShortRangeThreshLo "cal comments" VALUE 0xBFE0 Scalar_UW 0.0 CM_Percent_0to100_1 0.0 99.9984130859375 /end CHARACTERISTIC
/begin CHARACTERISTIC D_ACSShortHighFailTimeThrsh "cal comments" VALUE 0xBFE8 Scalar_UW 0.0 CM_Count_0to65535_1 0.0 65535.0 /end CHARACTERISTIC
/begin CHARACTERISTIC D_ACSShortHighPassTimeThrsh "cal comments" VALUE 0xBFEA Scalar_UW 0.0 CM_Count_0to65535_1 0.0 65535.0 /end CHARACTERISTIC
/begin CHARACTERISTIC D_ACSShortLowFailTimeThrsh "cal comments" VALUE 0xBFEC Scalar_UW 0.0 CM_Count_0to65535_1 0.0 65535.0 /end CHARACTERISTIC
/begin CHARACTERISTIC D_ACSShortLowPassTimeThrsh "cal comments" VALUE 0xBFEE Scalar_UW 0.0 CM_Count_0to65535_1 0.0 65535.0 /end CHARACTERISTIC
/begin CHARACTERISTIC D_ACSShortRangeThreshHi "cal comments" VALUE 0xBFF0 Scalar_UW 0.0 CM_Percent_0to100_1 0.0 99.9984130859375 /end CHARACTERISTIC
/begin CHARACTERISTIC D_ACSShortRangeThreshLo "cal comments" VALUE 0xBFF2 Scalar_UW 0.0 CM_Percent_0to100_1 0.0 99.9984130859375 /end CHARACTERISTIC
/begin CHARACTERISTIC D_ACSShortEnb "cal comments" VALUE 0xBFF4 Scalar_UB 0.0 CM_Boolean6 0.0 255.0 /end CHARACTERISTIC
/begin CHARACTERISTIC D_WPSShortHighFailTimeThrsh "cal comments" VALUE 0x0 Scalar_UW 0.0 CM_Count_0to65535_1 0.0 65535.0 /end CHARACTERISTIC
/begin CHARACTERISTIC D_WPSShortHighPassTimeThrsh "cal comments" VALUE 0x0 Scalar_UW 0.0 CM_Count_0to65535_1 0.0 65535.0 /end CHARACTERISTIC
/begin CHARACTERISTIC D_WPSShortLowFailTimeThrsh "cal comments" VALUE 0x0 Scalar_UW 0.0 CM_Count_0to65535_1 0.0 65535.0 /end CHARACTERISTIC
/begin CHARACTERISTIC D_WPSShortLowPassTimeThrsh "cal comments" VALUE 0x0 Scalar_UW 0.0 CM_Count_0to65535_1 0.0 65535.0 /end CHARACTERISTIC
/begin CHARACTERISTIC D_WPSShortRangeThreshHi "cal comments" VALUE 0x0 Scalar_UW 0.0 CM_Percent_0to100_1 0.0 99.9984130859375 /end CHARACTERISTIC
/begin CHARACTERISTIC D_WPSShortRangeThreshLo "cal comments" VALUE 0x0 Scalar_UW 0.0 CM_Percent_0to100_1 0.0 99.9984130859375 /end CHARACTERISTIC
/begin CHARACTERISTIC D_WPSShortEnb "cal comments" VALUE 0x0 Scalar_UB 0.0 CM_Boolean6 0.0 255.0 /end CHARACTERISTIC
/begin CHARACTERISTIC D_MAPShortEnb "cal comments" VALUE 0xC02C Scalar_UB 0.0 CM_Boolean6 0.0 255.0 /end CHARACTERISTIC
/begin CHARACTERISTIC D_MAPShortHiDiagFailThrsh "cal comments" VALUE 0xC02A Scalar_UW 0.0 CM_Percent_0to100_1 0.0 99.9984130859375 /end CHARACTERISTIC
/begin CHARACTERISTIC D_MAPShortHighFailTimeThrsh "cal comments" VALUE 0xC020 Scalar_UW 0.0 CM_Count_0to65535_2 0.0 65535.0 /end CHARACTERISTIC
/begin CHARACTERISTIC D_MAPShortHighPassTimeThrsh "cal comments" VALUE 0xC022 Scalar_UW 0.0 CM_Count_0to65535_2 0.0 65535.0 /end CHARACTERISTIC
/begin CHARACTERISTIC D_MAPShortLoDiagFailThrsh "cal comments" VALUE 0xC028 Scalar_UW 0.0 CM_Percent_0to100_1 0.0 99.9984130859375 /end CHARACTERISTIC
/begin CHARACTERISTIC D_MAPShortLowFailTimeThrsh "cal comments" VALUE 0xC024 Scalar_UW 0.0 CM_Count_0to65535_2 0.0 65535.0 /end CHARACTERISTIC
/begin CHARACTERISTIC D_MAPShortLowPassTimeThrsh "cal comments" VALUE 0xC026 Scalar_UW 0.0 CM_Count_0to65535_2 0.0 65535.0 /end CHARACTERISTIC
/begin CHARACTERISTIC D_BSTPShortEnb "cal comments" VALUE 0xC006 Scalar_UB 0.0 CM_Boolean6 0.0 255.0 /end CHARACTERISTIC
/begin CHARACTERISTIC D_BSTPShortHiDiagFailThrsh "cal comments" VALUE 0xC004 Scalar_UW 0.0 CM_Percent_0to100_1 0.0 99.9984130859375 /end CHARACTERISTIC
/begin CHARACTERISTIC D_BSTPShortHighFailTimeThrsh "cal comments" VALUE 0xBFFA Scalar_UW 0.0 CM_Count_0to65535_2 0.0 65535.0 /end CHARACTERISTIC
/begin CHARACTERISTIC D_BSTPShortHighPassTimeThrsh "cal comments" VALUE 0xBFFC Scalar_UW 0.0 CM_Count_0to65535_2 0.0 65535.0 /end CHARACTERISTIC
/begin CHARACTERISTIC D_BSTPShortLoDiagFailThrsh "cal comments" VALUE 0xC002 Scalar_UW 0.0 CM_Percent_0to100_1 0.0 99.9984130859375 /end CHARACTERISTIC
/begin CHARACTERISTIC D_BSTPShortLowFailTimeThrsh "cal comments" VALUE 0xBFFE Scalar_UW 0.0 CM_Count_0to65535_2 0.0 65535.0 /end CHARACTERISTIC
/begin CHARACTERISTIC D_BSTPShortLowPassTimeThrsh "cal comments" VALUE 0xC000 Scalar_UW 0.0 CM_Count_0to65535_2 0.0 65535.0 /end CHARACTERISTIC
/begin CHARACTERISTIC D_O21ShortDiagCoolTempThrsh "cal comments" VALUE 0xBEE4 Scalar_SW 0.0 CM_DegC_N256to256 -256.0 255.9921875 /end CHARACTERISTIC
/begin CHARACTERISTIC D_O21ShortDiagEnableDelay "cal comments" VALUE 0xBEE6 Scalar_UW 0.0 CM_Second_0to65535 0.0 65535.0 /end CHARACTERISTIC
/begin CHARACTERISTIC D_O21ShortDiagIGNVoltThrsh "cal comments" VALUE 0xBEE2 Scalar_UW 0.0 CM_Volt_0to32_1 0.0 31.99900627136231 /end CHARACTERISTIC
/begin CHARACTERISTIC D_O21ShortDiagPassTimeThrsh "cal comments" VALUE 0xBEF0 Scalar_UW 0.0 CM_Count_0to65535_1 0.0 65535.0 /end CHARACTERISTIC
/begin CHARACTERISTIC D_O21ShortDiagSingalFiltCoef "cal comments" VALUE 0xBEE0 Scalar_UW 0.0 CM_FiltCoef 0.0 0.9999847412109375 /end CHARACTERISTIC
/begin CHARACTERISTIC D_O21ShortEnb "cal comments" VALUE 0xBEF2 Scalar_UB 0.0 CM_Boolean6 0.0 255.0 /end CHARACTERISTIC
/begin CHARACTERISTIC D_O21ShortHighFailTimeThrsh "cal comments" VALUE 0xBEEE Scalar_UW 0.0 CM_Count_0to65535_1 0.0 65535.0 /end CHARACTERISTIC
/begin CHARACTERISTIC D_O21ShortLowFailTimeThrsh "cal comments" VALUE 0xBEEC Scalar_UW 0.0 CM_Count_0to65535_1 0.0 65535.0 /end CHARACTERISTIC
/begin CHARACTERISTIC D_O21ShortRangeThreshHi "cal comments" VALUE 0xBEEA Scalar_UW 0.0 CM_mVolt_2 0.0 1023.96875 /end CHARACTERISTIC
/begin CHARACTERISTIC D_O21ShortRangeThreshLo "cal comments" VALUE 0xBEE8 Scalar_UW 0.0 CM_mVolt_2 0.0 1023.96875 /end CHARACTERISTIC
/begin CHARACTERISTIC D_RO21ShortDiagCoolTempThrsh "cal comments" VALUE 0xBEFC Scalar_SW 0.0 CM_DegC_N256to256 -256.0 255.9921875 /end CHARACTERISTIC
/begin CHARACTERISTIC D_RO21ShortDiagEnableDelay "cal comments" VALUE 0xBEFE Scalar_UW 0.0 CM_Second_0to65535 0.0 65535.0 /end CHARACTERISTIC
/begin CHARACTERISTIC D_RO21ShortDiagIGNVoltThrsh "cal comments" VALUE 0xBEFA Scalar_UW 0.0 CM_Volt_0to32_1 0.0 31.99900627136231 /end CHARACTERISTIC
/begin CHARACTERISTIC D_RO21ShortDiagPassTimeThrsh "cal comments" VALUE 0xBF08 Scalar_UW 0.0 CM_Count_0to65535_1 0.0 65535.0 /end CHARACTERISTIC
/begin CHARACTERISTIC D_RO21ShortDiagSingalFiltCoef "cal comments" VALUE 0xBEF8 Scalar_UW 0.0 CM_FiltCoef 0.0 0.9999847412109375 /end CHARACTERISTIC
/begin CHARACTERISTIC D_RO21ShortEnb "cal comments" VALUE 0xBF0A Scalar_UB 0.0 CM_Boolean6 0.0 255.0 /end CHARACTERISTIC
/begin CHARACTERISTIC D_RO21ShortHighFailTimeThrsh "cal comments" VALUE 0xBF06 Scalar_UW 0.0 CM_Count_0to65535_1 0.0 65535.0 /end CHARACTERISTIC
/begin CHARACTERISTIC D_RO21ShortLowFailTimeThrsh "cal comments" VALUE 0xBF04 Scalar_UW 0.0 CM_Count_0to65535_1 0.0 65535.0 /end CHARACTERISTIC
/begin CHARACTERISTIC D_RO21ShortRangeThreshHi "cal comments" VALUE 0xBF02 Scalar_UW 0.0 CM_mVolt_2 0.0 1023.96875 /end CHARACTERISTIC
/begin CHARACTERISTIC D_RO21ShortRangeThreshLo "cal comments" VALUE 0xBF00 Scalar_UW 0.0 CM_mVolt_2 0.0 1023.96875 /end CHARACTERISTIC
/begin CHARACTERISTIC D_O2HeaterShortEnb "cal comments" VALUE 0xBF7A Scalar_UB 0.0 CM_Boolean6 0.0 255.0 /end CHARACTERISTIC
/begin CHARACTERISTIC D_O2HeaterShortFailThresh "cal comments" VALUE 0xBF7B Scalar_UB 0.0 CM_Count1 0.0 255.0 /end CHARACTERISTIC
/begin CHARACTERISTIC D_O2HeaterShortPassThresh "cal comments" VALUE 0xBF7C Scalar_UB 0.0 CM_Count1 0.0 255.0 /end CHARACTERISTIC
/begin CHARACTERISTIC D_RO2Heater1ShortEnb "cal comments" VALUE 0xBF81 Scalar_UB 0.0 CM_Boolean6 0.0 255.0 /end CHARACTERISTIC
/begin CHARACTERISTIC D_RO2Heater1ShortFailThresh "cal comments" VALUE 0xBF82 Scalar_UB 0.0 CM_Count1 0.0 255.0 /end CHARACTERISTIC
/begin CHARACTERISTIC D_RO2Heater1ShortPassThresh "cal comments" VALUE 0xBF83 Scalar_UB 0.0 CM_Count1 0.0 255.0 /end CHARACTERISTIC
/begin CHARACTERISTIC D_BSTCShortEnb "cal comments" VALUE 0xBFAB Scalar_UB 0.0 CM_Boolean6 0.0 255.0 /end CHARACTERISTIC
/begin CHARACTERISTIC D_BSTCShortFailThresh "cal comments" VALUE 0xBFAC Scalar_UB 0.0 CM_Count1 0.0 255.0 /end CHARACTERISTIC
/begin CHARACTERISTIC D_BSTCShortPassThresh "cal comments" VALUE 0xBFAD Scalar_UB 0.0 CM_Count1 0.0 255.0 /end CHARACTERISTIC
/begin CHARACTERISTIC D_REF1ShortEnb "cal comments" VALUE 0xBF9D Scalar_UB 0.0 CM_Boolean6 0.0 255.0 /end CHARACTERISTIC
/begin CHARACTERISTIC D_REF1ShortFailThresh "cal comments" VALUE 0xBF9E Scalar_UB 0.0 CM_Count1 0.0 255.0 /end CHARACTERISTIC
/begin CHARACTERISTIC D_REF1ShortPassThresh "cal comments" VALUE 0xBF9F Scalar_UB 0.0 CM_Count1 0.0 255.0 /end CHARACTERISTIC
/begin CHARACTERISTIC D_REF2ShortEnb "cal comments" VALUE 0xBFA4 Scalar_UB 0.0 CM_Boolean6 0.0 255.0 /end CHARACTERISTIC
/begin CHARACTERISTIC D_REF2ShortFailThresh "cal comments" VALUE 0xBFA5 Scalar_UB 0.0 CM_Count1 0.0 255.0 /end CHARACTERISTIC
/begin CHARACTERISTIC D_REF2ShortPassThresh "cal comments" VALUE 0xBFA6 Scalar_UB 0.0 CM_Count1 0.0 255.0 /end CHARACTERISTIC
/begin CHARACTERISTIC D_BLM_TrimEnb "cal comments" VALUE 0xBF10 Scalar_UB 0.0 CM_Boolean6 0.0 255.0 /end CHARACTERISTIC
/begin CHARACTERISTIC D_BLM_FailThresh "cal comments" VALUE 0xBF16 Scalar_UB 0.0 CM_Count1 0.0 255.0 /end CHARACTERISTIC
/begin CHARACTERISTIC D_BLM_PassThresh "cal comments" VALUE 0xBF17 Scalar_UB 0.0 CM_Count1 0.0 255.0 /end CHARACTERISTIC
/begin CHARACTERISTIC D_BLM_TrimHiLimit "cal comments" VALUE 0xBF12 Scalar_UW 0.0 CM_Ratio_0to2_2 0.0 1.999969482421875 /end CHARACTERISTIC
/begin CHARACTERISTIC D_BLM_TrimLoLimit "cal comments" VALUE 0xBF14 Scalar_UW 0.0 CM_Ratio_0to2_2 0.0 1.999969482421875 /end CHARACTERISTIC
/begin CHARACTERISTIC D_BLM_CellCntThresh "cal comments" VALUE 0xBF11 Scalar_UB 0.0 CM_Count1 0.0 255.0 /end CHARACTERISTIC
/begin CHARACTERISTIC D_FCV1ShortEnb "cal comments" VALUE 0xBF8F Scalar_UB 0.0 CM_Boolean6 0.0 255.0 /end CHARACTERISTIC
/begin CHARACTERISTIC D_IACVShortEnb "cal comments" VALUE 0xBF88 Scalar_UB 0.0 CM_Boolean6 0.0 255.0 /end CHARACTERISTIC
/begin CHARACTERISTIC D_IACVShortFailThresh "cal comments" VALUE 0xBF89 Scalar_UB 0.0 CM_Count1 0.0 255.0 /end CHARACTERISTIC
/begin CHARACTERISTIC D_IACVShortPassThresh "cal comments" VALUE 0xBF8A Scalar_UB 0.0 CM_Count1 0.0 255.0 /end CHARACTERISTIC
/begin CHARACTERISTIC D_FCV1ShortFailThresh "cal comments" VALUE 0xBF90 Scalar_UB 0.0 CM_Count1 0.0 255.0 /end CHARACTERISTIC
/begin CHARACTERISTIC D_FCV1ShortPassThresh "cal comments" VALUE 0xBF91 Scalar_UB 0.0 CM_Count1 0.0 255.0 /end CHARACTERISTIC
/begin CHARACTERISTIC D_FCV2ShortEnb "cal comments" VALUE 0xBF96 Scalar_UB 0.0 CM_Boolean6 0.0 255.0 /end CHARACTERISTIC
/begin CHARACTERISTIC D_FCV2ShortFailThresh "cal comments" VALUE 0xBF97 Scalar_UB 0.0 CM_Count1 0.0 255.0 /end CHARACTERISTIC
/begin CHARACTERISTIC D_FCV2ShortPassThresh "cal comments" VALUE 0xBF98 Scalar_UB 0.0 CM_Count1 0.0 255.0 /end CHARACTERISTIC
/begin CHARACTERISTIC D_OutputDiagEnableDelay "cal comments" VALUE 0xC039 Scalar_UB 0.0 CM_Second_0to32 0.0 31.875 /end CHARACTERISTIC
/begin CHARACTERISTIC D_SoftwareErrorEnb "cal comments" VALUE 0xC04E Scalar_UB 0.0 CM_Boolean6 0.0 255.0 /end CHARACTERISTIC
/begin CHARACTERISTIC D_SoftwareErrorFailTimeThrsh "cal comments" VALUE 0xC04A Scalar_UW 0.0 CM_Count_0to65535_2 0.0 65535.0 /end CHARACTERISTIC
/begin CHARACTERISTIC D_SoftwareErrorPassTimeThrsh "cal comments" VALUE 0xC04C Scalar_UW 0.0 CM_Count_0to65535_2 0.0 65535.0 /end CHARACTERISTIC
/begin CHARACTERISTIC D_FPFeedbackInputEnb "cal comments" VALUE 0xBF52 Scalar_UB 0.0 CM_Boolean6 0.0 255.0 /end CHARACTERISTIC
/begin CHARACTERISTIC D_FPFeedbackShortFailThresh "cal comments" VALUE 0xBF50 Scalar_UB 0.0 CM_Count3 0.0 255.0 /end CHARACTERISTIC
/begin CHARACTERISTIC D_FPFeedbackShortPassThresh "cal comments" VALUE 0xBF51 Scalar_UB 0.0 CM_Count3 0.0 255.0 /end CHARACTERISTIC
/begin CHARACTERISTIC D_OilPressureInputEnb "cal comments" VALUE 0xC034 Scalar_UB 0.0 CM_Boolean6 0.0 255.0 /end CHARACTERISTIC
/begin CHARACTERISTIC D_OilPressureShortFailThresh "cal comments" VALUE 0xC032 Scalar_UB 0.0 CM_Count3 0.0 255.0 /end CHARACTERISTIC
/begin CHARACTERISTIC D_OilPressureShortPassThresh "cal comments" VALUE 0xC033 Scalar_UB 0.0 CM_Count3 0.0 255.0 /end CHARACTERISTIC
/begin CHARACTERISTIC D_OilPressureShortDiagRunTimeThrsh "cal comments" VALUE 0xC031 Scalar_UB 0.0 CM_Count3 0.0 255.0 /end CHARACTERISTIC
/begin CHARACTERISTIC D_OilSWLowActive "cal comments" VALUE 0xC035 Scalar_UB 0.0 CM_Boolean6 0.0 255.0 /end CHARACTERISTIC
/begin CHARACTERISTIC D_OilSWDiagDucar "cal comments" VALUE 0xC036 Scalar_UB 0.0 CM_Boolean6 0.0 255.0 /end CHARACTERISTIC
/begin CHARACTERISTIC D_SpkCoilShortFailThresh "cal comments" CURVE 0xC03A 2D_Array_UB 0.0 CM_Count1 0.0 255.0
 /begin AXIS_DESCR FIX_AXIS NO_INPUT_QUANTITY CM_EOI 4 0.0 4.0 MAX_GRAD 0.0 /begin FIX_AXIS_PAR_LIST 0 1 2 3 /end FIX_AXIS_PAR_LIST /end AXIS_DESCR
/end CHARACTERISTIC
/begin CHARACTERISTIC D_SpkCoilShortPassThresh "cal comments" CURVE 0xC03E 2D_Array_UB 0.0 CM_Count1 0.0 255.0
 /begin AXIS_DESCR FIX_AXIS NO_INPUT_QUANTITY CM_EOI 4 0.0 4.0 MAX_GRAD 0.0 /begin FIX_AXIS_PAR_LIST 0 1 2 3 /end FIX_AXIS_PAR_LIST /end AXIS_DESCR
/end CHARACTERISTIC
/begin CHARACTERISTIC D_TPSMotorControlEnb "cal comments" VALUE 0xBFB2 Scalar_UB 0.0 CM_Boolean6 0.0 255.0 /end CHARACTERISTIC
/begin CHARACTERISTIC D_TPSMotorDiagFailTimeThresh "cal comments" VALUE 0xBFB4 Scalar_UW 0.0 CM_Count_0to65535_1 0.0 65535.0 /end CHARACTERISTIC
/begin CHARACTERISTIC D_TPSMotorDiagPassTimeThresh "cal comments" VALUE 0xBFB6 Scalar_UW 0.0 CM_Count_0to65535_1 0.0 65535.0 /end CHARACTERISTIC
/begin CHARACTERISTIC D_TPSMotorDiagTPSErrThresh "cal comments" VALUE 0xBFBC Scalar_UW 0.0 CM_Percent_0to200_2 0.0 199.9969024658203 /end CHARACTERISTIC
/begin CHARACTERISTIC D_TPSMotorDynErrThrDecayStep "cal comments" VALUE 0xBFBA Scalar_UW 0.0 CM_Percent_0to200_2 0.0 199.9969024658203 /end CHARACTERISTIC
/begin CHARACTERISTIC D_TPSMotorDynErrThrshGain "cal comments" VALUE 0xBFB8 Scalar_UW 0.0 udf_CM_18376 0.0 15.999755859375 /end CHARACTERISTIC
/begin CHARACTERISTIC D_FCVMotorControlEnb "cal comments" VALUE 0xBF6C Scalar_UB 0.0 CM_Boolean6 0.0 255.0 /end CHARACTERISTIC
/begin CHARACTERISTIC D_FCVMotorDiagFailTimeThresh "cal comments" VALUE 0xBF6E Scalar_UW 0.0 CM_Count_0to65535_1 0.0 65535.0 /end CHARACTERISTIC
/begin CHARACTERISTIC D_FCVMotorDiagPassTimeThresh "cal comments" VALUE 0xBF70 Scalar_UW 0.0 CM_Count_0to65535_1 0.0 65535.0 /end CHARACTERISTIC
/begin CHARACTERISTIC D_FCVMotorDiagFCVPSErrThresh "cal comments" VALUE 0xBF76 Scalar_UW 0.0 CM_Percent_0to200_2 0.0 199.9969024658203 /end CHARACTERISTIC
/begin CHARACTERISTIC D_FCVMotorDynErrThrDecayStep "cal comments" VALUE 0xBF74 Scalar_UW 0.0 CM_Percent_0to200_2 0.0 199.9969024658203 /end CHARACTERISTIC
/begin CHARACTERISTIC D_FCVMotorDynErrThrshGain "cal comments" VALUE 0xBF72 Scalar_UW 0.0 udf_CM_18376 0.0 15.999755859375 /end CHARACTERISTIC
/begin CHARACTERISTIC D_SWLOnMinDuration "cal comments" VALUE 0xBEB7 Scalar_UB 0.0 CM_Second_0to32 0.0 31.0 /end CHARACTERISTIC
/begin CHARACTERISTIC D_IGNOffInitDDMS "cal comments" VALUE 0xBEB8 Scalar_UB 0.0 CM_Boolean1 0.0 1.0 /end CHARACTERISTIC
/begin CHARACTERISTIC D_StopLightKillEn "cal comments" VALUE 0xBEB9 Scalar_UB 0.0 CM_Boolean1 0.0 1.0 /end CHARACTERISTIC
/begin CHARACTERISTIC D_ProtectLightKillEn "cal comments" VALUE 0xBEBA Scalar_UB 0.0 CM_Boolean1 0.0 1.0 /end CHARACTERISTIC
/begin CHARACTERISTIC D_MilLightMode "cal comments" VALUE 0xBEBB Scalar_UB 0.0 CM_Count1 0.0 255.0 /end CHARACTERISTIC
/begin CHARACTERISTIC D_O21ShortLoLightType "cal comments" VALUE 0xBEF3 Scalar_UB 0.0 CM_LIGHT_TYPE 0.0 4.0 /end CHARACTERISTIC
/begin CHARACTERISTIC D_O21ShortHiLightType "cal comments" VALUE 0xBEF4 Scalar_UB 0.0 CM_LIGHT_TYPE 0.0 4.0 /end CHARACTERISTIC
/begin CHARACTERISTIC D_RO21ShortLoLightType "cal comments" VALUE 0xBF0B Scalar_UB 0.0 CM_LIGHT_TYPE 0.0 4.0 /end CHARACTERISTIC
/begin CHARACTERISTIC D_RO21ShortHiLightType "cal comments" VALUE 0xBF0C Scalar_UB 0.0 CM_LIGHT_TYPE 0.0 4.0 /end CHARACTERISTIC
/begin CHARACTERISTIC D_O2HeaterShortLoLightType "cal comments" VALUE 0xBF7D Scalar_UB 0.0 CM_LIGHT_TYPE 0.0 4.0 /end CHARACTERISTIC
/begin CHARACTERISTIC D_O2HeaterShortHiLightType "cal comments" VALUE 0xBF7E Scalar_UB 0.0 CM_LIGHT_TYPE 0.0 4.0 /end CHARACTERISTIC
/begin CHARACTERISTIC D_RO2Heater1ShortLoLightType "cal comments" VALUE 0xBF84 Scalar_UB 0.0 CM_LIGHT_TYPE 0.0 4.0 /end CHARACTERISTIC
/begin CHARACTERISTIC D_RO2Heater1ShortHiLightType "cal comments" VALUE 0xBF85 Scalar_UB 0.0 CM_LIGHT_TYPE 0.0 4.0 /end CHARACTERISTIC
/begin CHARACTERISTIC D_CoolTempShortLoLightType "cal comments" VALUE 0xBED7 Scalar_UB 0.0 CM_LIGHT_TYPE 0.0 4.0 /end CHARACTERISTIC
/begin CHARACTERISTIC D_CoolTempShortHiLightType "cal comments" VALUE 0xBED8 Scalar_UB 0.0 CM_LIGHT_TYPE 0.0 4.0 /end CHARACTERISTIC
/begin CHARACTERISTIC D_CoolTempOH1LightType "cal comments" VALUE 0xBED9 Scalar_UB 0.0 CM_LIGHT_TYPE 0.0 4.0 /end CHARACTERISTIC
/begin CHARACTERISTIC D_CoolTempOH2LightType "cal comments" VALUE 0xBEDA Scalar_UB 0.0 CM_LIGHT_TYPE 0.0 4.0 /end CHARACTERISTIC
/begin CHARACTERISTIC D_IntakeAirTempShortLoLightType "cal comments" VALUE 0xBFD1 Scalar_UB 0.0 CM_LIGHT_TYPE 0.0 4.0 /end CHARACTERISTIC
/begin CHARACTERISTIC D_IntakeAirTempShortHiLightType "cal comments" VALUE 0xBFD2 Scalar_UB 0.0 CM_LIGHT_TYPE 0.0 4.0 /end CHARACTERISTIC
/begin CHARACTERISTIC D_IntakeAirTempOH1LightType "cal comments" VALUE 0xBFD3 Scalar_UB 0.0 CM_LIGHT_TYPE 0.0 4.0 /end CHARACTERISTIC
/begin CHARACTERISTIC D_IntakeAirTempOH2LightType "cal comments" VALUE 0xBFD4 Scalar_UB 0.0 CM_LIGHT_TYPE 0.0 4.0 /end CHARACTERISTIC
/begin CHARACTERISTIC D_SCIShortLoLightType "cal comments" VALUE 0xBFE3 Scalar_UB 0.0 CM_LIGHT_TYPE 0.0 4.0 /end CHARACTERISTIC
/begin CHARACTERISTIC D_SCIShortHiLightType "cal comments" VALUE 0xBFE4 Scalar_UB 0.0 CM_LIGHT_TYPE 0.0 4.0 /end CHARACTERISTIC
/begin CHARACTERISTIC D_BSTPShortLoLightType "cal comments" VALUE 0xC007 Scalar_UB 0.0 CM_LIGHT_TYPE 0.0 4.0 /end CHARACTERISTIC
/begin CHARACTERISTIC D_BSTPShortHiLightType "cal comments" VALUE 0xC008 Scalar_UB 0.0 CM_LIGHT_TYPE 0.0 4.0 /end CHARACTERISTIC
/begin CHARACTERISTIC D_BSTCShortLoLightType "cal comments" VALUE 0xBFAE Scalar_UB 0.0 CM_LIGHT_TYPE 0.0 4.0 /end CHARACTERISTIC
/begin CHARACTERISTIC D_BSTCShortHiLightType "cal comments" VALUE 0xBFAF Scalar_UB 0.0 CM_LIGHT_TYPE 0.0 4.0 /end CHARACTERISTIC
/begin CHARACTERISTIC D_MAPShortLoLightType "cal comments" VALUE 0xC02D Scalar_UB 0.0 CM_LIGHT_TYPE 0.0 4.0 /end CHARACTERISTIC
/begin CHARACTERISTIC D_MAPShortHiLightType "cal comments" VALUE 0xC02E Scalar_UB 0.0 CM_LIGHT_TYPE 0.0 4.0 /end CHARACTERISTIC
/begin CHARACTERISTIC D_FPShortLoLightType "cal comments" VALUE 0xBF63 Scalar_UB 0.0 CM_LIGHT_TYPE 0.0 4.0 /end CHARACTERISTIC
/begin CHARACTERISTIC D_FPShortHiLightType "cal comments" VALUE 0xBF64 Scalar_UB 0.0 CM_LIGHT_TYPE 0.0 4.0 /end CHARACTERISTIC
/begin CHARACTERISTIC D_FPLoLightType "cal comments" VALUE 0xBF66 Scalar_UB 0.0 CM_LIGHT_TYPE 0.0 4.0 /end CHARACTERISTIC
/begin CHARACTERISTIC D_FPHiLightType "cal comments" VALUE 0xBF65 Scalar_UB 0.0 CM_LIGHT_TYPE 0.0 4.0 /end CHARACTERISTIC
/begin CHARACTERISTIC D_OilPressureLightType "cal comments" VALUE 0xC037 Scalar_UB 0.0 CM_LIGHT_TYPE 0.0 4.0 /end CHARACTERISTIC
/begin CHARACTERISTIC D_TPSShortLoLightType "cal comments" VALUE 0xC05D Scalar_UB 0.0 CM_LIGHT_TYPE 0.0 4.0 /end CHARACTERISTIC
/begin CHARACTERISTIC D_TPSShortHiLightType "cal comments" VALUE 0xC05E Scalar_UB 0.0 CM_LIGHT_TYPE 0.0 4.0 /end CHARACTERISTIC
/begin CHARACTERISTIC D_DCMShortLoLightType "cal comments" VALUE 0xBEB3 Scalar_UB 0.0 CM_LIGHT_TYPE 0.0 4.0 /end CHARACTERISTIC
/begin CHARACTERISTIC D_DCMShortHiLightType "cal comments" VALUE 0xBEB4 Scalar_UB 0.0 CM_LIGHT_TYPE 0.0 4.0 /end CHARACTERISTIC
/begin CHARACTERISTIC D_TPSMotorControlLightType "cal comments" VALUE 0xBFBE Scalar_UB 0.0 CM_LIGHT_TYPE 0.0 4.0 /end CHARACTERISTIC
/begin CHARACTERISTIC D_FCVPSShortLoLightType "cal comments" VALUE 0xC06B Scalar_UB 0.0 CM_LIGHT_TYPE 0.0 4.0 /end CHARACTERISTIC
/begin CHARACTERISTIC D_FCVPSShortHiLightType "cal comments" VALUE 0xC06C Scalar_UB 0.0 CM_LIGHT_TYPE 0.0 4.0 /end CHARACTERISTIC
/begin CHARACTERISTIC D_FCVMShortLoLightType "cal comments" VALUE 0xBEBC Scalar_UB 0.0 CM_LIGHT_TYPE 0.0 4.0 /end CHARACTERISTIC
/begin CHARACTERISTIC D_FCVMShortHiLightType "cal comments" VALUE 0xBEBD Scalar_UB 0.0 CM_LIGHT_TYPE 0.0 4.0 /end CHARACTERISTIC
/begin CHARACTERISTIC D_FCVMotorControlLightType "cal comments" VALUE 0xBF78 Scalar_UB 0.0 CM_LIGHT_TYPE 0.0 4.0 /end CHARACTERISTIC
/begin CHARACTERISTIC D_FCV1ShortLoLightType "cal comments" VALUE 0xBF92 Scalar_UB 0.0 CM_LIGHT_TYPE 0.0 4.0 /end CHARACTERISTIC
/begin CHARACTERISTIC D_FCV1ShortHiLightType "cal comments" VALUE 0xBF93 Scalar_UB 0.0 CM_LIGHT_TYPE 0.0 4.0 /end CHARACTERISTIC
/begin CHARACTERISTIC D_FCV2ShortLoLightType "cal comments" VALUE 0xBF99 Scalar_UB 0.0 CM_LIGHT_TYPE 0.0 4.0 /end CHARACTERISTIC
/begin CHARACTERISTIC D_FCV2ShortHiLightType "cal comments" VALUE 0xBF9A Scalar_UB 0.0 CM_LIGHT_TYPE 0.0 4.0 /end CHARACTERISTIC
/begin CHARACTERISTIC D_REF1ShortLoLightType "cal comments" VALUE 0xBFA0 Scalar_UB 0.0 CM_LIGHT_TYPE 0.0 4.0 /end CHARACTERISTIC
/begin CHARACTERISTIC D_REF1ShortHiLightType "cal comments" VALUE 0xBFA1 Scalar_UB 0.0 CM_LIGHT_TYPE 0.0 4.0 /end CHARACTERISTIC
/begin CHARACTERISTIC D_REF2ShortLoLightType "cal comments" VALUE 0xBFA7 Scalar_UB 0.0 CM_LIGHT_TYPE 0.0 4.0 /end CHARACTERISTIC
/begin CHARACTERISTIC D_REF2ShortHiLightType "cal comments" VALUE 0xBFA8 Scalar_UB 0.0 CM_LIGHT_TYPE 0.0 4.0 /end CHARACTERISTIC
/begin CHARACTERISTIC D_BLM_TrimLoLightType "cal comments" VALUE 0xBF18 Scalar_UB 0.0 CM_LIGHT_TYPE 0.0 4.0 /end CHARACTERISTIC
/begin CHARACTERISTIC D_BLM_TrimHiLightType "cal comments" VALUE 0xBF19 Scalar_UB 0.0 CM_LIGHT_TYPE 0.0 4.0 /end CHARACTERISTIC
/begin CHARACTERISTIC D_IgnitionCoil1LoLightType "cal comments" VALUE 0xBF36 Scalar_UB 0.0 CM_LIGHT_TYPE 0.0 4.0 /end CHARACTERISTIC
/begin CHARACTERISTIC D_IgnitionCoil1HiLightType "cal comments" VALUE 0xBF37 Scalar_UB 0.0 CM_LIGHT_TYPE 0.0 4.0 /end CHARACTERISTIC
/begin CHARACTERISTIC D_IgnitionCoil2LoLightType "cal comments" VALUE 0xBF38 Scalar_UB 0.0 CM_LIGHT_TYPE 0.0 4.0 /end CHARACTERISTIC
/begin CHARACTERISTIC D_IgnitionCoil2HiLightType "cal comments" VALUE 0xBF39 Scalar_UB 0.0 CM_LIGHT_TYPE 0.0 4.0 /end CHARACTERISTIC
/begin CHARACTERISTIC D_IgnitionCoil3LoLightType "cal comments" VALUE 0xBF3A Scalar_UB 0.0 CM_LIGHT_TYPE 0.0 4.0 /end CHARACTERISTIC
/begin CHARACTERISTIC D_IgnitionCoil3HiLightType "cal comments" VALUE 0xBF3B Scalar_UB 0.0 CM_LIGHT_TYPE 0.0 4.0 /end CHARACTERISTIC
/begin CHARACTERISTIC D_IgnitionCoil4LoLightType "cal comments" VALUE 0xBF3C Scalar_UB 0.0 CM_LIGHT_TYPE 0.0 4.0 /end CHARACTERISTIC
/begin CHARACTERISTIC D_IgnitionCoil4HiLightType "cal comments" VALUE 0xBF3D Scalar_UB 0.0 CM_LIGHT_TYPE 0.0 4.0 /end CHARACTERISTIC
/begin CHARACTERISTIC D_InjectorCyl1LoLightType "cal comments" VALUE 0xC00F Scalar_UB 0.0 CM_LIGHT_TYPE 0.0 4.0 /end CHARACTERISTIC
/begin CHARACTERISTIC D_InjectorCyl1HiLoLightType "cal comments" VALUE 0xC010 Scalar_UB 0.0 CM_LIGHT_TYPE 0.0 4.0 /end CHARACTERISTIC
/begin CHARACTERISTIC D_InjectorCyl2LoLightType "cal comments" VALUE 0xC011 Scalar_UB 0.0 CM_LIGHT_TYPE 0.0 4.0 /end CHARACTERISTIC
/begin CHARACTERISTIC D_InjectorCyl2HiLoLightType "cal comments" VALUE 0xC012 Scalar_UB 0.0 CM_LIGHT_TYPE 0.0 4.0 /end CHARACTERISTIC
/begin CHARACTERISTIC D_InjectorCyl3LoLightType "cal comments" VALUE 0xC013 Scalar_UB 0.0 CM_LIGHT_TYPE 0.0 4.0 /end CHARACTERISTIC
/begin CHARACTERISTIC D_InjectorCyl3HiLoLightType "cal comments" VALUE 0xC014 Scalar_UB 0.0 CM_LIGHT_TYPE 0.0 4.0 /end CHARACTERISTIC
/begin CHARACTERISTIC D_InjectorCyl4LoLightType "cal comments" VALUE 0xC015 Scalar_UB 0.0 CM_LIGHT_TYPE 0.0 4.0 /end CHARACTERISTIC
/begin CHARACTERISTIC D_InjectorCyl4HiLoLightType "cal comments" VALUE 0xC016 Scalar_UB 0.0 CM_LIGHT_TYPE 0.0 4.0 /end CHARACTERISTIC
/begin CHARACTERISTIC D_CrankSignalLossLightType "cal comments" VALUE 0xBF2B Scalar_UB 0.0 CM_LIGHT_TYPE 0.0 4.0 /end CHARACTERISTIC
/begin CHARACTERISTIC D_CrankSignalNoiseLightType "cal comments" VALUE 0xBF2C Scalar_UB 0.0 CM_LIGHT_TYPE 0.0 4.0 /end CHARACTERISTIC
/begin CHARACTERISTIC D_BatVoltLoLightType "cal comments" VALUE 0xC089 Scalar_UB 0.0 CM_LIGHT_TYPE 0.0 4.0 /end CHARACTERISTIC
/begin CHARACTERISTIC D_BatVoltHiLightType "cal comments" VALUE 0xC08A Scalar_UB 0.0 CM_LIGHT_TYPE 0.0 4.0 /end CHARACTERISTIC
/begin CHARACTERISTIC D_Knock1SignalLightType "cal comments" VALUE 0xBEBE Scalar_UB 0.0 CM_LIGHT_TYPE 0.0 4.0 /end CHARACTERISTIC
/begin CHARACTERISTIC D_Knock2SignalLightType "cal comments" VALUE 0xBEBF Scalar_UB 0.0 CM_LIGHT_TYPE 0.0 4.0 /end CHARACTERISTIC
/begin CHARACTERISTIC D_IACVShortLoLightType "cal comments" VALUE 0xBF8B Scalar_UB 0.0 CM_LIGHT_TYPE 0.0 4.0 /end CHARACTERISTIC
/begin CHARACTERISTIC D_IACVShortHiLightType "cal comments" VALUE 0xBF8C Scalar_UB 0.0 CM_LIGHT_TYPE 0.0 4.0 /end CHARACTERISTIC
/begin CHARACTERISTIC D_FuelPumpShortLoLightType "cal comments" VALUE 0xBF4C Scalar_UB 0.0 CM_LIGHT_TYPE 0.0 4.0 /end CHARACTERISTIC
/begin CHARACTERISTIC D_FuelPumpShortHiLightType "cal comments" VALUE 0xBF4D Scalar_UB 0.0 CM_LIGHT_TYPE 0.0 4.0 /end CHARACTERISTIC
/begin CHARACTERISTIC D_FPFeedbackLightType "cal comments" VALUE 0xBF53 Scalar_UB 0.0 CM_LIGHT_TYPE 0.0 4.0 /end CHARACTERISTIC
/begin CHARACTERISTIC D_CCPShortLoLightType "cal comments" VALUE 0x0 Scalar_UB 0.0 CM_LIGHT_TYPE 0.0 4.0 /end CHARACTERISTIC
/begin CHARACTERISTIC D_CCPShortHiLightType "cal comments" VALUE 0x0 Scalar_UB 0.0 CM_LIGHT_TYPE 0.0 4.0 /end CHARACTERISTIC
/begin CHARACTERISTIC D_SoftwareErrorLightType "cal comments" VALUE 0xC04F Scalar_UB 0.0 CM_LIGHT_TYPE 0.0 4.0 /end CHARACTERISTIC
/begin CHARACTERISTIC D_ACSShortLoLightType "cal comments" VALUE 0xBFF5 Scalar_UB 0.0 CM_LIGHT_TYPE 0.0 4.0 /end CHARACTERISTIC
/begin CHARACTERISTIC D_ACSShortHiLightType "cal comments" VALUE 0xBFF6 Scalar_UB 0.0 CM_LIGHT_TYPE 0.0 4.0 /end CHARACTERISTIC
/begin CHARACTERISTIC D_WPSShortLoLightType "cal comments" VALUE 0x0 Scalar_UB 0.0 CM_LIGHT_TYPE 0.0 4.0 /end CHARACTERISTIC
/begin CHARACTERISTIC D_WPSShortHiLightType "cal comments" VALUE 0x0 Scalar_UB 0.0 CM_LIGHT_TYPE 0.0 4.0 /end CHARACTERISTIC
/begin CHARACTERISTIC D_GENVLoLightType "cal comments" VALUE 0x0 Scalar_UB 0.0 CM_LIGHT_TYPE 0.0 4.0 /end CHARACTERISTIC
/begin CHARACTERISTIC D_GENVHiLightType "cal comments" VALUE 0x0 Scalar_UB 0.0 CM_LIGHT_TYPE 0.0 4.0 /end CHARACTERISTIC
/begin CHARACTERISTIC D_COSLightType "cal comments" VALUE 0xC077 Scalar_UB 0.0 CM_LIGHT_TYPE 0.0 4.0 /end CHARACTERISTIC
/begin CHARACTERISTIC D_COALightType "cal comments" VALUE 0xC07C Scalar_UB 0.0 CM_LIGHT_TYPE 0.0 4.0 /end CHARACTERISTIC
/begin CHARACTERISTIC D_O21ShortLoFMIType "cal comments" VALUE 0xBEF5 Scalar_UB 0.0 CM_Count1 0.0 255.0 /end CHARACTERISTIC
/begin CHARACTERISTIC D_O21ShortHiFMIType "cal comments" VALUE 0xBEF6 Scalar_UB 0.0 CM_Count1 0.0 255.0 /end CHARACTERISTIC
/begin CHARACTERISTIC D_RO21ShortLoFMIType "cal comments" VALUE 0xBF0D Scalar_UB 0.0 CM_Count1 0.0 255.0 /end CHARACTERISTIC
/begin CHARACTERISTIC D_RO21ShortHiFMIType "cal comments" VALUE 0xBF0E Scalar_UB 0.0 CM_Count1 0.0 255.0 /end CHARACTERISTIC
/begin CHARACTERISTIC D_O2HeaterShortLoFMIType "cal comments" VALUE 0xBF7F Scalar_UB 0.0 CM_Count1 0.0 255.0 /end CHARACTERISTIC
/begin CHARACTERISTIC D_O2HeaterShortHiFMIType "cal comments" VALUE 0xBF80 Scalar_UB 0.0 CM_Count1 0.0 255.0 /end CHARACTERISTIC
/begin CHARACTERISTIC D_RO2Heater1ShortLoFMIType "cal comments" VALUE 0xBF86 Scalar_UB 0.0 CM_Count1 0.0 255.0 /end CHARACTERISTIC
/begin CHARACTERISTIC D_RO2Heater1ShortHiFMIType "cal comments" VALUE 0xBF87 Scalar_UB 0.0 CM_Count1 0.0 255.0 /end CHARACTERISTIC
/begin CHARACTERISTIC D_CoolTempShortLoFMIType "cal comments" VALUE 0xBEDB Scalar_UB 0.0 CM_Count1 0.0 255.0 /end CHARACTERISTIC
/begin CHARACTERISTIC D_CoolTempShortHiFMIType "cal comments" VALUE 0xBEDC Scalar_UB 0.0 CM_Count1 0.0 255.0 /end CHARACTERISTIC
/begin CHARACTERISTIC D_CoolTempOH1FMIType "cal comments" VALUE 0xBEDD Scalar_UB 0.0 CM_Count1 0.0 255.0 /end CHARACTERISTIC
/begin CHARACTERISTIC D_CoolTempOH2FMIType "cal comments" VALUE 0xBEDE Scalar_UB 0.0 CM_Count1 0.0 255.0 /end CHARACTERISTIC
/begin CHARACTERISTIC D_IntakeAirTempShortLoFMIType "cal comments" VALUE 0xBFD5 Scalar_UB 0.0 CM_Count1 0.0 255.0 /end CHARACTERISTIC
/begin CHARACTERISTIC D_IntakeAirTempShortHiFMIType "cal comments" VALUE 0xBFD6 Scalar_UB 0.0 CM_Count1 0.0 255.0 /end CHARACTERISTIC
/begin CHARACTERISTIC D_IntakeAirTempOH1FMIType "cal comments" VALUE 0xBFD7 Scalar_UB 0.0 CM_Count1 0.0 255.0 /end CHARACTERISTIC
/begin CHARACTERISTIC D_IntakeAirTempOH2FMIType "cal comments" VALUE 0xBFD8 Scalar_UB 0.0 CM_Count1 0.0 255.0 /end CHARACTERISTIC
/begin CHARACTERISTIC D_SCIShortLoFMIType "cal comments" VALUE 0xBFE5 Scalar_UB 0.0 CM_Count1 0.0 255.0 /end CHARACTERISTIC
/begin CHARACTERISTIC D_SCIShortHiFMIType "cal comments" VALUE 0xBFE6 Scalar_UB 0.0 CM_Count1 0.0 255.0 /end CHARACTERISTIC
/begin CHARACTERISTIC D_BSTPShortLoFMIType "cal comments" VALUE 0xC009 Scalar_UB 0.0 CM_Count1 0.0 255.0 /end CHARACTERISTIC
/begin CHARACTERISTIC D_BSTPShortHiFMIType "cal comments" VALUE 0xC00A Scalar_UB 0.0 CM_Count1 0.0 255.0 /end CHARACTERISTIC
/begin CHARACTERISTIC D_BSTCShortLoFMIType "cal comments" VALUE 0xBFB0 Scalar_UB 0.0 CM_Count1 0.0 255.0 /end CHARACTERISTIC
/begin CHARACTERISTIC D_BSTCShortHiFMIType "cal comments" VALUE 0xBFB1 Scalar_UB 0.0 CM_Count1 0.0 255.0 /end CHARACTERISTIC
/begin CHARACTERISTIC D_MAPShortLoFMIType "cal comments" VALUE 0xC02F Scalar_UB 0.0 CM_Count1 0.0 255.0 /end CHARACTERISTIC
/begin CHARACTERISTIC D_MAPShortHiFMIType "cal comments" VALUE 0xC030 Scalar_UB 0.0 CM_Count1 0.0 255.0 /end CHARACTERISTIC
/begin CHARACTERISTIC D_FPShortLoFMIType "cal comments" VALUE 0xBF67 Scalar_UB 0.0 CM_Count1 0.0 255.0 /end CHARACTERISTIC
/begin CHARACTERISTIC D_FPShortHiFMIType "cal comments" VALUE 0xBF68 Scalar_UB 0.0 CM_Count1 0.0 255.0 /end CHARACTERISTIC
/begin CHARACTERISTIC D_FPLoFMIType "cal comments" VALUE 0xBF69 Scalar_UB 0.0 CM_Count1 0.0 255.0 /end CHARACTERISTIC
/begin CHARACTERISTIC D_FPHiFMIType "cal comments" VALUE 0xBF6A Scalar_UB 0.0 CM_Count1 0.0 255.0 /end CHARACTERISTIC
/begin CHARACTERISTIC D_OilPressureFMIType "cal comments" VALUE 0xC038 Scalar_UB 0.0 CM_Count1 0.0 255.0 /end CHARACTERISTIC
/begin CHARACTERISTIC D_TPSShortLoFMIType "cal comments" VALUE 0xC05F Scalar_UB 0.0 CM_Count1 0.0 255.0 /end CHARACTERISTIC
/begin CHARACTERISTIC D_TPSShortHiFMIType "cal comments" VALUE 0xC060 Scalar_UB 0.0 CM_Count1 0.0 255.0 /end CHARACTERISTIC
/begin CHARACTERISTIC D_DCMShortLoFMIType "cal comments" VALUE 0xBEB5 Scalar_UB 0.0 CM_Count1 0.0 255.0 /end CHARACTERISTIC
/begin CHARACTERISTIC D_DCMShortHiFMIType "cal comments" VALUE 0xBEB6 Scalar_UB 0.0 CM_Count1 0.0 255.0 /end CHARACTERISTIC
/begin CHARACTERISTIC D_TPSMotorControlFMIType "cal comments" VALUE 0xBFBF Scalar_UB 0.0 CM_Count1 0.0 255.0 /end CHARACTERISTIC
/begin CHARACTERISTIC D_FCVPSShortLoFMIType "cal comments" VALUE 0xC06D Scalar_UB 0.0 CM_Count1 0.0 255.0 /end CHARACTERISTIC
/begin CHARACTERISTIC D_FCVPSShortHiFMIType "cal comments" VALUE 0xC06E Scalar_UB 0.0 CM_Count1 0.0 255.0 /end CHARACTERISTIC
/begin CHARACTERISTIC D_FCVMShortLoFMIType "cal comments" VALUE 0xBEC0 Scalar_UB 0.0 CM_Count1 0.0 255.0 /end CHARACTERISTIC
/begin CHARACTERISTIC D_FCVMShortHiFMIType "cal comments" VALUE 0xBEC1 Scalar_UB 0.0 CM_Count1 0.0 255.0 /end CHARACTERISTIC
/begin CHARACTERISTIC D_FCVMotorControlFMIType "cal comments" VALUE 0xBF79 Scalar_UB 0.0 CM_Count1 0.0 255.0 /end CHARACTERISTIC
/begin CHARACTERISTIC D_FCV1ShortLoFMIType "cal comments" VALUE 0xBF94 Scalar_UB 0.0 CM_Count1 0.0 255.0 /end CHARACTERISTIC
/begin CHARACTERISTIC D_FCV1ShortHiFMIType "cal comments" VALUE 0xBF95 Scalar_UB 0.0 CM_Count1 0.0 255.0 /end CHARACTERISTIC
/begin CHARACTERISTIC D_FCV2ShortLoFMIType "cal comments" VALUE 0xBF9B Scalar_UB 0.0 CM_Count1 0.0 255.0 /end CHARACTERISTIC
/begin CHARACTERISTIC D_FCV2ShortHiFMIType "cal comments" VALUE 0xBF9C Scalar_UB 0.0 CM_Count1 0.0 255.0 /end CHARACTERISTIC
/begin CHARACTERISTIC D_REF1ShortLoFMIType "cal comments" VALUE 0xBFA2 Scalar_UB 0.0 CM_Count1 0.0 255.0 /end CHARACTERISTIC
/begin CHARACTERISTIC D_REF1ShortHiFMIType "cal comments" VALUE 0xBFA3 Scalar_UB 0.0 CM_Count1 0.0 255.0 /end CHARACTERISTIC
/begin CHARACTERISTIC D_REF2ShortLoFMIType "cal comments" VALUE 0xBFA9 Scalar_UB 0.0 CM_Count1 0.0 255.0 /end CHARACTERISTIC
/begin CHARACTERISTIC D_REF2ShortHiFMIType "cal comments" VALUE 0xBFAA Scalar_UB 0.0 CM_Count1 0.0 255.0 /end CHARACTERISTIC
/begin CHARACTERISTIC D_BLM_TrimLoFMIType "cal comments" VALUE 0xBF1A Scalar_UB 0.0 CM_Count1 0.0 255.0 /end CHARACTERISTIC
/begin CHARACTERISTIC D_BLM_TrimHiFMIType "cal comments" VALUE 0xBF1B Scalar_UB 0.0 CM_Count1 0.0 255.0 /end CHARACTERISTIC
/begin CHARACTERISTIC D_IgnitionCoil1LoFMIType "cal comments" VALUE 0xBF3E Scalar_UB 0.0 CM_Count1 0.0 255.0 /end CHARACTERISTIC
/begin CHARACTERISTIC D_IgnitionCoil1HiFMIType "cal comments" VALUE 0xBF3F Scalar_UB 0.0 CM_Count1 0.0 255.0 /end CHARACTERISTIC
/begin CHARACTERISTIC D_IgnitionCoil2LoFMIType "cal comments" VALUE 0xBF40 Scalar_UB 0.0 CM_Count1 0.0 255.0 /end CHARACTERISTIC
/begin CHARACTERISTIC D_IgnitionCoil2HiFMIType "cal comments" VALUE 0xBF41 Scalar_UB 0.0 CM_Count1 0.0 255.0 /end CHARACTERISTIC
/begin CHARACTERISTIC D_IgnitionCoil3LoFMIType "cal comments" VALUE 0xBF42 Scalar_UB 0.0 CM_Count1 0.0 255.0 /end CHARACTERISTIC
/begin CHARACTERISTIC D_IgnitionCoil3HiFMIType "cal comments" VALUE 0xBF43 Scalar_UB 0.0 CM_Count1 0.0 255.0 /end CHARACTERISTIC
/begin CHARACTERISTIC D_IgnitionCoil4LoFMIType "cal comments" VALUE 0xBF44 Scalar_UB 0.0 CM_Count1 0.0 255.0 /end CHARACTERISTIC
/begin CHARACTERISTIC D_IgnitionCoil4HiFMIType "cal comments" VALUE 0xBF45 Scalar_UB 0.0 CM_Count1 0.0 255.0 /end CHARACTERISTIC
/begin CHARACTERISTIC D_InjectorCyl1LoFMIType "cal comments" VALUE 0xC017 Scalar_UB 0.0 CM_Count1 0.0 255.0 /end CHARACTERISTIC
/begin CHARACTERISTIC D_InjectorCyl1HiLoFMIType "cal comments" VALUE 0xC018 Scalar_UB 0.0 CM_Count1 0.0 255.0 /end CHARACTERISTIC
/begin CHARACTERISTIC D_InjectorCyl2LoFMIType "cal comments" VALUE 0xC019 Scalar_UB 0.0 CM_Count1 0.0 255.0 /end CHARACTERISTIC
/begin CHARACTERISTIC D_InjectorCyl2HiLoFMIType "cal comments" VALUE 0xC01A Scalar_UB 0.0 CM_Count1 0.0 255.0 /end CHARACTERISTIC
/begin CHARACTERISTIC D_InjectorCyl3LoFMIType "cal comments" VALUE 0xC01B Scalar_UB 0.0 CM_Count1 0.0 255.0 /end CHARACTERISTIC
/begin CHARACTERISTIC D_InjectorCyl3HiLoFMIType "cal comments" VALUE 0xC01C Scalar_UB 0.0 CM_Count1 0.0 255.0 /end CHARACTERISTIC
/begin CHARACTERISTIC D_InjectorCyl4LoFMIType "cal comments" VALUE 0xC01D Scalar_UB 0.0 CM_Count1 0.0 255.0 /end CHARACTERISTIC
/begin CHARACTERISTIC D_InjectorCyl4HiLoFMIType "cal comments" VALUE 0xC01E Scalar_UB 0.0 CM_Count1 0.0 255.0 /end CHARACTERISTIC
/begin CHARACTERISTIC D_CrankSignalLossFMIType "cal comments" VALUE 0xBF2D Scalar_UB 0.0 CM_Count1 0.0 255.0 /end CHARACTERISTIC
/begin CHARACTERISTIC D_CrankSignalNoiseFMIType "cal comments" VALUE 0xBF2E Scalar_UB 0.0 CM_Count1 0.0 255.0 /end CHARACTERISTIC
/begin CHARACTERISTIC D_BatVoltLoFMIType "cal comments" VALUE 0xC08B Scalar_UB 0.0 CM_Count1 0.0 255.0 /end CHARACTERISTIC
/begin CHARACTERISTIC D_BatVoltHiFMIType "cal comments" VALUE 0xC08C Scalar_UB 0.0 CM_Count1 0.0 255.0 /end CHARACTERISTIC
/begin CHARACTERISTIC D_Knock1SignalFMIType "cal comments" VALUE 0xBEC2 Scalar_UB 0.0 CM_Count1 0.0 255.0 /end CHARACTERISTIC
/begin CHARACTERISTIC D_Knock2SignalFMIType "cal comments" VALUE 0xBEC3 Scalar_UB 0.0 CM_Count1 0.0 255.0 /end CHARACTERISTIC
/begin CHARACTERISTIC D_IACVShortLoFMIType "cal comments" VALUE 0xBF8D Scalar_UB 0.0 CM_Count1 0.0 255.0 /end CHARACTERISTIC
/begin CHARACTERISTIC D_IACVShortHiFMIType "cal comments" VALUE 0xBF8E Scalar_UB 0.0 CM_Count1 0.0 255.0 /end CHARACTERISTIC
/begin CHARACTERISTIC D_FuelPumpShortLoFMIType "cal comments" VALUE 0xBF4E Scalar_UB 0.0 CM_Count1 0.0 255.0 /end CHARACTERISTIC
/begin CHARACTERISTIC D_FuelPumpShortHiFMIType "cal comments" VALUE 0xBF4F Scalar_UB 0.0 CM_Count1 0.0 255.0 /end CHARACTERISTIC
/begin CHARACTERISTIC D_FPFeedbackFMIType "cal comments" VALUE 0xBF54 Scalar_UB 0.0 CM_Count1 0.0 255.0 /end CHARACTERISTIC
/begin CHARACTERISTIC D_CCPShortLoFMIType "cal comments" VALUE 0x0 Scalar_UB 0.0 CM_Count1 0.0 255.0 /end CHARACTERISTIC
/begin CHARACTERISTIC D_CCPShortHiFMIType "cal comments" VALUE 0x0 Scalar_UB 0.0 CM_Count1 0.0 255.0 /end CHARACTERISTIC
/begin CHARACTERISTIC D_SoftwareErrorFMIType "cal comments" VALUE 0xC050 Scalar_UB 0.0 CM_Count1 0.0 255.0 /end CHARACTERISTIC
/begin CHARACTERISTIC D_ACSShortLoFMIType "cal comments" VALUE 0xBFF7 Scalar_UB 0.0 CM_Count1 0.0 255.0 /end CHARACTERISTIC
/begin CHARACTERISTIC D_ACSShortHiFMIType "cal comments" VALUE 0xBFF8 Scalar_UB 0.0 CM_Count1 0.0 255.0 /end CHARACTERISTIC
/begin CHARACTERISTIC D_WPSShortLoFMIType "cal comments" VALUE 0x0 Scalar_UB 0.0 CM_Count1 0.0 255.0 /end CHARACTERISTIC
/begin CHARACTERISTIC D_WPSShortHiFMIType "cal comments" VALUE 0x0 Scalar_UB 0.0 CM_Count1 0.0 255.0 /end CHARACTERISTIC
/begin CHARACTERISTIC D_GENVLoFMIType "cal comments" VALUE 0x0 Scalar_UB 0.0 CM_Count1 0.0 255.0 /end CHARACTERISTIC
/begin CHARACTERISTIC D_GENVHiFMIType "cal comments" VALUE 0x0 Scalar_UB 0.0 CM_Count1 0.0 255.0 /end CHARACTERISTIC
/begin CHARACTERISTIC D_COSFMIType "cal comments" VALUE 0xC078 Scalar_UB 0.0 CM_Count1 0.0 255.0 /end CHARACTERISTIC
/begin CHARACTERISTIC D_COAFMIType "cal comments" VALUE 0xC07D Scalar_UB 0.0 CM_Count1 0.0 255.0 /end CHARACTERISTIC
/begin CHARACTERISTIC D_TPSShortDiagPassTimeThrsh "cal comments" VALUE 0xC056 Scalar_UW 0.0 CM_Count_0to65535_2 0.0 65535.0 /end CHARACTERISTIC
/begin CHARACTERISTIC D_TPSShortEnb "cal comments" VALUE 0xC05C Scalar_UB 0.0 CM_Boolean6 0.0 255.0 /end CHARACTERISTIC
/begin CHARACTERISTIC D_TPSShortHighFailTimeThrsh "cal comments" VALUE 0xC052 Scalar_UW 0.0 CM_Count_0to65535_2 0.0 65535.0 /end CHARACTERISTIC
/begin CHARACTERISTIC D_TPSShortLowFailTimeThrsh "cal comments" VALUE 0xC054 Scalar_UW 0.0 CM_Count_0to65535_2 0.0 65535.0 /end CHARACTERISTIC
/begin CHARACTERISTIC D_TPSShortRangeThreshHi "cal comments" VALUE 0xC05A Scalar_UW 0.0 CM_Percent_0to100_1 0.0 99.9984130859375 /end CHARACTERISTIC
/begin CHARACTERISTIC D_TPSShortRangeThreshLo "cal comments" VALUE 0xC058 Scalar_UW 0.0 CM_Percent_0to100_1 0.0 99.9984130859375 /end CHARACTERISTIC
/begin CHARACTERISTIC D_FCVPSShortEnb "cal comments" VALUE 0xC06A Scalar_UB 0.0 CM_Boolean6 0.0 255.0 /end CHARACTERISTIC
/begin CHARACTERISTIC D_FCVPSFailTimeThrsh "cal comments" VALUE 0xC062 Scalar_UW 0.0 CM_Count_0to65535_2 0.0 65535.0 /end CHARACTERISTIC
/begin CHARACTERISTIC D_FCVPSPassTimeThrsh "cal comments" VALUE 0xC064 Scalar_UW 0.0 CM_Count_0to65535_2 0.0 65535.0 /end CHARACTERISTIC
/begin CHARACTERISTIC D_FCVPSShortRangeThreshHi "cal comments" VALUE 0xC068 Scalar_UW 0.0 CM_Percent_0to100_1 0.0 99.9984130859375 /end CHARACTERISTIC
/begin CHARACTERISTIC D_FCVPSShortRangeThreshLo "cal comments" VALUE 0xC066 Scalar_UW 0.0 CM_Percent_0to100_1 0.0 99.9984130859375 /end CHARACTERISTIC
/begin CHARACTERISTIC C_FL_LoopCount "cal comments" VALUE 0x0 Scalar_UB 0.0 CM_Count1 0.0 255.0 /end CHARACTERISTIC
/begin CHARACTERISTIC CT_FL_DATA_TAB "cal comments" MAP 0x0 3D_Array_UB 0.0 CM_Count1 0.0 255.0
 /begin AXIS_DESCR FIX_AXIS NO_INPUT_QUANTITY CM_ID 7 0.0 7.0 MAX_GRAD 0.0 /begin FIX_AXIS_PAR_LIST 0 1 2 3 4 5 6 /end FIX_AXIS_PAR_LIST /end AXIS_DESCR
 /begin AXIS_DESCR FIX_AXIS NO_INPUT_QUANTITY CM_FL_DAT 9 0.0 9.0 MAX_GRAD 0.0 /begin FIX_AXIS_PAR_LIST 0 1 2 3 4 5 6 7 8 /end FIX_AXIS_PAR_LIST /end AXIS_DESCR
/end CHARACTERISTIC
/begin CHARACTERISTIC CT_FL_ID_TAB "cal comments" CURVE 0x0 2D_Array_UW 0.0 CM_Count1 0.0 2047.0
 /begin AXIS_DESCR FIX_AXIS NO_INPUT_QUANTITY CM_ID 7 0.0 7.0 MAX_GRAD 0.0 /begin FIX_AXIS_PAR_LIST 0 1 2 3 4 5 6 /end FIX_AXIS_PAR_LIST /end AXIS_DESCR
/end CHARACTERISTIC
/begin AXIS_PTS CA_EngSpd17Step1 "AXIS comments" 0x80F6 NO_INPUT_QUANTITY AxisPtsX_UW 0.0 CM_RPM_0to16384 17 0.0 16383.75 /end AXIS_PTS
/begin AXIS_PTS CA_EngSpd17Step2 "AXIS comments" 0x81D0 NO_INPUT_QUANTITY AxisPtsX_UW 0.0 CM_RPM_0to16384 17 0.0 16383.75 /end AXIS_PTS
/begin AXIS_PTS CA_EngSpd17Step4 "AXIS comments" 0x81F4 NO_INPUT_QUANTITY AxisPtsX_UW 0.0 CM_RPM_0to16384 17 0.0 16383.75 /end AXIS_PTS
/begin AXIS_PTS CA_EngSpd11Step2 "AXIS comments" 0x80C6 NO_INPUT_QUANTITY AxisPtsX_UW 0.0 CM_RPM_0to16384 11 0.0 16383.75 /end AXIS_PTS
/begin AXIS_PTS CA_EngSpd4Step1 "AXIS comments" 0x823E NO_INPUT_QUANTITY AxisPtsX_UW 0.0 CM_RPM_0to16384 4 0.0 16383.75 /end AXIS_PTS
/begin AXIS_PTS CA_EngSpd6Step1 "AXIS comments" 0x8230 NO_INPUT_QUANTITY AxisPtsX_UW 0.0 CM_RPM_0to16384 6 0.0 16383.75 /end AXIS_PTS
/begin AXIS_PTS CA_EngSpd6Step2 "AXIS comments" 0x8218 NO_INPUT_QUANTITY AxisPtsX_UW 0.0 CM_RPM_0to16384 6 0.0 16383.75 /end AXIS_PTS
/begin AXIS_PTS CA_EngSpd9Step1 "AXIS comments" 0x809C NO_INPUT_QUANTITY AxisPtsX_UW 0.0 CM_RPM_0to16384 9 0.0 16383.75 /end AXIS_PTS
/begin AXIS_PTS CA_GramStep21 "AXIS comments" 0x8298 NO_INPUT_QUANTITY AxisPtsX_UW 0.0 udf_CM_18705 21 0.0 511.9921875 /end AXIS_PTS
/begin AXIS_PTS CA_AirGramStep9 "AXIS comments" 0x2 NO_INPUT_QUANTITY AxisPtsX_UW 0.0 udf_CM_18705 9 0.0 511.9921875 /end AXIS_PTS
/begin AXIS_PTS CA_MAP10Step1 "AXIS comments" 0x8166 NO_INPUT_QUANTITY AxisPtsX_UW 0.0 CM_kpa_0to256_1 10 0.0 255.99609375 /end AXIS_PTS
/begin AXIS_PTS CA_MAP18Step1 "AXIS comments" 0x817C NO_INPUT_QUANTITY AxisPtsX_UW 0.0 CM_kpa_0to256_1 18 0.0 255.99609375 /end AXIS_PTS
/begin AXIS_PTS CA_MAP22Step1 "AXIS comments" 0x81A2 NO_INPUT_QUANTITY AxisPtsX_UW 0.0 CM_kpa_0to256_1 22 0.0 255.99609375 /end AXIS_PTS
/begin AXIS_PTS CA_MAP8Step1 "AXIS comments" 0x8154 NO_INPUT_QUANTITY AxisPtsX_SW 0.0 CM_kpa_n256to256_1 8 -256 255.9921875 /end AXIS_PTS
/begin AXIS_PTS CA_MAP9Step1 "AXIS comments" 0x811A NO_INPUT_QUANTITY AxisPtsX_UW 0.0 CM_kpa_0to256_1 9 0.0 255.99609375 /end AXIS_PTS
/begin AXIS_PTS CA_MAP9Step3 "AXIS comments" 0x812E NO_INPUT_QUANTITY AxisPtsX_UW 0.0 CM_kpa_0to256_1 9 0.0 255.99609375 /end AXIS_PTS
/begin AXIS_PTS CA_PercentStep21 "AXIS comments" 0x8248 NO_INPUT_QUANTITY AxisPtsX_UW 0.0 CM_Percent_0to200_2 21 0.0 199.9969024658203 /end AXIS_PTS
/begin AXIS_PTS CA_VELoad6Step "AXIS comments" 0x82C4 NO_INPUT_QUANTITY AxisPtsX_UW 0.0 CM_kpa_0to256_1 6 0.0 255.99609375 /end AXIS_PTS
/begin MEASUREMENT AFRRamped "var comments" UWORD udf_CM_15464 0 0.0 0.0 31.99951171875 ECU_ADDRESS 0x4000269C /end MEASUREMENT
/begin MEASUREMENT AFRBase "var comments" UWORD udf_CM_15422 0 0.0 0.0 31.99951171875 ECU_ADDRESS 0x4000276E /end MEASUREMENT
/begin MEASUREMENT AFRCrankToRun "var comments" UBYTE udf_CM_15436 0 0.0 0.0 255.0 ECU_ADDRESS 0x40002698 /end MEASUREMENT
/begin MEASUREMENT AFRWarmUpEnb "var comments" UBYTE udf_CM_15513 0 0.0 0.0 255.0 ECU_ADDRESS 0x400026A6 /end MEASUREMENT
/begin MEASUREMENT AFRWarmUp "var comments" UWORD udf_CM_15506 0 0.0 0.0 31.99951171875 ECU_ADDRESS 0x400026A4 /end MEASUREMENT
/begin MEASUREMENT AFRWarmUpIdle "var comments" UWORD udf_CM_15520 0 0.0 0.0 31.99951171875 ECU_ADDRESS 0x400026A0 /end MEASUREMENT
/begin MEASUREMENT AFRWarmUpRun "var comments" UWORD udf_CM_15527 0 0.0 0.0 31.99951171875 ECU_ADDRESS 0x400026A2 /end MEASUREMENT
/begin MEASUREMENT AFRCrank "var comments" UWORD udf_CM_15429 0 0.0 0.0 31.99951171875 ECU_ADDRESS 0x40002768 /end MEASUREMENT
/begin MEASUREMENT AFRFinal "var comments" UWORD udf_CM_15450 0 0.0 0.0 31.99951171875 ECU_ADDRESS 0x400026AA /end MEASUREMENT
/begin MEASUREMENT AFRPE "var comments" UWORD udf_CM_15457 0 0.0 0.0 31.99951171875 ECU_ADDRESS 0x400026AC /end MEASUREMENT
/begin MEASUREMENT AFRTarget "var comments" UWORD udf_CM_15485 0 0.0 0.0 31.99951171875 ECU_ADDRESS 0x4000269A /end MEASUREMENT
/begin MEASUREMENT AirFlowCyl1 "var comments" UWORD udf_CM_15534 0 0.0 0.0 511.9921875 DISPLAY_IDENTIFIER AirFlowCyl[0] ECU_ADDRESS 0x4000260C /end MEASUREMENT
/begin MEASUREMENT AirFlowCyl2 "var comments" UWORD udf_CM_15541 0 0.0 0.0 511.9921875 DISPLAY_IDENTIFIER AirFlowCyl[1] ECU_ADDRESS 0x4000260E /end MEASUREMENT
/begin MEASUREMENT AFRVolt1Unfilt "var comments" UWORD udf_CM_15492 0 0.0 0.0 31.99951171875 ECU_ADDRESS 0x0 /end MEASUREMENT
/begin MEASUREMENT AFRVolt2Unfilt "var comments" UWORD udf_CM_15499 0 0.0 0.0 31.99951171875 ECU_ADDRESS 0x0 /end MEASUREMENT
/begin MEASUREMENT AFRVolt1 "var comments" UWORD udf_CM_15492 0 0.0 0.0 31.99951171875 ECU_ADDRESS 0x0 /end MEASUREMENT
/begin MEASUREMENT AFRVolt2 "var comments" UWORD udf_CM_15499 0 0.0 0.0 31.99951171875 ECU_ADDRESS 0x0 /end MEASUREMENT
/begin MEASUREMENT ClTSTDiagEnb "var comments" UBYTE udf_CM_15723 0 0.0 0.0 255.0 DISPLAY_IDENTIFIER ClTSTDiagEnb[0] ECU_ADDRESS 0x40002CEC /end MEASUREMENT
/begin MEASUREMENT ClTSTDiagEnb2 "var comments" UBYTE udf_CM_15723 0 0.0 0.0 255.0 DISPLAY_IDENTIFIER ClTSTDiagEnb[1] ECU_ADDRESS 0x40002CED /end MEASUREMENT
/begin MEASUREMENT ClTSTDiagEnb3 "var comments" UBYTE udf_CM_15723 0 0.0 0.0 255.0 DISPLAY_IDENTIFIER ClTSTDiagEnb[2] ECU_ADDRESS 0x40002CEE /end MEASUREMENT
/begin MEASUREMENT ClTSTDiagEnb4 "var comments" UBYTE udf_CM_15723 0 0.0 0.0 255.0 DISPLAY_IDENTIFIER ClTSTDiagEnb[3] ECU_ADDRESS 0x40002CEF /end MEASUREMENT
/begin MEASUREMENT ClTSTDiagEnb5 "var comments" UBYTE udf_CM_15723 0 0.0 0.0 255.0 DISPLAY_IDENTIFIER ClTSTDiagEnb[4] ECU_ADDRESS 0x40002CF0 /end MEASUREMENT
/begin MEASUREMENT ClTSTDiagEnb6 "var comments" UBYTE udf_CM_15723 0 0.0 0.0 255.0 DISPLAY_IDENTIFIER ClTSTDiagEnb[5] ECU_ADDRESS 0x40002CF1 /end MEASUREMENT
/begin MEASUREMENT ClTOHDiagEnb "var comments" UBYTE udf_CM_15674 0 0.0 0.0 255.0 ECU_ADDRESS 0x40002CFF /end MEASUREMENT
/begin MEASUREMENT ClTSHFailCount "var comments" UWORD udf_CM_15730 0 0.0 0.0 65535.0 DISPLAY_IDENTIFIER ClTSHFailCount[0] ECU_ADDRESS 0x40002D06 /end MEASUREMENT
/begin MEASUREMENT ClTSHFailCount2 "var comments" UWORD udf_CM_15730 0 0.0 0.0 65535.0 DISPLAY_IDENTIFIER ClTSHFailCount[1] ECU_ADDRESS 0x40002D08 /end MEASUREMENT
/begin MEASUREMENT ClTSHFailCount3 "var comments" UWORD udf_CM_15730 0 0.0 0.0 65535.0 DISPLAY_IDENTIFIER ClTSHFailCount[2] ECU_ADDRESS 0x40002D0A /end MEASUREMENT
/begin MEASUREMENT ClTSHFailCount4 "var comments" UWORD udf_CM_15730 0 0.0 0.0 65535.0 DISPLAY_IDENTIFIER ClTSHFailCount[3] ECU_ADDRESS 0x40002D0C /end MEASUREMENT
/begin MEASUREMENT ClTSHFailCount5 "var comments" UWORD udf_CM_15730 0 0.0 0.0 65535.0 DISPLAY_IDENTIFIER ClTSHFailCount[4] ECU_ADDRESS 0x40002D0E /end MEASUREMENT
/begin MEASUREMENT ClTSHFailCount6 "var comments" UWORD udf_CM_15730 0 0.0 0.0 65535.0 DISPLAY_IDENTIFIER ClTSHFailCount[5] ECU_ADDRESS 0x40002D10 /end MEASUREMENT
/begin MEASUREMENT ClTSHFailMet "var comments" UBYTE udf_CM_15723 0 0.0 0.0 255.0 DISPLAY_IDENTIFIER ClTSHFailMet[0] ECU_ADDRESS 0x40002D00 /end MEASUREMENT
/begin MEASUREMENT ClTSHFailMet2 "var comments" UBYTE udf_CM_15723 0 0.0 0.0 255.0 DISPLAY_IDENTIFIER ClTSHFailMet[1] ECU_ADDRESS 0x40002D01 /end MEASUREMENT
/begin MEASUREMENT ClTSHFailMet3 "var comments" UBYTE udf_CM_15723 0 0.0 0.0 255.0 DISPLAY_IDENTIFIER ClTSHFailMet[2] ECU_ADDRESS 0x40002D02 /end MEASUREMENT
/begin MEASUREMENT ClTSHFailMet4 "var comments" UBYTE udf_CM_15723 0 0.0 0.0 255.0 DISPLAY_IDENTIFIER ClTSHFailMet[3] ECU_ADDRESS 0x40002D03 /end MEASUREMENT
/begin MEASUREMENT ClTSHFailMet5 "var comments" UBYTE udf_CM_15723 0 0.0 0.0 255.0 DISPLAY_IDENTIFIER ClTSHFailMet[4] ECU_ADDRESS 0x40002D04 /end MEASUREMENT
/begin MEASUREMENT ClTSHFailMet6 "var comments" UBYTE udf_CM_15723 0 0.0 0.0 255.0 DISPLAY_IDENTIFIER ClTSHFailMet[5] ECU_ADDRESS 0x40002D05 /end MEASUREMENT
/begin MEASUREMENT ClTSHPassCount "var comments" UWORD udf_CM_15730 0 0.0 0.0 65535.0 DISPLAY_IDENTIFIER ClTSHPassCount[0] ECU_ADDRESS 0x40002D08 /end MEASUREMENT
/begin MEASUREMENT ClTSHPassCount2 "var comments" UWORD udf_CM_15730 0 0.0 0.0 65535.0 DISPLAY_IDENTIFIER ClTSHPassCount[1] ECU_ADDRESS 0x40002D0A /end MEASUREMENT
/begin MEASUREMENT ClTSHPassCount3 "var comments" UWORD udf_CM_15730 0 0.0 0.0 65535.0 DISPLAY_IDENTIFIER ClTSHPassCount[2] ECU_ADDRESS 0x40002D0C /end MEASUREMENT
/begin MEASUREMENT ClTSHPassCount4 "var comments" UWORD udf_CM_15730 0 0.0 0.0 65535.0 DISPLAY_IDENTIFIER ClTSHPassCount[3] ECU_ADDRESS 0x40002D0E /end MEASUREMENT
/begin MEASUREMENT ClTSHPassCount5 "var comments" UWORD udf_CM_15730 0 0.0 0.0 65535.0 DISPLAY_IDENTIFIER ClTSHPassCount[4] ECU_ADDRESS 0x40002D10 /end MEASUREMENT
/begin MEASUREMENT ClTSHPassCount6 "var comments" UWORD udf_CM_15730 0 0.0 0.0 65535.0 DISPLAY_IDENTIFIER ClTSHPassCount[5] ECU_ADDRESS 0x40002D12 /end MEASUREMENT
/begin MEASUREMENT ClTSHTestFail "var comments" UBYTE udf_CM_15723 0 0.0 0.0 255.0 DISPLAY_IDENTIFIER ClTSHTestFail[0] ECU_ADDRESS 0x40002CEF /end MEASUREMENT
/begin MEASUREMENT ClTSHTestFail2 "var comments" UBYTE udf_CM_15723 0 0.0 0.0 255.0 DISPLAY_IDENTIFIER ClTSHTestFail[1] ECU_ADDRESS 0x40002CF0 /end MEASUREMENT
/begin MEASUREMENT ClTSHTestFail3 "var comments" UBYTE udf_CM_15723 0 0.0 0.0 255.0 DISPLAY_IDENTIFIER ClTSHTestFail[2] ECU_ADDRESS 0x40002CF1 /end MEASUREMENT
/begin MEASUREMENT ClTSHTestFail4 "var comments" UBYTE udf_CM_15723 0 0.0 0.0 255.0 DISPLAY_IDENTIFIER ClTSHTestFail[3] ECU_ADDRESS 0x40002CF2 /end MEASUREMENT
/begin MEASUREMENT ClTSHTestFail5 "var comments" UBYTE udf_CM_15723 0 0.0 0.0 255.0 DISPLAY_IDENTIFIER ClTSHTestFail[4] ECU_ADDRESS 0x40002CF3 /end MEASUREMENT
/begin MEASUREMENT ClTSHTestFail6 "var comments" UBYTE udf_CM_15723 0 0.0 0.0 255.0 DISPLAY_IDENTIFIER ClTSHTestFail[5] ECU_ADDRESS 0x40002CF4 /end MEASUREMENT
/begin MEASUREMENT ClTSLFailCount "var comments" UWORD udf_CM_15730 0 0.0 0.0 65535.0 DISPLAY_IDENTIFIER ClTSLFailCount[0] ECU_ADDRESS 0x40002D02 /end MEASUREMENT
/begin MEASUREMENT ClTSLFailCount2 "var comments" UWORD udf_CM_15730 0 0.0 0.0 65535.0 DISPLAY_IDENTIFIER ClTSLFailCount[1] ECU_ADDRESS 0x40002D04 /end MEASUREMENT
/begin MEASUREMENT ClTSLFailCount3 "var comments" UWORD udf_CM_15730 0 0.0 0.0 65535.0 DISPLAY_IDENTIFIER ClTSLFailCount[2] ECU_ADDRESS 0x40002D06 /end MEASUREMENT
/begin MEASUREMENT ClTSLFailCount4 "var comments" UWORD udf_CM_15730 0 0.0 0.0 65535.0 DISPLAY_IDENTIFIER ClTSLFailCount[3] ECU_ADDRESS 0x40002D08 /end MEASUREMENT
/begin MEASUREMENT ClTSLFailCount5 "var comments" UWORD udf_CM_15730 0 0.0 0.0 65535.0 DISPLAY_IDENTIFIER ClTSLFailCount[4] ECU_ADDRESS 0x40002D0A /end MEASUREMENT
/begin MEASUREMENT ClTSLFailCount6 "var comments" UWORD udf_CM_15730 0 0.0 0.0 65535.0 DISPLAY_IDENTIFIER ClTSLFailCount[5] ECU_ADDRESS 0x40002D0C /end MEASUREMENT
/begin MEASUREMENT ClTSLFailMet "var comments" UBYTE udf_CM_15723 0 0.0 0.0 255.0 DISPLAY_IDENTIFIER ClTSLFailMet[0] ECU_ADDRESS 0x40002CFE /end MEASUREMENT
/begin MEASUREMENT ClTSLFailMet2 "var comments" UBYTE udf_CM_15723 0 0.0 0.0 255.0 DISPLAY_IDENTIFIER ClTSLFailMet[1] ECU_ADDRESS 0x40002CFF /end MEASUREMENT
/begin MEASUREMENT ClTSLFailMet3 "var comments" UBYTE udf_CM_15723 0 0.0 0.0 255.0 DISPLAY_IDENTIFIER ClTSLFailMet[2] ECU_ADDRESS 0x40002D00 /end MEASUREMENT
/begin MEASUREMENT ClTSLFailMet4 "var comments" UBYTE udf_CM_15723 0 0.0 0.0 255.0 DISPLAY_IDENTIFIER ClTSLFailMet[3] ECU_ADDRESS 0x40002D01 /end MEASUREMENT
/begin MEASUREMENT ClTSLFailMet5 "var comments" UBYTE udf_CM_15723 0 0.0 0.0 255.0 DISPLAY_IDENTIFIER ClTSLFailMet[4] ECU_ADDRESS 0x40002D02 /end MEASUREMENT
/begin MEASUREMENT ClTSLFailMet6 "var comments" UBYTE udf_CM_15723 0 0.0 0.0 255.0 DISPLAY_IDENTIFIER ClTSLFailMet[5] ECU_ADDRESS 0x40002D03 /end MEASUREMENT
/begin MEASUREMENT ClTSLPassCount "var comments" UWORD udf_CM_15730 0 0.0 0.0 65535.0 DISPLAY_IDENTIFIER ClTSLPassCount[0] ECU_ADDRESS 0x40002D04 /end MEASUREMENT
/begin MEASUREMENT ClTSLPassCount2 "var comments" UWORD udf_CM_15730 0 0.0 0.0 65535.0 DISPLAY_IDENTIFIER ClTSLPassCount[1] ECU_ADDRESS 0x40002D06 /end MEASUREMENT
/begin MEASUREMENT ClTSLPassCount3 "var comments" UWORD udf_CM_15730 0 0.0 0.0 65535.0 DISPLAY_IDENTIFIER ClTSLPassCount[2] ECU_ADDRESS 0x40002D08 /end MEASUREMENT
/begin MEASUREMENT ClTSLPassCount4 "var comments" UWORD udf_CM_15730 0 0.0 0.0 65535.0 DISPLAY_IDENTIFIER ClTSLPassCount[3] ECU_ADDRESS 0x40002D0A /end MEASUREMENT
/begin MEASUREMENT ClTSLPassCount5 "var comments" UWORD udf_CM_15730 0 0.0 0.0 65535.0 DISPLAY_IDENTIFIER ClTSLPassCount[4] ECU_ADDRESS 0x40002D0C /end MEASUREMENT
/begin MEASUREMENT ClTSLPassCount6 "var comments" UWORD udf_CM_15730 0 0.0 0.0 65535.0 DISPLAY_IDENTIFIER ClTSLPassCount[5] ECU_ADDRESS 0x40002D0E /end MEASUREMENT
/begin MEASUREMENT ClTSLTestFail "var comments" UBYTE udf_CM_15723 0 0.0 0.0 255.0 DISPLAY_IDENTIFIER ClTSLTestFail[0] ECU_ADDRESS 0x40002CED /end MEASUREMENT
/begin MEASUREMENT ClTSLTestFail2 "var comments" UBYTE udf_CM_15723 0 0.0 0.0 255.0 DISPLAY_IDENTIFIER ClTSLTestFail[1] ECU_ADDRESS 0x40002CEE /end MEASUREMENT
/begin MEASUREMENT ClTSLTestFail3 "var comments" UBYTE udf_CM_15723 0 0.0 0.0 255.0 DISPLAY_IDENTIFIER ClTSLTestFail[2] ECU_ADDRESS 0x40002CEF /end MEASUREMENT
/begin MEASUREMENT ClTSLTestFail4 "var comments" UBYTE udf_CM_15723 0 0.0 0.0 255.0 DISPLAY_IDENTIFIER ClTSLTestFail[3] ECU_ADDRESS 0x40002CF0 /end MEASUREMENT
/begin MEASUREMENT ClTSLTestFail5 "var comments" UBYTE udf_CM_15723 0 0.0 0.0 255.0 DISPLAY_IDENTIFIER ClTSLTestFail[4] ECU_ADDRESS 0x40002CF1 /end MEASUREMENT
/begin MEASUREMENT ClTSLTestFail6 "var comments" UBYTE udf_CM_15723 0 0.0 0.0 255.0 DISPLAY_IDENTIFIER ClTSLTestFail[5] ECU_ADDRESS 0x40002CF2 /end MEASUREMENT
/begin MEASUREMENT ClTOH1FailCount "var comments" UWORD udf_CM_15716 0 0.0 0.0 65535.0 ECU_ADDRESS 0x40002CF6 /end MEASUREMENT
/begin MEASUREMENT ClTOH1FailMet "var comments" UBYTE udf_CM_15723 0 0.0 0.0 255.0 ECU_ADDRESS 0x40002D01 /end MEASUREMENT
/begin MEASUREMENT ClTOH1PassCount "var comments" UWORD udf_CM_15730 0 0.0 0.0 65535.0 ECU_ADDRESS 0x40002CF8 /end MEASUREMENT
/begin MEASUREMENT ClTOH1TestFail "var comments" UBYTE udf_CM_15737 0 0.0 0.0 255.0 ECU_ADDRESS 0x40002CF4 /end MEASUREMENT
/begin MEASUREMENT ClTOH2FailCount "var comments" UWORD udf_CM_15716 0 0.0 0.0 65535.0 ECU_ADDRESS 0x40002CFA /end MEASUREMENT
/begin MEASUREMENT ClTOH2FailMet "var comments" UBYTE udf_CM_15723 0 0.0 0.0 255.0 ECU_ADDRESS 0x40002CEB /end MEASUREMENT
/begin MEASUREMENT ClTOH2PassCount "var comments" UWORD udf_CM_15730 0 0.0 0.0 65535.0 ECU_ADDRESS 0x40002CFC /end MEASUREMENT
/begin MEASUREMENT ClTOH2TestFail "var comments" UBYTE udf_CM_15737 0 0.0 0.0 255.0 ECU_ADDRESS 0x40002CF5 /end MEASUREMENT
/begin MEASUREMENT FPDiagEnb "var comments" UBYTE udf_CM_17382 0 0.0 0.0 255.0 ECU_ADDRESS 0x40002DB2 /end MEASUREMENT
/begin MEASUREMENT FPLoDiagEnb "var comments" UBYTE udf_CM_17382 0 0.0 0.0 255.0 ECU_ADDRESS 0x40002DBB /end MEASUREMENT
/begin MEASUREMENT FPSLFailMet "var comments" UBYTE udf_CM_17410 0 0.0 0.0 255.0 ECU_ADDRESS 0x40002DAD /end MEASUREMENT
/begin MEASUREMENT FPSLTestComp "var comments" UBYTE udf_CM_17424 0 0.0 0.0 255.0 ECU_ADDRESS 0x40002DB3 /end MEASUREMENT
/begin MEASUREMENT FPSLTestFail "var comments" UBYTE udf_CM_17431 0 0.0 0.0 255.0 ECU_ADDRESS 0x40002DB7 /end MEASUREMENT
/begin MEASUREMENT FPSLFailCount "var comments" UWORD udf_CM_17389 0 0.0 0.0 65535.0 ECU_ADDRESS 0x40002DBC /end MEASUREMENT
/begin MEASUREMENT FPSLPassCount "var comments" UWORD udf_CM_17417 0 0.0 0.0 65535.0 ECU_ADDRESS 0x40002DBE /end MEASUREMENT
/begin MEASUREMENT FPSHFailMet "var comments" UBYTE udf_CM_17410 0 0.0 0.0 255.0 ECU_ADDRESS 0x40002DAE /end MEASUREMENT
/begin MEASUREMENT FPSHTestComp "var comments" UBYTE udf_CM_17424 0 0.0 0.0 255.0 ECU_ADDRESS 0x40002DB4 /end MEASUREMENT
/begin MEASUREMENT FPSHTestFail "var comments" UBYTE udf_CM_17431 0 0.0 0.0 255.0 ECU_ADDRESS 0x40002DB8 /end MEASUREMENT
/begin MEASUREMENT FPSHFailCount "var comments" UWORD udf_CM_17389 0 0.0 0.0 65535.0 ECU_ADDRESS 0x40002DC0 /end MEASUREMENT
/begin MEASUREMENT FPSHPassCount "var comments" UWORD udf_CM_17417 0 0.0 0.0 65535.0 ECU_ADDRESS 0x40002DC2 /end MEASUREMENT
/begin MEASUREMENT FPLoFailMet "var comments" UBYTE udf_CM_17410 0 0.0 0.0 255.0 ECU_ADDRESS 0x40002DAF /end MEASUREMENT
/begin MEASUREMENT FPLoTestComp "var comments" UBYTE udf_CM_17424 0 0.0 0.0 255.0 ECU_ADDRESS 0x40002DB5 /end MEASUREMENT
/begin MEASUREMENT FPLoTestFail "var comments" UBYTE udf_CM_17431 0 0.0 0.0 255.0 ECU_ADDRESS 0x40002DB9 /end MEASUREMENT
/begin MEASUREMENT FPLoFailCount "var comments" UWORD udf_CM_17389 0 0.0 0.0 65535.0 ECU_ADDRESS 0x40002DC4 /end MEASUREMENT
/begin MEASUREMENT FPLoPassCount "var comments" UWORD udf_CM_17417 0 0.0 0.0 65535.0 ECU_ADDRESS 0x40002DC6 /end MEASUREMENT
/begin MEASUREMENT FPHiFailMet "var comments" UBYTE udf_CM_17410 0 0.0 0.0 255.0 ECU_ADDRESS 0x40002DB0 /end MEASUREMENT
/begin MEASUREMENT FPHiTestComp "var comments" UBYTE udf_CM_17424 0 0.0 0.0 255.0 ECU_ADDRESS 0x40002DB6 /end MEASUREMENT
/begin MEASUREMENT FPHiTestFail "var comments" UBYTE udf_CM_17431 0 0.0 0.0 255.0 ECU_ADDRESS 0x40002DBA /end MEASUREMENT
/begin MEASUREMENT FPHiFailCount "var comments" UWORD udf_CM_17389 0 0.0 0.0 65535.0 ECU_ADDRESS 0x40002DC8 /end MEASUREMENT
/begin MEASUREMENT FPHiPassCount "var comments" UWORD udf_CM_17417 0 0.0 0.0 65535.0 ECU_ADDRESS 0x40002DCA /end MEASUREMENT
/begin MEASUREMENT Coil1DiagEnb "var comments" UBYTE udf_CM_18019 0 0.0 0.0 255.0 DISPLAY_IDENTIFIER CoilDiagEnb[0] ECU_ADDRESS 0x40002E06 /end MEASUREMENT
/begin MEASUREMENT Coil1SLFailMet "var comments" UBYTE udf_CM_18047 0 0.0 0.0 255.0 DISPLAY_IDENTIFIER CoilSLFailMet[0] ECU_ADDRESS 0x40002E0A /end MEASUREMENT
/begin MEASUREMENT Coil1SLTestComp "var comments" UBYTE udf_CM_18061 0 0.0 0.0 255.0 DISPLAY_IDENTIFIER CoilSLTestComp[0] ECU_ADDRESS 0x40002E12 /end MEASUREMENT
/begin MEASUREMENT Coil1SLTestFail "var comments" UBYTE udf_CM_18068 0 0.0 0.0 255.0 DISPLAY_IDENTIFIER CoilSLTestFail[0] ECU_ADDRESS 0x40002E3A /end MEASUREMENT
/begin MEASUREMENT Coil1SLFailCount "var comments" UWORD udf_CM_18026 0 0.0 0.0 65535.0 DISPLAY_IDENTIFIER CoilSLFailCount[0] ECU_ADDRESS 0x40002E1A /end MEASUREMENT
/begin MEASUREMENT Coil1SLPassCount "var comments" UWORD udf_CM_18054 0 0.0 0.0 65535.0 DISPLAY_IDENTIFIER CoilSLPassCount[0] ECU_ADDRESS 0x40002E22 /end MEASUREMENT
/begin MEASUREMENT Coil1SHFailMet "var comments" UBYTE udf_CM_18047 0 0.0 0.0 255.0 DISPLAY_IDENTIFIER CoilSHFailMet[0] ECU_ADDRESS 0x40002E0E /end MEASUREMENT
/begin MEASUREMENT Coil1SHTestComp "var comments" UBYTE udf_CM_18061 0 0.0 0.0 255.0 DISPLAY_IDENTIFIER CoilSHTestComp[0] ECU_ADDRESS 0x40002E16 /end MEASUREMENT
/begin MEASUREMENT Coil1SHTestFail "var comments" UBYTE udf_CM_18068 0 0.0 0.0 255.0 DISPLAY_IDENTIFIER CoilSHTestFail[0] ECU_ADDRESS 0x40002E3E /end MEASUREMENT
/begin MEASUREMENT Coil1SHFailCount "var comments" UWORD udf_CM_18026 0 0.0 0.0 65535.0 DISPLAY_IDENTIFIER CoilSHFailCount[0] ECU_ADDRESS 0x40002E2A /end MEASUREMENT
/begin MEASUREMENT Coil1SHPassCount "var comments" UWORD udf_CM_18054 0 0.0 0.0 65535.0 DISPLAY_IDENTIFIER CoilSHPassCount[0] ECU_ADDRESS 0x40002E32 /end MEASUREMENT
/begin MEASUREMENT Coil2DiagEnb "var comments" UBYTE udf_CM_18019 0 0.0 0.0 255.0 DISPLAY_IDENTIFIER CoilDiagEnb[1] ECU_ADDRESS 0x40002E07 /end MEASUREMENT
/begin MEASUREMENT Coil2SLFailMet "var comments" UBYTE udf_CM_18047 0 0.0 0.0 255.0 DISPLAY_IDENTIFIER CoilSLFailMet[1] ECU_ADDRESS 0x40002E0B /end MEASUREMENT
/begin MEASUREMENT Coil2SLTestComp "var comments" UBYTE udf_CM_18061 0 0.0 0.0 255.0 DISPLAY_IDENTIFIER CoilSLTestComp[1] ECU_ADDRESS 0x40002E13 /end MEASUREMENT
/begin MEASUREMENT Coil2SLTestFail "var comments" UBYTE udf_CM_18068 0 0.0 0.0 255.0 DISPLAY_IDENTIFIER CoilSLTestFail[1] ECU_ADDRESS 0x40002E3B /end MEASUREMENT
/begin MEASUREMENT Coil2SLFailCount "var comments" UWORD udf_CM_18026 0 0.0 0.0 65535.0 DISPLAY_IDENTIFIER CoilSLFailCount[1] ECU_ADDRESS 0x40002E1C /end MEASUREMENT
/begin MEASUREMENT Coil2SLPassCount "var comments" UWORD udf_CM_18054 0 0.0 0.0 65535.0 DISPLAY_IDENTIFIER CoilSLPassCount[1] ECU_ADDRESS 0x40002E24 /end MEASUREMENT
/begin MEASUREMENT Coil2SHFailMet "var comments" UBYTE udf_CM_18047 0 0.0 0.0 255.0 DISPLAY_IDENTIFIER CoilSHFailMet[1] ECU_ADDRESS 0x40002E0F /end MEASUREMENT
/begin MEASUREMENT Coil2SHTestComp "var comments" UBYTE udf_CM_18061 0 0.0 0.0 255.0 DISPLAY_IDENTIFIER CoilSHTestComp[1] ECU_ADDRESS 0x40002E17 /end MEASUREMENT
/begin MEASUREMENT Coil2SHTestFail "var comments" UBYTE udf_CM_18068 0 0.0 0.0 255.0 DISPLAY_IDENTIFIER CoilSHTestFail[1] ECU_ADDRESS 0x40002E3F /end MEASUREMENT
/begin MEASUREMENT Coil2SHFailCount "var comments" UWORD udf_CM_18026 0 0.0 0.0 65535.0 DISPLAY_IDENTIFIER CoilSHFailCount[1] ECU_ADDRESS 0x40002E2C /end MEASUREMENT
/begin MEASUREMENT Coil2SHPassCount "var comments" UWORD udf_CM_18054 0 0.0 0.0 65535.0 DISPLAY_IDENTIFIER CoilSHPassCount[1] ECU_ADDRESS 0x40002E34 /end MEASUREMENT
/begin MEASUREMENT Coil3DiagEnb "var comments" UBYTE udf_CM_18019 0 0.0 0.0 255.0 DISPLAY_IDENTIFIER CoilDiagEnb[2] ECU_ADDRESS 0x40002E08 /end MEASUREMENT
/begin MEASUREMENT Coil3SLFailMet "var comments" UBYTE udf_CM_18047 0 0.0 0.0 255.0 DISPLAY_IDENTIFIER CoilSLFailMet[2] ECU_ADDRESS 0x40002E0C /end MEASUREMENT
/begin MEASUREMENT Coil3SLTestComp "var comments" UBYTE udf_CM_18061 0 0.0 0.0 255.0 DISPLAY_IDENTIFIER CoilSLTestComp[2] ECU_ADDRESS 0x40002E14 /end MEASUREMENT
/begin MEASUREMENT Coil3SLTestFail "var comments" UBYTE udf_CM_18068 0 0.0 0.0 255.0 DISPLAY_IDENTIFIER CoilSLTestFail[2] ECU_ADDRESS 0x40002E3C /end MEASUREMENT
/begin MEASUREMENT Coil3SLFailCount "var comments" UWORD udf_CM_18026 0 0.0 0.0 65535.0 DISPLAY_IDENTIFIER CoilSLFailCount[2] ECU_ADDRESS 0x40002E1E /end MEASUREMENT
/begin MEASUREMENT Coil3SLPassCount "var comments" UWORD udf_CM_18054 0 0.0 0.0 65535.0 DISPLAY_IDENTIFIER CoilSLPassCount[2] ECU_ADDRESS 0x40002E26 /end MEASUREMENT
/begin MEASUREMENT Coil3SHFailMet "var comments" UBYTE udf_CM_18047 0 0.0 0.0 255.0 DISPLAY_IDENTIFIER CoilSHFailMet[2] ECU_ADDRESS 0x40002E10 /end MEASUREMENT
/begin MEASUREMENT Coil3SHTestComp "var comments" UBYTE udf_CM_18061 0 0.0 0.0 255.0 DISPLAY_IDENTIFIER CoilSHTestComp[2] ECU_ADDRESS 0x40002E18 /end MEASUREMENT
/begin MEASUREMENT Coil3SHTestFail "var comments" UBYTE udf_CM_18068 0 0.0 0.0 255.0 DISPLAY_IDENTIFIER CoilSHTestFail[2] ECU_ADDRESS 0x40002E40 /end MEASUREMENT
/begin MEASUREMENT Coil3SHFailCount "var comments" UWORD udf_CM_18026 0 0.0 0.0 65535.0 DISPLAY_IDENTIFIER CoilSHFailCount[2] ECU_ADDRESS 0x40002E2E /end MEASUREMENT
/begin MEASUREMENT Coil3SHPassCount "var comments" UWORD udf_CM_18054 0 0.0 0.0 65535.0 DISPLAY_IDENTIFIER CoilSHPassCount[2] ECU_ADDRESS 0x40002E36 /end MEASUREMENT
/begin MEASUREMENT Coil4DiagEnb "var comments" UBYTE udf_CM_18019 0 0.0 0.0 255.0 DISPLAY_IDENTIFIER CoilDiagEnb[3] ECU_ADDRESS 0x40002E09 /end MEASUREMENT
/begin MEASUREMENT Coil4SLFailMet "var comments" UBYTE udf_CM_18047 0 0.0 0.0 255.0 DISPLAY_IDENTIFIER CoilSLFailMet[3] ECU_ADDRESS 0x40002E0D /end MEASUREMENT
/begin MEASUREMENT Coil4SLTestComp "var comments" UBYTE udf_CM_18061 0 0.0 0.0 255.0 DISPLAY_IDENTIFIER CoilSLTestComp[3] ECU_ADDRESS 0x40002E15 /end MEASUREMENT
/begin MEASUREMENT Coil4SLTestFail "var comments" UBYTE udf_CM_18068 0 0.0 0.0 255.0 DISPLAY_IDENTIFIER CoilSLTestFail[3] ECU_ADDRESS 0x40002E3D /end MEASUREMENT
/begin MEASUREMENT Coil4SLFailCount "var comments" UWORD udf_CM_18026 0 0.0 0.0 65535.0 DISPLAY_IDENTIFIER CoilSLFailCount[3] ECU_ADDRESS 0x40002E20 /end MEASUREMENT
/begin MEASUREMENT Coil4SLPassCount "var comments" UWORD udf_CM_18054 0 0.0 0.0 65535.0 DISPLAY_IDENTIFIER CoilSLPassCount[3] ECU_ADDRESS 0x40002E28 /end MEASUREMENT
/begin MEASUREMENT Coil4SHFailMet "var comments" UBYTE udf_CM_18047 0 0.0 0.0 255.0 DISPLAY_IDENTIFIER CoilSHFailMet[3] ECU_ADDRESS 0x40002E11 /end MEASUREMENT
/begin MEASUREMENT Coil4SHTestComp "var comments" UBYTE udf_CM_18061 0 0.0 0.0 255.0 DISPLAY_IDENTIFIER CoilSHTestComp[3] ECU_ADDRESS 0x40002E19 /end MEASUREMENT
/begin MEASUREMENT Coil4SHTestFail "var comments" UBYTE udf_CM_18068 0 0.0 0.0 255.0 DISPLAY_IDENTIFIER CoilSHTestFail[3] ECU_ADDRESS 0x40002E41 /end MEASUREMENT
/begin MEASUREMENT Coil4SHFailCount "var comments" UWORD udf_CM_18026 0 0.0 0.0 65535.0 DISPLAY_IDENTIFIER CoilSHFailCount[3] ECU_ADDRESS 0x40002E30 /end MEASUREMENT
/begin MEASUREMENT Coil4SHPassCount "var comments" UWORD udf_CM_18054 0 0.0 0.0 65535.0 DISPLAY_IDENTIFIER CoilSHPassCount[3] ECU_ADDRESS 0x40002E38 /end MEASUREMENT
/begin MEASUREMENT CrkNoSigDiagEnb "var comments" UBYTE udf_CM_15905 0 0.0 0.0 255.0 ECU_ADDRESS 0x40002D2C /end MEASUREMENT
/begin MEASUREMENT CrkNoSigFailMet "var comments" UBYTE udf_CM_15912 0 0.0 0.0 255.0 ECU_ADDRESS 0x40002D35 /end MEASUREMENT
/begin MEASUREMENT CrkNoSigTestFail "var comments" UBYTE udf_CM_15926 0 0.0 0.0 255.0 ECU_ADDRESS 0x40002D33 /end MEASUREMENT
/begin MEASUREMENT CrkNoSigTestComp "var comments" UBYTE udf_CM_15919 0 0.0 0.0 255.0 ECU_ADDRESS 0x40002D31 /end MEASUREMENT
/begin MEASUREMENT CrkNoSigFailCount "var comments" UWORD udf_CM_18054 0 0.0 0.0 65535.0 ECU_ADDRESS 0x40002D38 /end MEASUREMENT
/begin MEASUREMENT CrkNoSigPassCount "var comments" UWORD udf_CM_18054 0 0.0 0.0 65535.0 ECU_ADDRESS 0x40002D36 /end MEASUREMENT
/begin MEASUREMENT CrkNoSigMAPFilt "var comments" UWORD udf_CM_15562 0 0.0 0.0 255.99609375 ECU_ADDRESS 0x40002D2E /end MEASUREMENT
/begin MEASUREMENT CrkNoSigMAPDelta "var comments" UWORD udf_CM_15562 0 0.0 0.0 255.99609375 ECU_ADDRESS 0x40002D3E /end MEASUREMENT
/begin MEASUREMENT CrkNoisyDiagEnb "var comments" UBYTE udf_CM_15856 0 0.0 0.0 255.0 ECU_ADDRESS 0x40002D2D /end MEASUREMENT
/begin MEASUREMENT CrkNoisyFailCnt "var comments" UWORD udf_CM_15863 0 0.0 0.0 65535.0 ECU_ADDRESS 0x40002D3C /end MEASUREMENT
/begin MEASUREMENT CrkNoisyFailMet "var comments" UBYTE udf_CM_15870 0 0.0 0.0 255.0 ECU_ADDRESS 0x40002D30 /end MEASUREMENT
/begin MEASUREMENT CrkNoisyPassCnt "var comments" UWORD udf_CM_15877 0 0.0 0.0 65535.0 ECU_ADDRESS 0x40002D3A /end MEASUREMENT
/begin MEASUREMENT CrkNoisyTestComp "var comments" UBYTE udf_CM_15884 0 0.0 0.0 255.0 ECU_ADDRESS 0x40002D32 /end MEASUREMENT
/begin MEASUREMENT CrkNoisyTestFail "var comments" UBYTE udf_CM_15891 0 0.0 0.0 255.0 ECU_ADDRESS 0x40002D34 /end MEASUREMENT
/begin MEASUREMENT CrankToRunMet "var comments" UBYTE udf_CM_15821 0 0.0 0.0 255.0 ECU_ADDRESS 0x40002A79 /end MEASUREMENT
/begin MEASUREMENT CrankToStallMet "var comments" UBYTE udf_CM_15828 0 0.0 0.0 255.0 ECU_ADDRESS 0x40002A7A /end MEASUREMENT
/begin MEASUREMENT MAPCIDEnb "var comments" UBYTE udf_CM_17095 0 0.0 0.0 255.0 ECU_ADDRESS 0x40002A65 /end MEASUREMENT
/begin MEASUREMENT DesireTPS "var comments" UWORD udf_CM_15989 0 0.0 0.0 199.9969482421875 ECU_ADDRESS 0x40002BC6 /end MEASUREMENT
/begin MEASUREMENT DiagWarningLamp "var comments" UBYTE udf_CM_16010 0 0.0 0.0 1.0 ECU_ADDRESS 0x40002C38 /end MEASUREMENT
/begin MEASUREMENT IdlDsrdEngSpdStep "var comments" UWORD udf_CM_16787 0 0.0 0.0 16383.75 ECU_ADDRESS 0x400028E0 /end MEASUREMENT
/begin MEASUREMENT IdlDsrdEngSpdTarget "var comments" UWORD udf_CM_16794 0 0.0 0.0 16383.75 ECU_ADDRESS 0x400028DE /end MEASUREMENT
/begin MEASUREMENT DsrdThrFlow "var comments" UWORD udf_CM_15982 0 0.0 0.0 511.9921875 ECU_ADDRESS 0x40002BDC /end MEASUREMENT
/begin MEASUREMENT DesireTPSOld "var comments" UWORD udf_CM_15996 0 0.0 0.0 199.9969482421875 ECU_ADDRESS 0x40002BDE /end MEASUREMENT
/begin MEASUREMENT EngSpdOld0 "var comments" UWORD udf_CM_16073 0 0.0 0.0 16383.75 DISPLAY_IDENTIFIER EngineSpeedOld[0] ECU_ADDRESS 0x40002B66 /end MEASUREMENT
/begin MEASUREMENT EngSpdOld1 "var comments" UWORD udf_CM_16122 0 0.0 0.0 16383.75 DISPLAY_IDENTIFIER EngineSpeedOld[1] ECU_ADDRESS 0x40002B68 /end MEASUREMENT
/begin MEASUREMENT EngSpdOld10 "var comments" UWORD udf_CM_16080 0 0.0 0.0 16383.75 DISPLAY_IDENTIFIER EngineSpeedOld[10] ECU_ADDRESS 0x40002B7A /end MEASUREMENT
/begin MEASUREMENT EngSpdOld11 "var comments" UWORD udf_CM_16087 0 0.0 0.0 16383.75 DISPLAY_IDENTIFIER EngineSpeedOld[11] ECU_ADDRESS 0x40002B7C /end MEASUREMENT
/begin MEASUREMENT EngSpdOld12 "var comments" UWORD udf_CM_16094 0 0.0 0.0 16383.75 DISPLAY_IDENTIFIER EngineSpeedOld[12] ECU_ADDRESS 0x40002B7E /end MEASUREMENT
/begin MEASUREMENT EngSpdOld13 "var comments" UWORD udf_CM_16101 0 0.0 0.0 16383.75 DISPLAY_IDENTIFIER EngineSpeedOld[13] ECU_ADDRESS 0x40002B80 /end MEASUREMENT
/begin MEASUREMENT EngSpdOld14 "var comments" UWORD udf_CM_16108 0 0.0 0.0 16383.75 DISPLAY_IDENTIFIER EngineSpeedOld[14] ECU_ADDRESS 0x40002B82 /end MEASUREMENT
/begin MEASUREMENT EngSpdOld15 "var comments" UWORD udf_CM_16115 0 0.0 0.0 16383.75 DISPLAY_IDENTIFIER EngineSpeedOld[15] ECU_ADDRESS 0x40002B84 /end MEASUREMENT
/begin MEASUREMENT EngSpdOld2 "var comments" UWORD udf_CM_16129 0 0.0 0.0 16383.75 DISPLAY_IDENTIFIER EngineSpeedOld[2] ECU_ADDRESS 0x40002B6A /end MEASUREMENT
/begin MEASUREMENT EngSpdOld3 "var comments" UWORD udf_CM_16136 0 0.0 0.0 16383.75 DISPLAY_IDENTIFIER EngineSpeedOld[3] ECU_ADDRESS 0x40002B6C /end MEASUREMENT
/begin MEASUREMENT EngSpdOld4 "var comments" UWORD udf_CM_16143 0 0.0 0.0 16383.75 DISPLAY_IDENTIFIER EngineSpeedOld[4] ECU_ADDRESS 0x40002B6E /end MEASUREMENT
/begin MEASUREMENT EngSpdOld5 "var comments" UWORD udf_CM_16150 0 0.0 0.0 16383.75 DISPLAY_IDENTIFIER EngineSpeedOld[5] ECU_ADDRESS 0x40002B70 /end MEASUREMENT
/begin MEASUREMENT EngSpdOld6 "var comments" UWORD udf_CM_16157 0 0.0 0.0 16383.75 DISPLAY_IDENTIFIER EngineSpeedOld[6] ECU_ADDRESS 0x40002B72 /end MEASUREMENT
/begin MEASUREMENT EngSpdOld7 "var comments" UWORD udf_CM_16164 0 0.0 0.0 16383.75 DISPLAY_IDENTIFIER EngineSpeedOld[7] ECU_ADDRESS 0x40002B74 /end MEASUREMENT
/begin MEASUREMENT EngSpdOld8 "var comments" UWORD udf_CM_16171 0 0.0 0.0 16383.75 DISPLAY_IDENTIFIER EngineSpeedOld[8] ECU_ADDRESS 0x40002B76 /end MEASUREMENT
/begin MEASUREMENT EngSpdOld9 "var comments" UWORD udf_CM_16178 0 0.0 0.0 16383.75 DISPLAY_IDENTIFIER EngineSpeedOld[9] ECU_ADDRESS 0x40002B78 /end MEASUREMENT
/begin MEASUREMENT MultFuelType "var comments" UBYTE udf_CM_16193 0 0.0 0.0 255.0 ECU_ADDRESS 0x40002BB0 /end MEASUREMENT
/begin MEASUREMENT MultFuelSeq "var comments" UBYTE udf_CM_18012 0 0.0 0.0 255.0 ECU_ADDRESS 0x40002BB5 /end MEASUREMENT
/begin MEASUREMENT EngineState "var comments" UBYTE udf_CM_16192 0 0.0 0.0 255.0 ECU_ADDRESS 0x40002A76 /end MEASUREMENT
/begin MEASUREMENT EngTorque "var comments" SWORD udf_CM_16059 0 0.0 -128.0 127.99609375 DISPLAY_IDENTIFIER EngineFlywheelTorq ECU_ADDRESS 0x40002678 /end MEASUREMENT
/begin MEASUREMENT EngineTuning "var comments" UBYTE udf_CM_16199 0 0.0 0.0 255.0 ECU_ADDRESS 0x40002A83 /end MEASUREMENT
/begin MEASUREMENT O2_1_SHTestFail "var comments" UBYTE udf_CM_17508 0 0.0 0.0 255.0 ECU_ADDRESS 0x40002D0E /end MEASUREMENT
/begin MEASUREMENT O2_1_ShrtDiagEnb "var comments" UBYTE udf_CM_17494 0 0.0 0.0 255.0 ECU_ADDRESS 0x40002D0C /end MEASUREMENT
/begin MEASUREMENT O2_1_SHFailMet "var comments" UBYTE udf_CM_17487 0 0.0 0.0 255.0 ECU_ADDRESS 0x40002D12 /end MEASUREMENT
/begin MEASUREMENT O2_1_SHFailCount "var comments" UWORD udf_CM_17480 0 0.0 0.0 65535.0 ECU_ADDRESS 0x40002D14 /end MEASUREMENT
/begin MEASUREMENT O2_1_SLFailMet "var comments" UBYTE udf_CM_17522 0 0.0 0.0 255.0 ECU_ADDRESS 0x40002D11 /end MEASUREMENT
/begin MEASUREMENT O2_1_SLFailCount "var comments" UWORD udf_CM_17515 0 0.0 0.0 65535.0 ECU_ADDRESS 0x40002D16 /end MEASUREMENT
/begin MEASUREMENT O2_1_SLTestFail "var comments" UBYTE udf_CM_17529 0 0.0 0.0 255.0 ECU_ADDRESS 0x40002D0F /end MEASUREMENT
/begin MEASUREMENT O2_1_ShrtPassCount "var comments" UWORD udf_CM_17501 0 0.0 0.0 65535.0 ECU_ADDRESS 0x40002D18 /end MEASUREMENT
/begin MEASUREMENT RO2_1_SHTestFail "var comments" UBYTE udf_CM_17508 0 0.0 0.0 255.0 ECU_ADDRESS 0x40002D1D /end MEASUREMENT
/begin MEASUREMENT RO2_1_ShrtDiagEnb "var comments" UBYTE udf_CM_17494 0 0.0 0.0 255.0 ECU_ADDRESS 0x40002D1A /end MEASUREMENT
/begin MEASUREMENT RO2_1_SHFailMet "var comments" UBYTE udf_CM_17487 0 0.0 0.0 255.0 ECU_ADDRESS 0x40002D20 /end MEASUREMENT
/begin MEASUREMENT RO2_1_SHFailCount "var comments" UWORD udf_CM_17480 0 0.0 0.0 65535.0 ECU_ADDRESS 0x40002D22 /end MEASUREMENT
/begin MEASUREMENT RO2_1_SLFailMet "var comments" UBYTE udf_CM_17522 0 0.0 0.0 255.0 ECU_ADDRESS 0x40002D1F /end MEASUREMENT
/begin MEASUREMENT RO2_1_SLFailCount "var comments" UWORD udf_CM_17515 0 0.0 0.0 65535.0 ECU_ADDRESS 0x40002D24 /end MEASUREMENT
/begin MEASUREMENT RO2_1_SLTestFail "var comments" UBYTE udf_CM_17529 0 0.0 0.0 255.0 ECU_ADDRESS 0x40002D1C /end MEASUREMENT
/begin MEASUREMENT RO2_1_ShrtPassCount "var comments" UWORD udf_CM_17501 0 0.0 0.0 65535.0 ECU_ADDRESS 0x40002D26 /end MEASUREMENT
/begin MEASUREMENT BaseFPWCyl1 "var comments" UWORD udf_CM_15597 0 0.0 0.0 1023.984375 DISPLAY_IDENTIFIER BaseFPWCyl ECU_ADDRESS 0x4000268C /end MEASUREMENT
/begin MEASUREMENT BaseFuelMassCyl1 "var comments" UWORD udf_CM_15604 0 0.0 0.0 0.9999849796295166 DISPLAY_IDENTIFIER BaseFuelMassCyl ECU_ADDRESS 0x40002686 /end MEASUREMENT
/begin MEASUREMENT BaseFMPrevCyl1 "var comments" UWORD udf_CM_15590 0 0.0 0.0 0.9999849796295166 DISPLAY_IDENTIFIER BaseFMPrevCyl ECU_ADDRESS 0x40002696 /end MEASUREMENT
/begin MEASUREMENT FPWClCorrCyl1 "var comments" UWORD udf_CM_16409 0 0.0 0.0 1023.984375 DISPLAY_IDENTIFIER FPWClCorrCyl[0] ECU_ADDRESS 0x4000267E /end MEASUREMENT
/begin MEASUREMENT FPWClCorrCyl2 "var comments" UWORD udf_CM_16416 0 0.0 0.0 1023.984375 DISPLAY_IDENTIFIER FPWClCorrCyl[1] ECU_ADDRESS 0x40002680 /end MEASUREMENT
/begin MEASUREMENT ChrgAirTmpCyl1 "var comments" SWORD udf_CM_15646 0 0.0 -256.0 255.9921875 DISPLAY_IDENTIFIER ChrgAirTmpCyl ECU_ADDRESS 0x40002618 /end MEASUREMENT
/begin MEASUREMENT FuelCLTermCyl1 "var comments" SWORD udf_CM_16437 0 0.0 -4.0 3.9998779296875 DISPLAY_IDENTIFIER FuelCLTermCyl ECU_ADDRESS 0x40002844 /end MEASUREMENT
/begin MEASUREMENT FuelCLEnbCyl1 "var comments" UBYTE udf_CM_16423 0 0.0 0.0 255.0 DISPLAY_IDENTIFIER FuelCLEnbCyl ECU_ADDRESS 0x40002855 /end MEASUREMENT
/begin MEASUREMENT FuelINTCyl1 "var comments" SWORD udf_CM_16500 0 0.0 -32768.0 32767.0 DISPLAY_IDENTIFIER FuelINTCyl ECU_ADDRESS 0x40002852 /end MEASUREMENT
/begin MEASUREMENT FuelINTDlyCyl1 "var comments" UWORD udf_CM_16507 0 0.0 0.0 1023.984375 DISPLAY_IDENTIFIER FuelINTDlyCyl ECU_ADDRESS 0x40002866 /end MEASUREMENT
/begin MEASUREMENT FPropMinDurEnb "var comments" UBYTE udf_CM_16395 0 0.0 0.0 255.0 ECU_ADDRESS 0x40002861 /end MEASUREMENT
/begin MEASUREMENT FuelCLC_MultTerm "var comments" SWORD udf_CM_17067 0 0.0 -32.0 31.9990234375 ECU_ADDRESS 0x40002840 /end MEASUREMENT
/begin MEASUREMENT RawO2RLThresh "var comments" UWORD udf_CM_17648 0 0.0 0.0 1023.984375 ECU_ADDRESS 0x4000286C /end MEASUREMENT
/begin MEASUREMENT FPropLoLoadCond "var comments" UBYTE udf_CM_19230 0 0.0 0.0 255.0 ECU_ADDRESS 0x40002860 /end MEASUREMENT
/begin MEASUREMENT FPropAddFuelCyl1 "var comments" UBYTE udf_CM_16381 0 0.0 0.0 255.0 DISPLAY_IDENTIFIER FPropAddFuelCyl[0] ECU_ADDRESS 0x4000286E /end MEASUREMENT
/begin MEASUREMENT FuelINTRstCyl1 "var comments" UBYTE udf_CM_16521 0 0.0 0.0 255.0 DISPLAY_IDENTIFIER FuelINTRstCyl ECU_ADDRESS 0x4000284B /end MEASUREMENT
/begin MEASUREMENT FuelINTDlyPass1 "var comments" UBYTE udf_CM_16514 0 0.0 0.0 255.0 DISPLAY_IDENTIFIER FuelINTDlyPass ECU_ADDRESS 0x4000284A /end MEASUREMENT
/begin MEASUREMENT INTRatioCyl1 "var comments" UWORD udf_CM_19048 0 0.0 0.0 1.999969005584717 DISPLAY_IDENTIFIER INTRatioCyl ECU_ADDRESS 0x40002842 /end MEASUREMENT
/begin MEASUREMENT FPropRichHold "var comments" UBYTE udf_CM_16402 0 0.0 0.0 255.0 ECU_ADDRESS 0x4000285A /end MEASUREMENT
/begin MEASUREMENT FuelPropCyl1 "var comments" UWORD udf_CM_16535 0 0.0 0.0 199.9969482421875 DISPLAY_IDENTIFIER FuelPropCyl ECU_ADDRESS 0x40002858 /end MEASUREMENT
/begin MEASUREMENT FuelCLRstCyl1 "var comments" UBYTE udf_CM_16430 0 0.0 0.0 255.0 DISPLAY_IDENTIFIER FuelCLRstCyl ECU_ADDRESS 0x4000285E /end MEASUREMENT
/begin MEASUREMENT CATFactorCyl1 "var comments" SWORD udf_CM_15639 0 0.0 -1.998847961425781 1.998787045478821 DISPLAY_IDENTIFIER CATFactorCyl ECU_ADDRESS 0x40002616 /end MEASUREMENT
/begin MEASUREMENT AIRF_T_Inverse_CAT_Term "var comments" UWORD udf_CM_15261 0 0.0 0.0 0.9999849796295166 ECU_ADDRESS 0x40002614 /end MEASUREMENT
/begin MEASUREMENT FuelEOI "var comments" UWORD udf_CM_16465 0 0.0 0.0 1023.984375 ECU_ADDRESS 0x40002722 /end MEASUREMENT
/begin COMPU_METHOD udf_CM_15261 "Ax + B" RAT_FUNC "%4.4" "ratio" COEFFS 0.0 65536.00026843546 0.0 0.0 0.0 1.0 /end COMPU_METHOD
/begin COMPU_METHOD udf_CM_15422 "Ax + B" RAT_FUNC "%4.4" "ratio" COEFFS 0.0 2048.0 0.0 0.0 0.0 1.0 /end COMPU_METHOD
/begin COMPU_METHOD udf_CM_15429 "Ax + B" RAT_FUNC "%4.4" "ratio" COEFFS 0.0 2048.0 0.0 0.0 0.0 1.0 /end COMPU_METHOD
/begin COMPU_METHOD udf_CM_15436 "Ax + B" RAT_FUNC "%4.0" "boolean" COEFFS 0 1 0 0 0 1 /end COMPU_METHOD
/begin COMPU_METHOD udf_CM_15450 "Ax + B" RAT_FUNC "%4.4" "ratio" COEFFS 0.0 2048.0 0.0 0.0 0.0 1.0 /end COMPU_METHOD
/begin COMPU_METHOD udf_CM_15457 "Ax + B" RAT_FUNC "%4.4" "ratio" COEFFS 0.0 2048.0 0.0 0.0 0.0 1.0 /end COMPU_METHOD
/begin COMPU_METHOD udf_CM_15464 "Ax + B" RAT_FUNC "%4.4" "ratio" COEFFS 0.0 2048.0 0.0 0.0 0.0 1.0 /end COMPU_METHOD
/begin COMPU_METHOD udf_CM_15485 "Ax + B" RAT_FUNC "%4.4" "ratio" COEFFS 0.0 2048.0 0.0 0.0 0.0 1.0 /end COMPU_METHOD
/begin COMPU_METHOD udf_CM_15492 "Ax + B" RAT_FUNC "%4.4" "volt" COEFFS 0.0 2048.0 0.0 0.0 0.0 1.0 /end COMPU_METHOD
/begin COMPU_METHOD udf_CM_15499 "Ax + B" RAT_FUNC "%4.4" "volt" COEFFS 0.0 2048.0 0.0 0.0 0.0 1.0 /end COMPU_METHOD
/begin COMPU_METHOD udf_CM_15506 "Ax + B" RAT_FUNC "%4.4" "ratio" COEFFS 0.0 2048.0 0.0 0.0 0.0 1.0 /end COMPU_METHOD
/begin COMPU_METHOD udf_CM_15513 "Ax + B" RAT_FUNC "%4.0" "boolean" COEFFS 0 1 0 0 0 1 /end COMPU_METHOD
/begin COMPU_METHOD udf_CM_15520 "Ax + B" RAT_FUNC "%4.4" "ratio" COEFFS 0.0 2048.0 0.0 0.0 0.0 1.0 /end COMPU_METHOD
/begin COMPU_METHOD udf_CM_15527 "Ax + B" RAT_FUNC "%4.4" "ratio" COEFFS 0.0 2048.0 0.0 0.0 0.0 1.0 /end COMPU_METHOD
/begin COMPU_METHOD udf_CM_15534 "Ax + B" RAT_FUNC "%4.4" "gm/sec" COEFFS 0.0 128.0 0.0 0.0 0.0 1.0 /end COMPU_METHOD
/begin COMPU_METHOD udf_CM_15541 "Ax + B" RAT_FUNC "%4.4" "gm/sec" COEFFS 0.0 128.0 0.0 0.0 0.0 1.0 /end COMPU_METHOD
/begin COMPU_METHOD udf_CM_15562 "Ax + B" RAT_FUNC "%4.4" "kpa" COEFFS 0.0 256.0 0.0 0.0 0.0 1.0 /end COMPU_METHOD
/begin COMPU_METHOD udf_CM_15590 "Ax + B" RAT_FUNC "%4.4" "gm" COEFFS 0.0 65536.00026843546 0.0 0.0 0.0 1.0 /end COMPU_METHOD
/begin COMPU_METHOD udf_CM_15597 "Ax + B" RAT_FUNC "%4.4" "msec" COEFFS 0.0 64.0 0.0 0.0 0.0 1.0 /end COMPU_METHOD
/begin COMPU_METHOD udf_CM_15604 "Ax + B" RAT_FUNC "%4.4" "gm" COEFFS 0.0 65536.00026843546 0.0 0.0 0.0 1.0 /end COMPU_METHOD
/begin COMPU_METHOD CM_Boolean1 "" RAT_FUNC "%1.0" "bool" COEFFS 0 1 0 0 0 1 /end COMPU_METHOD
/begin COMPU_METHOD CM_Boolean4 "" RAT_FUNC "%1.0" "None" COEFFS 0 1 0 0 0 1 /end COMPU_METHOD
/begin COMPU_METHOD udf_CM_15639 "Ax + B" RAT_FUNC "%4.4" "ratio" COEFFS 0.0 16393.44262295082 0.0 0.0 0.0 1.0 /end COMPU_METHOD
/begin COMPU_METHOD udf_CM_15646 "Ax + B" RAT_FUNC "%4.4" "degC" COEFFS 0.0 128.0 0.0 0.0 0.0 1.0 /end COMPU_METHOD
/begin COMPU_METHOD udf_CM_15674 "Ax + B" RAT_FUNC "%4.0" "None" COEFFS 0 1 0 0 0 1 /end COMPU_METHOD
/begin COMPU_METHOD udf_CM_15716 "Ax + B" RAT_FUNC "%4.0" "Counts" COEFFS 0 1 0 0 0 1 /end COMPU_METHOD
/begin COMPU_METHOD udf_CM_15723 "Ax + B" RAT_FUNC "%4.0" "None" COEFFS 0 1 0 0 0 1 /end COMPU_METHOD
/begin COMPU_METHOD udf_CM_15730 "Ax + B" RAT_FUNC "%4.0" "Counts" COEFFS 0 1 0 0 0 1 /end COMPU_METHOD
/begin COMPU_METHOD udf_CM_15737 "Ax + B" RAT_FUNC "%4.0" "None" COEFFS 0 1 0 0 0 1 /end COMPU_METHOD
/begin COMPU_METHOD CM_Count1 "" RAT_FUNC "%3.0" "count" COEFFS 0 1 0 0 0 1 /end COMPU_METHOD
/begin COMPU_METHOD CM_Count3 "" RAT_FUNC "%3.0" "None" COEFFS 0 1 0 0 0 1 /end COMPU_METHOD
/begin COMPU_METHOD udf_CM_15821 "Ax + B" RAT_FUNC "%4.0" "None" COEFFS 0 1 0 0 0 1 /end COMPU_METHOD
/begin COMPU_METHOD udf_CM_15828 "Ax + B" RAT_FUNC "%4.0" "None" COEFFS 0 1 0 0 0 1 /end COMPU_METHOD
/begin COMPU_METHOD udf_CM_15856 "Ax + B" RAT_FUNC "%4.0" "" COEFFS 0 1 0 0 0 1 /end COMPU_METHOD
/begin COMPU_METHOD udf_CM_15863 "Ax + B" RAT_FUNC "%4.0" "" COEFFS 0 1 0 0 0 1 /end COMPU_METHOD
/begin COMPU_METHOD udf_CM_15870 "Ax + B" RAT_FUNC "%4.0" "" COEFFS 0 1 0 0 0 1 /end COMPU_METHOD
/begin COMPU_METHOD udf_CM_15877 "Ax + B" RAT_FUNC "%4.0" "" COEFFS 0 1 0 0 0 1 /end COMPU_METHOD
/begin COMPU_METHOD udf_CM_15884 "Ax + B" RAT_FUNC "%4.0" "" COEFFS 0 1 0 0 0 1 /end COMPU_METHOD
/begin COMPU_METHOD udf_CM_15891 "Ax + B" RAT_FUNC "%4.0" "" COEFFS 0 1 0 0 0 1 /end COMPU_METHOD
/begin COMPU_METHOD udf_CM_15905 "Ax + B" RAT_FUNC "%4.0" "" COEFFS 0 1 0 0 0 1 /end COMPU_METHOD
/begin COMPU_METHOD udf_CM_15912 "Ax + B" RAT_FUNC "%4.0" "" COEFFS 0 1 0 0 0 1 /end COMPU_METHOD
/begin COMPU_METHOD udf_CM_15919 "Ax + B" RAT_FUNC "%4.0" "" COEFFS 0 1 0 0 0 1 /end COMPU_METHOD
/begin COMPU_METHOD udf_CM_15926 "Ax + B" RAT_FUNC "%4.0" "" COEFFS 0 1 0 0 0 1 /end COMPU_METHOD
/begin COMPU_METHOD CM_EOI "" TAB_VERB "%10.4" "" COMPU_TAB_REF CM_EOI_TAB /end COMPU_METHOD
/begin COMPU_METHOD CM_ID "" TAB_VERB "%10.4" "" COMPU_TAB_REF CM_ID_TAB /end COMPU_METHOD
/begin COMPU_METHOD CM_FL_DAT "" TAB_VERB "%10.4" "" COMPU_TAB_REF CM_FL_DAT_TAB /end COMPU_METHOD
/begin COMPU_METHOD CM_LIGHT_TYPE "" TAB_VERB "%4.0" "" COMPU_TAB_REF CM_LIGHT_TYPE_TAB /end COMPU_METHOD
/begin COMPU_METHOD CM_KNK_HZ "" TAB_VERB "%4.0" "" COMPU_TAB_REF CM_KNK_HZ_TAB /end COMPU_METHOD
/begin COMPU_METHOD CM_KNK_GAIN "" TAB_VERB "%4.0" "" COMPU_TAB_REF CM_KNK_GAIN_TAB /end COMPU_METHOD
/begin COMPU_METHOD CM_KNK_INT "" TAB_VERB "%4.0" "" COMPU_TAB_REF CM_KNK_INT_TAB /end COMPU_METHOD
/begin COMPU_METHOD udf_CM_15982 "Ax + B" RAT_FUNC "%4.4" "Gram" COEFFS 0.0 128.0 0.0 0.0 0.0 1.0 /end COMPU_METHOD
/begin COMPU_METHOD udf_CM_15989 "Ax + B" RAT_FUNC "%4.4" "percent" COEFFS 0.0 327.6800000536871 0.0 0.0 0.0 1.0 /end COMPU_METHOD
/begin COMPU_METHOD udf_CM_15996 "Ax + B" RAT_FUNC "%4.0" "percent" COEFFS 0.0 327.6800000536871 0.0 0.0 0.0 1.0 /end COMPU_METHOD
/begin COMPU_METHOD udf_CM_16010 "" TAB_VERB "%10.4" "" COMPU_TAB_REF udf_CV_19704 /end COMPU_METHOD
/begin COMPU_METHOD udf_CM_16059 "Ax + B" RAT_FUNC "%4.4" "NM" COEFFS 0.0 256.0 0.0 0.0 0.0 1.0 /end COMPU_METHOD
/begin COMPU_METHOD udf_CM_16073 "Ax + B" RAT_FUNC "%4.4" "rpm" COEFFS 0.0 4.0 0.0 0.0 0.0 1.0 /end COMPU_METHOD
/begin COMPU_METHOD udf_CM_16080 "Ax + B" RAT_FUNC "%4.4" "rpm" COEFFS 0.0 4.0 0.0 0.0 0.0 1.0 /end COMPU_METHOD
/begin COMPU_METHOD udf_CM_16087 "Ax + B" RAT_FUNC "%4.4" "rpm" COEFFS 0.0 4.0 0.0 0.0 0.0 1.0 /end COMPU_METHOD
/begin COMPU_METHOD udf_CM_16094 "Ax + B" RAT_FUNC "%4.4" "rpm" COEFFS 0.0 4.0 0.0 0.0 0.0 1.0 /end COMPU_METHOD
/begin COMPU_METHOD udf_CM_16101 "Ax + B" RAT_FUNC "%4.4" "rpm" COEFFS 0.0 4.0 0.0 0.0 0.0 1.0 /end COMPU_METHOD
/begin COMPU_METHOD udf_CM_16108 "Ax + B" RAT_FUNC "%4.4" "rpm" COEFFS 0.0 4.0 0.0 0.0 0.0 1.0 /end COMPU_METHOD
/begin COMPU_METHOD udf_CM_16115 "Ax + B" RAT_FUNC "%4.4" "rpm" COEFFS 0.0 4.0 0.0 0.0 0.0 1.0 /end COMPU_METHOD
/begin COMPU_METHOD udf_CM_16122 "Ax + B" RAT_FUNC "%4.4" "rpm" COEFFS 0.0 4.0 0.0 0.0 0.0 1.0 /end COMPU_METHOD
/begin COMPU_METHOD udf_CM_16129 "Ax + B" RAT_FUNC "%4.4" "rpm" COEFFS 0.0 4.0 0.0 0.0 0.0 1.0 /end COMPU_METHOD
/begin COMPU_METHOD udf_CM_16136 "Ax + B" RAT_FUNC "%4.4" "rpm" COEFFS 0.0 4.0 0.0 0.0 0.0 1.0 /end COMPU_METHOD
/begin COMPU_METHOD udf_CM_16143 "Ax + B" RAT_FUNC "%4.4" "rpm" COEFFS 0.0 4.0 0.0 0.0 0.0 1.0 /end COMPU_METHOD
/begin COMPU_METHOD udf_CM_16150 "Ax + B" RAT_FUNC "%4.4" "rpm" COEFFS 0.0 4.0 0.0 0.0 0.0 1.0 /end COMPU_METHOD
/begin COMPU_METHOD udf_CM_16157 "Ax + B" RAT_FUNC "%4.4" "rpm" COEFFS 0.0 4.0 0.0 0.0 0.0 1.0 /end COMPU_METHOD
/begin COMPU_METHOD udf_CM_16164 "Ax + B" RAT_FUNC "%4.4" "rpm" COEFFS 0.0 4.0 0.0 0.0 0.0 1.0 /end COMPU_METHOD
/begin COMPU_METHOD udf_CM_16171 "Ax + B" RAT_FUNC "%4.4" "rpm" COEFFS 0.0 4.0 0.0 0.0 0.0 1.0 /end COMPU_METHOD
/begin COMPU_METHOD udf_CM_16178 "Ax + B" RAT_FUNC "%4.4" "rpm" COEFFS 0.0 4.0 0.0 0.0 0.0 1.0 /end COMPU_METHOD
/begin COMPU_METHOD udf_CM_16192 "" TAB_VERB "%10.4" "" COMPU_TAB_REF udf_CV_19710 /end COMPU_METHOD
/begin COMPU_METHOD udf_CM_16193 "" TAB_VERB "%10.4" "" COMPU_TAB_REF udf_CV_19711 /end COMPU_METHOD
/begin COMPU_METHOD udf_CM_16199 "Ax + B" RAT_FUNC "%4.0" "None" COEFFS 0 1 0 0 0 1 /end COMPU_METHOD
/begin COMPU_METHOD udf_CM_16381 "Ax + B" RAT_FUNC "%4.0" "boolean" COEFFS 0 1 0 0 0 1 /end COMPU_METHOD
/begin COMPU_METHOD udf_CM_16395 "Ax + B" RAT_FUNC "%4.0" "boolean" COEFFS 0 1 0 0 0 1 /end COMPU_METHOD
/begin COMPU_METHOD udf_CM_16402 "Ax + B" RAT_FUNC "%4.0" "boolean" COEFFS 0 1 0 0 0 1 /end COMPU_METHOD
/begin COMPU_METHOD udf_CM_16409 "Ax + B" RAT_FUNC "%4.4" "msec" COEFFS 0.0 64.0 0.0 0.0 0.0 1.0 /end COMPU_METHOD
/begin COMPU_METHOD udf_CM_16416 "Ax + B" RAT_FUNC "%4.4" "msec" COEFFS 0.0 64.0 0.0 0.0 0.0 1.0 /end COMPU_METHOD
/begin COMPU_METHOD udf_CM_16423 "Ax + B" RAT_FUNC "%4.0" "boolean" COEFFS 0 1 0 0 0 1 /end COMPU_METHOD
/begin COMPU_METHOD udf_CM_16430 "Ax + B" RAT_FUNC "%4.0" "boolean" COEFFS 0 1 0 0 0 1 /end COMPU_METHOD
/begin COMPU_METHOD udf_CM_16437 "Ax + B" RAT_FUNC "%4.4" "msec" COEFFS 0.0 8192.000033554432 0.0 0.0 0.0 1.0 /end COMPU_METHOD
/begin COMPU_METHOD udf_CM_16465 "Ax + B" RAT_FUNC "%4.4" "angle" COEFFS 0.0 64.0 0.0 0.0 0.0 1.0 /end COMPU_METHOD
/begin COMPU_METHOD udf_CM_16500 "Ax + B" RAT_FUNC "%4.4" "counts" COEFFS 0 1 0 0 0 1 /end COMPU_METHOD
/begin COMPU_METHOD udf_CM_16507 "Ax + B" RAT_FUNC "%4.4" "msec" COEFFS 0.0 64.0 0.0 0.0 0.0 1.0 /end COMPU_METHOD
/begin COMPU_METHOD udf_CM_16514 "Ax + B" RAT_FUNC "%4.0" "boolean" COEFFS 0 1 0 0 0 1 /end COMPU_METHOD
/begin COMPU_METHOD udf_CM_16521 "Ax + B" RAT_FUNC "%4.0" "boolean" COEFFS 0 1 0 0 0 1 /end COMPU_METHOD
/begin COMPU_METHOD udf_CM_16535 "Ax + B" RAT_FUNC "%4.4" "percent" COEFFS 0.0 327.6800000536871 0.0 0.0 0.0 1.0 /end COMPU_METHOD
/begin COMPU_METHOD udf_CM_16577 "Ax + B" RAT_FUNC "%4.0" "Counts" COEFFS 0 1 0 0 0 1 /end COMPU_METHOD
/begin COMPU_METHOD udf_CM_16584 "Ax + B" RAT_FUNC "%4.0" "None" COEFFS 0 1 0 0 0 1 /end COMPU_METHOD
/begin COMPU_METHOD udf_CM_16591 "Ax + B" RAT_FUNC "%4.0" "None" COEFFS 0 1 0 0 0 1 /end COMPU_METHOD
/begin COMPU_METHOD udf_CM_16696 "Ax + B" RAT_FUNC "%4.0" "None" COEFFS 0 1 0 0 0 1 /end COMPU_METHOD
/begin COMPU_METHOD udf_CM_16787 "Ax + B" RAT_FUNC "%4.4" "rpm" COEFFS 0.0 4.0 0.0 0.0 0.0 1.0 /end COMPU_METHOD
/begin COMPU_METHOD udf_CM_16794 "Ax + B" RAT_FUNC "%4.4" "rpm" COEFFS 0.0 4.0 0.0 0.0 0.0 1.0 /end COMPU_METHOD
/begin COMPU_METHOD udf_CM_16878 "Ax + B" RAT_FUNC "%4.4" "msec" COEFFS 0.0 64.0 0.0 0.0 0.0 1.0 /end COMPU_METHOD
/begin COMPU_METHOD udf_CM_16920 "Ax + B" RAT_FUNC "%4.1" "" COEFFS 0.0 2048.0 0.0 0.0 0.0 1.0 /end COMPU_METHOD
/begin COMPU_METHOD udf_CM_16948 "Ax + B" RAT_FUNC "%4.0" "None" COEFFS 0 1 0 0 0 1 /end COMPU_METHOD
/begin COMPU_METHOD udf_CM_16955 "Ax + B" RAT_FUNC "%4.0" "None" COEFFS 0 1 0 0 0 1 /end COMPU_METHOD
/begin COMPU_METHOD udf_CM_16997 "Ax + B" RAT_FUNC "%4.0" "Counts" COEFFS 0 1 0 0 0 1 /end COMPU_METHOD
/begin COMPU_METHOD udf_CM_17004 "Ax + B" RAT_FUNC "%4.0" "None" COEFFS 0 1 0 0 0 1 /end COMPU_METHOD
/begin COMPU_METHOD udf_CM_17011 "Ax + B" RAT_FUNC "%4.0" "None" COEFFS 0 1 0 0 0 1 /end COMPU_METHOD
/begin COMPU_METHOD udf_CM_17018 "Ax + B" RAT_FUNC "%4.0" "None" COEFFS 0 1 0 0 0 1 /end COMPU_METHOD
/begin COMPU_METHOD udf_CM_17025 "Ax + B" RAT_FUNC "%4.0" "Counts" COEFFS 0 1 0 0 0 1 /end COMPU_METHOD
/begin COMPU_METHOD udf_CM_17032 "Ax + B" RAT_FUNC "%4.0" "None" COEFFS 0 1 0 0 0 1 /end COMPU_METHOD
/begin COMPU_METHOD udf_CM_17039 "Ax + B" RAT_FUNC "%4.0" "None" COEFFS 0 1 0 0 0 1 /end COMPU_METHOD
/begin COMPU_METHOD udf_CM_17067 "Ax + B" RAT_FUNC "%4.4" "ratio" COEFFS 0.0 1024.0 0.0 0.0 0.0 1.0 /end COMPU_METHOD
/begin COMPU_METHOD udf_CM_17095 "Ax + B" RAT_FUNC "%4.0" "None" COEFFS 0 1 0 0 0 1 /end COMPU_METHOD
/begin COMPU_METHOD udf_CM_17235 "Ax + B" RAT_FUNC "%4.0" "boolean" COEFFS 0 1 0 0 0 1 /end COMPU_METHOD
/begin COMPU_METHOD udf_CM_17256 "Ax + B" RAT_FUNC "%4.0" "None" COEFFS 0 1 0 0 0 1 /end COMPU_METHOD
/begin COMPU_METHOD CM_Microsecond_1 "" RAT_FUNC "%6.0" "micro-seconds" COEFFS 0.0 0.125 0.0 0.0 0.0 1.0 /end COMPU_METHOD
/begin COMPU_METHOD CM_Mult_0to2 "" RAT_FUNC "%5.4" "Mul_0_to_2" COEFFS 0.0 128.0 0.0 0.0 0.0 1.0 /end COMPU_METHOD
/begin COMPU_METHOD CM_Mult0_to_2_ratio "" RAT_FUNC "%5.4" "ratio" COEFFS 0.0 128.0 0.0 0.0 0.0 1.0 /end COMPU_METHOD
/begin COMPU_METHOD CM_Mult0_to_2_ratio1 "" RAT_FUNC "%5.4" "ratio/512rpm" COEFFS 0.0 128.0 0.0 0.0 0.0 1.0 /end COMPU_METHOD
/begin COMPU_METHOD CM_Mult0_to_4_ratio "" RAT_FUNC "%5.4" "ratio" COEFFS 0.0 64.0 0.0 0.0 0.0 1.0 /end COMPU_METHOD
/begin COMPU_METHOD CM_Mult0_to_2_second "" RAT_FUNC "%5.4" "sec" COEFFS 0.0 128.0 0.0 0.0 0.0 1.0 /end COMPU_METHOD
/begin COMPU_METHOD CM_Equaloutput1 "Default N=E compu method" RAT_FUNC "%10.4" "" COEFFS 0 1 0 0 0 1 /end COMPU_METHOD
/begin COMPU_METHOD CM_Boolean6 "Default N=E compu method" RAT_FUNC "%10.4" "Boolean" COEFFS 0 1 0 0 0 1 /end COMPU_METHOD
/begin COMPU_METHOD udf_CM_17382 "Ax + B" RAT_FUNC "%4.0" "None" COEFFS 0 1 0 0 0 1 /end COMPU_METHOD
/begin COMPU_METHOD udf_CM_17389 "Ax + B" RAT_FUNC "%4.0" "Counts" COEFFS 0 1 0 0 0 1 /end COMPU_METHOD
/begin COMPU_METHOD udf_CM_17396 "Ax + B" RAT_FUNC "%4.0" "None" COEFFS 0 1 0 0 0 1 /end COMPU_METHOD
/begin COMPU_METHOD udf_CM_17403 "Ax + B" RAT_FUNC "%4.0" "None" COEFFS 0 1 0 0 0 1 /end COMPU_METHOD
/begin COMPU_METHOD udf_CM_17410 "Ax + B" RAT_FUNC "%4.0" "None" COEFFS 0 1 0 0 0 1 /end COMPU_METHOD
/begin COMPU_METHOD udf_CM_17417 "Ax + B" RAT_FUNC "%4.0" "Counts" COEFFS 0 1 0 0 0 1 /end COMPU_METHOD
/begin COMPU_METHOD udf_CM_17424 "Ax + B" RAT_FUNC "%4.0" "None" COEFFS 0 1 0 0 0 1 /end COMPU_METHOD
/begin COMPU_METHOD udf_CM_17431 "Ax + B" RAT_FUNC "%4.0" "None" COEFFS 0 1 0 0 0 1 /end COMPU_METHOD
/begin COMPU_METHOD udf_CM_17480 "Ax + B" RAT_FUNC "%4.0" "counts" COEFFS 0 1 0 0 0 1 /end COMPU_METHOD
/begin COMPU_METHOD udf_CM_17487 "Ax + B" RAT_FUNC "%4.0" "None" COEFFS 0 1 0 0 0 1 /end COMPU_METHOD
/begin COMPU_METHOD udf_CM_17494 "Ax + B" RAT_FUNC "%4.0" "None" COEFFS 0 1 0 0 0 1 /end COMPU_METHOD
/begin COMPU_METHOD udf_CM_17501 "Ax + B" RAT_FUNC "%4.0" "counts" COEFFS 0 1 0 0 0 1 /end COMPU_METHOD
/begin COMPU_METHOD udf_CM_17508 "Ax + B" RAT_FUNC "%4.0" "None" COEFFS 0 1 0 0 0 1 /end COMPU_METHOD
/begin COMPU_METHOD udf_CM_17515 "Ax + B" RAT_FUNC "%4.0" "counts" COEFFS 0 1 0 0 0 1 /end COMPU_METHOD
/begin COMPU_METHOD udf_CM_17522 "Ax + B" RAT_FUNC "%4.0" "None" COEFFS 0 1 0 0 0 1 /end COMPU_METHOD
/begin COMPU_METHOD udf_CM_17529 "Ax + B" RAT_FUNC "%4.0" "None" COEFFS 0 1 0 0 0 1 /end COMPU_METHOD
/begin COMPU_METHOD udf_CM_17648 "Ax + B" RAT_FUNC "%4.4" "millivolt" COEFFS 0.0 64.0 0.0 0.0 0.0 1.0 /end COMPU_METHOD
/begin COMPU_METHOD udf_CM_17690 "Ax + B" RAT_FUNC "%4.0" "None" COEFFS 0 1 0 0 0 1 /end COMPU_METHOD
/begin COMPU_METHOD udf_CM_18012 "Ax + B" RAT_FUNC "%4.0" "count" COEFFS 0 1 0 0 0 1 /end COMPU_METHOD
/begin COMPU_METHOD udf_CM_18019 "Ax + B" RAT_FUNC "%4.0" "None" COEFFS 0 1 0 0 0 1 /end COMPU_METHOD
/begin COMPU_METHOD udf_CM_18026 "Ax + B" RAT_FUNC "%4.0" "Counts" COEFFS 0 1 0 0 0 1 /end COMPU_METHOD
/begin COMPU_METHOD udf_CM_18047 "Ax + B" RAT_FUNC "%4.0" "None" COEFFS 0 1 0 0 0 1 /end COMPU_METHOD
/begin COMPU_METHOD udf_CM_18054 "Ax + B" RAT_FUNC "%4.0" "Counts" COEFFS 0 1 0 0 0 1 /end COMPU_METHOD
/begin COMPU_METHOD udf_CM_18061 "Ax + B" RAT_FUNC "%4.0" "None" COEFFS 0 1 0 0 0 1 /end COMPU_METHOD
/begin COMPU_METHOD udf_CM_18068 "Ax + B" RAT_FUNC "%4.0" "None" COEFFS 0 1 0 0 0 1 /end COMPU_METHOD
/begin COMPU_METHOD CM_Angle_8bit "" RAT_FUNC "%3.1" "angle" COEFFS 0.0 2.0 0.0 0.0 0.0 1.0 /end COMPU_METHOD
/begin COMPU_METHOD CM_Grams0to8_1 "" RAT_FUNC "%6.5" "grams" COEFFS 0.0 8192.000033554432 0.0 0.0 0.0 1.0 /end COMPU_METHOD
/begin COMPU_METHOD CM_FiltCoef "" RAT_FUNC "%7.6" "coef" COEFFS 0.0 65536.00026843546 0.0 0.0 0.0 1.0 /end COMPU_METHOD
/begin COMPU_METHOD CM_FactorRatio "" RAT_FUNC "%7.6" "ratio" COEFFS 0.0 65536.00026843546 0.0 0.0 0.0 1.0 /end COMPU_METHOD
/begin COMPU_METHOD CM_GramPerSecond_1 "" RAT_FUNC "%7.5" "grams/sec" COEFFS 0.0 128.0 0.0 0.0 0.0 1.0 /end COMPU_METHOD
/begin COMPU_METHOD udf_CM_18376 "" RAT_FUNC "%7.5" "ratio" COEFFS 0.0 4096.0 0.0 0.0 0.0 1.0 /end COMPU_METHOD
/begin COMPU_METHOD CM_kpa_8bit "" RAT_FUNC "%4.1" "kpa" COEFFS 0.0 2.0 0.0 0.0 0.0 1.0 /end COMPU_METHOD
/begin COMPU_METHOD CM_msec "" RAT_FUNC "%5.3" "msec" COEFFS 0.0 16.0 0.0 0.0 0.0 1.0 /end COMPU_METHOD
/begin COMPU_METHOD CM_mVolt "" RAT_FUNC "%4.0" "millivolt" COEFFS 0.0 0.25 0.0 0.0 0.0 1.0 /end COMPU_METHOD
/begin COMPU_METHOD CM_mVolt_2 "" RAT_FUNC "%7.3" "mvolt" COEFFS 0.0 64.0 0.0 0.0 0.0 1.0 /end COMPU_METHOD
/begin COMPU_METHOD CM_Ratio_0to2_2 "" RAT_FUNC "%6.5" "ratio" COEFFS 0.0 32768.00013421773 0.0 0.0 0.0 1.0 /end COMPU_METHOD
/begin COMPU_METHOD CM_Seconds_1 "" RAT_FUNC "%7.3" "sec" COEFFS 0.0 32.0 0.0 0.0 0.0 1.0 /end COMPU_METHOD
/begin COMPU_METHOD CM_SparkAngle_N256to256 "" RAT_FUNC "%7.4" "angle" COEFFS 0.0 128.0 0.0 0.0 0.0 1.0 /end COMPU_METHOD
/begin COMPU_METHOD CM_DegC_N256to256 "" RAT_FUNC "%7.4" "degC" COEFFS 0.0 128.0 0.0 0.0 0.0 1.0 /end COMPU_METHOD
/begin COMPU_METHOD CM_FiltCoef_1 "" RAT_FUNC "%5.4" "coef" COEFFS 0.0 256.0 0.0 0.0 0.0 1.0 /end COMPU_METHOD
/begin COMPU_METHOD CM_Mult_0to1_2 "" RAT_FUNC "%5.4" "ratio" COEFFS 0.0 256.0 0.0 0.0 0.0 1.0 /end COMPU_METHOD
/begin COMPU_METHOD CM_Percent_0to100 "" RAT_FUNC "%5.3" "percent" COEFFS 0.0 2.56 0.0 0.0 0.0 1.0 /end COMPU_METHOD
/begin COMPU_METHOD CM_Percent_0to100_1 "" RAT_FUNC "%6.4" "percent" COEFFS 0.0 655.3603892316423 0.0 0.0 0.0 1.0 /end COMPU_METHOD
/begin COMPU_METHOD CM_Percent_0to200_2 "" RAT_FUNC "%7.4" "percent" COEFFS 0.0 327.6800872415464 0.0 0.0 0.0 1.0 /end COMPU_METHOD
/begin COMPU_METHOD CM_Percent_0to200_3 "" RAT_FUNC "%6.3" "percent" COEFFS 0.0 1.28 0.0 0.0 0.0 1.0 /end COMPU_METHOD
/begin COMPU_METHOD CM_RPM_0to16384 "" RAT_FUNC "%7.2" "rpm" COEFFS 0.0 4.0 0.0 0.0 0.0 1.0 /end COMPU_METHOD
/begin COMPU_METHOD udf_CM_18586 "" RAT_FUNC "%7.2" "RPM" COEFFS 0.0 4.0 0.0 0.0 0.0 1.0 /end COMPU_METHOD
/begin COMPU_METHOD CM_kpa_n256to256_1 "" RAT_FUNC "%7.4" "kpa" COEFFS 0.0 128.0 0.0 0.0 0.0 1.0 /end COMPU_METHOD
/begin COMPU_METHOD CM_kpa_0to256_1 "" RAT_FUNC "%7.4" "kpa" COEFFS 0.0 256.0 0.0 0.0 0.0 1.0 /end COMPU_METHOD
/begin COMPU_METHOD CM_CrankAngle_0to1024 "" RAT_FUNC "%7.3" "angle" COEFFS 0.0 64.0 0.0 0.0 0.0 1.0 /end COMPU_METHOD
/begin COMPU_METHOD CM_msec_0to1024 "" RAT_FUNC "%7.3" "msec" COEFFS 0.0 64.0 0.0 0.0 0.0 1.0 /end COMPU_METHOD
/begin COMPU_METHOD CM_Second_0to1024 "" RAT_FUNC "%7.3" "sec" COEFFS 0.0 64.0 0.0 0.0 0.0 1.0 /end COMPU_METHOD
/begin COMPU_METHOD CM_Second_0to32 "" RAT_FUNC "%7.3" "sec" COEFFS 0.0 8.0 0.0 0.0 0.0 1.0 /end COMPU_METHOD
/begin COMPU_METHOD CM_SignedWord_n32768to32768_2 "" RAT_FUNC "%5.0" "counts" COEFFS 0 1 0 0 0 1 /end COMPU_METHOD
/begin COMPU_METHOD CM_Volt_0to32_1 "" RAT_FUNC "%6.4" "volt" COEFFS 0.0 2048.001048576537 0.0 0.0 0.0 1.0 /end COMPU_METHOD
/begin COMPU_METHOD CM_Volt_0to1024_1 "" RAT_FUNC "%6.4" "volt" COEFFS 0.0 64.0 0.0 0.0 0.0 1.0 /end COMPU_METHOD
/begin COMPU_METHOD CM_Second_0to4096 "" RAT_FUNC "%7.3" "sec" COEFFS 0.0 16.0 0.0 0.0 0.0 1.0 /end COMPU_METHOD
/begin COMPU_METHOD udf_CM_18698 "" RAT_FUNC "%7.4" "gram" COEFFS 0.0 128.0 0.0 0.0 0.0 1.0 /end COMPU_METHOD
/begin COMPU_METHOD udf_CM_18705 "" RAT_FUNC "%7.4" "grams" COEFFS 0.0 128.0 0.0 0.0 0.0 1.0 /end COMPU_METHOD
/begin COMPU_METHOD CM_Second_0to512 "" RAT_FUNC "%7.4" "sec" COEFFS 0.0 128.0 0.0 0.0 0.0 1.0 /end COMPU_METHOD
/begin COMPU_METHOD CM_Second_0to512_1 "" RAT_FUNC "%7.4" "seconds" COEFFS 0.0 128.0 0.0 0.0 0.0 1.0 /end COMPU_METHOD
/begin COMPU_METHOD CM_Count_0to65535 "" RAT_FUNC "%5.0" "count" COEFFS 0 1 0 0 0 1 /end COMPU_METHOD
/begin COMPU_METHOD CM_Count_0to65535_1 "" RAT_FUNC "%5.0" "counts" COEFFS 0 1 0 0 0 1 /end COMPU_METHOD
/begin COMPU_METHOD CM_Count_0to65535_2 "" RAT_FUNC "%5.0" "None" COEFFS 0 1 0 0 0 1 /end COMPU_METHOD
/begin COMPU_METHOD CM_Count_0to65535_3 "" RAT_FUNC "%5.0" "percent" COEFFS 0 1 0 0 0 1 /end COMPU_METHOD
/begin COMPU_METHOD CM_Second_0to65535 "" RAT_FUNC "%5.0" "sec" COEFFS 0 1 0 0 0 1 /end COMPU_METHOD
/begin COMPU_METHOD CM_msec_0to4 "" RAT_FUNC "%4.3" "msec" COEFFS 0.0 64.0 0.0 0.0 0.0 1.0 /end COMPU_METHOD
/begin COMPU_METHOD CM_Second_0to4 "" RAT_FUNC "%4.3" "sec" COEFFS 0.0 64.0 0.0 0.0 0.0 1.0 /end COMPU_METHOD
/begin COMPU_METHOD CM_Mult_0to8 "" RAT_FUNC "%4.3" "ratio" COEFFS 0.0 32.0 0.0 0.0 0.0 1.0 /end COMPU_METHOD
/begin COMPU_METHOD udf_CM_19048 "Ax + B" RAT_FUNC "%4.4" "ratio" COEFFS 0.0 32768.00013421773 0.0 0.0 0.0 1.0 /end COMPU_METHOD
/begin COMPU_METHOD udf_CM_19230 "Ax + B" RAT_FUNC "%4.0" "boolean" COEFFS 0 1 0 0 0 1 /end COMPU_METHOD
/begin COMPU_VTAB CM_EOI_TAB "" TAB_VERB 4 0 "Cyl1" 1 "Cyl2" 2 "Cyl3" 3 "Cyl4" /end COMPU_VTAB
/begin COMPU_VTAB CM_ID_TAB "" TAB_VERB 7 0 "ID1" 1 "ID2" 2 "ID3" 3 "ID4" 4 "ID5" 5 "ID6" 6 "ID7" /end COMPU_VTAB
/begin COMPU_VTAB CM_FL_DAT_TAB "" TAB_VERB 9 0 "LOOP" 1 "DAT1" 2 "DAT2" 3 "DAT3" 4 "DAT4" 5 "DAT5" 6 "DAT6" 7 "DAT7" 8 "DAT8" /end COMPU_VTAB
/begin COMPU_VTAB CM_LIGHT_TYPE_TAB "" TAB_VERB 5 0 "NONE" 1 "MIL" 2 "STOP" 3 "WARNING" 4 "PROTECT" /end COMPU_VTAB
/begin COMPU_VTAB CM_KNK_HZ_TAB "" TAB_VERB 64 0 "1.22KHz" 1 "1.26KHz" 2 "1.31KHz" 3 "1.35KHz" 4 "1.40KHz" 5 "1.45KHz" 6 "1.51KHz" 7 "1.57KHz" 8 "1.63KHz" 9 "1.71KHz" 10 "1.78KHz" 11 "1.87KHz" 12 "1.96KHz" 13 "2.07KHz" 14 "2.18KHz" 15 "2.31KHz" 16 "2.46KHz" 17 "2.54KHz" 18 "2.62KHz" 19 "2.71KHz" 20 "2.81KHz" 21 "2.92KHz" 22 "3.03KHz" 23 "3.15KHz" 24 "3.28KHz" 25 "3.43KHz" 26 "3.59KHz" 27 "3.76KHz" 28 "3.95KHz" 29 "4.16KHz" 30 "4.39KHz" 31 "4.66KHz" 32 "4.95KHz" 33 "5.12KHz" 34 "5.29KHz" 35 "5.48KHz" 36 "5.68KHz" 37 "5.90KHz" 38 "6.12KHz" 39 "6.37KHz" 40 "6.64KHz" 41 "6.94KHz" 42 "7.27KHz" 43 "7.63KHz" 44 "8.02KHz" 45 "8.46KHz" 46 "8.95KHz" 47 "9.50KHz" 48 "10.12KHz" 49 "10.46KHz" 50 "10.83KHz" 51 "11.22KHz" 52 "11.65KHz" 53 "12.10KHz" 54 "12.60KHz" 55 "13.14KHz" 56 "13.72KHz" 57 "14.36KHz" 58 "15.07KHz" 59 "15.84KHz" 60 "16.71KHz" 61 "17.67KHz" 62 "18.76KHz" 63 "19.98KHz" /end COMPU_VTAB
/begin COMPU_VTAB CM_KNK_GAIN_TAB "" TAB_VERB 64 0 "2.000" 1 "1.882" 2 "1.778" 3 "1.684" 4 "1.600" 5 "1.523" 6 "1.455" 7 "1.391" 8 "1.333" 9 "1.280" 10 "1.231" 11 "1.185" 12 "1.143" 13 "1.063" 14 "1.0" 15 "0.944" 16 "0.895" 17 "0.850" 18 "0.810" 19 "0.773" 20 "0.739" 21 "0.708" 22 "0.680" 23 "0.654" 24 "0.630" 25 "0.607" 26 "0.586" 27 "0.567" 28 "0.548" 29 "0.500" 30 "0.471" 31 "0.444" 32 "0.421" 33 "0.400" 34 "0.381" 35 "0.364" 36 "0.348" 37 "0.333" 38 "0.320" 39 "0.308" 40 "0.296" 41 "0.286" 42 "0.276" 43 "0.267" 44 "0.258" 45 "0.250" 46 "0.236" 47 "0.222" 48 "0.211" 49 "0.200" 50 "0.190" 51 "0.182" 52 "0.174" 53 "0.167" 54 "0.160" 55 "0.154" 56 "0.148" 57 "0.143" 58 "0.138" 59 "0.133" 60 "0.129" 61 "0.125" 62 "0.118" 63 "0.111" /end COMPU_VTAB
/begin COMPU_VTAB CM_KNK_INT_TAB "" TAB_VERB 32 0 "40us" 1 "45us" 2 "50us" 3 "55us" 4 "60us" 5 "65us" 6 "70us" 7 "75us" 8 "80us" 9 "90us" 10 "100us" 11 "110us" 12 "120us" 13 "130us" 14 "140us" 15 "150us" 16 "160us" 17 "180us" 18 "200us" 19 "220us" 20 "240us" 21 "260us" 22 "280us" 23 "300us" 24 "320us" 25 "360us" 26 "400us" 27 "440us" 28 "480us" 29 "520us" 30 "560us" 31 "600us" /end COMPU_VTAB
/begin COMPU_VTAB udf_CV_19704 "" TAB_VERB 2 0 "OFF" 1 "ON" /end COMPU_VTAB
/begin COMPU_VTAB udf_CV_19710 "" TAB_VERB 7 0 "0_EngineOff" 1 "1_KeyOn" 2 "2_Cranking" 3 "3_Run" 4 "4_Stall" 5 "5_ShutDownDelay" 6 "6_ShutDown" /end COMPU_VTAB
/begin COMPU_VTAB udf_CV_19711 "" TAB_VERB 3 0 "0_Petrol" 1 "1_NG" 2 "2_LPG" /end COMPU_VTAB
/begin RECORD_LAYOUT 2D_Array_SB FNC_VALUES 1 SBYTE COLUMN_DIR DIRECT ALIGNMENT_WORD 1 ALIGNMENT_LONG 2 /end RECORD_LAYOUT
/begin RECORD_LAYOUT 2D_Array_SW FNC_VALUES 1 SWORD COLUMN_DIR DIRECT ALIGNMENT_WORD 1 ALIGNMENT_LONG 2 /end RECORD_LAYOUT
/begin RECORD_LAYOUT 2D_Array_UB FNC_VALUES 1 UBYTE COLUMN_DIR DIRECT ALIGNMENT_WORD 1 ALIGNMENT_LONG 2 /end RECORD_LAYOUT
/begin RECORD_LAYOUT 2D_Array_UW FNC_VALUES 1 UWORD COLUMN_DIR DIRECT ALIGNMENT_WORD 1 ALIGNMENT_LONG 2 /end RECORD_LAYOUT
/begin RECORD_LAYOUT D_Array_SB FNC_VALUES 1 SBYTE COLUMN_DIR DIRECT ALIGNMENT_WORD 1 ALIGNMENT_LONG 2 /end RECORD_LAYOUT
/begin RECORD_LAYOUT 3D_Array_UB FNC_VALUES 1 UBYTE COLUMN_DIR DIRECT ALIGNMENT_WORD 1 ALIGNMENT_LONG 2 /end RECORD_LAYOUT
/begin RECORD_LAYOUT 3D_Array_UW FNC_VALUES 1 UWORD COLUMN_DIR DIRECT ALIGNMENT_WORD 1 ALIGNMENT_LONG 2 /end RECORD_LAYOUT
/begin RECORD_LAYOUT AxisPtsX_UW AXIS_PTS_X 1 UWORD INDEX_INCR DIRECT ALIGNMENT_WORD 1 ALIGNMENT_LONG 2 /end RECORD_LAYOUT
/begin RECORD_LAYOUT AxisPtsX_SW AXIS_PTS_X 1 SWORD INDEX_INCR DIRECT ALIGNMENT_WORD 1 ALIGNMENT_LONG 2 /end RECORD_LAYOUT
/begin RECORD_LAYOUT Scalar_SW FNC_VALUES 1 SWORD COLUMN_DIR DIRECT ALIGNMENT_WORD 1 ALIGNMENT_LONG 2 /end RECORD_LAYOUT
/begin RECORD_LAYOUT Scalar_UB FNC_VALUES 1 UBYTE COLUMN_DIR DIRECT ALIGNMENT_WORD 1 ALIGNMENT_LONG 2 /end RECORD_LAYOUT
/begin RECORD_LAYOUT Scalar_UW FNC_VALUES 1 UWORD COLUMN_DIR DIRECT ALIGNMENT_WORD 1 ALIGNMENT_LONG 2 /end RECORD_LAYOUT
/end MODULE
/end PROJECT
