ASAP2_VERSION 1 40
/begin PROJECT RS19_Prod ""
/begin HEADER "" VERSION "" /end HEADER
/begin MODULE RS19_Prod ""
/begin MOD_PAR "SAILOR" CPU_TYPE "SPC560P"
 /begin MEMORY_SEGMENT Code "External Flash Calibration Space" DATA FLASH INTERN 0x8000 0x5000 -1 -1 -1 -1 -1 /end MEMORY_SEGMENT
 /begin MEMORY_SEGMENT Code "External Flash unuse Space" CODE FLASH INTERN 0xD000 0x0000 -1 -1 -1 -1 -1 /end MEMORY_SEGMENT
 /begin MEMORY_SEGMENT Code "External Flash Code Space" CODE FLASH INTERN 0xD000 0x33000 -1 -1 -1 -1 -1 /end MEMORY_SEGMENT
 /begin MEMORY_SEGMENT Ram "External Ram BSS Space" VARIABLES RAM EXTERN 0x40000000 0x4800 -1 -1 -1 -1 -1 /end MEMORY_SEGMENT
 /begin MEMORY_SEGMENT Data "External RAM Calibration Space" DATA RAM EXTERN 0x40004800 0x5000 -1 -1 -1 -1 -1 /end MEMORY_SEGMENT
 /begin MEMORY_SEGMENT Ram "External Ram Stack Space" VARIABLES RAM EXTERN 0x40009800 0x800 -1 -1 -1 -1 -1 /end MEMORY_SEGMENT
/end MOD_PAR
/begin MOD_COMMON "" BYTE_ORDER MSB_FIRST ALIGNMENT_BYTE 1 ALIGNMENT_WORD 1 ALIGNMENT_LONG 2 ALIGNMENT_FLOAT32_IEEE 4 ALIGNMENT_FLOAT64_IEEE 8 /end MOD_COMMON
/begin IF_DATA ASAP1B_CCP
 /begin SOURCE "Cyl Event" 103 1
  /begin QP_BLOB 0 LENGTH 0x14 CAN_ID_FIXED 0x7D5 RASTER 0 REDUCTION_ALLOWED FIRST_PID 0x00 /end QP_BLOB
  DISPLAY_IDENTIFIER DAQ0 /end SOURCE
 /begin SOURCE "7.82ms" 1 782
  /begin QP_BLOB 1 LENGTH 0x14 CAN_ID_FIXED 0x7D6 RASTER 10 REDUCTION_ALLOWED FIRST_PID 0x14 /end QP_BLOB
  DISPLAY_IDENTIFIER DAQ1 /end SOURCE
 /begin SOURCE "15.6ms" 1 1562
  /begin QP_BLOB 2 LENGTH 0x14 CAN_ID_FIXED 0x7D7 RASTER 11 REDUCTION_ALLOWED FIRST_PID 0x28 /end QP_BLOB
  DISPLAY_IDENTIFIER DAQ2 /end SOURCE
 /begin SOURCE "125ms" 3 125
  /begin QP_BLOB 3 LENGTH 0x3A CAN_ID_FIXED 0x7D8 RASTER 25 REDUCTION_ALLOWED FIRST_PID 0x3C /end QP_BLOB
  DISPLAY_IDENTIFIER DAQ3 /end SOURCE
 /begin TP_BLOB 0x201 0x202 0x7D0 0x7D4 0x0 0x1 DAQ_MODE 1 CONSISTENCY 1 ADDRESS_EXTENSION 0
  /begin DEFINED_PAGES 1 "Working page" 0x0 0x40004800 0x5000 RAM RAM_INIT_BY_ECU DEFAULT /end DEFINED_PAGES
  /begin DEFINED_PAGES 2 "Reference page" 0x0 0x8000 0x5000 FLASH DEFAULT /end DEFINED_PAGES
  OPTIONAL_CMD 0xC OPTIONAL_CMD 0xD OPTIONAL_CMD 0xE OPTIONAL_CMD 0x11 OPTIONAL_CMD 0x19 BAUDRATE 250000 SAMPLE_POINT 70 SAMPLE_RATE 1 BTL_CYCLES 16 SJW 2 SYNC_EDGE 0 /begin CHECKSUM_PARAM 0x8001 20480 CHECKSUM_CALCULATION ACTIVE_PAGE /end CHECKSUM_PARAM RESUME_SUPPORTED /end TP_BLOB
 /begin SEED_KEY "" /end SEED_KEY
 /begin RASTER "Cyl Event Trigger" Cyl 0 103 1 /end RASTER
 /begin RASTER "AMAF Trigger" 1.00 1 3 1 /end RASTER
 /begin RASTER "3.91ms Trigger" 3.91 2 1 391 /end RASTER
 /begin RASTER "7.81ms Trigger" 7.81 10 1 781 /end RASTER
 /begin RASTER "15.62ms Trigger" 15.62 11 1 1562 /end RASTER
 /begin RASTER "125ms Trigger" 125 25 3 125 /end RASTER
/end IF_DATA
/begin CHARACTERISTIC C_AECutoffDltTPSThresh "cal comments" VALUE 0x9C62 Scalar_UW 0.0 CM_Percent_0to200_2 0.0 199.9969024658203 /end CHARACTERISTIC
/begin CHARACTERISTIC C_AEEnableDltTPSThresh "cal comments" VALUE 0x9C60 Scalar_SW 0.0 CM_Percent_N200to200 -199.9999847412109 199.9938812255859 /end CHARACTERISTIC
/begin CHARACTERISTIC C_AETPSDecFiltCoef "cal comments" VALUE 0xB6DE Scalar_UW 0.0 CM_FiltCoef 0.0 0.9999847412109375 /end CHARACTERISTIC
/begin CHARACTERISTIC C_AETPSIncFiltCoef "cal comments" VALUE 0xB6DC Scalar_UW 0.0 CM_FiltCoef 0.0 0.9999847412109375 /end CHARACTERISTIC
/begin CHARACTERISTIC C_AFLCBaroMinThresh "cal comments" VALUE 0xB68A Scalar_UW 0.0 CM_kpa_0to256_1 0.0 255.99609375 /end CHARACTERISTIC
/begin CHARACTERISTIC C_AFLCCellEngSpdBoundaryHyst "cal comments" VALUE 0xB6A0 Scalar_UW 0.0 CM_RPM_0to16384 0.0 16383.75 /end CHARACTERISTIC
/begin CHARACTERISTIC C_AFLCCellTPSBoundaryHyst "cal comments" VALUE 0xB6A2 Scalar_UW 0.0 CM_Percent_0to200_2 0.0 199.9969024658203 /end CHARACTERISTIC
/begin CHARACTERISTIC C_AFLCChargeAirTempMaxThresh "cal comments" VALUE 0xB696 Scalar_SW 0.0 CM_DegC_N256to256 -256.0 255.9921875 /end CHARACTERISTIC
/begin CHARACTERISTIC C_AFLCChargeAirTempMinThresh "cal comments" VALUE 0xB694 Scalar_SW 0.0 CM_DegC_N256to256 -256.0 255.9921875 /end CHARACTERISTIC
/begin CHARACTERISTIC C_AFLCCoolTempMaxThresh "cal comments" VALUE 0xB692 Scalar_SW 0.0 CM_DegC_N256to256 -256.0 255.9921875 /end CHARACTERISTIC
/begin CHARACTERISTIC C_AFLCCoolTempMinThresh "cal comments" VALUE 0xB690 Scalar_SW 0.0 CM_DegC_N256to256 -256.0 255.9921875 /end CHARACTERISTIC
/begin CHARACTERISTIC C_AFLCEngSpdDeltaThresh "cal comments" VALUE 0xB688 Scalar_UW 0.0 CM_RPM_0to16384 0.0 16383.75 /end CHARACTERISTIC
/begin CHARACTERISTIC C_AFLCEngSpdMaxThresh "cal comments" VALUE 0xB68E Scalar_UW 0.0 CM_RPM_0to16384 0.0 16383.75 /end CHARACTERISTIC
/begin CHARACTERISTIC C_AFLCEngSpdMinThresh "cal comments" VALUE 0xB68C Scalar_UW 0.0 CM_RPM_0to16384 0.0 16383.75 /end CHARACTERISTIC
/begin CHARACTERISTIC C_AFLCLearnedMultMax "cal comments" VALUE 0xB69A Scalar_UW 0.0 CM_Ratio_0to2_2 0.0 1.999969482421875 /end CHARACTERISTIC
/begin CHARACTERISTIC C_AFLCLearnedMultMin "cal comments" VALUE 0xB69C Scalar_UW 0.0 CM_Ratio_0to2_2 0.0 1.999969482421875 /end CHARACTERISTIC
/begin CHARACTERISTIC C_AFLCMultLearnCoef "cal comments" VALUE 0xB69E Scalar_UW 0.0 CM_FiltCoef 0.0 0.9999847412109375 /end CHARACTERISTIC
/begin CHARACTERISTIC C_AFLCSteadyStateTime "cal comments" VALUE 0xB698 Scalar_UW 0.0 CM_Second_0to1024 0.0 1023.984375 /end CHARACTERISTIC
/begin CHARACTERISTIC C_AFLCTPSDeltaThresh "cal comments" VALUE 0xB686 Scalar_SW 0.0 CM_Percent_N200to200 -199.9999847412109 199.9938812255859 /end CHARACTERISTIC
/begin CHARACTERISTIC C_AFRLeanLimitDuringAE "cal comments" VALUE 0x9222 Scalar_UW 0.0 CM_AFR_0to32 0.0 31.99900627136231 /end CHARACTERISTIC
/begin CHARACTERISTIC C_AFRPERampDownStep "cal comments" VALUE 0x97FA Scalar_UW 0.0 CM_AFR_0to32 0.0 31.99900627136231 /end CHARACTERISTIC
/begin CHARACTERISTIC C_AFRPERampInterval "cal comments" VALUE 0x97FC Scalar_UW 0.0 CM_Seconds_1 0.0 2047.96875 /end CHARACTERISTIC
/begin CHARACTERISTIC C_AFRPERampUpStep "cal comments" VALUE 0x97F8 Scalar_UW 0.0 CM_AFR_0to32 0.0 31.99900627136231 /end CHARACTERISTIC
/begin CHARACTERISTIC C_AFRRampDownStep "cal comments" VALUE 0x922C Scalar_UW 0.0 CM_AFR_0to32 0.0 31.99900627136231 /end CHARACTERISTIC
/begin CHARACTERISTIC C_AFRRampIntervalRun "cal comments" VALUE 0x9226 Scalar_UW 0.0 CM_Seconds_1 0.0 2047.96875 /end CHARACTERISTIC
/begin CHARACTERISTIC C_AFRRampUpStepIdle "cal comments" VALUE 0x9228 Scalar_UW 0.0 CM_AFR_0to32 0.0 31.99900627136231 /end CHARACTERISTIC
/begin CHARACTERISTIC C_AFRRampUpStepRun "cal comments" VALUE 0x922A Scalar_UW 0.0 CM_AFR_0to32 0.0 31.99900627136231 /end CHARACTERISTIC
/begin CHARACTERISTIC C_AFR1SensorFiltCoef "cal comments" VALUE 0xB7F6 Scalar_UW 0.0 CM_FiltCoef 0.0 0.9999847412109375 /end CHARACTERISTIC
/begin CHARACTERISTIC C_AFRWarmUpOffsetDecayFactor "cal comments" VALUE 0x9990 Scalar_UW 0.0 CM_FactorRatio 0.0 0.9999847412109375 /end CHARACTERISTIC
/begin CHARACTERISTIC C_AltMAPCalcOffset "cal comments" VALUE 0xB7F0 Scalar_UW 0.0 CM_kpa_0to256_1 0.0 255.99609375 /end CHARACTERISTIC
/begin CHARACTERISTIC C_BaroDefault "cal comments" VALUE 0xB79E Scalar_UW 0.0 CM_kpa_0to256_1 0.0 255.99609375 /end CHARACTERISTIC
/begin CHARACTERISTIC C_BaroMaxLimit "cal comments" VALUE 0xB7A2 Scalar_UW 0.0 CM_kpa_0to256_1 0.0 255.99609375 /end CHARACTERISTIC
/begin CHARACTERISTIC C_BaroMinLimit "cal comments" VALUE 0xB7A4 Scalar_UW 0.0 CM_kpa_0to256_1 0.0 255.99609375 /end CHARACTERISTIC
/begin CHARACTERISTIC C_BaroStallUpdateMAPCheckTimes "cal comments" VALUE 0xB808 Scalar_UW 0.0 CM_Count_0to65535_1 0.0 65535.0 /end CHARACTERISTIC
/begin CHARACTERISTIC C_BaroUpdateDltEngSpdThresh "cal comments" VALUE 0xB818 Scalar_UW 0.0 CM_RPM_0to16384 0.0 16383.75 /end CHARACTERISTIC
/begin CHARACTERISTIC C_BaroUpdtEngRunTPSDeltaMaxThrsh "cal comments" VALUE 0xB844 Scalar_SW 0.0 CM_Percent_N200to200 -199.9999847412109 199.9938812255859 /end CHARACTERISTIC
/begin CHARACTERISTIC C_BaroUpdtEngSpdThrshHi "cal comments" VALUE 0xB816 Scalar_UW 0.0 CM_RPM_0to16384 0.0 16383.75 /end CHARACTERISTIC
/begin CHARACTERISTIC C_BaroUpdtFiltCoefRun "cal comments" VALUE 0xB81C Scalar_UW 0.0 CM_FiltCoef 0.0 0.9999847412109375 /end CHARACTERISTIC
/begin CHARACTERISTIC C_BaroUpdtFiltCoefStall "cal comments" VALUE 0xB7A0 Scalar_UW 0.0 CM_FiltCoef 0.0 0.9999847412109375 /end CHARACTERISTIC
/begin CHARACTERISTIC C_ChargeAirTempFiltCoef "cal comments" VALUE 0x8298 Scalar_UW 0.0 CM_FiltCoef 0.0 0.9999847412109375 /end CHARACTERISTIC
/begin CHARACTERISTIC C_CIDFailThreshold "cal comments" VALUE 0xB7B4 Scalar_UW 0.0 CM_Count_0to65535_1 0.0 65535.0 /end CHARACTERISTIC
/begin CHARACTERISTIC C_CIDPassThreshold "cal comments" VALUE 0xB7B2 Scalar_UW 0.0 CM_Count_0to65535_1 0.0 65535.0 /end CHARACTERISTIC
/begin CHARACTERISTIC C_CLAFREnbCoolTempThresh "cal comments" VALUE 0x96F4 Scalar_SW 0.0 CM_DegC_N256to256 -256.0 255.9921875 /end CHARACTERISTIC
/begin CHARACTERISTIC C_CLFuelControlEnb "cal comments" VALUE 0x9A2A Scalar_UB 0.0 CM_Boolean1 0.0 1.0 /end CHARACTERISTIC
/begin CHARACTERISTIC C_CLFuelIntegralMultUsed "cal comments" VALUE 0x9A2B Scalar_UB 0.0 CM_Boolean1 0.0 1.0 /end CHARACTERISTIC
/begin CHARACTERISTIC C_StepForceControlEnable "cal comments" VALUE 0x9EA8 Scalar_UB 0.0 CM_Boolean6 0.0 255.0 /end CHARACTERISTIC
/begin CHARACTERISTIC C_CCPS_MaxVolt "cal comments" VALUE 0x0 Scalar_UW 0.0 CM_Volt_0to32_1 0.0 31.99900627136231 /end CHARACTERISTIC
/begin CHARACTERISTIC C_CCPS_RunTimeCold "cal comments" VALUE 0x0 Scalar_UW 0.0 CM_Count_0to65535_1 0.0 65535.0 /end CHARACTERISTIC
/begin CHARACTERISTIC C_CCPS_RunTimeHot "cal comments" VALUE 0x0 Scalar_UW 0.0 CM_Count_0to65535_1 0.0 65535.0 /end CHARACTERISTIC
/begin CHARACTERISTIC C_CCPS_StartupCold "cal comments" VALUE 0x0 Scalar_SW 0.0 CM_DegC_N256to256 -256.0 255.9921875 /end CHARACTERISTIC
/begin CHARACTERISTIC C_CCPS_CoolantHigh "cal comments" VALUE 0x0 Scalar_SW 0.0 CM_DegC_N256to256 -256.0 255.9921875 /end CHARACTERISTIC
/begin CHARACTERISTIC C_CCPS_CoolantLow "cal comments" VALUE 0x0 Scalar_SW 0.0 CM_DegC_N256to256 -256.0 255.9921875 /end CHARACTERISTIC
/begin CHARACTERISTIC C_CCPS_CoolantHyst "cal comments" VALUE 0x0 Scalar_SW 0.0 CM_DegC_N256to256 -256.0 255.9921875 /end CHARACTERISTIC
/begin CHARACTERISTIC C_CCPS_DFCOTime "cal comments" VALUE 0x0 Scalar_UW 0.0 CM_Second_0to1024 0.0 1023.984375 /end CHARACTERISTIC
/begin CHARACTERISTIC C_CCPS_RichO2Time "cal comments" VALUE 0x0 Scalar_UW 0.0 CM_Second_0to1024 0.0 1023.984375 /end CHARACTERISTIC
/begin CHARACTERISTIC C_CCPS_RichO2TimeHyst "cal comments" VALUE 0x0 Scalar_UW 0.0 CM_Second_0to1024 0.0 1023.984375 /end CHARACTERISTIC
/begin CHARACTERISTIC C_CCPS_TPSHigh "cal comments" VALUE 0x0 Scalar_UW 0.0 CM_Percent_0to200_2 0.0 199.9969024658203 /end CHARACTERISTIC
/begin CHARACTERISTIC C_CCPS_TPSLow "cal comments" VALUE 0x0 Scalar_UW 0.0 CM_Percent_0to200_2 0.0 199.9969024658203 /end CHARACTERISTIC
/begin CHARACTERISTIC C_CCPS_TPSHyst "cal comments" VALUE 0x0 Scalar_UW 0.0 CM_Percent_0to200_2 0.0 199.9969024658203 /end CHARACTERISTIC
/begin CHARACTERISTIC C_CCPS_DutyCycleMin "cal comments" VALUE 0x0 Scalar_UW 0.0 CM_Percent_0to200_2 0.0 199.9969024658203 /end CHARACTERISTIC
/begin CHARACTERISTIC C_CCPS_DutyCycleIdleMax "cal comments" VALUE 0x0 Scalar_UW 0.0 CM_Percent_0to200_2 0.0 199.9969024658203 /end CHARACTERISTIC
/begin CHARACTERISTIC C_CCPS_BLM_BlmHigh "cal comments" VALUE 0x0 Scalar_UW 0.0 CM_Ratio_0to2_2 0.0 1.999969482421875 /end CHARACTERISTIC
/begin CHARACTERISTIC C_CCPS_BLM_BlmLow "cal comments" VALUE 0x0 Scalar_UW 0.0 CM_Ratio_0to2_2 0.0 1.999969482421875 /end CHARACTERISTIC
/begin CHARACTERISTIC C_CCPS_CL_IntHigh "cal comments" VALUE 0x0 Scalar_SW 0.0 CM_SignedWord_n32768to32768_2 -32768.0 32766.0 /end CHARACTERISTIC
/begin CHARACTERISTIC C_CCPS_CL_IntLow "cal comments" VALUE 0x0 Scalar_SW 0.0 CM_SignedWord_n32768to32768_2 -32768.0 32766.0 /end CHARACTERISTIC
/begin CHARACTERISTIC C_CCPS_DutyCycleStepUp "cal comments" VALUE 0x0 Scalar_UW 0.0 CM_Percent_0to200_2 0.0 199.9969024658203 /end CHARACTERISTIC
/begin CHARACTERISTIC C_CCPS_DutyCycleStepDown "cal comments" VALUE 0x0 Scalar_UW 0.0 CM_Percent_0to200_2 0.0 199.9969024658203 /end CHARACTERISTIC
/begin CHARACTERISTIC C_CCPS_DutyCycleStepTime "cal comments" VALUE 0x0 Scalar_UW 0.0 CM_Second_0to8192 0.0 8191.0 /end CHARACTERISTIC
/begin CHARACTERISTIC C_CCPS_RPMMinHigh "cal comments" VALUE 0x0 Scalar_UW 0.0 udf_CM_18586 0.0 16383.75 /end CHARACTERISTIC
/begin CHARACTERISTIC C_CCPS_RPMMinLow "cal comments" VALUE 0x0 Scalar_UW 0.0 udf_CM_18586 0.0 16383.75 /end CHARACTERISTIC
/begin CHARACTERISTIC C_CCPS_BPWHigh "cal comments" VALUE 0x0 Scalar_UW 0.0 CM_msec_0to1024 0.0 1023.984375 /end CHARACTERISTIC
/begin CHARACTERISTIC C_CCPS_BPWLow "cal comments" VALUE 0x0 Scalar_UW 0.0 CM_msec_0to1024 0.0 1023.984375 /end CHARACTERISTIC
/begin CHARACTERISTIC CT_CCPS_DutyCycleMax "cal comments" CURVE 0x2 2D_Array_UB 0.0 CM_Percent_0to100 0.0 99.609375
 /begin AXIS_DESCR COM_AXIS NO_INPUT_QUANTITY CM_RPM_0to16384 17 0.0 16383.75 AXIS_PTS_REF CA_EngSpd17Step1 MAX_GRAD 0.0 /end AXIS_DESCR
/end CHARACTERISTIC
/begin CHARACTERISTIC C_CLIdleEnableDelay "cal comments" VALUE 0x9E72 Scalar_UW 0.0 CM_Second_0to1024 0.0 1023.984375 /end CHARACTERISTIC
/begin CHARACTERISTIC C_CLIdleSwitchDelay "cal comments" VALUE 0x9E74 Scalar_UW 0.0 CM_Second_0to1024 0.0 1023.984375 /end CHARACTERISTIC
/begin CHARACTERISTIC C_CLIdleSpdUpDelay "cal comments" VALUE 0x9E76 Scalar_UW 0.0 CM_Second_0to1024 0.0 1023.984375 /end CHARACTERISTIC
/begin CHARACTERISTIC C_CLIdleSpdDwnDelay "cal comments" VALUE 0x9E78 Scalar_UW 0.0 CM_Second_0to1024 0.0 1023.984375 /end CHARACTERISTIC
/begin CHARACTERISTIC C_CLIdleSpdH2LDelay "cal comments" VALUE 0x9E7A Scalar_UW 0.0 CM_Second_0to1024 0.0 1023.984375 /end CHARACTERISTIC
/begin CHARACTERISTIC C_ClosedLoopAFR "cal comments" VALUE 0x96EA Scalar_UW 0.0 CM_AFR_0to32 0.0 31.99900627136231 /end CHARACTERISTIC
/begin CHARACTERISTIC C_CLTThreshToEnbNextPrimePulse "cal comments" VALUE 0x91EC Scalar_SW 0.0 CM_DegC_N256to256 -256.0 255.9921875 /end CHARACTERISTIC
/begin CHARACTERISTIC C_ColdEngineIdleEnrichEnable "cal comments" VALUE 0x9220 Scalar_UB 0.0 CM_Boolean2 0.0 1.0 /end CHARACTERISTIC
/begin CHARACTERISTIC C_ColdEnrichCompTempThresh "cal comments" VALUE 0x9224 Scalar_SW 0.0 CM_DegC_N256to256 -256.0 255.9921875 /end CHARACTERISTIC
/begin CHARACTERISTIC C_CoolantTempFiltCoef "cal comments" VALUE 0xB7BE Scalar_UW 0.0 CM_FiltCoef 0.0 0.9999847412109375 /end CHARACTERISTIC
/begin CHARACTERISTIC C_CrankAFROffset "cal comments" VALUE 0x9828 Scalar_UW 0.0 CM_AFR_0to32 0.0 31.99900627136231 /end CHARACTERISTIC
/begin CHARACTERISTIC C_CrankAFROffsetDecayDealy "cal comments" VALUE 0x982A Scalar_UW 0.0 CM_Count_0to65535 0.0 65535.0 /end CHARACTERISTIC
/begin CHARACTERISTIC C_CrankAFROffsetDecayFactor "cal comments" VALUE 0x982C Scalar_UW 0.0 CM_FactorRatio 0.0 0.9999847412109375 /end CHARACTERISTIC
/begin CHARACTERISTIC C_CrankAFROffsetDecayInterval "cal comments" VALUE 0x982E Scalar_UB 0.0 CM_Second_0to8 0.0 7.96875 /end CHARACTERISTIC
/begin CHARACTERISTIC C_CrankAFROffsetResetCltTempThrsh "cal comments" VALUE 0x9830 Scalar_SW 0.0 CM_DegC_N256to256 -256.0 255.9921875 /end CHARACTERISTIC
/begin CHARACTERISTIC C_CrankAFROffsetResetRunTimeThrsh "cal comments" VALUE 0x9832 Scalar_UW 0.0 CM_Second_0to65535 0.0 65535.0 /end CHARACTERISTIC
/begin CHARACTERISTIC C_CrankToRunEngSpdThresh "cal comments" VALUE 0xB782 Scalar_UW 0.0 CM_RPM_0to16384 0.0 16383.75 /end CHARACTERISTIC
/begin CHARACTERISTIC C_CylinderDisplacement "cal comments" VALUE 0x8296 Scalar_UW 0.0 CM_milliliter_0to1024 0.0 1023.984375 /end CHARACTERISTIC
/begin CHARACTERISTIC C_DECutoffDltTPSThresh "cal comments" VALUE 0x9C64 Scalar_UW 0.0 CM_Percent_0to200_2 0.0 199.9969024658203 /end CHARACTERISTIC
/begin CHARACTERISTIC C_DEEnableDltTPSThresh "cal comments" VALUE 0x9C5E Scalar_SW 0.0 CM_Percent_N200to200 -199.9999847412109 199.9938812255859 /end CHARACTERISTIC
/begin CHARACTERISTIC C_DEEnableEngSpdThresh "cal comments" VALUE 0x96BC Scalar_UW 0.0 CM_RPM_0to16384 0.0 16383.75 /end CHARACTERISTIC
/begin CHARACTERISTIC C_DefaultCoolTemp "cal comments" VALUE 0xB7FE Scalar_SW 0.0 CM_DegC_N256to256 -256.0 255.9921875 /end CHARACTERISTIC
/begin CHARACTERISTIC C_DefaultCoolTempRunTimeFactor "cal comments" VALUE 0xB7FC Scalar_UW 0.0 CM_FactorRatio 0.0 0.9999847412109375 /end CHARACTERISTIC
/begin CHARACTERISTIC C_DeltaMAPThrshForBaroUpdtStall "cal comments" VALUE 0xB7F8 Scalar_UW 0.0 CM_kpa_0to256_1 0.0 255.99609375 /end CHARACTERISTIC
/begin CHARACTERISTIC C_IDLELoopCounter "cal comments" VALUE 0xB8E1 Scalar_UB 0.0 CM_Count1 0.0 255.0 /end CHARACTERISTIC
/begin CHARACTERISTIC C_DesireSpeedMoveFactor "cal comments" VALUE 0x9F14 Scalar_UW 0.0 CM_FactorRatio 0.0 0.9999847412109375 /end CHARACTERISTIC
/begin CHARACTERISTIC C_DesireSpeedDecreaseStepFactor "cal comments" VALUE 0x9F12 Scalar_UW 0.0 CM_Ratio_0to2_2 0.0 1.999969482421875 /end CHARACTERISTIC
/begin CHARACTERISTIC C_DesireSpeedDecreaseStepMin "cal comments" VALUE 0x9F10 Scalar_UW 0.0 udf_CM_18586 0.0 16383.75 /end CHARACTERISTIC
/begin CHARACTERISTIC C_DesireSpeedIncreaseStepFactor "cal comments" VALUE 0x9F0E Scalar_UW 0.0 CM_Ratio_0to2_2 0.0 1.999969482421875 /end CHARACTERISTIC
/begin CHARACTERISTIC C_DesireSpeedIncreaseStepMin "cal comments" VALUE 0x9F06 Scalar_UW 0.0 udf_CM_18586 0.0 16383.75 /end CHARACTERISTIC
/begin CHARACTERISTIC C_DesireSpeedUpOfst "cal comments" VALUE 0x9F08 Scalar_UW 0.0 udf_CM_18586 0.0 16383.75 /end CHARACTERISTIC
/begin CHARACTERISTIC C_DesireSpeedDwnOfst "cal comments" VALUE 0x9F0A Scalar_UW 0.0 udf_CM_18586 0.0 16383.75 /end CHARACTERISTIC
/begin CHARACTERISTIC C_DesireSpeedH2LOfst "cal comments" VALUE 0x9F0C Scalar_UW 0.0 udf_CM_18586 0.0 16383.75 /end CHARACTERISTIC
/begin CHARACTERISTIC C_DETPSDecFiltCoef "cal comments" VALUE 0xB6E2 Scalar_UW 0.0 CM_FiltCoef 0.0 0.9999847412109375 /end CHARACTERISTIC
/begin CHARACTERISTIC C_DETPSIncFiltCoef "cal comments" VALUE 0xB6E0 Scalar_UW 0.0 CM_FiltCoef 0.0 0.9999847412109375 /end CHARACTERISTIC
/begin CHARACTERISTIC C_EngineRunThreshCold "cal comments" VALUE 0xB790 Scalar_UB 0.0 CM_Count2 0.0 255.0 /end CHARACTERISTIC
/begin CHARACTERISTIC C_EngineRunThreshCoolTempHi "cal comments" VALUE 0xB78C Scalar_SW 0.0 CM_DegC_N256to256 -256.0 255.9921875 /end CHARACTERISTIC
/begin CHARACTERISTIC C_EngineRunThreshCoolTempLo "cal comments" VALUE 0xB78A Scalar_SW 0.0 CM_DegC_N256to256 -256.0 255.9921875 /end CHARACTERISTIC
/begin CHARACTERISTIC C_EngineRunThreshHot "cal comments" VALUE 0xB788 Scalar_UB 0.0 CM_Count2 0.0 255.0 /end CHARACTERISTIC
/begin CHARACTERISTIC C_EngineRunThreshWarm "cal comments" VALUE 0xB791 Scalar_UB 0.0 CM_Count2 0.0 255.0 /end CHARACTERISTIC
/begin CHARACTERISTIC C_EngineTurningResetDelayTime "cal comments" VALUE 0xB7B0 Scalar_UW 0.0 CM_Second_0to512 0.0 511.9921875 /end CHARACTERISTIC
/begin CHARACTERISTIC C_EngSpdDeltaCalcNumber "cal comments" VALUE 0xB7A8 Scalar_UB 0.0 CM_Count2 0.0 255.0 /end CHARACTERISTIC
/begin CHARACTERISTIC C_EngSpdDeltaSAGovCalcNumber "cal comments" VALUE 0xB7A9 Scalar_UB 0.0 CM_Count2 0.0 255.0 /end CHARACTERISTIC
/begin CHARACTERISTIC C_EngSpdFiltCoef "cal comments" VALUE 0xB7A6 Scalar_UW 0.0 CM_FiltCoef 0.0 0.9999847412109375 /end CHARACTERISTIC
/begin CHARACTERISTIC C_EOIRampInterval "cal comments" VALUE 0x921E Scalar_UW 0.0 CM_Second_0to1024 0.0 1023.984375 /end CHARACTERISTIC
/begin CHARACTERISTIC C_EOIRampStep "cal comments" VALUE 0x921C Scalar_UW 0.0 CM_CrankAngle_0to1024 0.0 1023.984375 /end CHARACTERISTIC
/begin CHARACTERISTIC C_ExpectMAPUsedTPSThreshHi "cal comments" VALUE 0xB6B6 Scalar_UW 0.0 CM_Percent_0to200_2 0.0 199.9969024658203 /end CHARACTERISTIC
/begin CHARACTERISTIC C_ExpectMAPUsedTPSThreshLo "cal comments" VALUE 0xB6B4 Scalar_UW 0.0 CM_Percent_0to200_2 0.0 199.9969024658203 /end CHARACTERISTIC
/begin CHARACTERISTIC C_ExtPEModeAFRExtraOffset "cal comments" VALUE 0x96F2 Scalar_UW 0.0 CM_AFR_0to32 0.0 31.99900627136231 /end CHARACTERISTIC
/begin CHARACTERISTIC C_ExtPEModeCoolTempThresh "cal comments" VALUE 0x96EC Scalar_SW 0.0 CM_DegC_N256to256 -256.0 255.9921875 /end CHARACTERISTIC
/begin CHARACTERISTIC C_ExtPEModeDisableDelay "cal comments" VALUE 0x96F0 Scalar_UW 0.0 CM_Second_0to65535 0.0 65535.0 /end CHARACTERISTIC
/begin CHARACTERISTIC C_ExtPEModeEnableDelay "cal comments" VALUE 0x96EE Scalar_UW 0.0 CM_Second_0to65535 0.0 65535.0 /end CHARACTERISTIC
/begin CHARACTERISTIC C_FPWIgnoreThresh "cal comments" VALUE 0x96C4 Scalar_UW 0.0 CM_msec_0to1024 0.0 1023.984375 /end CHARACTERISTIC
/begin CHARACTERISTIC C_FPWMaxThresh "cal comments" VALUE 0x96C0 Scalar_UW 0.0 CM_msec_0to1024 0.0 1023.984375 /end CHARACTERISTIC
/begin CHARACTERISTIC C_FPW_IAC_Max "cal comments" VALUE 0x96C2 Scalar_UW 0.0 CM_msec_0to1024 0.0 1023.984375 /end CHARACTERISTIC
/begin CHARACTERISTIC C_FPWMinThresh "cal comments" VALUE 0x96BE Scalar_UW 0.0 CM_msec_0to1024 0.0 1023.984375 /end CHARACTERISTIC
/begin CHARACTERISTIC C_CylPhase "cal comments" CURVE 0x804A 2D_Array_UW 0.0 CM_Count1 0.0 720.0
 /begin AXIS_DESCR FIX_AXIS NO_INPUT_QUANTITY CM_EOI 4 0.0 4.0 MAX_GRAD 0.0 /begin FIX_AXIS_PAR_LIST 0 1 2 3 /end FIX_AXIS_PAR_LIST /end AXIS_DESCR
/end CHARACTERISTIC
/begin CHARACTERISTIC C_9177_HSY_CFG_VRS "cal comments" VALUE 0x8045 Scalar_UB 0.0 CM_Count1 0.0 255.0 /end CHARACTERISTIC
/begin CHARACTERISTIC C_NbOfCyls "cal comments" VALUE 0x8046 Scalar_UB 0.0 CM_Count1 0.0 4.0 /end CHARACTERISTIC
/begin CHARACTERISTIC C_FuelRateMult "cal comments" VALUE 0x9840 Scalar_UW 0.0 udf_CM_18376 0.0 15.999755859375 /end CHARACTERISTIC
/begin CHARACTERISTIC C_NbOfWheelTeeth "cal comments" VALUE 0x8047 Scalar_UB 0.0 CM_Count1 0.0 60.0 /end CHARACTERISTIC
/begin CHARACTERISTIC C_NbOfMissingTeeth "cal comments" VALUE 0x8048 Scalar_UB 0.0 CM_Count1 0.0 2.0 /end CHARACTERISTIC
/begin CHARACTERISTIC C_MapCylTDCtooth "cal comments" VALUE 0x8049 Scalar_UB 0.0 CM_Count1 0.0 60.0 /end CHARACTERISTIC
/begin CHARACTERISTIC C_RubbishSignalForDucar "cal comments" VALUE 0x8052 Scalar_UB 0.0 CM_Boolean6 0.0 255.0 /end CHARACTERISTIC
/begin CHARACTERISTIC C_TwoStrokeCylinder "cal comments" VALUE 0x8053 Scalar_UB 0.0 CM_Boolean6 0.0 255.0 /end CHARACTERISTIC
/begin CHARACTERISTIC C_L9960Used "cal comments" VALUE 0x8055 Scalar_UB 0.0 CM_Boolean6 0.0 255.0 /end CHARACTERISTIC
/begin CHARACTERISTIC C_PGN65252Mask "cal comments" VALUE 0x8056 Scalar_UB 0.0 CM_Boolean6 0.0 255.0 /end CHARACTERISTIC
/begin CHARACTERISTIC C_EngOffEeBackupEn "cal comments" VALUE 0x8057 Scalar_UB 0.0 CM_Boolean6 0.0 255.0 /end CHARACTERISTIC
/begin CHARACTERISTIC C_RefPeriodBuffLen "cal comments" VALUE 0x8058 Scalar_UB 0.0 CM_Count1 1.0 8.0 /end CHARACTERISTIC
/begin CHARACTERISTIC C_ToothNoiseFilterTime "cal comments" VALUE 0x8054 Scalar_UB 0.0 CM_Second_us_0to80 0.0 39.84375 /end CHARACTERISTIC
/begin CHARACTERISTIC C_L9779VrsFullAdptiveEn "cal comments" VALUE 0x8059 Scalar_UB 0.0 CM_Count1 0.0 255.0 /end CHARACTERISTIC
/begin CHARACTERISTIC C_L9779VrsHystFallingFilterEn "cal comments" VALUE 0x805A Scalar_UB 0.0 CM_Count1 0.0 255.0 /end CHARACTERISTIC
/begin CHARACTERISTIC C_L9779VrsHystAfterFilterEn "cal comments" VALUE 0x805B Scalar_UB 0.0 CM_Count1 0.0 255.0 /end CHARACTERISTIC
/begin CHARACTERISTIC C_L9779VrsMinHsytEn "cal comments" VALUE 0x805C Scalar_UB 0.0 CM_Count1 0.0 255.0 /end CHARACTERISTIC
/begin CHARACTERISTIC C_L9779VrsMode "cal comments" VALUE 0x805D Scalar_UB 0.0 CM_Count1 0.0 255.0 /end CHARACTERISTIC
/begin CHARACTERISTIC C_L9779VrsHyst "cal comments" VALUE 0x805E Scalar_UB 0.0 CM_Count1 0.0 255.0 /end CHARACTERISTIC
/begin CHARACTERISTIC C_HWIO_CCP_Output_Usage "cal comments" VALUE 0x8002 Scalar_UB 0.0 CM_Count1 0.0 255.0 /end CHARACTERISTIC
/begin CHARACTERISTIC C_HWIO_FPR_Output_Usage "cal comments" VALUE 0x8003 Scalar_UB 0.0 CM_Count1 0.0 255.0 /end CHARACTERISTIC
/begin CHARACTERISTIC C_HWIO_O2HTR_Output_Usage "cal comments" VALUE 0x8004 Scalar_UB 0.0 CM_Count1 0.0 255.0 /end CHARACTERISTIC
/begin CHARACTERISTIC C_HWIO_TACH_Output_Usage "cal comments" VALUE 0x8005 Scalar_UB 0.0 CM_Count1 0.0 255.0 /end CHARACTERISTIC
/begin CHARACTERISTIC C_HWIO_DCM_Output_Usage "cal comments" VALUE 0x8006 Scalar_UB 0.0 CM_Count1 0.0 255.0 /end CHARACTERISTIC
/begin CHARACTERISTIC C_HWIO_SPRK1_Output_Usage "cal comments" VALUE 0x8007 Scalar_UB 0.0 CM_Count1 0.0 255.0 /end CHARACTERISTIC
/begin CHARACTERISTIC C_HWIO_SPRK2_Output_Usage "cal comments" VALUE 0x8008 Scalar_UB 0.0 CM_Count1 0.0 255.0 /end CHARACTERISTIC
/begin CHARACTERISTIC C_HWIO_SPRK3_Output_Usage "cal comments" VALUE 0x8009 Scalar_UB 0.0 CM_Count1 0.0 255.0 /end CHARACTERISTIC
/begin CHARACTERISTIC C_HWIO_SPRK4_Output_Usage "cal comments" VALUE 0x800A Scalar_UB 0.0 CM_Count1 0.0 255.0 /end CHARACTERISTIC
/begin CHARACTERISTIC C_FuelCLEnbRunTimeThrsh "cal comments" VALUE 0x9A2E Scalar_UW 0.0 CM_Second_0to65535 0.0 65535.0 /end CHARACTERISTIC
/begin CHARACTERISTIC C_FuellLowLoadCondEngSpdThrsh "cal comments" VALUE 0x9B0A Scalar_UW 0.0 CM_RPM_0to16384 0.0 16383.75 /end CHARACTERISTIC
/begin CHARACTERISTIC C_FuellLowLoadCondMAPThrsh "cal comments" VALUE 0x9B0C Scalar_UW 0.0 CM_kpa_0to256_1 0.0 255.99609375 /end CHARACTERISTIC
/begin CHARACTERISTIC C_FuelO2RichLeanWindowDelta "cal comments" VALUE 0x9B0E Scalar_UW 0.0 CM_mVolt_1 0.0 1023.96875 /end CHARACTERISTIC
/begin CHARACTERISTIC C_FuelO2RLThreshMaxLimit "cal comments" VALUE 0x9ADA Scalar_UW 0.0 CM_mVolt_1 0.0 1023.96875 /end CHARACTERISTIC
/begin CHARACTERISTIC C_FuelO2RLThreshMinLimit "cal comments" VALUE 0x9ADC Scalar_UW 0.0 CM_mVolt_1 0.0 1023.96875 /end CHARACTERISTIC
/begin CHARACTERISTIC C_FuelPropLowLoadCond "cal comments" VALUE 0x9B68 Scalar_UW 0.0 CM_Percent_0to200_2 0.0 199.9969024658203 /end CHARACTERISTIC
/begin CHARACTERISTIC C_DiagFuelPumpDC "cal comments" VALUE 0x983E Scalar_UW 0.0 CM_Percent_0to200_2 0.0 199.9969024658203 /end CHARACTERISTIC
/begin CHARACTERISTIC C_FuelPumpFreq "cal comments" VALUE 0x8034 Scalar_UW 0.0 CM_Hz_0to16384 0.0 16383.75 /end CHARACTERISTIC
/begin CHARACTERISTIC C_LinFlexFuncSel "cal comments" VALUE 0x8036 Scalar_UB 0.0 CM_Count1 0.0 4.0 /end CHARACTERISTIC
/begin CHARACTERISTIC C_ProductTypeSel "cal comments" VALUE 0x8037 Scalar_UB 0.0 CM_Count1 0.0 4.0 /end CHARACTERISTIC
/begin CHARACTERISTIC C_FuelPumpOffDelay "cal comments" VALUE 0x91EE Scalar_UW 0.0 CM_Second_0to512 0.0 511.9921875 /end CHARACTERISTIC
/begin CHARACTERISTIC C_FuelSTFTRichClampCltThrsh "cal comments" VALUE 0x9B18 Scalar_SW 0.0 CM_DegC_N256to256 -256.0 255.9921875 /end CHARACTERISTIC
/begin CHARACTERISTIC C_FuelSTFTRichClampVacThrsh "cal comments" VALUE 0x9B16 Scalar_UW 0.0 CM_kpa_0to256_1 0.0 255.99609375 /end CHARACTERISTIC
/begin CHARACTERISTIC C_FUEL_T_LightOffAFR_CltThrshHi "cal comments" VALUE 0x9B10 Scalar_SW 0.0 CM_DegC_N256to256 -256.0 255.9921875 /end CHARACTERISTIC
/begin CHARACTERISTIC C_FUEL_T_LightOffAFR_CltThrshLo "cal comments" VALUE 0x9B12 Scalar_SW 0.0 CM_DegC_N256to256 -256.0 255.9921875 /end CHARACTERISTIC
/begin CHARACTERISTIC C_FUEL_p_CL_LeanBiasThrsh "cal comments" VALUE 0x9B14 Scalar_UW 0.0 CM_kpa_0to256_1 0.0 255.99609375 /end CHARACTERISTIC
/begin CHARACTERISTIC C_FuelSTFuelTrimMax "cal comments" VALUE 0x9AF4 Scalar_SW 0.0 CM_SignedWord_n32768to32768_2 -32768.0 32766.0 /end CHARACTERISTIC
/begin CHARACTERISTIC C_FuelSTFuelTrimMaxPE "cal comments" VALUE 0x9AF6 Scalar_SW 0.0 CM_SignedWord_n32768to32768_2 -32768.0 32766.0 /end CHARACTERISTIC
/begin CHARACTERISTIC C_FuelSTFuelTrimMin "cal comments" VALUE 0x9AF8 Scalar_SW 0.0 CM_SignedWord_n32768to32768_2 -32768.0 32766.0 /end CHARACTERISTIC
/begin CHARACTERISTIC C_FuelSTFuelTrimPctConvFactor "cal comments" VALUE 0x9B76 Scalar_UW 0.0 CM_Percent_0to200 0.0 199.9969482421875 /end CHARACTERISTIC
/begin CHARACTERISTIC C_FuelSTFuelTrimPWConvFactor "cal comments" VALUE 0x9AFA Scalar_UW 0.0 CM_Ratio_0to2_1 0.0 1.999969482421875 /end CHARACTERISTIC
/begin CHARACTERISTIC C_FUEL_Pct_ClearFloodTPS "cal comments" VALUE 0x0 Scalar_UW 0.0 CM_Percent_0to200_2 0.0 199.9969024658203 /end CHARACTERISTIC
/begin CHARACTERISTIC C_FUEL_t_ClearFloodTime "cal comments" VALUE 0x0 Scalar_UW 0.0 CM_Second_0to4096 0.0 4095.9375 /end CHARACTERISTIC
/begin CHARACTERISTIC CT_FUEL_Pct_DFCO_TPS_Thrsh "cal comments" CURVE 0x2 2D_Array_UW 0.0 CM_Percent_0to200_2 0.0 199.9969024658203
 /begin AXIS_DESCR FIX_AXIS NO_INPUT_QUANTITY CM_Equaloutput1 17 0.0 12800.0 MAX_GRAD 0.0
  /begin FIX_AXIS_PAR_LIST 0 800 1600 2400 3200 4000 4800 5600 6400 7200 8000 8800 9600 10400 11200 12000 12800 /end FIX_AXIS_PAR_LIST
 /end AXIS_DESCR
/end CHARACTERISTIC
/begin CHARACTERISTIC C_FUEL_Pct_DFCO_TPS_Hys "cal comments" VALUE 0x0 Scalar_UW 0.0 CM_Percent_0to200_2 0.0 199.9969024658203 /end CHARACTERISTIC
/begin CHARACTERISTIC CT_FUEL_t_DFCOMetTime "cal comments" CURVE 0x2 2D_Array_UB 0.0 CM_Second_0to4 0.0 3.984375
 /begin AXIS_DESCR COM_AXIS NO_INPUT_QUANTITY CM_RPM_0to16384 9 0.0 16383.75 AXIS_PTS_REF CA_EngSpd9Step1 MAX_GRAD 0.0 /end AXIS_DESCR
/end CHARACTERISTIC
/begin CHARACTERISTIC C_FUEL_n_DFCOdRPMDa "cal comments" VALUE 0x0 Scalar_UW 0.0 CM_RPM_0to16384 0.0 16383.75 /end CHARACTERISTIC
/begin CHARACTERISTIC C_FUEL_n_DFCOEnable_RPMThrsh "cal comments" VALUE 0x0 Scalar_UW 0.0 CM_RPM_0to16384 0.0 16383.75 /end CHARACTERISTIC
/begin CHARACTERISTIC C_FUEL_T_DFCO_CoolTempThrsh "cal comments" VALUE 0x0 Scalar_SW 0.0 CM_DegC_N256to256 -256.0 255.9921875 /end CHARACTERISTIC
/begin CHARACTERISTIC C_FUEL_p_DFCO_MAP_Hys "cal comments" VALUE 0x0 Scalar_UW 0.0 CM_kpa_0to256_1 0.0 255.99609375 /end CHARACTERISTIC
/begin CHARACTERISTIC CT_FUEL_p_DFCO_MAP_Thrsh "cal comments" CURVE 0x2 2D_Array_UB 0.0 CM_kpa_8bit 0.0 127.5
 /begin AXIS_DESCR FIX_AXIS NO_INPUT_QUANTITY CM_Equaloutput1 17 0.0 12800.0 MAX_GRAD 0.0
  /begin FIX_AXIS_PAR_LIST 0 800 1600 2400 3200 4000 4800 5600 6400 7200 8000 8800 9600 10400 11200 12000 12800 /end FIX_AXIS_PAR_LIST
 /end AXIS_DESCR
/end CHARACTERISTIC
/begin CHARACTERISTIC C_FUEL_n_DFCOExit_Thrsh "cal comments" VALUE 0x0 Scalar_UW 0.0 CM_RPM_0to16384 0.0 16383.75 /end CHARACTERISTIC
/begin CHARACTERISTIC C_FUEL_r_DFCOExit_FuelDecayFactor "cal comments" VALUE 0x0 Scalar_UB 0.0 CM_Mult_0to1_2 0.0 0.99609375 /end CHARACTERISTIC
/begin CHARACTERISTIC C_FUEL_t_DFCOExit_FuelDecayTime "cal comments" VALUE 0x0 Scalar_UW 0.0 CM_Second_0to1024 0.0 1023.984375 /end CHARACTERISTIC
/begin CHARACTERISTIC C_FUEL_t_DFCO_RunTimeThrsh "cal comments" VALUE 0x0 Scalar_UW 0.0 CM_Count_0to65535_1 0.0 65535.0 /end CHARACTERISTIC
/begin CHARACTERISTIC C_FUEL_t_DFCO_Spark_Exit_Dly "cal comments" VALUE 0x0 Scalar_UW 0.0 CM_Second_0to1024 0.0 1023.984375 /end CHARACTERISTIC
/begin CHARACTERISTIC C_FUEL_t_DFCO_RampOUT_Interval "cal comments" VALUE 0x0 Scalar_UW 0.0 CM_Second_0to1024 0.0 1023.984375 /end CHARACTERISTIC
/begin CHARACTERISTIC C_FUEL_r_DFCO_RampOUT_Step "cal comments" VALUE 0x0 Scalar_UW 0.0 CM_Ratio_0to2_2 0.0 1.999969482421875 /end CHARACTERISTIC
/begin CHARACTERISTIC C_FUEL_n_DFCO_RampOUT_ExitThresh "cal comments" VALUE 0x0 Scalar_UW 0.0 CM_RPM_0to16384 0.0 16383.75 /end CHARACTERISTIC
/begin CHARACTERISTIC C_FUEL_r_DFCO_RampOUT_Initial "cal comments" VALUE 0x0 Scalar_UW 0.0 CM_Ratio_0to2_2 0.0 1.999969482421875 /end CHARACTERISTIC
/begin CHARACTERISTIC C_FUEL_n_DFCO_RampOUT_MinVSS "cal comments" VALUE 0x0 Scalar_UW 0.0 CM_KPH_0to512 0.0 511.9921875 /end CHARACTERISTIC
/begin CHARACTERISTIC CT_FUEL_r_DFCOExit_TempFactor "cal comments" CURVE 0x2 2D_Array_UB 0.0 CM_Mult0_to_2_ratio 0.0 1.9921875
 /begin AXIS_DESCR FIX_AXIS NO_INPUT_QUANTITY CM_Equaloutput1 17 -28.0 164.0 MAX_GRAD 0.0 /begin FIX_AXIS_PAR_LIST -28 -16 -4 8 20 32 44 56 68 80 92 104 116 128 140 152 164 /end FIX_AXIS_PAR_LIST /end AXIS_DESCR
/end CHARACTERISTIC
/begin CHARACTERISTIC CT_FUEL_t_DFCOExitBPW "cal comments" CURVE 0x2 2D_Array_UW 0.0 CM_msec_0to1024 0.0 1023.984375
 /begin AXIS_DESCR FIX_AXIS NO_INPUT_QUANTITY CM_Second_0to1024 17 0 16.0 MAX_GRAD 0.0
  /begin FIX_AXIS_PAR_LIST 0.0 1.0 2.0 3.0 4.0 5.0 6.0 7.0 8.0 9.0 10.0 11.0 12.0 13.0 14.0 15.0 16.0 /end FIX_AXIS_PAR_LIST
 /end AXIS_DESCR
/end CHARACTERISTIC
/begin CHARACTERISTIC CT_FUEL_COWeightFactor "cal comments" MAP 0x9B87 3D_Array_UB 0.0 CM_Mult_0to1 0.0 0.99609375
 /begin AXIS_DESCR COM_AXIS NO_INPUT_QUANTITY CM_kpa_0to256_1 10 0.0 255.99609375 AXIS_PTS_REF CA_MAP10Step1 MAX_GRAD 0.0 /end AXIS_DESCR
 /begin AXIS_DESCR COM_AXIS NO_INPUT_QUANTITY CM_RPM_0to16384 9 0.0 16383.75 AXIS_PTS_REF CA_EngSpd9Step1 MAX_GRAD 0.0 /end AXIS_DESCR
/end CHARACTERISTIC
/begin CHARACTERISTIC C_FUEL_COAdjIATMinThrsh "cal comments" VALUE 0x9B78 Scalar_SW 0.0 CM_DegC_N256to256 -256.0 255.9921875 /end CHARACTERISTIC
/begin CHARACTERISTIC C_FUEL_COAdjIATMaxThrsh "cal comments" VALUE 0x9B7A Scalar_SW 0.0 CM_DegC_N256to256 -256.0 255.9921875 /end CHARACTERISTIC
/begin CHARACTERISTIC C_FUEL_COAdjCoolMinThrsh "cal comments" VALUE 0x9B7C Scalar_SW 0.0 CM_DegC_N256to256 -256.0 255.9921875 /end CHARACTERISTIC
/begin CHARACTERISTIC C_FUEL_COAdjCoolMaxThrsh "cal comments" VALUE 0x9B7E Scalar_SW 0.0 CM_DegC_N256to256 -256.0 255.9921875 /end CHARACTERISTIC
/begin CHARACTERISTIC C_FUEL_COPinGndTime "cal comments" VALUE 0x9B80 Scalar_UW 0.0 CM_Second_0to4096 0.0 4095.9375 /end CHARACTERISTIC
/begin CHARACTERISTIC C_FUEL_COMultStep "cal comments" VALUE 0x9B82 Scalar_UW 0.0 CM_FactorRatio 0.0 0.9999847412109375 /end CHARACTERISTIC
/begin CHARACTERISTIC C_FUEL_COADDefMult "cal comments" VALUE 0x9BE2 Scalar_SW 0.0 CM_FactorRatio_N1to1 0.0 0.9999847412109375 /end CHARACTERISTIC
/begin CHARACTERISTIC C_FUEL_COAdjustEn "cal comments" VALUE 0x9BE4 Scalar_UB 0.0 CM_Boolean6 0.0 255.0 /end CHARACTERISTIC
/begin CHARACTERISTIC C_GPIO_VSS_FUNC "cal comments" VALUE 0x8013 Scalar_UB 0.0 CM_Count1 0.0 255.0 /end CHARACTERISTIC
/begin CHARACTERISTIC C_GPIO_DCMEN_FUNC "cal comments" VALUE 0x800F Scalar_UB 0.0 CM_Count1 0.0 255.0 /end CHARACTERISTIC
/begin CHARACTERISTIC C_GPIO_DCMCS_FUNC "cal comments" VALUE 0x8010 Scalar_UB 0.0 CM_Count1 0.0 255.0 /end CHARACTERISTIC
/begin CHARACTERISTIC C_GPIO_DCMDIR_FUNC "cal comments" VALUE 0x8011 Scalar_UB 0.0 CM_Count1 0.0 255.0 /end CHARACTERISTIC
/begin CHARACTERISTIC C_GPIO_DCMPWM_FUNC "cal comments" VALUE 0x8012 Scalar_UB 0.0 CM_Count1 0.0 255.0 /end CHARACTERISTIC
/begin CHARACTERISTIC C_GPIO_LP_SW_FUNC "cal comments" VALUE 0x8014 Scalar_UB 0.0 CM_Count1 0.0 255.0 /end CHARACTERISTIC
/begin CHARACTERISTIC C_GPIO_PN_SW_FUNC "cal comments" VALUE 0x8015 Scalar_UB 0.0 CM_Count1 0.0 255.0 /end CHARACTERISTIC
/begin CHARACTERISTIC C_GPIO_Rollover_FUNC "cal comments" VALUE 0x8016 Scalar_UB 0.0 CM_Count1 0.0 255.0 /end CHARACTERISTIC
/begin CHARACTERISTIC C_GPIO_DIAG_FUNC "cal comments" VALUE 0x8017 Scalar_UB 0.0 CM_Count1 0.0 255.0 /end CHARACTERISTIC
/begin CHARACTERISTIC C_GPIO_O2A_FUNC "cal comments" VALUE 0x8018 Scalar_UB 0.0 CM_Count1 0.0 255.0 /end CHARACTERISTIC
/begin CHARACTERISTIC C_GPIO_O2B_FUNC "cal comments" VALUE 0x8019 Scalar_UB 0.0 CM_Count1 0.0 255.0 /end CHARACTERISTIC
/begin CHARACTERISTIC C_GPIO_CLT_FUNC "cal comments" VALUE 0x801A Scalar_UB 0.0 CM_Count1 0.0 255.0 /end CHARACTERISTIC
/begin CHARACTERISTIC C_GPIO_MAT_FUNC "cal comments" VALUE 0x801B Scalar_UB 0.0 CM_Count1 0.0 255.0 /end CHARACTERISTIC
/begin CHARACTERISTIC C_GPIO_MAP_FUNC "cal comments" VALUE 0x801C Scalar_UB 0.0 CM_Count1 0.0 255.0 /end CHARACTERISTIC
/begin CHARACTERISTIC C_GPIO_TPS1_FUNC "cal comments" VALUE 0x801D Scalar_UB 0.0 CM_Count1 0.0 255.0 /end CHARACTERISTIC
/begin CHARACTERISTIC C_GPIO_TPS2_FUNC "cal comments" VALUE 0x801E Scalar_UB 0.0 CM_Count1 0.0 255.0 /end CHARACTERISTIC
/begin CHARACTERISTIC C_GPIO_FCVPS_FUNC "cal comments" VALUE 0x801F Scalar_UB 0.0 CM_Count1 0.0 255.0 /end CHARACTERISTIC
/begin CHARACTERISTIC C_GPIO_TACH_FUNC "cal comments" VALUE 0x8020 Scalar_UB 0.0 CM_Count1 0.0 255.0 /end CHARACTERISTIC
/begin CHARACTERISTIC C_GPIO_CCP_FUNC "cal comments" VALUE 0x8021 Scalar_UB 0.0 CM_Count1 0.0 255.0 /end CHARACTERISTIC
/begin CHARACTERISTIC C_GPIO_O2HTR_FUNC "cal comments" VALUE 0x8022 Scalar_UB 0.0 CM_Count1 0.0 255.0 /end CHARACTERISTIC
/begin CHARACTERISTIC C_GPIO_IDLE_EN_FUNC "cal comments" VALUE 0x8024 Scalar_UB 0.0 CM_Count1 0.0 255.0 /end CHARACTERISTIC
/begin CHARACTERISTIC C_GPIO_IDLE_DIR_FUNC "cal comments" VALUE 0x8025 Scalar_UB 0.0 CM_Count1 0.0 255.0 /end CHARACTERISTIC
/begin CHARACTERISTIC C_GPIO_IDLE_STEP_FUNC "cal comments" VALUE 0x8026 Scalar_UB 0.0 CM_Count1 0.0 255.0 /end CHARACTERISTIC
/begin CHARACTERISTIC C_GPIO_8101CS_FUNC "cal comments" VALUE 0x8027 Scalar_UB 0.0 CM_Count1 0.0 255.0 /end CHARACTERISTIC
/begin CHARACTERISTIC C_GPIO_INJ1_FUNC "cal comments" VALUE 0x8028 Scalar_UB 0.0 CM_Count1 0.0 255.0 /end CHARACTERISTIC
/begin CHARACTERISTIC C_GPIO_INJ2_FUNC "cal comments" VALUE 0x8029 Scalar_UB 0.0 CM_Count1 0.0 255.0 /end CHARACTERISTIC
/begin CHARACTERISTIC C_GPIO_INJ3_FUNC "cal comments" VALUE 0x802A Scalar_UB 0.0 CM_Count1 0.0 255.0 /end CHARACTERISTIC
/begin CHARACTERISTIC C_GPIO_INJ4_FUNC "cal comments" VALUE 0x802B Scalar_UB 0.0 CM_Count1 0.0 255.0 /end CHARACTERISTIC
/begin CHARACTERISTIC C_GPIO_MIL_FUNC "cal comments" VALUE 0x8023 Scalar_UB 0.0 CM_Count1 0.0 255.0 /end CHARACTERISTIC
/begin CHARACTERISTIC C_GPIO_VI0_FUNC "cal comments" VALUE 0x802C Scalar_UB 0.0 CM_Count1 0.0 255.0 /end CHARACTERISTIC
/begin CHARACTERISTIC C_GPIO_VI1_FUNC "cal comments" VALUE 0x802D Scalar_UB 0.0 CM_Count1 0.0 255.0 /end CHARACTERISTIC
/begin CHARACTERISTIC C_GPIO_VI2_FUNC "cal comments" VALUE 0x802E Scalar_UB 0.0 CM_Count1 0.0 255.0 /end CHARACTERISTIC
/begin CHARACTERISTIC C_GPIO_VI3_FUNC "cal comments" VALUE 0x802F Scalar_UB 0.0 CM_Count1 0.0 255.0 /end CHARACTERISTIC
/begin CHARACTERISTIC C_GPIO_VI4_FUNC "cal comments" VALUE 0x8030 Scalar_UB 0.0 CM_Count1 0.0 255.0 /end CHARACTERISTIC
/begin CHARACTERISTIC C_GPIO_VI5_FUNC "cal comments" VALUE 0x8031 Scalar_UB 0.0 CM_Count1 0.0 255.0 /end CHARACTERISTIC
/begin CHARACTERISTIC C_GPIO_VI6_FUNC "cal comments" VALUE 0x8032 Scalar_UB 0.0 CM_Count1 0.0 255.0 /end CHARACTERISTIC
/begin CHARACTERISTIC C_GPIO_VI7_FUNC "cal comments" VALUE 0x8033 Scalar_UB 0.0 CM_Count1 0.0 255.0 /end CHARACTERISTIC
/begin CHARACTERISTIC C_HeatedO2SensorUsed "cal comments" VALUE 0x91E6 Scalar_UB 0.0 CM_Boolean2 0.0 1.0 /end CHARACTERISTIC
/begin CHARACTERISTIC C_HighEngSpdFCOThreshHi "cal comments" VALUE 0x9394 Scalar_UW 0.0 CM_RPM_0to16384 0.0 16383.75 /end CHARACTERISTIC
/begin CHARACTERISTIC C_HighEngSpdFCOThreshLo "cal comments" VALUE 0x9392 Scalar_UW 0.0 CM_RPM_0to16384 0.0 16383.75 /end CHARACTERISTIC
/begin CHARACTERISTIC C_FUEL_n_LackOilHighRPM "cal comments" VALUE 0xC24C Scalar_UW 0.0 CM_RPM_0to16384 0.0 16383.75 /end CHARACTERISTIC
/begin CHARACTERISTIC C_FUEL_n_LackOilLowRPM "cal comments" VALUE 0xC24E Scalar_UW 0.0 CM_RPM_0to16384 0.0 16383.75 /end CHARACTERISTIC
/begin CHARACTERISTIC C_FUEL_LackOil_CutOffEn "cal comments" VALUE 0xC250 Scalar_UB 0.0 CM_Boolean6 0.0 255.0 /end CHARACTERISTIC
/begin CHARACTERISTIC C_OSWPFiltCoef "cal comments" VALUE 0xC252 Scalar_UW 0.0 CM_FiltCoef 0.0 0.9999847412109375 /end CHARACTERISTIC
/begin CHARACTERISTIC C_OSWPSignalConvSlope "cal comments" VALUE 0xC254 Scalar_UW 0.0 CM_Percent_0to200_2 0.0 199.9969024658203 /end CHARACTERISTIC
/begin CHARACTERISTIC C_OSWPSignalConvIntercept "cal comments" VALUE 0xC256 Scalar_SW 0.0 CM_Percent_N200to200 -199.9999847412109 199.9938812255859 /end CHARACTERISTIC
/begin CHARACTERISTIC C_FUEL_n_COAHighRPM "cal comments" VALUE 0xC258 Scalar_UW 0.0 CM_RPM_0to16384 0.0 16383.75 /end CHARACTERISTIC
/begin CHARACTERISTIC C_FUEL_n_COALowRPM "cal comments" VALUE 0xC25A Scalar_UW 0.0 CM_RPM_0to16384 0.0 16383.75 /end CHARACTERISTIC
/begin CHARACTERISTIC C_FUEL_COA_CutOffEn "cal comments" VALUE 0xC25C Scalar_UB 0.0 CM_Boolean6 0.0 255.0 /end CHARACTERISTIC
/begin CHARACTERISTIC C_FUEL_COA_PulseOut "cal comments" VALUE 0xC25D Scalar_UB 0.0 CM_Boolean6 0.0 255.0 /end CHARACTERISTIC
/begin CHARACTERISTIC C_FUEL_t_COA_Ignore "cal comments" VALUE 0xC25E Scalar_UW 0.0 CM_Seconds_1 0.0 2047.96875 /end CHARACTERISTIC
/begin CHARACTERISTIC C_FUEL_t_COA_Lost "cal comments" VALUE 0xC260 Scalar_UW 0.0 CM_Seconds_1 0.0 2047.96875 /end CHARACTERISTIC
/begin CHARACTERISTIC C_FUEL_t_COA_Lock "cal comments" VALUE 0xC262 Scalar_UW 0.0 CM_Seconds_1 0.0 2047.96875 /end CHARACTERISTIC
/begin CHARACTERISTIC C_MultFuelSWFiltTime "cal comments" VALUE 0xC23E Scalar_UW 0.0 CM_Second_0to4096 0.0 4095.9375 /end CHARACTERISTIC
/begin CHARACTERISTIC C_MultFuelValvePulseOnTimeDuringCrank "cal comments" VALUE 0xC240 Scalar_UW 0.0 CM_Second_0to4096 0.0 4095.9375 /end CHARACTERISTIC
/begin CHARACTERISTIC C_MultFuelValvePulseOffTimeDuringCrank "cal comments" VALUE 0xC242 Scalar_UW 0.0 CM_Second_0to4096 0.0 4095.9375 /end CHARACTERISTIC
/begin CHARACTERISTIC C_VIOS_MultFuelSWLowActive "cal comments" VALUE 0xC244 Scalar_UB 0.0 CM_Boolean6 0.0 255.0 /end CHARACTERISTIC
/begin CHARACTERISTIC C_MultFuelType "cal comments" VALUE 0xC245 Scalar_UB 0.0 CM_Count1 0.0 255.0 /end CHARACTERISTIC
/begin CHARACTERISTIC C_MultFuelTypeLvl_Gas_NG "cal comments" VALUE 0xC246 Scalar_UW 0.0 CM_Percent_0to100_1 0.0 99.9984130859375 /end CHARACTERISTIC
/begin CHARACTERISTIC C_MultFuelTypeLvl_NG_LPG "cal comments" VALUE 0xC248 Scalar_UW 0.0 CM_Percent_0to100_1 0.0 99.9984130859375 /end CHARACTERISTIC
/begin CHARACTERISTIC C_FUEL_n_CltOverHeatHighRPM "cal comments" VALUE 0x9836 Scalar_UW 0.0 CM_RPM_0to16384 0.0 16383.75 /end CHARACTERISTIC
/begin CHARACTERISTIC C_FUEL_n_CltOverHeatLowRPM "cal comments" VALUE 0x9838 Scalar_UW 0.0 CM_RPM_0to16384 0.0 16383.75 /end CHARACTERISTIC
/begin CHARACTERISTIC C_FUEL_CltOverHeat_CutOffEn "cal comments" VALUE 0x983A Scalar_UB 0.0 CM_Boolean6 0.0 255.0 /end CHARACTERISTIC
/begin CHARACTERISTIC C_Fuel_Cont_IGNOff_HiRPM "cal comments" VALUE 0x983C Scalar_UW 0.0 CM_RPM_0to16384 0.0 16383.75 /end CHARACTERISTIC
/begin CHARACTERISTIC C_ACCurrentHigh "cal comments" VALUE 0xB33A Scalar_UW 0.0 CM_amp_0to512_1 0.0 511.9921875 /end CHARACTERISTIC
/begin CHARACTERISTIC C_ACCurrentLow "cal comments" VALUE 0xB33C Scalar_UW 0.0 CM_amp_0to512_1 0.0 511.9921875 /end CHARACTERISTIC
/begin CHARACTERISTIC C_ACLow2HighTime "cal comments" VALUE 0xB340 Scalar_UW 0.0 CM_Second_0to512 0.0 511.9921875 /end CHARACTERISTIC
/begin CHARACTERISTIC C_ACHigh2LowTime "cal comments" VALUE 0xB33E Scalar_UW 0.0 CM_Second_0to512 0.0 511.9921875 /end CHARACTERISTIC
/begin CHARACTERISTIC C_DC_CurrentSignalConvIntercept "cal comments" VALUE 0xB344 Scalar_SW 0.0 CM_Ratio_n256to256 -256.0 255.9921875 /end CHARACTERISTIC
/begin CHARACTERISTIC C_DC_CurrentSignalConvSlope "cal comments" VALUE 0xB342 Scalar_UW 0.0 CM_amp_0to512_1 0.0 511.9921875 /end CHARACTERISTIC
/begin CHARACTERISTIC C_DC_CurrentFiltCoef "cal comments" VALUE 0xB346 Scalar_UW 0.0 CM_FiltCoef 0.0 0.9999847412109375 /end CHARACTERISTIC
/begin CHARACTERISTIC C_IDLEMoveBatVoltMaxLimit "cal comments" VALUE 0xB8D0 Scalar_UW 0.0 CM_Volt_0to32_1 0.0 31.99900627136231 /end CHARACTERISTIC
/begin CHARACTERISTIC C_IDLEMoveBatVoltMinLimit "cal comments" VALUE 0xB8D2 Scalar_UW 0.0 CM_Volt_0to32_1 0.0 31.99900627136231 /end CHARACTERISTIC
/begin CHARACTERISTIC C_IdleDerivEngSpdHiDeadBand "cal comments" VALUE 0x9F1A Scalar_UW 0.0 CM_RPM_0to16384 0.0 16383.75 /end CHARACTERISTIC
/begin CHARACTERISTIC C_IdleDerivEngSpdLoDeadBand "cal comments" VALUE 0x9F1C Scalar_UW 0.0 CM_RPM_0to16384 0.0 16383.75 /end CHARACTERISTIC
/begin CHARACTERISTIC C_IdleDerivEngSpdUpDeltaDeadBand "cal comments" VALUE 0x9F1E Scalar_UW 0.0 CM_RPM_0to16384 0.0 16383.75 /end CHARACTERISTIC
/begin CHARACTERISTIC C_IdleDerivEngSpdDwnDeltaDeadBand "cal comments" VALUE 0x9F20 Scalar_UW 0.0 CM_RPM_0to16384 0.0 16383.75 /end CHARACTERISTIC
/begin CHARACTERISTIC C_IdleEnableEngSpdThresh "cal comments" VALUE 0x9F46 Scalar_UW 0.0 CM_RPM_0to16384 0.0 16383.75 /end CHARACTERISTIC
/begin CHARACTERISTIC C_IdleEnableTPSThresh "cal comments" VALUE 0x9F48 Scalar_UW 0.0 CM_Percent_0to200_2 0.0 199.9969024658203 /end CHARACTERISTIC
/begin CHARACTERISTIC C_IdleIntEnbEngSpdErrorThresh "cal comments" VALUE 0x9F16 Scalar_UW 0.0 CM_RPM_0to16384 0.0 16383.75 /end CHARACTERISTIC
/begin CHARACTERISTIC C_IdleIntDltRange "cal comments" VALUE 0x9F18 Scalar_UW 0.0 CM_RPM_0to16384 0.0 16383.75 /end CHARACTERISTIC
/begin CHARACTERISTIC C_IdleIntInitDefault "cal comments" VALUE 0x9F44 Scalar_UW 0.0 CM_Percent_0to200_2 0.0 199.9969024658203 /end CHARACTERISTIC
/begin CHARACTERISTIC C_IdlePropEngSpdHiDeadBand "cal comments" VALUE 0x9F22 Scalar_UW 0.0 CM_RPM_0to16384 0.0 16383.75 /end CHARACTERISTIC
/begin CHARACTERISTIC C_IdlePropEngSpdLoDeadBand "cal comments" VALUE 0x9F24 Scalar_UW 0.0 CM_RPM_0to16384 0.0 16383.75 /end CHARACTERISTIC
/begin CHARACTERISTIC CT_IdlePropEngSpdHigh_EX "cal comments" MAP 0x9F4D 3D_Array_UB 0.0 CM_Percent_0to100 0.0 99.609375
 /begin AXIS_DESCR COM_AXIS NO_INPUT_QUANTITY CM_RPM_0to16384 17 0.0 16383.75 AXIS_PTS_REF CA_EngSpd17Step4 MAX_GRAD 0.0 /end AXIS_DESCR
 /begin AXIS_DESCR COM_AXIS NO_INPUT_QUANTITY CM_kpa_0to256_1 8 0.0 255.99609375 AXIS_PTS_REF CA_MAP8Step3 MAX_GRAD 0.0 /end AXIS_DESCR
/end CHARACTERISTIC
/begin CHARACTERISTIC CT_IdlePropEngSpdLow_EX "cal comments" MAP 0x9FD8 3D_Array_UB 0.0 CM_Percent_0to100 0.0 99.609375
 /begin AXIS_DESCR COM_AXIS NO_INPUT_QUANTITY CM_RPM_0to16384 17 0.0 16383.75 AXIS_PTS_REF CA_EngSpd17Step4 MAX_GRAD 0.0 /end AXIS_DESCR
 /begin AXIS_DESCR COM_AXIS NO_INPUT_QUANTITY CM_kpa_0to256_1 8 0.0 255.99609375 AXIS_PTS_REF CA_MAP8Step3 MAX_GRAD 0.0 /end AXIS_DESCR
/end CHARACTERISTIC
/begin CHARACTERISTIC CT_IdleIntGainEngSpdHigh_EX "cal comments" MAP 0xA063 3D_Array_UB 0.0 CM_Mult0_to_2_ratio1 0.0 1.9921875
 /begin AXIS_DESCR COM_AXIS NO_INPUT_QUANTITY CM_RPM_0to16384 11 0.0 16383.75 AXIS_PTS_REF CA_EngSpd11Step2 MAX_GRAD 0.0 /end AXIS_DESCR
 /begin AXIS_DESCR COM_AXIS NO_INPUT_QUANTITY CM_kpa_0to256_1 8 0.0 255.99609375 AXIS_PTS_REF CA_MAP8Step3 MAX_GRAD 0.0 /end AXIS_DESCR
/end CHARACTERISTIC
/begin CHARACTERISTIC CT_IdleIntGainEngSpdLow_EX "cal comments" MAP 0xA0BE 3D_Array_UB 0.0 CM_Mult0_to_2_ratio1 0.0 1.9921875
 /begin AXIS_DESCR COM_AXIS NO_INPUT_QUANTITY CM_RPM_0to16384 11 0.0 16383.75 AXIS_PTS_REF CA_EngSpd11Step2 MAX_GRAD 0.0 /end AXIS_DESCR
 /begin AXIS_DESCR COM_AXIS NO_INPUT_QUANTITY CM_kpa_0to256_1 8 0.0 255.99609375 AXIS_PTS_REF CA_MAP8Step3 MAX_GRAD 0.0 /end AXIS_DESCR
/end CHARACTERISTIC
/begin CHARACTERISTIC CT_IdleDerivEngSpdHigh_EX "cal comments" MAP 0xA119 3D_Array_UB 0.0 CM_Percent_0to100 0.0 99.609375
 /begin AXIS_DESCR COM_AXIS NO_INPUT_QUANTITY CM_RPM_0to16384 11 0.0 16383.75 AXIS_PTS_REF CA_EngSpd11Step3 MAX_GRAD 0.0 /end AXIS_DESCR
 /begin AXIS_DESCR COM_AXIS NO_INPUT_QUANTITY CM_kpa_0to256_1 8 0.0 255.99609375 AXIS_PTS_REF CA_MAP8Step3 MAX_GRAD 0.0 /end AXIS_DESCR
/end CHARACTERISTIC
/begin CHARACTERISTIC CT_IdleDerivEngSpdLow_EX "cal comments" MAP 0xA174 3D_Array_UB 0.0 CM_Percent_0to100 0.0 99.609375
 /begin AXIS_DESCR COM_AXIS NO_INPUT_QUANTITY CM_RPM_0to16384 11 0.0 16383.75 AXIS_PTS_REF CA_EngSpd11Step3 MAX_GRAD 0.0 /end AXIS_DESCR
 /begin AXIS_DESCR COM_AXIS NO_INPUT_QUANTITY CM_kpa_0to256_1 8 0.0 255.99609375 AXIS_PTS_REF CA_MAP8Step3 MAX_GRAD 0.0 /end AXIS_DESCR
/end CHARACTERISTIC
/begin CHARACTERISTIC CT_IdleDerivEngSpdHighEnh "cal comments" MAP 0xA1CF 3D_Array_UB 0.0 CM_Percent_0to100 0.0 99.609375
 /begin AXIS_DESCR COM_AXIS NO_INPUT_QUANTITY CM_RPM_0to16384 11 0.0 16383.75 AXIS_PTS_REF CA_EngSpd11Step3 MAX_GRAD 0.0 /end AXIS_DESCR
 /begin AXIS_DESCR COM_AXIS NO_INPUT_QUANTITY CM_kpa_0to256_1 8 0.0 255.99609375 AXIS_PTS_REF CA_MAP8Step3 MAX_GRAD 0.0 /end AXIS_DESCR
/end CHARACTERISTIC
/begin CHARACTERISTIC CT_IdleDerivEngSpdLowEnh "cal comments" MAP 0xA22A 3D_Array_UB 0.0 CM_Percent_0to100 0.0 99.609375
 /begin AXIS_DESCR COM_AXIS NO_INPUT_QUANTITY CM_RPM_0to16384 11 0.0 16383.75 AXIS_PTS_REF CA_EngSpd11Step3 MAX_GRAD 0.0 /end AXIS_DESCR
 /begin AXIS_DESCR COM_AXIS NO_INPUT_QUANTITY CM_kpa_0to256_1 8 0.0 255.99609375 AXIS_PTS_REF CA_MAP8Step3 MAX_GRAD 0.0 /end AXIS_DESCR
/end CHARACTERISTIC
/begin CHARACTERISTIC C_IACV_n_BattOffsetMax "cal comments" VALUE 0x9C66 Scalar_UW 0.0 udf_CM_18586 0.0 16383.75 /end CHARACTERISTIC
/begin CHARACTERISTIC C_IACV_n_BattRPMStep "cal comments" VALUE 0x9C68 Scalar_UW 0.0 udf_CM_18586 0.0 16383.75 /end CHARACTERISTIC
/begin CHARACTERISTIC C_IACV_r_StartUpFactor "cal comments" VALUE 0x9C6A Scalar_UW 0.0 CM_FactorRatio 0.0 0.9999847412109375 /end CHARACTERISTIC
/begin CHARACTERISTIC C_IACV_t_BattWaitTime "cal comments" VALUE 0x9C6C Scalar_UW 0.0 CM_Second_0to1024 0.0 1023.984375 /end CHARACTERISTIC
/begin CHARACTERISTIC C_IACV_t_DsrdSpdSUDecayTime "cal comments" VALUE 0x9C6E Scalar_UW 0.0 CM_Second_0to1024 0.0 1023.984375 /end CHARACTERISTIC
/begin CHARACTERISTIC C_IACV_t_LowBattWaitTime "cal comments" VALUE 0x9C70 Scalar_UW 0.0 CM_Second_0to1024 0.0 1023.984375 /end CHARACTERISTIC
/begin CHARACTERISTIC C_IACV_U_BattHigh "cal comments" VALUE 0x9C72 Scalar_UW 0.0 CM_Volt_0to32_1 0.0 31.99900627136231 /end CHARACTERISTIC
/begin CHARACTERISTIC C_IACV_U_BattLow "cal comments" VALUE 0x9C74 Scalar_UW 0.0 CM_Volt_0to32_1 0.0 31.99900627136231 /end CHARACTERISTIC
/begin CHARACTERISTIC CT_IACV_n_BaseDsrdSpd "cal comments" CURVE 0x9C78 2D_Array_UW 0.0 CM_RPM_0to16384 0.0 16383.75
 /begin AXIS_DESCR FIX_AXIS NO_INPUT_QUANTITY CM_Equaloutput1 17 -28.0 164.0 MAX_GRAD 0.0 /begin FIX_AXIS_PAR_LIST -28 -16 -4 8 20 32 44 56 68 80 92 104 116 128 140 152 164 /end FIX_AXIS_PAR_LIST /end AXIS_DESCR
/end CHARACTERISTIC
/begin CHARACTERISTIC CT_IACV_pct_DsrdThrotFollow "cal comments" MAP 0x9CD4 3D_Array_UB 0.0 CM_Percent_0to100 0.0 99.609375
 /begin AXIS_DESCR FIX_AXIS NO_INPUT_QUANTITY CM_Equaloutput1 9 0.0 50.0 MAX_GRAD 0.0 /begin FIX_AXIS_PAR_LIST 0 6.25 12.5 18.75 25 31.25 37.5 43.75 50 /end FIX_AXIS_PAR_LIST /end AXIS_DESCR
 /begin AXIS_DESCR FIX_AXIS NO_INPUT_QUANTITY CM_Equaloutput1 9 800.0 7200.0 MAX_GRAD 0.0 /begin FIX_AXIS_PAR_LIST 800 1600 2400 3200 4000 4800 5600 6400 7200 /end FIX_AXIS_PAR_LIST /end AXIS_DESCR
/end CHARACTERISTIC
/begin CHARACTERISTIC CT_IACV_r_TFDecayCoeff "cal comments" CURVE 0x9D28 2D_Array_UB 0.0 CM_Mult_0to1 0.0 0.99609375
 /begin AXIS_DESCR FIX_AXIS NO_INPUT_QUANTITY CM_Equaloutput1 9 800.0 7200.0 MAX_GRAD 0.0 /begin FIX_AXIS_PAR_LIST 800 1600 2400 3200 4000 4800 5600 6400 7200 /end FIX_AXIS_PAR_LIST /end AXIS_DESCR
/end CHARACTERISTIC
/begin CHARACTERISTIC CT_IACV_r_TFRampUpCoeff "cal comments" CURVE 0x9D33 2D_Array_UB 0.0 CM_Mult_0to1 0.0 0.99609375
 /begin AXIS_DESCR FIX_AXIS NO_INPUT_QUANTITY CM_Equaloutput1 9 0.0 50.0 MAX_GRAD 0.0 /begin FIX_AXIS_PAR_LIST 0 6.25 12.5 18.75 25 31.25 37.5 43.75 50 /end FIX_AXIS_PAR_LIST /end AXIS_DESCR
/end CHARACTERISTIC
/begin CHARACTERISTIC CT_IACV_r_ThrotFollowFactor "cal comments" CURVE 0x9D3E 2D_Array_UB 0.0 CM_Mult0_to_2_ratio 0.0 1.9921875
 /begin AXIS_DESCR FIX_AXIS NO_INPUT_QUANTITY CM_Equaloutput1 17 -28.0 164.0 MAX_GRAD 0.0 /begin FIX_AXIS_PAR_LIST -28 -16 -4 8 20 32 44 56 68 80 92 104 116 128 140 152 164 /end FIX_AXIS_PAR_LIST /end AXIS_DESCR
/end CHARACTERISTIC
/begin CHARACTERISTIC C_IACV_r_TF_NeutralDecayCoeff "cal comments" VALUE 0x9D50 Scalar_UW 0.0 CM_FactorRatio 0.0 0.9999847412109375 /end CHARACTERISTIC
/begin CHARACTERISTIC C_IACVEnableEngSpdThresh "cal comments" VALUE 0x9CCE Scalar_UW 0.0 CM_RPM_0to16384 0.0 16383.75 /end CHARACTERISTIC
/begin CHARACTERISTIC C_IACVEnableTPSThresh "cal comments" VALUE 0x9CD0 Scalar_UW 0.0 CM_Percent_0to200_2 0.0 199.9969024658203 /end CHARACTERISTIC
/begin CHARACTERISTIC C_IACVIntEnbEngSpdErrorThresh "cal comments" VALUE 0x9D52 Scalar_UW 0.0 CM_RPM_0to16384 0.0 16383.75 /end CHARACTERISTIC
/begin CHARACTERISTIC C_IACVPropEngSpdHiDeadBand "cal comments" VALUE 0x9D5A Scalar_UW 0.0 CM_RPM_0to16384 0.0 16383.75 /end CHARACTERISTIC
/begin CHARACTERISTIC C_IACVPropEngSpdLoDeadBand "cal comments" VALUE 0x9D5C Scalar_UW 0.0 CM_RPM_0to16384 0.0 16383.75 /end CHARACTERISTIC
/begin CHARACTERISTIC C_IACV_pct_AiflowLrnBaseVal "cal comments" VALUE 0x9D5E Scalar_UW 0.0 CM_Percent_0to200_2 0.0 199.9969024658203 /end CHARACTERISTIC
/begin CHARACTERISTIC C_IACV_pct_AirflowMaxIntgOffset "cal comments" VALUE 0x9D60 Scalar_UW 0.0 CM_Percent_0to200_2 0.0 199.9969024658203 /end CHARACTERISTIC
/begin CHARACTERISTIC C_IACV_pct_AirflowSlowLrnOffset "cal comments" VALUE 0x9D62 Scalar_UW 0.0 CM_Percent_0to200_2 0.0 199.9969024658203 /end CHARACTERISTIC
/begin CHARACTERISTIC C_IACV_r_AirflowRPMErrCoeff "cal comments" VALUE 0x9D64 Scalar_UW 0.0 CM_FactorRatio 0.0 0.9999847412109375 /end CHARACTERISTIC
/begin CHARACTERISTIC C_IACV_r_CrankDecayFactor "cal comments" VALUE 0x9D66 Scalar_UW 0.0 CM_FactorRatio 0.0 0.9999847412109375 /end CHARACTERISTIC
/begin CHARACTERISTIC C_IACV_r_AirflowICoolMaxFactor "cal comments" VALUE 0x9E0C Scalar_UW 0.0 CM_FactorRatio 0.0 0.9999847412109375 /end CHARACTERISTIC
/begin CHARACTERISTIC C_IACV_t_AirflowBattDelayTime "cal comments" VALUE 0x9D68 Scalar_UW 0.0 CM_Second_0to1024 0.0 1023.984375 /end CHARACTERISTIC
/begin CHARACTERISTIC C_IACV_t_CrankDecayTime "cal comments" VALUE 0x9D6A Scalar_UW 0.0 CM_Second_0to1024 0.0 1023.984375 /end CHARACTERISTIC
/begin CHARACTERISTIC C_IACV_t_MotorResetDly "cal comments" VALUE 0x9D6E Scalar_UW 0.0 CM_Second_0to1024 0.0 1023.984375 /end CHARACTERISTIC
/begin CHARACTERISTIC C_IACVCLDelayAftStartUp "cal comments" VALUE 0x9D70 Scalar_UW 0.0 CM_Second_0to1024 0.0 1023.984375 /end CHARACTERISTIC
/begin CHARACTERISTIC C_IACV_U_AirflowAltCrank "cal comments" VALUE 0x9D72 Scalar_UW 0.0 CM_Volt_0to32_1 0.0 31.99900627136231 /end CHARACTERISTIC
/begin CHARACTERISTIC C_IACV_U_AirflowAltIncVolt "cal comments" VALUE 0x9D74 Scalar_UW 0.0 CM_Volt_0to32_1 0.0 31.99900627136231 /end CHARACTERISTIC
/begin CHARACTERISTIC C_IACV_T_EngTmpWarm "cal comments" VALUE 0x9D6C Scalar_SW 0.0 CM_DegC_N256to256 -256.0 255.9921875 /end CHARACTERISTIC
/begin CHARACTERISTIC C_IACV_pct_AirflowSlowLrnLimit "cal comments" VALUE 0x9E70 Scalar_UW 0.0 CM_Percent_0to200_2 0.0 199.9969024658203 /end CHARACTERISTIC
/begin CHARACTERISTIC CT_IACV_p_IntegralDeltaHiThrs "cal comments" CURVE 0x9D78 2D_Array_UB 0.0 CM_kpa_8bit 0.0 127.5
 /begin AXIS_DESCR FIX_AXIS NO_INPUT_QUANTITY CM_Equaloutput1 7 -28.0 164.0 MAX_GRAD 0.0 /begin FIX_AXIS_PAR_LIST -28 4 36 68 100 132 164 /end FIX_AXIS_PAR_LIST /end AXIS_DESCR
/end CHARACTERISTIC
/begin CHARACTERISTIC CT_IACV_p_IntegralDeltaLowThrs "cal comments" CURVE 0x9E62 2D_Array_UW 0.0 CM_kpa_0to256_1 0.0 255.99609375
 /begin AXIS_DESCR FIX_AXIS NO_INPUT_QUANTITY CM_Equaloutput1 7 -28.0 164.0 MAX_GRAD 0.0 /begin FIX_AXIS_PAR_LIST -28 4 36 68 100 132 164 /end FIX_AXIS_PAR_LIST /end AXIS_DESCR
/end CHARACTERISTIC
/begin CHARACTERISTIC CT_IACV_pct_AirflowBattVoltOff "cal comments" CURVE 0x9D81 2D_Array_UB 0.0 CM_Percent_0to100 0.0 99.609375
 /begin AXIS_DESCR FIX_AXIS NO_INPUT_QUANTITY CM_Equaloutput1 17 6 18.8 MAX_GRAD 0.0
  /begin FIX_AXIS_PAR_LIST 6 6.8 7.6 8.4 9.2 10 10.8 11.6 12.4 13.2 14.0 14.8 15.6 16.4 17.2 18 18.8 /end FIX_AXIS_PAR_LIST
 /end AXIS_DESCR
/end CHARACTERISTIC
/begin CHARACTERISTIC CT_IACV_pct_AirflowCrankOffset "cal comments" CURVE 0x9D94 2D_Array_UB 0.0 CM_Percent_0to100 0.0 99.609375
 /begin AXIS_DESCR FIX_AXIS NO_INPUT_QUANTITY CM_Equaloutput1 17 -28.0 164.0 MAX_GRAD 0.0 /begin FIX_AXIS_PAR_LIST -28 -16 -4 8 20 32 44 56 68 80 92 104 116 128 140 152 164 /end FIX_AXIS_PAR_LIST /end AXIS_DESCR
/end CHARACTERISTIC
/begin CHARACTERISTIC CT_IACV_r_AirflowICoolOffsetFact "cal comments" CURVE 0x9E10 2D_Array_UB 0.0 CM_Mult_0to1_2 0.0 0.99609375
 /begin AXIS_DESCR FIX_AXIS NO_INPUT_QUANTITY CM_Equaloutput1 17 -28.0 164.0 MAX_GRAD 0.0 /begin FIX_AXIS_PAR_LIST -28 -16 -4 8 20 32 44 56 68 80 92 104 116 128 140 152 164 /end FIX_AXIS_PAR_LIST /end AXIS_DESCR
/end CHARACTERISTIC
/begin CHARACTERISTIC C_CLIACVEnableDelay "cal comments" VALUE 0x9C9A Scalar_UW 0.0 CM_Second_0to1024 0.0 1023.984375 /end CHARACTERISTIC
/begin CHARACTERISTIC CT_IACVFlowBaroMult "cal comments" CURVE 0x9DBA 2D_Array_UB 0.0 CM_Mult_0to8 0.0 7.96875
 /begin AXIS_DESCR FIX_AXIS NO_INPUT_QUANTITY CM_Equaloutput1 6 55.0 105.0 MAX_GRAD 0.0 /begin FIX_AXIS_PAR_LIST 55 65 75 85 95 105 /end FIX_AXIS_PAR_LIST /end AXIS_DESCR
/end CHARACTERISTIC
/begin CHARACTERISTIC CT_IACVAirflowColdOffset "cal comments" CURVE 0x9DA7 2D_Array_UB 0.0 CM_Percent_0to100 0.0 99.609375
 /begin AXIS_DESCR FIX_AXIS NO_INPUT_QUANTITY CM_Equaloutput1 17 -28.0 164.0 MAX_GRAD 0.0 /begin FIX_AXIS_PAR_LIST -28 -16 -4 8 20 32 44 56 68 80 92 104 116 128 140 152 164 /end FIX_AXIS_PAR_LIST /end AXIS_DESCR
/end CHARACTERISTIC
/begin CHARACTERISTIC CT_IACVDerivEngSpdHigh "cal comments" CURVE 0x9DC2 2D_Array_UB 0.0 CM_Percent_0to100 0.0 99.609375
 /begin AXIS_DESCR FIX_AXIS NO_INPUT_QUANTITY CM_Equaloutput1 17 0.0 128.0 MAX_GRAD 0.0 /begin FIX_AXIS_PAR_LIST 0 8 16 24 32 40 48 56 64 72 80 88 96 104 112 120 128 /end FIX_AXIS_PAR_LIST /end AXIS_DESCR
/end CHARACTERISTIC
/begin CHARACTERISTIC CT_IACVDerivEngSpdLow "cal comments" CURVE 0x9DD5 2D_Array_UB 0.0 CM_Percent_0to100 0.0 99.609375
 /begin AXIS_DESCR FIX_AXIS NO_INPUT_QUANTITY CM_Equaloutput1 17 0.0 128.0 MAX_GRAD 0.0 /begin FIX_AXIS_PAR_LIST 0 8 16 24 32 40 48 56 64 72 80 88 96 104 112 120 128 /end FIX_AXIS_PAR_LIST /end AXIS_DESCR
/end CHARACTERISTIC
/begin CHARACTERISTIC CT_IACVDesireSpdStartup "cal comments" CURVE 0x9C9E 2D_Array_UW 0.0 CM_RPM_0to16384 0.0 16383.75
 /begin AXIS_DESCR FIX_AXIS NO_INPUT_QUANTITY CM_Equaloutput1 17 -28.0 164.0 MAX_GRAD 0.0 /begin FIX_AXIS_PAR_LIST -28 -16 -4 8 20 32 44 56 68 80 92 104 116 128 140 152 164 /end FIX_AXIS_PAR_LIST /end AXIS_DESCR
/end CHARACTERISTIC
/begin CHARACTERISTIC CT_IACVIntGainEngSpdHigh "cal comments" CURVE 0x9E23 2D_Array_UB 0.0 CM_Mult0_to_2_ratio1 0.0 1.9921875
 /begin AXIS_DESCR FIX_AXIS NO_INPUT_QUANTITY CM_Equaloutput1 11 0.0 500.0 MAX_GRAD 0.0 /begin FIX_AXIS_PAR_LIST 0 50 100 150 200 250 300 350 400 450 500 /end FIX_AXIS_PAR_LIST /end AXIS_DESCR
/end CHARACTERISTIC
/begin CHARACTERISTIC CT_IACVIntGainEngSpdLow "cal comments" CURVE 0x9E30 2D_Array_UB 0.0 CM_Mult0_to_2_ratio1 0.0 1.9921875
 /begin AXIS_DESCR FIX_AXIS NO_INPUT_QUANTITY CM_Equaloutput1 11 0.0 500.0 MAX_GRAD 0.0 /begin FIX_AXIS_PAR_LIST 0 50 100 150 200 250 300 350 400 450 500 /end FIX_AXIS_PAR_LIST /end AXIS_DESCR
/end CHARACTERISTIC
/begin CHARACTERISTIC CT_IACVPropEngSpdHigh "cal comments" CURVE 0x9DE8 2D_Array_UB 0.0 CM_Percent_0to100 0.0 99.609375
 /begin AXIS_DESCR COM_AXIS NO_INPUT_QUANTITY CM_RPM_0to16384 17 0.0 16383.75 AXIS_PTS_REF CA_EngSpd17Step4 MAX_GRAD 0.0 /end AXIS_DESCR
/end CHARACTERISTIC
/begin CHARACTERISTIC CT_IACVPropEngSpdLow "cal comments" CURVE 0x9DFB 2D_Array_UB 0.0 CM_Percent_0to100 0.0 99.609375
 /begin AXIS_DESCR COM_AXIS NO_INPUT_QUANTITY CM_RPM_0to16384 17 0.0 16383.75 AXIS_PTS_REF CA_EngSpd17Step4 MAX_GRAD 0.0 /end AXIS_DESCR
/end CHARACTERISTIC
/begin CHARACTERISTIC CT_IACV_t_CoolantDecayTime "cal comments" CURVE 0x9E3E 2D_Array_UW 0.0 CM_Second_0to1024 0.0 1023.984375
 /begin AXIS_DESCR FIX_AXIS NO_INPUT_QUANTITY CM_Equaloutput1 17 -28.0 164.0 MAX_GRAD 0.0 /begin FIX_AXIS_PAR_LIST -28 -16 -4 8 20 32 44 56 68 80 92 104 116 128 140 152 164 /end FIX_AXIS_PAR_LIST /end AXIS_DESCR
/end CHARACTERISTIC
/begin CHARACTERISTIC C_VIOS_IACV_PstnDft "cal comments" VALUE 0xB8C7 Scalar_UB 0.0 CM_Count4 0.0 255.0 /end CHARACTERISTIC
/begin CHARACTERISTIC C_VIOS_IACV_PstnMax "cal comments" VALUE 0xB8C8 Scalar_UB 0.0 CM_Count4 0.0 255.0 /end CHARACTERISTIC
/begin CHARACTERISTIC C_VIOS_IACV_PstnMin "cal comments" VALUE 0xB8C9 Scalar_UB 0.0 CM_Count4 0.0 255.0 /end CHARACTERISTIC
/begin CHARACTERISTIC C_IACVMotorParkDelay "cal comments" VALUE 0xB8CA Scalar_UW 0.0 CM_Count_0to65535 0.0 65535.0 /end CHARACTERISTIC
/begin CHARACTERISTIC C_IACVStepMotorHiEn "cal comments" VALUE 0xB8CC Scalar_UB 0.0 CM_Boolean6 0.0 255.0 /end CHARACTERISTIC
/begin CHARACTERISTIC C_IACVStepMotorDir "cal comments" VALUE 0xB8CD Scalar_UB 0.0 CM_Boolean6 0.0 255.0 /end CHARACTERISTIC
/begin CHARACTERISTIC C_IACVLoopCounter "cal comments" VALUE 0xB8CE Scalar_UB 0.0 CM_Count1 0.0 255.0 /end CHARACTERISTIC
/begin CHARACTERISTIC C_IACVMoveBatVoltMaxLimit "cal comments" VALUE 0xB89A Scalar_UW 0.0 CM_Volt_0to32_1 0.0 31.99900627136231 /end CHARACTERISTIC
/begin CHARACTERISTIC C_IACVMoveBatVoltMinLimit "cal comments" VALUE 0xB89C Scalar_UW 0.0 CM_Volt_0to32_1 0.0 31.99900627136231 /end CHARACTERISTIC
/begin CHARACTERISTIC C_IACVMotorDirChangeDelay "cal comments" VALUE 0xB8A0 Scalar_UB 0.0 CM_Count4 0.0 255.0 /end CHARACTERISTIC
/begin CHARACTERISTIC C_IACVMotorStartDelay "cal comments" VALUE 0xB89E Scalar_UB 0.0 CM_Count4 0.0 255.0 /end CHARACTERISTIC
/begin CHARACTERISTIC C_IACVMotorStartDelaySteps "cal comments" VALUE 0xB89F Scalar_UB 0.0 CM_Count4 0.0 255.0 /end CHARACTERISTIC
/begin CHARACTERISTIC CT_IACVDsrdMtrPstn "cal comments" CURVE 0xB8A3 2D_Array_UB 0.0 CM_Count4 0.0 255.0
 /begin AXIS_DESCR FIX_AXIS NO_INPUT_QUANTITY CM_Equaloutput1 17 0.0 100.0 MAX_GRAD 0.0
  /begin FIX_AXIS_PAR_LIST 0.0 6.25 12.5 18.75 25.0 31.25 37.5 43.75 50.0 56.25 62.5 68.75 75.0 81.25 87.5 93.75 100.0 /end FIX_AXIS_PAR_LIST
 /end AXIS_DESCR
/end CHARACTERISTIC
/begin CHARACTERISTIC CT_IACV_ParkPstn "cal comments" CURVE 0xB8B6 2D_Array_UB 0.0 CM_Count4 0.0 255.0
 /begin AXIS_DESCR FIX_AXIS NO_INPUT_QUANTITY CM_Equaloutput1 17 -28.0 164.0 MAX_GRAD 0.0 /begin FIX_AXIS_PAR_LIST -28 -16 -4 8 20 32 44 56 68 80 92 104 116 128 140 152 164 /end FIX_AXIS_PAR_LIST /end AXIS_DESCR
/end CHARACTERISTIC
/begin CHARACTERISTIC C_IACV_ForChokeEnable "cal comments" VALUE 0x9CC0 Scalar_UB 0.0 CM_Boolean6 0.0 255.0 /end CHARACTERISTIC
/begin CHARACTERISTIC C_IACVMotorResetEachPowerDown "cal comments" VALUE 0x9CCA Scalar_UB 0.0 CM_Boolean1 0.0 1.0 /end CHARACTERISTIC
/begin CHARACTERISTIC C_IACVMotorRstEn "cal comments" VALUE 0x9CCC Scalar_UB 0.0 CM_Boolean1 0.0 1.0 /end CHARACTERISTIC
/begin CHARACTERISTIC C_IACVMotorResetEngSpdThresh "cal comments" VALUE 0x9CC4 Scalar_UW 0.0 CM_RPM_0to16384 0.0 16383.75 /end CHARACTERISTIC
/begin CHARACTERISTIC C_IACVMotorResetIGNOffDelay "cal comments" VALUE 0x9CC8 Scalar_UW 0.0 CM_Second_0to512 0.0 511.9921875 /end CHARACTERISTIC
/begin CHARACTERISTIC C_IACVMotorResetMaxPintleSeatStep "cal comments" VALUE 0x9CCB Scalar_UB 0.0 CM_Count4 0.0 255.0 /end CHARACTERISTIC
/begin CHARACTERISTIC C_IACVMotorResetTPSThresh "cal comments" VALUE 0x9CC6 Scalar_UW 0.0 CM_Percent_0to200_2 0.0 199.9969024658203 /end CHARACTERISTIC
/begin CHARACTERISTIC C_IACVPosLostCoolTempThresh "cal comments" VALUE 0x9CC2 Scalar_SW 0.0 CM_DegC_N256to256 -256.0 255.9921875 /end CHARACTERISTIC
/begin CHARACTERISTIC CT_BSTPPropCntrHigh "cal comments" CURVE 0x8F58 2D_Array_UB 0.0 CM_Percent_0to100 0.0 99.609375
 /begin AXIS_DESCR COM_AXIS NO_INPUT_QUANTITY CM_kpa_0to256_1 9 0.0 255.99609375 AXIS_PTS_REF CA_MAP9Step2 MAX_GRAD 0.0 /end AXIS_DESCR
/end CHARACTERISTIC
/begin CHARACTERISTIC CT_BSTPPropCntrLow "cal comments" CURVE 0x8F6B 2D_Array_UB 0.0 CM_Percent_0to100 0.0 99.609375
 /begin AXIS_DESCR COM_AXIS NO_INPUT_QUANTITY CM_kpa_0to256_1 9 0.0 255.99609375 AXIS_PTS_REF CA_MAP9Step2 MAX_GRAD 0.0 /end AXIS_DESCR
/end CHARACTERISTIC
/begin CHARACTERISTIC CT_BSTPIntGainHigh "cal comments" CURVE 0x8F7E 2D_Array_UB 0.0 CM_Mult0_to_2_ratio 0.0 1.9921875
 /begin AXIS_DESCR COM_AXIS NO_INPUT_QUANTITY CM_kpa_0to256_1 9 0.0 255.99609375 AXIS_PTS_REF CA_MAP9Step2 MAX_GRAD 0.0 /end AXIS_DESCR
/end CHARACTERISTIC
/begin CHARACTERISTIC CT_BSTPIntGainLow "cal comments" CURVE 0x8F8B 2D_Array_UB 0.0 CM_Mult0_to_2_ratio 0.0 1.9921875
 /begin AXIS_DESCR COM_AXIS NO_INPUT_QUANTITY CM_kpa_0to256_1 9 0.0 255.99609375 AXIS_PTS_REF CA_MAP9Step2 MAX_GRAD 0.0 /end AXIS_DESCR
/end CHARACTERISTIC
/begin CHARACTERISTIC C_BSTPClosedLoopOffset "cal comments" VALUE 0x8FAA Scalar_UW 0.0 CM_kpa_0to256_1 0.0 255.99609375 /end CHARACTERISTIC
/begin CHARACTERISTIC C_BSTPCLControlRange "cal comments" VALUE 0x8FAC Scalar_UW 0.0 CM_kpa_0to256_1 0.0 255.99609375 /end CHARACTERISTIC
/begin CHARACTERISTIC C_BSTPIntEnbErrorThresh "cal comments" VALUE 0x8F50 Scalar_UW 0.0 CM_kpa_0to256_1 0.0 255.99609375 /end CHARACTERISTIC
/begin CHARACTERISTIC C_BSTPPropHiDeadBand "cal comments" VALUE 0x8F52 Scalar_UW 0.0 CM_kpa_0to256_1 0.0 255.99609375 /end CHARACTERISTIC
/begin CHARACTERISTIC C_BSTPPropLoDeadBand "cal comments" VALUE 0x8F54 Scalar_UW 0.0 CM_kpa_0to256_1 0.0 255.99609375 /end CHARACTERISTIC
/begin CHARACTERISTIC C_BSTPControlEnable "cal comments" VALUE 0x8F4E Scalar_UB 0.0 CM_Count1 0.0 255.0 /end CHARACTERISTIC
/begin CHARACTERISTIC C_CLBSTPEnableDelay "cal comments" VALUE 0x8F4C Scalar_UW 0.0 CM_Second_0to1024 0.0 1023.984375 /end CHARACTERISTIC
/begin CHARACTERISTIC CT_BSTPDsrd "cal comments" MAP 0x8FB1 3D_Array_UB 0.0 CM_kpa_0_256_8bit 0.0 255
 /begin AXIS_DESCR COM_AXIS NO_INPUT_QUANTITY udf_CM_18705 21 0.0 511.9921875 AXIS_PTS_REF CA_GramStep21 MAX_GRAD 0.0 /end AXIS_DESCR
 /begin AXIS_DESCR COM_AXIS NO_INPUT_QUANTITY CM_RPM_0to16384 17 0.0 16383.75 AXIS_PTS_REF CA_EngSpd17Step1 MAX_GRAD 0.0 /end AXIS_DESCR
/end CHARACTERISTIC
/begin CHARACTERISTIC CT_BSTPDsrdMaxLimit "cal comments" MAP 0x9119 3D_Array_UB 0.0 CM_kpa_0_256_8bit 0.0 255
 /begin AXIS_DESCR FIX_AXIS NO_INPUT_QUANTITY CM_Equaloutput1 9 -28.0 36.0 MAX_GRAD 0.0 /begin FIX_AXIS_PAR_LIST -28 -20 -12 -4 4 12 20 28 36 /end FIX_AXIS_PAR_LIST /end AXIS_DESCR
 /begin AXIS_DESCR COM_AXIS NO_INPUT_QUANTITY CM_RPM_0to16384 17 0.0 16383.75 AXIS_PTS_REF CA_EngSpd17Step1 MAX_GRAD 0.0 /end AXIS_DESCR
/end CHARACTERISTIC
/begin CHARACTERISTIC CT_BSTPWithoutControl "cal comments" CURVE 0x8F98 2D_Array_UB 0 CM_kpa_0_256_8bit 0.0 255
 /begin AXIS_DESCR COM_AXIS NO_INPUT_QUANTITY CM_RPM_0to16384 17 0.0 16383.75 AXIS_PTS_REF CA_EngSpd17Step1 MAX_GRAD 0.0 /end AXIS_DESCR
/end CHARACTERISTIC
/begin CHARACTERISTIC CT_BSTPFactorIATCorr "cal comments" CURVE 0x91B4 2D_Array_UB 0.0 CM_Mult0_to_2_ratio 0.0 1.9921875
 /begin AXIS_DESCR FIX_AXIS NO_INPUT_QUANTITY CM_Equaloutput1 9 -28.0 36.0 MAX_GRAD 0.0 /begin FIX_AXIS_PAR_LIST -28 -20 -12 -4 4 12 20 28 36 /end FIX_AXIS_PAR_LIST /end AXIS_DESCR
/end CHARACTERISTIC
/begin CHARACTERISTIC C_IgnCoil_Prot_Current "cal comments" CURVE 0x8039 2D_Array_UB 0.0 CM_Count1 0.0 255.0
 /begin AXIS_DESCR FIX_AXIS NO_INPUT_QUANTITY CM_EOI 4 0.0 4.0 MAX_GRAD 0.0 /begin FIX_AXIS_PAR_LIST 0 1 2 3 /end FIX_AXIS_PAR_LIST /end AXIS_DESCR
/end CHARACTERISTIC
/begin CHARACTERISTIC C_IgnCoil_STG_Threhold "cal comments" CURVE 0x803D 2D_Array_UB 0.0 CM_Count1 0.0 255.0
 /begin AXIS_DESCR FIX_AXIS NO_INPUT_QUANTITY CM_EOI 4 0.0 4.0 MAX_GRAD 0.0 /begin FIX_AXIS_PAR_LIST 0 1 2 3 /end FIX_AXIS_PAR_LIST /end AXIS_DESCR
/end CHARACTERISTIC
/begin CHARACTERISTIC C_InjectorType "cal comments" CURVE 0x8041 2D_Array_UB 0.0 CM_Count1 0.0 255.0
 /begin AXIS_DESCR FIX_AXIS NO_INPUT_QUANTITY CM_EOI 4 0.0 4.0 MAX_GRAD 0.0 /begin FIX_AXIS_PAR_LIST 0 1 2 3 /end FIX_AXIS_PAR_LIST /end AXIS_DESCR
/end CHARACTERISTIC
/begin CHARACTERISTIC C_IGNOffDelayTime "cal comments" VALUE 0xB796 Scalar_UW 0.0 CM_Second_0to512 0.0 511.9921875 /end CHARACTERISTIC
/begin CHARACTERISTIC C_IGNOnDelay "cal comments" VALUE 0xB802 Scalar_UW 0.0 CM_Second_0to512 0.0 511.9921875 /end CHARACTERISTIC
/begin CHARACTERISTIC C_IGNOnDelayEngSpdThreshHi "cal comments" VALUE 0xB806 Scalar_UW 0.0 CM_RPM_0to16384 0.0 16383.75 /end CHARACTERISTIC
/begin CHARACTERISTIC C_IGNOnDelayEngSpdThreshLo "cal comments" VALUE 0xB804 Scalar_UW 0.0 CM_RPM_0to16384 0.0 16383.75 /end CHARACTERISTIC
/begin CHARACTERISTIC C_IGNOnVoltThreshHi "cal comments" VALUE 0xB792 Scalar_UW 0.0 CM_Volt_0to32_1 0.0 31.99900627136231 /end CHARACTERISTIC
/begin CHARACTERISTIC C_IGNOnVoltThreshLo "cal comments" VALUE 0xB794 Scalar_UW 0.0 CM_Volt_0to32_1 0.0 31.99900627136231 /end CHARACTERISTIC
/begin CHARACTERISTIC C_IGNVoltFiltCoef "cal comments" VALUE 0xB798 Scalar_UW 0.0 CM_FiltCoef 0.0 0.9999847412109375 /end CHARACTERISTIC
/begin CHARACTERISTIC C_InjectorFlow "cal comments" VALUE 0x9214 Scalar_UW 0.0 CM_GramPerSecond 0.0 15.999755859375 /end CHARACTERISTIC
/begin CHARACTERISTIC C_ValveFlow_NG "cal comments" VALUE 0x9216 Scalar_UW 0.0 CM_GramPerSecond 0.0 15.999755859375 /end CHARACTERISTIC
/begin CHARACTERISTIC C_ValveFlow_LPG "cal comments" VALUE 0x9218 Scalar_UW 0.0 CM_GramPerSecond 0.0 15.999755859375 /end CHARACTERISTIC
/begin CHARACTERISTIC C_IntakeAirTempDefault "cal comments" VALUE 0xB7FA Scalar_SW 0.0 CM_DegC_N256to256 -256.0 255.9921875 /end CHARACTERISTIC
/begin CHARACTERISTIC C_IntakeAirTempFiltCoef "cal comments" VALUE 0xB786 Scalar_UW 0.0 CM_FiltCoef 0.0 0.9999847412109375 /end CHARACTERISTIC
/begin CHARACTERISTIC C_EngineSpeedOffset "cal comments" VALUE 0xB81A Scalar_SW 0.0 CM_RPM_n8192to8192 -8192.0 8191.75 /end CHARACTERISTIC
/begin CHARACTERISTIC C_MAPCIDEnable "cal comments" VALUE 0xB338 Scalar_UB 0.0 CM_Boolean4 0.0 1.0 /end CHARACTERISTIC
/begin CHARACTERISTIC C_MAPCIDEngSpdErrorThresh "cal comments" VALUE 0xB7BA Scalar_SW 0.0 CM_RPM_n8192to8192 -8192.0 8191.75 /end CHARACTERISTIC
/begin CHARACTERISTIC C_MAPCIDEngSpdThreshHi "cal comments" VALUE 0xB7B6 Scalar_UW 0.0 CM_RPM_0to16384 0.0 16383.75 /end CHARACTERISTIC
/begin CHARACTERISTIC C_MAPCIDEngSpdThreshLo "cal comments" VALUE 0xB7B8 Scalar_UW 0.0 CM_RPM_0to16384 0.0 16383.75 /end CHARACTERISTIC
/begin CHARACTERISTIC C_MAPCIDMAPFiltCoef "cal comments" VALUE 0xB7C2 Scalar_UW 0.0 CM_FiltCoef 0.0 0.9999847412109375 /end CHARACTERISTIC
/begin CHARACTERISTIC C_MAPCIDMAPThresh "cal comments" VALUE 0xB7C0 Scalar_UW 0.0 CM_kpa_0to256_1 0.0 255.99609375 /end CHARACTERISTIC
/begin CHARACTERISTIC C_MAPCIDTPSDeltaThresh "cal comments" VALUE 0xB660 Scalar_SW 0.0 CM_Percent_N200to200 -199.9999847412109 199.9938812255859 /end CHARACTERISTIC
/begin CHARACTERISTIC C_MAPFiltCoef "cal comments" VALUE 0xB7E0 Scalar_UW 0.0 CM_FiltCoef 0.0 0.9999847412109375 /end CHARACTERISTIC
/begin CHARACTERISTIC C_MAPMaxLimit "cal comments" VALUE 0xB7C4 Scalar_UW 0.0 CM_kpa_0to256_1 0.0 255.99609375 /end CHARACTERISTIC
/begin CHARACTERISTIC C_MAPMinLimit "cal comments" VALUE 0xB7C6 Scalar_UW 0.0 CM_kpa_0to256_1 0.0 255.99609375 /end CHARACTERISTIC
/begin CHARACTERISTIC C_MAPReadingAngleMaxLimit "cal comments" VALUE 0xB7F2 Scalar_UW 0.0 CM_CrankAngle_0to1024 0.0 1023.984375 /end CHARACTERISTIC
/begin CHARACTERISTIC C_MAPReadingAngleMinLimit "cal comments" VALUE 0xB7F4 Scalar_UW 0.0 CM_CrankAngle_0to1024 0.0 1023.984375 /end CHARACTERISTIC
/begin CHARACTERISTIC C_MAPSignalConvIntercept "cal comments" VALUE 0xB79C Scalar_SW 0.0 CM_Ratio_n128to128 -128.0 127.99609375 /end CHARACTERISTIC
/begin CHARACTERISTIC C_MAPSignalConvSlope "cal comments" VALUE 0xB79A Scalar_UW 0.0 CM_kpa_0to512_1 0.0 511.9921875 /end CHARACTERISTIC
/begin CHARACTERISTIC C_FPSignalConvIntercept "cal comments" VALUE 0xC280 Scalar_SW 0.0 CM_Ratio_n128to128 -128.0 127.99609375 /end CHARACTERISTIC
/begin CHARACTERISTIC C_FPSignalConvSlope "cal comments" VALUE 0xC27E Scalar_UW 0.0 CM_kpa_0to512_1 0.0 511.9921875 /end CHARACTERISTIC
/begin CHARACTERISTIC CT_FPFiltCoef "cal comments" CURVE 0xC286 2D_Array_UW 0.0 CM_FiltCoef 0.0 0.9999847412109375
 /begin AXIS_DESCR FIX_AXIS NO_INPUT_QUANTITY CM_Equaloutput1 8 0 511.9921875 MAX_GRAD 0.0 /begin FIX_AXIS_PAR_LIST 0 10 20 30 40 50 60 70 /end FIX_AXIS_PAR_LIST /end AXIS_DESCR
/end CHARACTERISTIC
/begin CHARACTERISTIC C_BSTPSignalConvIntercept "cal comments" VALUE 0xC016 Scalar_SW 0.0 CM_Ratio_n128to128 -128.0 127.99609375 /end CHARACTERISTIC
/begin CHARACTERISTIC C_BSTPSignalConvSlope "cal comments" VALUE 0xC014 Scalar_UW 0.0 CM_kpa_0to512_1 0.0 511.9921875 /end CHARACTERISTIC
/begin CHARACTERISTIC C_BSTPFiltCoef "cal comments" VALUE 0xC018 Scalar_UW 0.0 CM_FiltCoef 0.0 0.9999847412109375 /end CHARACTERISTIC
/begin CHARACTERISTIC CT_BSTCDutyCycleBase "cal comments" MAP 0xC03E 3D_Array_UW 0.0 CM_Percent_0to200_2 0.0 199.9969024658203
 /begin AXIS_DESCR COM_AXIS NO_INPUT_QUANTITY CM_kpa_0to256_1 22 0.0 255.99609375 AXIS_PTS_REF CA_MAP22Step1 MAX_GRAD 0.0 /end AXIS_DESCR
 /begin AXIS_DESCR COM_AXIS NO_INPUT_QUANTITY CM_kpa_0to256_1 15 0.0 255.99609375 AXIS_PTS_REF CA_MAP15Step1 MAX_GRAD 0.0 /end AXIS_DESCR
/end CHARACTERISTIC
/begin CHARACTERISTIC C_BSTCPWMFrequency "cal comments" VALUE 0xC23C Scalar_UW 0.0 CM_Hz_0to16384 0.0 16383.75 /end CHARACTERISTIC
/begin CHARACTERISTIC C_WPSignalConvIntercept "cal comments" VALUE 0xC266 Scalar_SW 0.0 CM_Ratio_n8to8 -8.0 7.999755859375 /end CHARACTERISTIC
/begin CHARACTERISTIC C_WPSignalConvSlope "cal comments" VALUE 0xC264 Scalar_UW 0.0 CM_mpa_0to16_1 0.0 15.999755859375 /end CHARACTERISTIC
/begin CHARACTERISTIC C_WPFiltCoef "cal comments" VALUE 0xC268 Scalar_UW 0.0 CM_FiltCoef 0.0 0.9999847412109375 /end CHARACTERISTIC
/begin CHARACTERISTIC C_WPStartTrgTime "cal comments" VALUE 0xC270 Scalar_UW 0.0 CM_Seconds_1 0.0 2047.96875 /end CHARACTERISTIC
/begin CHARACTERISTIC C_WPStartTrgMin "cal comments" VALUE 0xC26C Scalar_UW 0.0 CM_mpa_0to16_1 0.0 15.999755859375 /end CHARACTERISTIC
/begin CHARACTERISTIC C_WPStartTrgMax "cal comments" VALUE 0xC26E Scalar_UW 0.0 CM_mpa_0to16_1 0.0 15.999755859375 /end CHARACTERISTIC
/begin CHARACTERISTIC C_WPAutoTrigEn "cal comments" VALUE 0xC26A Scalar_UB 0.0 CM_Boolean6 0.0 255.0 /end CHARACTERISTIC
/begin CHARACTERISTIC C_WPP_AMP_RESCALE "cal comments" VALUE 0xC272 Scalar_UW 0.0 CM_amp_0to512_1 0.0 511.9921875 /end CHARACTERISTIC
/begin CHARACTERISTIC C_WPPCurrThresh "cal comments" VALUE 0xC274 Scalar_UW 0.0 CM_amp_0to512_1 0.0 511.9921875 /end CHARACTERISTIC
/begin CHARACTERISTIC C_WPPCurrHyst "cal comments" VALUE 0xC276 Scalar_UW 0.0 CM_amp_0to512_1 0.0 511.9921875 /end CHARACTERISTIC
/begin CHARACTERISTIC C_WPP_NoWaterTime "cal comments" VALUE 0xC27C Scalar_UW 0.0 CM_Seconds_1 0.0 2047.96875 /end CHARACTERISTIC
/begin CHARACTERISTIC C_WPP_WakeupTime "cal comments" VALUE 0xC27A Scalar_UW 0.0 CM_Seconds_1 0.0 2047.96875 /end CHARACTERISTIC
/begin CHARACTERISTIC C_WPPCurrFiltCoef "cal comments" VALUE 0xC278 Scalar_UW 0.0 CM_FiltCoef 0.0 0.9999847412109375 /end CHARACTERISTIC
/begin CHARACTERISTIC C_MaxBatteryVoltForO2Heater "cal comments" VALUE 0x91E4 Scalar_UW 0.0 CM_Volt_0to32_1 0.0 31.99900627136231 /end CHARACTERISTIC
/begin CHARACTERISTIC C_MinRefPeriodUpdtMinEngSpd "cal comments" VALUE 0xB7AA Scalar_UW 0.0 CM_Second_0to512 0.0 511.9921875 /end CHARACTERISTIC
/begin CHARACTERISTIC C_NVMForceReset "cal comments" VALUE 0x91BD Scalar_UB 0.0 CM_Boolean2 0.0 1.0 /end CHARACTERISTIC
/begin CHARACTERISTIC C_O2ErrorMaxLimit "cal comments" VALUE 0x9AE4 Scalar_UW 0.0 CM_mVolt_1 0.0 1023.96875 /end CHARACTERISTIC
/begin CHARACTERISTIC C_O2FiltVoltInitValue "cal comments" VALUE 0x9A60 Scalar_UW 0.0 CM_mVolt_1 0.0 1023.96875 /end CHARACTERISTIC
/begin CHARACTERISTIC C_O2HeaterAccFuelMassUpdateTime "cal comments" VALUE 0x91E8 Scalar_UW 0.0 CM_Second_0to4096 0.0 4095.9375 /end CHARACTERISTIC
/begin CHARACTERISTIC C_O2HeaterCoolantTempThresh "cal comments" VALUE 0x91BE Scalar_SW 0.0 CM_DegC_N256to256 -256.0 255.9921875 /end CHARACTERISTIC
/begin CHARACTERISTIC C_O2HeaterDCNormFactor "cal comments" VALUE 0xB36E Scalar_UB 0.0 CM_Mult0_to_2_ratio 0.0 1.9921875 /end CHARACTERISTIC
/begin CHARACTERISTIC C_O2HeaterDCReducedEngSpdThrsh "cal comments" VALUE 0xB370 Scalar_UW 0.0 CM_RPM_0to16384 0.0 16383.75 /end CHARACTERISTIC
/begin CHARACTERISTIC C_O2HeaterDCReducedFactor "cal comments" VALUE 0xB36F Scalar_UB 0.0 CM_Mult0_to_2_ratio 0.0 1.9921875 /end CHARACTERISTIC
/begin CHARACTERISTIC C_O2HeaterDCReducedMAPThrsh "cal comments" VALUE 0xB372 Scalar_UW 0.0 CM_kpa_0to256_1 0.0 255.99609375 /end CHARACTERISTIC
/begin CHARACTERISTIC C_O2HeaterEnbKeyOnDelay "cal comments" VALUE 0x91EA Scalar_UW 0.0 CM_Second_0to4096 0.0 4095.9375 /end CHARACTERISTIC
/begin CHARACTERISTIC C_O2HeaterPWMFrequency "cal comments" VALUE 0xB36C Scalar_UW 0.0 CM_Hz_0to16384 0.0 16383.75 /end CHARACTERISTIC
/begin CHARACTERISTIC C_O2ReadyResetTimeThresh "cal comments" VALUE 0x9A56 Scalar_UW 0.0 CM_Second_0to1024 0.0 1023.984375 /end CHARACTERISTIC
/begin CHARACTERISTIC C_O2ReadyThresh "cal comments" VALUE 0x9A54 Scalar_UW 0.0 CM_mVolt_1 0.0 1023.96875 /end CHARACTERISTIC
/begin CHARACTERISTIC C_O2ReadyTimeThresh "cal comments" VALUE 0x9A58 Scalar_UW 0.0 CM_Second_0to1024 0.0 1023.984375 /end CHARACTERISTIC
/begin CHARACTERISTIC C_PEIdleWithAFROLEngSpdThresh "cal comments" VALUE 0x9BFC Scalar_UW 0.0 CM_RPM_0to16384 0.0 16383.75 /end CHARACTERISTIC
/begin CHARACTERISTIC C_PowerdownDelayTime "cal comments" VALUE 0xB78E Scalar_UW 0.0 CM_Second_0to512 0.0 511.9921875 /end CHARACTERISTIC
/begin CHARACTERISTIC C_PowerEnrichDsblTPSThrshHyst "cal comments" VALUE 0x9BFA Scalar_UW 0.0 CM_Percent_0to200_2 0.0 199.9969024658203 /end CHARACTERISTIC
/begin CHARACTERISTIC C_PrimePulseForceEnb "cal comments" VALUE 0x9834 Scalar_UB 0.0 CM_Boolean1 0.0 1.0 /end CHARACTERISTIC
/begin CHARACTERISTIC C_FuelPumpOffNoDelay "cal comments" VALUE 0x9835 Scalar_UB 0.0 CM_Boolean1 0.0 1.0 /end CHARACTERISTIC
/begin CHARACTERISTIC C_PrimeToSequentialFuelDelay "cal comments" VALUE 0x921A Scalar_UB 0.0 CM_Count1 0.0 255.0 /end CHARACTERISTIC
/begin CHARACTERISTIC C_ReferenceBaro "cal comments" VALUE 0xB6E4 Scalar_UW 0.0 CM_kpa_0to256_1 0.0 255.99609375 /end CHARACTERISTIC
/begin CHARACTERISTIC C_RunToCrankEngSpdThresh "cal comments" VALUE 0xB784 Scalar_UW 0.0 CM_RPM_0to16384 0.0 16383.75 /end CHARACTERISTIC
/begin CHARACTERISTIC C_SMTR_LowActive "cal comments" VALUE 0xA286 Scalar_UB 0.0 CM_Boolean6 0.0 255.0 /end CHARACTERISTIC
/begin CHARACTERISTIC C_SMTR_FaultStart_Forbid "cal comments" VALUE 0xA287 Scalar_UB 0.0 CM_Boolean6 0.0 255.0 /end CHARACTERISTIC
/begin CHARACTERISTIC C_SMTR_IGN_Start "cal comments" VALUE 0xA288 Scalar_UB 0.0 CM_Boolean6 0.0 255.0 /end CHARACTERISTIC
/begin CHARACTERISTIC C_SMTR_t_Duration "cal comments" VALUE 0xA28A Scalar_UW 0.0 CM_Seconds_1 0.0 2047.96875 /end CHARACTERISTIC
/begin CHARACTERISTIC C_SMTR_t_Interval "cal comments" VALUE 0xA28C Scalar_UW 0.0 CM_Seconds_1 0.0 2047.96875 /end CHARACTERISTIC
/begin CHARACTERISTIC C_SMTR_t_Button_Delay "cal comments" VALUE 0xA290 Scalar_UW 0.0 CM_Seconds_1 0.0 2047.96875 /end CHARACTERISTIC
/begin CHARACTERISTIC C_SMTR_c_Attempt "cal comments" VALUE 0xA28E Scalar_UB 0.0 CM_Count3 0.0 255.0 /end CHARACTERISTIC
/begin CHARACTERISTIC C_SMTR_DutyCycle "cal comments" VALUE 0xA292 Scalar_UW 0.0 CM_Percent_0to200_2 0.0 199.9969024658203 /end CHARACTERISTIC
/begin CHARACTERISTIC C_FUEL_STP_En "cal comments" VALUE 0xC24A Scalar_UB 0.0 CM_Boolean6 0.0 255.0 /end CHARACTERISTIC
/begin CHARACTERISTIC C_FUEL_STP_LowActive "cal comments" VALUE 0xC24B Scalar_UB 0.0 CM_Boolean6 0.0 255.0 /end CHARACTERISTIC
/begin CHARACTERISTIC CT_ETCMSprTPSHigh "cal comments" CURVE 0xA2AE 2D_Array_UB 0.0 CM_Percent_0to100 0.0 99.609375
 /begin AXIS_DESCR COM_AXIS NO_INPUT_QUANTITY CM_Percent_0to200_2 11 0.0 199.9969024658203 AXIS_PTS_REF CA_TPS11Step MAX_GRAD 0.0 /end AXIS_DESCR
/end CHARACTERISTIC
/begin CHARACTERISTIC CT_ETCMSprTPSLow "cal comments" CURVE 0xA2BB 2D_Array_UB 0.0 CM_Percent_0to100 0.0 99.609375
 /begin AXIS_DESCR COM_AXIS NO_INPUT_QUANTITY CM_Percent_0to200_2 11 0.0 199.9969024658203 AXIS_PTS_REF CA_TPS11Step MAX_GRAD 0.0 /end AXIS_DESCR
/end CHARACTERISTIC
/begin CHARACTERISTIC CT_ETCMPropTPSHigh "cal comments" CURVE 0xA2C8 2D_Array_UB 0.0 CM_Percent_0to100 0.0 99.609375
 /begin AXIS_DESCR COM_AXIS NO_INPUT_QUANTITY CM_Percent_0to200_2 11 0.0 199.9969024658203 AXIS_PTS_REF CA_TPS11Step MAX_GRAD 0.0 /end AXIS_DESCR
/end CHARACTERISTIC
/begin CHARACTERISTIC CT_ETCMPropTPSLow "cal comments" CURVE 0xA2D5 2D_Array_UB 0.0 CM_Percent_0to100 0.0 99.609375
 /begin AXIS_DESCR COM_AXIS NO_INPUT_QUANTITY CM_Percent_0to200_2 11 0.0 199.9969024658203 AXIS_PTS_REF CA_TPS11Step MAX_GRAD 0.0 /end AXIS_DESCR
/end CHARACTERISTIC
/begin CHARACTERISTIC CT_ETCMIntGainTPSHigh "cal comments" CURVE 0xA2E2 2D_Array_UB 0.0 CM_Mult0_to_2_ratio1 0.0 1.9921875
 /begin AXIS_DESCR COM_AXIS NO_INPUT_QUANTITY CM_Percent_0to200_2 11 0.0 199.9969024658203 AXIS_PTS_REF CA_TPS11Step MAX_GRAD 0.0 /end AXIS_DESCR
/end CHARACTERISTIC
/begin CHARACTERISTIC CT_ETCMIntGainTPSLow "cal comments" CURVE 0xA2EF 2D_Array_UB 0.0 CM_Mult0_to_2_ratio1 0.0 1.9921875
 /begin AXIS_DESCR COM_AXIS NO_INPUT_QUANTITY CM_Percent_0to200_2 11 0.0 199.9969024658203 AXIS_PTS_REF CA_TPS11Step MAX_GRAD 0.0 /end AXIS_DESCR
/end CHARACTERISTIC
/begin CHARACTERISTIC CT_ETCM_LTermOpenMax "cal comments" CURVE 0xA2FC 2D_Array_UB 0.0 CM_Percent_0to200_3 0.0 199.21875
 /begin AXIS_DESCR FIX_AXIS NO_INPUT_QUANTITY CM_Equaloutput1 9 6.400000095367432 19.20000076293945 MAX_GRAD 0.0 /begin FIX_AXIS_PAR_LIST 6.4 8 9.6 11.2 12.8 14.4 16 17.6 19.2 /end FIX_AXIS_PAR_LIST /end AXIS_DESCR
/end CHARACTERISTIC
/begin CHARACTERISTIC CT_ETCM_LTermCloseMax "cal comments" CURVE 0xA307 2D_Array_UB 0.0 CM_Percent_0to200_3 0.0 199.21875
 /begin AXIS_DESCR FIX_AXIS NO_INPUT_QUANTITY CM_Equaloutput1 9 6.400000095367432 19.20000076293945 MAX_GRAD 0.0 /begin FIX_AXIS_PAR_LIST 6.4 8 9.6 11.2 12.8 14.4 16 17.6 19.2 /end FIX_AXIS_PAR_LIST /end AXIS_DESCR
/end CHARACTERISTIC
/begin CHARACTERISTIC C_ETCM_AntiFrictClsPulse "cal comments" VALUE 0xA310 Scalar_UW 0.0 CM_Percent_0to200_2 0.0 199.9969024658203 /end CHARACTERISTIC
/begin CHARACTERISTIC C_ETCM_AntiFrictOpnPulse "cal comments" VALUE 0xA312 Scalar_UW 0.0 CM_Percent_0to200_2 0.0 199.9969024658203 /end CHARACTERISTIC
/begin CHARACTERISTIC C_DC_ETCM_OpeningMax "cal comments" VALUE 0xA31A Scalar_UW 0.0 CM_Percent_0to200_2 0.0 199.9969024658203 /end CHARACTERISTIC
/begin CHARACTERISTIC C_DC_ETCM_ClosingMax "cal comments" VALUE 0xA31C Scalar_UW 0.0 CM_Percent_0to200_2 0.0 199.9969024658203 /end CHARACTERISTIC
/begin CHARACTERISTIC C_ETCM_AboveLTDCTime "cal comments" VALUE 0xA31E Scalar_UW 0.0 CM_Second_0to512 0.0 511.9921875 /end CHARACTERISTIC
/begin CHARACTERISTIC C_ETCM_ClipLTDCTime "cal comments" VALUE 0xA320 Scalar_UW 0.0 CM_Second_0to512 0.0 511.9921875 /end CHARACTERISTIC
/begin CHARACTERISTIC C_ETCMSprTPSDeadBand "cal comments" VALUE 0xA324 Scalar_UW 0.0 CM_Percent_0to200_2 0.0 199.9969024658203 /end CHARACTERISTIC
/begin CHARACTERISTIC C_ETCMPropTPSHiDeadBand "cal comments" VALUE 0xA326 Scalar_UW 0.0 CM_Percent_0to200_2 0.0 199.9969024658203 /end CHARACTERISTIC
/begin CHARACTERISTIC C_ETCMPropTPSLoDeadBand "cal comments" VALUE 0xA328 Scalar_UW 0.0 CM_Percent_0to200_2 0.0 199.9969024658203 /end CHARACTERISTIC
/begin CHARACTERISTIC C_ETCMIntTPSDeadBand "cal comments" VALUE 0xA32A Scalar_UW 0.0 CM_Percent_0to200_2 0.0 199.9969024658203 /end CHARACTERISTIC
/begin CHARACTERISTIC C_ETCMIntTPSDltRange "cal comments" VALUE 0xA32C Scalar_UW 0.0 CM_Percent_0to200_2 0.0 199.9969024658203 /end CHARACTERISTIC
/begin CHARACTERISTIC C_ETCM_IntegralNegLimit "cal comments" VALUE 0xA32E Scalar_SW 0.0 CM_Percent_N200to200 -199.9999847412109 199.9938812255859 /end CHARACTERISTIC
/begin CHARACTERISTIC C_ETCM_IntegralPosLimit "cal comments" VALUE 0xA330 Scalar_SW 0.0 CM_Percent_N200to200 -199.9999847412109 199.9938812255859 /end CHARACTERISTIC
/begin CHARACTERISTIC C_ETCM_SteeringDCmin "cal comments" VALUE 0xA332 Scalar_SW 0.0 CM_Percent_N200to200 -199.9999847412109 199.9938812255859 /end CHARACTERISTIC
/begin CHARACTERISTIC C_ETCM_SteeringDCmax "cal comments" VALUE 0xA334 Scalar_SW 0.0 CM_Percent_N200to200 -199.9999847412109 199.9938812255859 /end CHARACTERISTIC
/begin CHARACTERISTIC C_ETCM_UsedForSteering "cal comments" VALUE 0xA314 Scalar_UB 0.0 CM_Boolean6 0.0 255.0 /end CHARACTERISTIC
/begin CHARACTERISTIC C_ETCM_DirLogic "cal comments" VALUE 0xA315 Scalar_UB 0.0 CM_Boolean6 0.0 255.0 /end CHARACTERISTIC
/begin CHARACTERISTIC C_ETCMMotorHiEn "cal comments" VALUE 0xA316 Scalar_UB 0.0 CM_Boolean6 0.0 255.0 /end CHARACTERISTIC
/begin CHARACTERISTIC C_ETCM_Frequency "cal comments" VALUE 0xA322 Scalar_UW 0.0 CM_Hz_0to16384 0.0 16383.75 /end CHARACTERISTIC
/begin CHARACTERISTIC C_ETCM_IGNRef "cal comments" VALUE 0xA318 Scalar_UW 0.0 CM_Volt_0to32_1 0.0 31.99900627136231 /end CHARACTERISTIC
/begin CHARACTERISTIC C_U_GEN_VOLT_RESCALE "cal comments" VALUE 0x0 Scalar_UW 0.0 CM_Volt_0to1024_1 0.0 1023.984375 /end CHARACTERISTIC
/begin CHARACTERISTIC C_GENVFiltCoef "cal comments" VALUE 0x0 Scalar_UW 0.0 CM_FiltCoef 0.0 0.9999847412109375 /end CHARACTERISTIC
/begin CHARACTERISTIC C_GENVDesired "cal comments" VALUE 0x0 Scalar_UW 0.0 CM_Volt_0to1024_1 0.0 1023.984375 /end CHARACTERISTIC
/begin CHARACTERISTIC C_GENVPropVOLTHiDeadBand "cal comments" VALUE 0x0 Scalar_UW 0.0 CM_Volt_0to1024_1 0.0 1023.984375 /end CHARACTERISTIC
/begin CHARACTERISTIC C_GENVPropVOLTLoDeadBand "cal comments" VALUE 0x0 Scalar_UW 0.0 CM_Volt_0to1024_1 0.0 1023.984375 /end CHARACTERISTIC
/begin CHARACTERISTIC C_GENVIntVOLTDeadBand "cal comments" VALUE 0x0 Scalar_UW 0.0 CM_Volt_0to1024_1 0.0 1023.984375 /end CHARACTERISTIC
/begin CHARACTERISTIC C_GENVIntVOLTDltRange "cal comments" VALUE 0x0 Scalar_UW 0.0 CM_Volt_0to1024_1 0.0 1023.984375 /end CHARACTERISTIC
/begin CHARACTERISTIC CT_GENVPropVOLTHigh "cal comments" CURVE 0x2 2D_Array_UB 0.0 CM_Percent_0to100 0.0 99.609375
 /begin AXIS_DESCR COM_AXIS NO_INPUT_QUANTITY CM_Volt_0to1024_1 11 0.0 1023.984375 AXIS_PTS_REF CA_GENV11Step MAX_GRAD 0.0 /end AXIS_DESCR
/end CHARACTERISTIC
/begin CHARACTERISTIC CT_GENVPropVOLTLow "cal comments" CURVE 0x2 2D_Array_UB 0.0 CM_Percent_0to100 0.0 99.609375
 /begin AXIS_DESCR COM_AXIS NO_INPUT_QUANTITY CM_Volt_0to1024_1 11 0.0 1023.984375 AXIS_PTS_REF CA_GENV11Step MAX_GRAD 0.0 /end AXIS_DESCR
/end CHARACTERISTIC
/begin CHARACTERISTIC CT_GENVIntGainVOLTHigh "cal comments" CURVE 0x2 2D_Array_UB 0.0 CM_Mult0_to_2_ratio1 0.0 1.9921875
 /begin AXIS_DESCR COM_AXIS NO_INPUT_QUANTITY CM_Volt_0to1024_1 11 0.0 1023.984375 AXIS_PTS_REF CA_GENV11Step MAX_GRAD 0.0 /end AXIS_DESCR
/end CHARACTERISTIC
/begin CHARACTERISTIC CT_GENVIntGainVOLTLow "cal comments" CURVE 0x2 2D_Array_UB 0.0 CM_Mult0_to_2_ratio1 0.0 1.9921875
 /begin AXIS_DESCR COM_AXIS NO_INPUT_QUANTITY CM_Volt_0to1024_1 11 0.0 1023.984375 AXIS_PTS_REF CA_GENV11Step MAX_GRAD 0.0 /end AXIS_DESCR
/end CHARACTERISTIC
/begin CHARACTERISTIC C_GENV_DutyCycle "cal comments" VALUE 0x0 Scalar_UW 0.0 CM_Percent_0to200_2 0.0 199.9969024658203 /end CHARACTERISTIC
/begin CHARACTERISTIC C_GENV_Out_Enbl_Thrsh "cal comments" VALUE 0x0 Scalar_UW 0.0 CM_RPM_0to16384 0.0 16383.75 /end CHARACTERISTIC
/begin CHARACTERISTIC C_GENV_Out_Dsbl_Thrsh "cal comments" VALUE 0x0 Scalar_UW 0.0 CM_RPM_0to16384 0.0 16383.75 /end CHARACTERISTIC
/begin CHARACTERISTIC C_WPGOVDesired "cal comments" VALUE 0x0 Scalar_UW 0.0 CM_mpa_0to16_1 0.0 15.999755859375 /end CHARACTERISTIC
/begin CHARACTERISTIC C_WPGOVPropHiDeadBand "cal comments" VALUE 0x0 Scalar_UW 0.0 CM_mpa_0to16_1 0.0 15.999755859375 /end CHARACTERISTIC
/begin CHARACTERISTIC C_WPGOVPropLoDeadBand "cal comments" VALUE 0x0 Scalar_UW 0.0 CM_mpa_0to16_1 0.0 15.999755859375 /end CHARACTERISTIC
/begin CHARACTERISTIC C_WPGOVIntDeadBand "cal comments" VALUE 0x0 Scalar_UW 0.0 CM_mpa_0to16_1 0.0 15.999755859375 /end CHARACTERISTIC
/begin CHARACTERISTIC C_WPGOVIntDltRange "cal comments" VALUE 0x0 Scalar_UW 0.0 CM_mpa_0to16_1 0.0 15.999755859375 /end CHARACTERISTIC
/begin CHARACTERISTIC CT_WPGOVPropHigh "cal comments" CURVE 0x2 2D_Array_UB 0.0 CM_Percent_0to100 0.0 99.609375
 /begin AXIS_DESCR COM_AXIS NO_INPUT_QUANTITY CM_mpa_0to16_1 9 0.0 15.999755859375 AXIS_PTS_REF CA_WPGOV9Step MAX_GRAD 0.0 /end AXIS_DESCR
/end CHARACTERISTIC
/begin CHARACTERISTIC CT_WPGOVPropLow "cal comments" CURVE 0x2 2D_Array_UB 0.0 CM_Percent_0to100 0.0 99.609375
 /begin AXIS_DESCR COM_AXIS NO_INPUT_QUANTITY CM_mpa_0to16_1 9 0.0 15.999755859375 AXIS_PTS_REF CA_WPGOV9Step MAX_GRAD 0.0 /end AXIS_DESCR
/end CHARACTERISTIC
/begin CHARACTERISTIC CT_WPGOVIntGainHigh "cal comments" CURVE 0x2 2D_Array_UB 0.0 CM_Mult0_to_2_ratio1 0.0 1.9921875
 /begin AXIS_DESCR COM_AXIS NO_INPUT_QUANTITY CM_mpa_0to16_1 9 0.0 15.999755859375 AXIS_PTS_REF CA_WPGOV9Step MAX_GRAD 0.0 /end AXIS_DESCR
/end CHARACTERISTIC
/begin CHARACTERISTIC CT_WPGOVIntGainLow "cal comments" CURVE 0x2 2D_Array_UB 0.0 CM_Mult0_to_2_ratio1 0.0 1.9921875
 /begin AXIS_DESCR COM_AXIS NO_INPUT_QUANTITY CM_mpa_0to16_1 9 0.0 15.999755859375 AXIS_PTS_REF CA_WPGOV9Step MAX_GRAD 0.0 /end AXIS_DESCR
/end CHARACTERISTIC
/begin CHARACTERISTIC C_WPGOV_CL_EnTime "cal comments" VALUE 0x0 Scalar_UW 0.0 CM_Seconds_1 0.0 2047.96875 /end CHARACTERISTIC
/begin CHARACTERISTIC C_WPGOV_CL_DisTime "cal comments" VALUE 0x0 Scalar_UW 0.0 CM_Seconds_1 0.0 2047.96875 /end CHARACTERISTIC
/begin CHARACTERISTIC C_WPGOV_CL_EnThresh "cal comments" VALUE 0x0 Scalar_UW 0.0 CM_mpa_0to16_1 0.0 15.999755859375 /end CHARACTERISTIC
/begin CHARACTERISTIC C_WPGOV_CL_DisThresh "cal comments" VALUE 0x0 Scalar_UW 0.0 CM_mpa_0to16_1 0.0 15.999755859375 /end CHARACTERISTIC
/begin CHARACTERISTIC C_SMTR_n_Rotate_Dsbl_Thrsh "cal comments" VALUE 0xA282 Scalar_UW 0.0 CM_RPM_0to16384 0.0 16383.75 /end CHARACTERISTIC
/begin CHARACTERISTIC C_SMTR_n_Rotate_Enbl_Thrsh "cal comments" VALUE 0xA284 Scalar_UW 0.0 CM_RPM_0to16384 0.0 16383.75 /end CHARACTERISTIC
/begin CHARACTERISTIC C_SACrankExitRampInterval "cal comments" VALUE 0xA34A Scalar_UW 0.0 CM_Second_0to1024 0.0 1023.984375 /end CHARACTERISTIC
/begin CHARACTERISTIC C_SACrankExitRampStep "cal comments" VALUE 0xA350 Scalar_SW 0.0 CM_SparkAngle_N256to256 -256.0 255.9921875 /end CHARACTERISTIC
/begin CHARACTERISTIC C_SANormalRampDownStep "cal comments" VALUE 0xA34C Scalar_SW 0.0 CM_SparkAngle_N256to256 -256.0 255.9921875 /end CHARACTERISTIC
/begin CHARACTERISTIC C_SANormalRampUpStep "cal comments" VALUE 0xA34E Scalar_SW 0.0 CM_SparkAngle_N256to256 -256.0 255.9921875 /end CHARACTERISTIC
/begin CHARACTERISTIC C_SparkAdvanceMaxLimit "cal comments" VALUE 0xA336 Scalar_SW 0.0 CM_SparkAngle_N256to256 -256.0 255.9921875 /end CHARACTERISTIC
/begin CHARACTERISTIC C_SparkAdvanceMinLimit "cal comments" VALUE 0xA338 Scalar_SW 0.0 CM_SparkAngle_N256to256 -256.0 255.9921875 /end CHARACTERISTIC
/begin CHARACTERISTIC C_SPRK_phi_DFCO "cal comments" VALUE 0xA33A Scalar_SW 0.0 CM_SparkAngle_N256to256 -256.0 255.9921875 /end CHARACTERISTIC
/begin CHARACTERISTIC C_SparkDeliverModeAfterCID "cal comments" VALUE 0xB7BC Scalar_UB 0.0 CM_Boolean4 0.0 1.0 /end CHARACTERISTIC
/begin CHARACTERISTIC C_SparkDwellIATMultRumTimeThrsh "cal comments" VALUE 0xAFCA Scalar_UW 0.0 CM_Second_0to65535 0.0 65535.0 /end CHARACTERISTIC
/begin CHARACTERISTIC C_SPRK_DFCO_ExitDuration "cal comments" VALUE 0xA33E Scalar_UW 0.0 CM_Second_0to1024 0.0 1023.984375 /end CHARACTERISTIC
/begin CHARACTERISTIC C_SPRK_DFCO_EntryDuration "cal comments" VALUE 0xA340 Scalar_UW 0.0 CM_Second_0to1024 0.0 1023.984375 /end CHARACTERISTIC
/begin CHARACTERISTIC C_SPRK_IDLE_ExitDuration "cal comments" VALUE 0xA346 Scalar_UW 0.0 CM_Second_0to1024 0.0 1023.984375 /end CHARACTERISTIC
/begin CHARACTERISTIC C_SPRK_IDLE_EntryDuration "cal comments" VALUE 0xA348 Scalar_UW 0.0 CM_Second_0to1024 0.0 1023.984375 /end CHARACTERISTIC
/begin CHARACTERISTIC C_SPRK_IDLE_EntryStep "cal comments" VALUE 0xA342 Scalar_SW 0.0 CM_SparkAngle_N256to256 -256.0 255.9921875 /end CHARACTERISTIC
/begin CHARACTERISTIC C_SPRK_DFCOEntryStep "cal comments" VALUE 0xA344 Scalar_SW 0.0 CM_SparkAngle_N256to256 -256.0 255.9921875 /end CHARACTERISTIC
/begin CHARACTERISTIC CT_SPRK_DFCOExitStepTPS "cal comments" CURVE 0xAFCE 2D_Array_SB 0.0 CM_Angle_8bit -64.0 63.5
 /begin AXIS_DESCR FIX_AXIS NO_INPUT_QUANTITY CM_Equaloutput1 17 0.0 100.0 MAX_GRAD 0.0
  /begin FIX_AXIS_PAR_LIST 0.0 6.25 12.5 18.75 25.0 31.25 37.5 43.75 50.0 56.25 62.5 68.75 75.0 81.25 87.5 93.75 100.0 /end FIX_AXIS_PAR_LIST
 /end AXIS_DESCR
/end CHARACTERISTIC
/begin CHARACTERISTIC CT_SPRK_IDLEExitStepTPS "cal comments" CURVE 0xAFE1 2D_Array_SB 0.0 CM_Angle_8bit -64.0 63.5
 /begin AXIS_DESCR FIX_AXIS NO_INPUT_QUANTITY CM_Equaloutput1 17 0.0 100.0 MAX_GRAD 0.0
  /begin FIX_AXIS_PAR_LIST 0.0 6.25 12.5 18.75 25.0 31.25 37.5 43.75 50.0 56.25 62.5 68.75 75.0 81.25 87.5 93.75 100.0 /end FIX_AXIS_PAR_LIST
 /end AXIS_DESCR
/end CHARACTERISTIC
/begin CHARACTERISTIC C_IGNOff_Through_Spark "cal comments" VALUE 0xAFF2 Scalar_UB 0.0 CM_Boolean1 0.0 1.0 /end CHARACTERISTIC
/begin CHARACTERISTIC C_SparkDwellCorrByCooltant "cal comments" VALUE 0xAFC9 Scalar_UB 0.0 CM_Boolean1 0.0 1.0 /end CHARACTERISTIC
/begin CHARACTERISTIC C_SAGovCntrlEn "cal comments" VALUE 0xB330 Scalar_UB 0.0 CM_Boolean1 0.0 1.0 /end CHARACTERISTIC
/begin CHARACTERISTIC C_SAGovDerivRampInterval "cal comments" VALUE 0xB332 Scalar_UW 0.0 CM_Second_0to1024 0.0 1023.984375 /end CHARACTERISTIC
/begin CHARACTERISTIC C_SAGovDerivRampUpStep "cal comments" VALUE 0xB334 Scalar_UW 0.0 CM_Percent_0to200_2 0.0 199.9969024658203 /end CHARACTERISTIC
/begin CHARACTERISTIC C_SAGovDerivRampDwnStep "cal comments" VALUE 0xB336 Scalar_UW 0.0 CM_Percent_0to200_2 0.0 199.9969024658203 /end CHARACTERISTIC
/begin CHARACTERISTIC C_SAGovPropDeadBand "cal comments" VALUE 0xB09A Scalar_UW 0.0 CM_RPM_0to16384 0.0 16383.75 /end CHARACTERISTIC
/begin CHARACTERISTIC C_SAGovAngleCntrlRange "cal comments" VALUE 0xB09C Scalar_SW 0.0 CM_SparkAngle_N256to256 -256.0 255.9921875 /end CHARACTERISTIC
/begin CHARACTERISTIC CT_SAGovMaxLimit_NG "cal comments" MAP 0xB0C9 D_Array_SB 0.0 CM_Angle_8bit -64.0 63.5
 /begin AXIS_DESCR COM_AXIS NO_INPUT_QUANTITY CM_kpa_0to256_1 18 0.0 255.99609375 AXIS_PTS_REF CA_MAP18Step1 MAX_GRAD 0.0 /end AXIS_DESCR
 /begin AXIS_DESCR COM_AXIS NO_INPUT_QUANTITY CM_RPM_0to16384 17 0.0 16383.75 AXIS_PTS_REF CA_EngSpd17Step1 MAX_GRAD 0.0 /end AXIS_DESCR
/end CHARACTERISTIC
/begin CHARACTERISTIC CT_SAGovMaxLimit_LPG "cal comments" MAP 0xB1FE D_Array_SB 0.0 CM_Angle_8bit -64.0 63.5
 /begin AXIS_DESCR COM_AXIS NO_INPUT_QUANTITY CM_kpa_0to256_1 18 0.0 255.99609375 AXIS_PTS_REF CA_MAP18Step1 MAX_GRAD 0.0 /end AXIS_DESCR
 /begin AXIS_DESCR COM_AXIS NO_INPUT_QUANTITY CM_RPM_0to16384 17 0.0 16383.75 AXIS_PTS_REF CA_EngSpd17Step1 MAX_GRAD 0.0 /end AXIS_DESCR
/end CHARACTERISTIC
/begin CHARACTERISTIC CT_SAGovMinLimit_NG "cal comments" CURVE 0xB0A0 2D_Array_SB 0.0 CM_Angle_8bit -64.0 63.5
 /begin AXIS_DESCR COM_AXIS NO_INPUT_QUANTITY CM_kpa_0to256_1 18 0.0 255.99609375 AXIS_PTS_REF CA_MAP18Step1 MAX_GRAD 0.0 /end AXIS_DESCR
/end CHARACTERISTIC
/begin CHARACTERISTIC CT_SAGovMinLimit_LPG "cal comments" CURVE 0xB0B4 2D_Array_SB 0.0 CM_Angle_8bit -64.0 63.5
 /begin AXIS_DESCR COM_AXIS NO_INPUT_QUANTITY CM_kpa_0to256_1 18 0.0 255.99609375 AXIS_PTS_REF CA_MAP18Step1 MAX_GRAD 0.0 /end AXIS_DESCR
/end CHARACTERISTIC
/begin CHARACTERISTIC CT_SAGovPropHigh "cal comments" CURVE 0xB05E 2D_Array_UB 0.0 CM_Percent_0to100 0.0 99.609375
 /begin AXIS_DESCR COM_AXIS NO_INPUT_QUANTITY CM_RPM_0to16384 17 0.0 16383.75 AXIS_PTS_REF CA_EngSpd11Step1 MAX_GRAD 0.0 /end AXIS_DESCR
/end CHARACTERISTIC
/begin CHARACTERISTIC CT_SAGovPropLow "cal comments" CURVE 0xB06B 2D_Array_UB 0.0 CM_Percent_0to100 0.0 99.609375
 /begin AXIS_DESCR COM_AXIS NO_INPUT_QUANTITY CM_RPM_0to16384 17 0.0 16383.75 AXIS_PTS_REF CA_EngSpd11Step1 MAX_GRAD 0.0 /end AXIS_DESCR
/end CHARACTERISTIC
/begin CHARACTERISTIC CT_SAGovDerivHigh "cal comments" CURVE 0xB078 2D_Array_UB 0.0 CM_Percent_0to100 0.0 99.609375
 /begin AXIS_DESCR COM_AXIS NO_INPUT_QUANTITY CM_RPM_0to16384 17 0.0 16383.75 AXIS_PTS_REF CA_EngSpd11Step4 MAX_GRAD 0.0 /end AXIS_DESCR
/end CHARACTERISTIC
/begin CHARACTERISTIC CT_SAGovDerivLow "cal comments" CURVE 0xB085 2D_Array_UB 0.0 CM_Percent_0to100 0.0 99.609375
 /begin AXIS_DESCR COM_AXIS NO_INPUT_QUANTITY CM_RPM_0to16384 17 0.0 16383.75 AXIS_PTS_REF CA_EngSpd11Step4 MAX_GRAD 0.0 /end AXIS_DESCR
/end CHARACTERISTIC
/begin CHARACTERISTIC C_SAGovDerivInterval "cal comments" VALUE 0xB090 Scalar_UB 0.0 CM_Count4 0.0 255.0 /end CHARACTERISTIC
/begin CHARACTERISTIC C_SAGovDerivHiDeadBand "cal comments" VALUE 0xB092 Scalar_UW 0.0 CM_RPM_0to16384 0.0 16383.75 /end CHARACTERISTIC
/begin CHARACTERISTIC C_SAGovDerivLoDeadBand "cal comments" VALUE 0xB094 Scalar_UW 0.0 CM_RPM_0to16384 0.0 16383.75 /end CHARACTERISTIC
/begin CHARACTERISTIC C_SAGovDerivUpDeltaDeadBand "cal comments" VALUE 0xB096 Scalar_UW 0.0 CM_RPM_0to16384 0.0 16383.75 /end CHARACTERISTIC
/begin CHARACTERISTIC C_SAGovDerivDwnDeltaDeadBand "cal comments" VALUE 0xB098 Scalar_UW 0.0 CM_RPM_0to16384 0.0 16383.75 /end CHARACTERISTIC
/begin CHARACTERISTIC CT_SparkAngle1TableAllocate "cal comments" CURVE 0xAFF3 2D_Array_UB 0.0 CM_Count1 0.0 255.0
 /begin AXIS_DESCR FIX_AXIS NO_INPUT_QUANTITY CM_FUEL_TYPE 3 0.0 3.0 MAX_GRAD 0.0 /begin FIX_AXIS_PAR_LIST 0 1 2 /end FIX_AXIS_PAR_LIST /end AXIS_DESCR
/end CHARACTERISTIC
/begin CHARACTERISTIC CT_SparkAngle2TableAllocate "cal comments" CURVE 0xAFF6 2D_Array_UB 0.0 CM_Count1 0.0 255.0
 /begin AXIS_DESCR FIX_AXIS NO_INPUT_QUANTITY CM_FUEL_TYPE 3 0.0 3.0 MAX_GRAD 0.0 /begin FIX_AXIS_PAR_LIST 0 1 2 /end FIX_AXIS_PAR_LIST /end AXIS_DESCR
/end CHARACTERISTIC
/begin CHARACTERISTIC C_SparkPowerOffDwell "cal comments" VALUE 0xAFB2 Scalar_UW 0.0 CM_msec_0to1024 0.0 1023.984375 /end CHARACTERISTIC
/begin CHARACTERISTIC C_SpdCntrlDerivInterval "cal comments" VALUE 0x9F41 Scalar_UB 0.0 CM_Count4 0.0 255.0 /end CHARACTERISTIC
/begin CHARACTERISTIC C_SpdCntrlDerivInterval2 "cal comments" VALUE 0x9F42 Scalar_UB 0.0 CM_Count4 0.0 255.0 /end CHARACTERISTIC
/begin CHARACTERISTIC C_TPSNoMoveAsEngineKilledEn "cal comments" VALUE 0x9EA6 Scalar_UB 0.0 CM_Count1 0.0 255.0 /end CHARACTERISTIC
/begin CHARACTERISTIC C_SpeedControlEnable "cal comments" VALUE 0x9EA7 Scalar_UB 0.0 CM_Count1 0.0 255.0 /end CHARACTERISTIC
/begin CHARACTERISTIC C_SpeedControlIntDerivLearnning "cal comments" VALUE 0x9EA9 Scalar_UB 0.0 CM_Boolean6 0.0 255.0 /end CHARACTERISTIC
/begin CHARACTERISTIC C_SpeedControlDerivEnhanced "cal comments" VALUE 0x9EAA Scalar_UB 0.0 CM_Boolean6 0.0 255.0 /end CHARACTERISTIC
/begin CHARACTERISTIC C_SpeedControlLvl0 "cal comments" VALUE 0x9E98 Scalar_UW 0.0 CM_Percent_0to100_1 0.0 99.9984130859375 /end CHARACTERISTIC
/begin CHARACTERISTIC C_SpeedControlLvl1 "cal comments" VALUE 0x9E9A Scalar_UW 0.0 CM_Percent_0to100_1 0.0 99.9984130859375 /end CHARACTERISTIC
/begin CHARACTERISTIC C_SpeedControlLvl2 "cal comments" VALUE 0x9E9C Scalar_UW 0.0 CM_Percent_0to100_1 0.0 99.9984130859375 /end CHARACTERISTIC
/begin CHARACTERISTIC C_SpeedControlLvl3 "cal comments" VALUE 0x9E9E Scalar_UW 0.0 CM_Percent_0to100_1 0.0 99.9984130859375 /end CHARACTERISTIC
/begin CHARACTERISTIC C_SpeedControlLvl4 "cal comments" VALUE 0x9EA0 Scalar_UW 0.0 CM_Percent_0to100_1 0.0 99.9984130859375 /end CHARACTERISTIC
/begin CHARACTERISTIC C_SpeedControlLvl5 "cal comments" VALUE 0x9EA2 Scalar_UW 0.0 CM_Percent_0to100_1 0.0 99.9984130859375 /end CHARACTERISTIC
/begin CHARACTERISTIC C_IDLEMotorDirChangeDelay "cal comments" VALUE 0xB8D6 Scalar_UB 0.0 CM_Count4 0.0 255.0 /end CHARACTERISTIC
/begin CHARACTERISTIC C_IDLEMotorStartDelay "cal comments" VALUE 0xB8D4 Scalar_UB 0.0 CM_Count4 0.0 255.0 /end CHARACTERISTIC
/begin CHARACTERISTIC C_IDLEMotorStartDelaySteps "cal comments" VALUE 0xB8D5 Scalar_UB 0.0 CM_Count4 0.0 255.0 /end CHARACTERISTIC
/begin CHARACTERISTIC C_IDLEStepMotorHiEn "cal comments" VALUE 0xB8D7 Scalar_UB 0.0 CM_Boolean6 0.0 255.0 /end CHARACTERISTIC
/begin CHARACTERISTIC C_IDLEStepMotorDir "cal comments" VALUE 0xB8D8 Scalar_UB 0.0 CM_Boolean6 0.0 255.0 /end CHARACTERISTIC
/begin CHARACTERISTIC C_FCVMoveBatVoltMaxLimit "cal comments" VALUE 0xB8E2 Scalar_UW 0.0 CM_Volt_0to32_1 0.0 31.99900627136231 /end CHARACTERISTIC
/begin CHARACTERISTIC C_FCVMoveBatVoltMinLimit "cal comments" VALUE 0xB8E4 Scalar_UW 0.0 CM_Volt_0to32_1 0.0 31.99900627136231 /end CHARACTERISTIC
/begin CHARACTERISTIC C_FCVMotorDirChangeDelay "cal comments" VALUE 0xB8E8 Scalar_UB 0.0 CM_Count4 0.0 255.0 /end CHARACTERISTIC
/begin CHARACTERISTIC C_FCVMotorStartDelay "cal comments" VALUE 0xB8E6 Scalar_UB 0.0 CM_Count4 0.0 255.0 /end CHARACTERISTIC
/begin CHARACTERISTIC C_FCVMotorStartDelaySteps "cal comments" VALUE 0xB8E7 Scalar_UB 0.0 CM_Count4 0.0 255.0 /end CHARACTERISTIC
/begin CHARACTERISTIC C_FCVStepMotorHiEn "cal comments" VALUE 0xB8E9 Scalar_UB 0.0 CM_Boolean6 0.0 255.0 /end CHARACTERISTIC
/begin CHARACTERISTIC C_FCVStepMotorDir "cal comments" VALUE 0xB8EA Scalar_UB 0.0 CM_Boolean6 0.0 255.0 /end CHARACTERISTIC
/begin CHARACTERISTIC C_FCVPSCloseSlowZone "cal comments" VALUE 0xB8EE Scalar_UW 0.0 CM_Percent_0to200_2 0.0 199.9969024658203 /end CHARACTERISTIC
/begin CHARACTERISTIC C_FCVMtrFCVPSDeltaOneStep "cal comments" VALUE 0xB8EC Scalar_UW 0.0 CM_Percent_0to200_2 0.0 199.9969024658203 /end CHARACTERISTIC
/begin CHARACTERISTIC C_FCVPSFiltCoef "cal comments" VALUE 0xC012 Scalar_UW 0.0 CM_FiltCoef 0.0 0.9999847412109375 /end CHARACTERISTIC
/begin CHARACTERISTIC C_FCVPSOpenSlowZone "cal comments" VALUE 0xB8F0 Scalar_UW 0.0 CM_Percent_0to200_2 0.0 199.9969024658203 /end CHARACTERISTIC
/begin CHARACTERISTIC C_FCVPSSlope "cal comments" VALUE 0xC010 Scalar_UW 0.0 CM_Ratio_0to8 0.0 7.9998779296875 /end CHARACTERISTIC
/begin CHARACTERISTIC C_FCVPSZeroInitial "cal comments" VALUE 0xC00E Scalar_UW 0.0 CM_Percent_0to200_2 0.0 199.9969024658203 /end CHARACTERISTIC
/begin CHARACTERISTIC C_FCVPSMinimumLrnCntThresh "cal comments" VALUE 0xB8F2 Scalar_UB 0.0 CM_Count1 0.0 255.0 /end CHARACTERISTIC
/begin CHARACTERISTIC C_FCVLoopCounter "cal comments" VALUE 0xB8F3 Scalar_UB 0.0 CM_Count1 0.0 255.0 /end CHARACTERISTIC
/begin CHARACTERISTIC C_FCV_PstnMax "cal comments" VALUE 0xB8F4 Scalar_UB 0.0 CM_Count4 0.0 255.0 /end CHARACTERISTIC
/begin CHARACTERISTIC C_FCVStepMotorCLEn "cal comments" VALUE 0xB8F5 Scalar_UB 0.0 CM_Boolean6 0.0 255.0 /end CHARACTERISTIC
/begin CHARACTERISTIC C_FCVMotorParkDelay "cal comments" VALUE 0xB91E Scalar_UW 0.0 CM_Count_0to65535 0.0 65535.0 /end CHARACTERISTIC
/begin CHARACTERISTIC CT_FCVPS_NG_ParkPstn "cal comments" CURVE 0xB8F8 2D_Array_UW 0.0 CM_Percent_0to200_2 0.0 199.9969024658203
 /begin AXIS_DESCR FIX_AXIS NO_INPUT_QUANTITY CM_Equaloutput1 9 -40.0 152.0 MAX_GRAD 0.0 /begin FIX_AXIS_PAR_LIST -40 -16 8 32 56 80 104 128 152 /end FIX_AXIS_PAR_LIST /end AXIS_DESCR
/end CHARACTERISTIC
/begin CHARACTERISTIC CT_FCVPS_LPG_ParkPstn "cal comments" CURVE 0xB90C 2D_Array_UW 0.0 CM_Percent_0to200_2 0.0 199.9969024658203
 /begin AXIS_DESCR FIX_AXIS NO_INPUT_QUANTITY CM_Equaloutput1 9 -40.0 152.0 MAX_GRAD 0.0 /begin FIX_AXIS_PAR_LIST -40 -16 8 32 56 80 104 128 152 /end FIX_AXIS_PAR_LIST /end AXIS_DESCR
/end CHARACTERISTIC
/begin CHARACTERISTIC CT_FCVPS_FP_CorrFactor_NG "cal comments" MAP 0xB959 3D_Array_UB 0.0 CM_Mult0_to_2_ratio 0.0 1.9921875
 /begin AXIS_DESCR COM_AXIS NO_INPUT_QUANTITY udf_CM_18705 17 0.0 511.9921875 AXIS_PTS_REF CA_AirGramStep17 MAX_GRAD 0.0 /end AXIS_DESCR
 /begin AXIS_DESCR COM_AXIS NO_INPUT_QUANTITY CM_kpa_n256to256_1 8 -256 255.9921875 AXIS_PTS_REF CA_MAP8Step1 MAX_GRAD 0.0 /end AXIS_DESCR
/end CHARACTERISTIC
/begin CHARACTERISTIC CT_FCVPS_Baro_CorrFactor_NG "cal comments" MAP 0xB9E4 3D_Array_UB 0.0 CM_Mult0_to_2_ratio 0.0 1.9921875
 /begin AXIS_DESCR COM_AXIS NO_INPUT_QUANTITY udf_CM_18705 17 0.0 511.9921875 AXIS_PTS_REF CA_AirGramStep17 MAX_GRAD 0.0 /end AXIS_DESCR
 /begin AXIS_DESCR COM_AXIS NO_INPUT_QUANTITY CM_kpa_0to256_1 8 0.0 255.99609375 AXIS_PTS_REF CA_MAP8Step2 MAX_GRAD 0.0 /end AXIS_DESCR
/end CHARACTERISTIC
/begin CHARACTERISTIC CT_FCVPS_FP_CorrFactor_LPG "cal comments" MAP 0xBA6F 3D_Array_UB 0.0 CM_Mult0_to_2_ratio 0.0 1.9921875
 /begin AXIS_DESCR COM_AXIS NO_INPUT_QUANTITY udf_CM_18705 17 0.0 511.9921875 AXIS_PTS_REF CA_AirGramStep17 MAX_GRAD 0.0 /end AXIS_DESCR
 /begin AXIS_DESCR COM_AXIS NO_INPUT_QUANTITY CM_kpa_n256to256_1 8 -256 255.9921875 AXIS_PTS_REF CA_MAP8Step1 MAX_GRAD 0.0 /end AXIS_DESCR
/end CHARACTERISTIC
/begin CHARACTERISTIC CT_FCVPS_Baro_CorrFactor_LPG "cal comments" MAP 0xBAFA 3D_Array_UB 0.0 CM_Mult0_to_2_ratio 0.0 1.9921875
 /begin AXIS_DESCR COM_AXIS NO_INPUT_QUANTITY udf_CM_18705 17 0.0 511.9921875 AXIS_PTS_REF CA_AirGramStep17 MAX_GRAD 0.0 /end AXIS_DESCR
 /begin AXIS_DESCR COM_AXIS NO_INPUT_QUANTITY CM_kpa_0to256_1 8 0.0 255.99609375 AXIS_PTS_REF CA_MAP8Step2 MAX_GRAD 0.0 /end AXIS_DESCR
/end CHARACTERISTIC
/begin CHARACTERISTIC CT_DesireFCVPS_NG "cal comments" MAP 0xBB86 3D_Array_UW 0.0 CM_Percent_0to200_2 0.0 199.9969024658203
 /begin AXIS_DESCR COM_AXIS NO_INPUT_QUANTITY udf_CM_18705 17 0.0 511.9921875 AXIS_PTS_REF CA_AirGramStep17 MAX_GRAD 0.0 /end AXIS_DESCR
 /begin AXIS_DESCR COM_AXIS NO_INPUT_QUANTITY udf_CM_16444 17 0.0 15.999755859375 AXIS_PTS_REF CA_FuelGramStep17 MAX_GRAD 0.0 /end AXIS_DESCR
/end CHARACTERISTIC
/begin CHARACTERISTIC CT_DesireFCVPS_LPG "cal comments" MAP 0xBDCC 3D_Array_UW 0.0 CM_Percent_0to200_2 0.0 199.9969024658203
 /begin AXIS_DESCR COM_AXIS NO_INPUT_QUANTITY udf_CM_18705 17 0.0 511.9921875 AXIS_PTS_REF CA_AirGramStep17 MAX_GRAD 0.0 /end AXIS_DESCR
 /begin AXIS_DESCR COM_AXIS NO_INPUT_QUANTITY udf_CM_16444 17 0.0 15.999755859375 AXIS_PTS_REF CA_FuelGramStep17 MAX_GRAD 0.0 /end AXIS_DESCR
/end CHARACTERISTIC
/begin CHARACTERISTIC C_TachOutOption "cal comments" VALUE 0x8038 Scalar_UB 0.0 CM_Enum_0to4 0.0 255.0 /end CHARACTERISTIC
/begin CHARACTERISTIC C_TargetWheelErrorOfst "cal comments" VALUE 0xB800 Scalar_SW 0.0 CM_SparkAngle_N256to256 -256.0 255.9921875 /end CHARACTERISTIC
/begin CHARACTERISTIC C_IDLETPSCloseSlowZone "cal comments" VALUE 0xB8DC Scalar_UW 0.0 CM_Percent_0to200_2 0.0 199.9969024658203 /end CHARACTERISTIC
/begin CHARACTERISTIC C_IDLEMtrTPSDeltaOneStep "cal comments" VALUE 0xB8DA Scalar_UW 0.0 CM_Percent_0to200_2 0.0 199.9969024658203 /end CHARACTERISTIC
/begin CHARACTERISTIC C_TPSFiltCoef "cal comments" VALUE 0xB65C Scalar_UW 0.0 CM_FiltCoef 0.0 0.9999847412109375 /end CHARACTERISTIC
/begin CHARACTERISTIC C_IDLETPSMinimumLrnCntThresh "cal comments" VALUE 0xB8E0 Scalar_UB 0.0 CM_Count1 0.0 255.0 /end CHARACTERISTIC
/begin CHARACTERISTIC C_IDLETPSOpenSlowZone "cal comments" VALUE 0xB8DE Scalar_UW 0.0 CM_Percent_0to200_2 0.0 199.9969024658203 /end CHARACTERISTIC
/begin CHARACTERISTIC C_TPSSensorPresent "cal comments" VALUE 0x800E Scalar_UB 0.0 CM_Boolean4 0.0 1.0 /end CHARACTERISTIC
/begin CHARACTERISTIC C_TPSSlope "cal comments" VALUE 0xB65E Scalar_UW 0.0 CM_Ratio_0to8 0.0 7.9998779296875 /end CHARACTERISTIC
/begin CHARACTERISTIC C_TPSSpdCtrlMinimum "cal comments" VALUE 0x9F04 Scalar_UW 0.0 CM_Percent_0to200_2 0.0 199.9969024658203 /end CHARACTERISTIC
/begin CHARACTERISTIC C_TPSZeroInitialDefault "cal comments" VALUE 0xB65A Scalar_UW 0.0 CM_Percent_0to200_2 0.0 199.9969024658203 /end CHARACTERISTIC
/begin CHARACTERISTIC C_TransientFuelEnable "cal comments" VALUE 0x972F Scalar_UB 0.0 CM_Boolean1 0.0 1.0 /end CHARACTERISTIC
/begin CHARACTERISTIC C_TrimPulseEnbEngSpdThresh "cal comments" VALUE 0x9C42 Scalar_UW 0.0 CM_RPM_0to16384 0.0 16383.75 /end CHARACTERISTIC
/begin CHARACTERISTIC C_TrimPulseEnbEngSpdThreshHyst "cal comments" VALUE 0x9C44 Scalar_UW 0.0 CM_RPM_0to16384 0.0 16383.75 /end CHARACTERISTIC
/begin CHARACTERISTIC C_TrimPulseScalarCyl "cal comments" CURVE 0x9C3A 2D_Array_UW 0.0 CM_Ratio_0to2_2 0.0 1.999969482421875
 /begin AXIS_DESCR FIX_AXIS NO_INPUT_QUANTITY CM_EOI 4 0.0 4.0 MAX_GRAD 0.0 /begin FIX_AXIS_PAR_LIST 0 1 2 3 /end FIX_AXIS_PAR_LIST /end AXIS_DESCR
/end CHARACTERISTIC
/begin CHARACTERISTIC C_TrimPulseWidthMinLimit "cal comments" VALUE 0x9C38 Scalar_UW 0.0 CM_msec_0to1024 0.0 1023.984375 /end CHARACTERISTIC
/begin CHARACTERISTIC C_TwoCylinderEngine "cal comments" VALUE 0xB339 Scalar_UB 0.0 CM_Boolean4 0.0 1.0 /end CHARACTERISTIC
/begin CHARACTERISTIC C_ValidToothOccurredResetTime "cal comments" VALUE 0xB7AE Scalar_UW 0.0 CM_Second_0to512 0.0 511.9921875 /end CHARACTERISTIC
/begin CHARACTERISTIC CT_AccEnrichDecayFactorCoolTemp "cal comments" CURVE 0x98B0 2D_Array_UB 0.0 CM_Mult_0to1 0.0 0.99609375
 /begin AXIS_DESCR FIX_AXIS NO_INPUT_QUANTITY CM_Equaloutput1 17 -28.0 164.0 MAX_GRAD 0.0 /begin FIX_AXIS_PAR_LIST -28 -16 -4 8 20 32 44 56 68 80 92 104 116 128 140 152 164 /end FIX_AXIS_PAR_LIST /end AXIS_DESCR
/end CHARACTERISTIC
/begin CHARACTERISTIC CT_AccEnrichDecayFactorEngSpd "cal comments" CURVE 0x9398 2D_Array_UB 0.0 CM_Mult_0to1_2 0.0 0.99609375
 /begin AXIS_DESCR COM_AXIS NO_INPUT_QUANTITY CM_RPM_0to16384 17 0.0 16383.75 AXIS_PTS_REF CA_EngSpd17Step1 MAX_GRAD 0.0 /end AXIS_DESCR
/end CHARACTERISTIC
/begin CHARACTERISTIC CT_AEDeltaFuelMultBase "cal comments" CURVE 0x93BE 2D_Array_UW 0.0 CM_Grams0to8 0.0 7.999755859375
 /begin AXIS_DESCR FIX_AXIS NO_INPUT_QUANTITY CM_Equaloutput1 18 0.0 1.700000092387199e-002 MAX_GRAD 0.0
  /begin FIX_AXIS_PAR_LIST 0 1.e-003 2.e-003 3.e-003 4.e-003 5.e-003 6.e-003 7.e-003 8.e-003 8.999999999999999e-003 1.e-002 1.1e-002 1.2e-002 1.3e-002 1.4e-002 1.5e-002 1.6e-002 1.7e-002 /end FIX_AXIS_PAR_LIST
 /end AXIS_DESCR
/end CHARACTERISTIC
/begin CHARACTERISTIC CT_AEDeltaFuelMultCoolTemp "cal comments" CURVE 0x98D6 2D_Array_UB 0.0 CM_mult_0to4 0.0 3.984375
 /begin AXIS_DESCR FIX_AXIS NO_INPUT_QUANTITY CM_Equaloutput1 17 -28.0 164.0 MAX_GRAD 0.0 /begin FIX_AXIS_PAR_LIST -28 -16 -4 8 20 32 44 56 68 80 92 104 116 128 140 152 164 /end FIX_AXIS_PAR_LIST /end AXIS_DESCR
/end CHARACTERISTIC
/begin CHARACTERISTIC CT_AEDeltaFuelMultSpeedLoad "cal comments" MAP 0x940C 3D_Array_UW 0.0 CM_Grams0to2 0.0 1.99993896484375
 /begin AXIS_DESCR COM_AXIS NO_INPUT_QUANTITY CM_RPM_0to16384 17 0.0 16383.75 AXIS_PTS_REF CA_EngSpd17Step2 MAX_GRAD 0.0 /end AXIS_DESCR
 /begin AXIS_DESCR FIX_AXIS NO_INPUT_QUANTITY CM_Equaloutput1 10 15.0 105.0 MAX_GRAD 0.0 /begin FIX_AXIS_PAR_LIST 15 25 35 45 55 65 75 85 95 105 /end FIX_AXIS_PAR_LIST /end AXIS_DESCR
/end CHARACTERISTIC
/begin CHARACTERISTIC CT_AFLCCellEngSpdBoundary "cal comments" VAL_BLK 0xB6AE ValueBlock_UW 0.0 CM_RPM_0to16384_1 0.0 16383.75 NUMBER 3 /end CHARACTERISTIC
/begin CHARACTERISTIC CT_AFLCCellTPSBoundary "cal comments" VAL_BLK 0xB6A4 ValueBlock_UW 0.0 CM_Percent_0to200_1 0.0 199.9969024658203 NUMBER 5 /end CHARACTERISTIC
/begin CHARACTERISTIC CT_AFLCTPSMaxThresh "cal comments" CURVE 0xB664 2D_Array_UW 0.0 CM_Percent_0to200_2 0.0 199.9969024658203
 /begin AXIS_DESCR COM_AXIS NO_INPUT_QUANTITY CM_RPM_0to16384 17 0.0 16383.75 AXIS_PTS_REF CA_EngSpd17Step1 MAX_GRAD 0.0 /end AXIS_DESCR
/end CHARACTERISTIC
/begin CHARACTERISTIC CT_AFRCrank "cal comments" CURVE 0x9956 2D_Array_UB 0.0 CM_AFR_8bit 0.0 31.875
 /begin AXIS_DESCR FIX_AXIS NO_INPUT_QUANTITY CM_Equaloutput1 17 -28.0 164.0 MAX_GRAD 0.0 /begin FIX_AXIS_PAR_LIST -28 -16 -4 8 20 32 44 56 68 80 92 104 116 128 140 152 164 /end FIX_AXIS_PAR_LIST /end AXIS_DESCR
/end CHARACTERISTIC
/begin CHARACTERISTIC CT_AFRCrankNG "cal comments" CURVE 0x9969 2D_Array_UB 0.0 CM_AFR_8bit 0.0 31.875
 /begin AXIS_DESCR FIX_AXIS NO_INPUT_QUANTITY CM_Equaloutput1 9 -28.0 92.0 MAX_GRAD 0.0 /begin FIX_AXIS_PAR_LIST -16 -4 8 20 32 44 56 68 80 /end FIX_AXIS_PAR_LIST /end AXIS_DESCR
/end CHARACTERISTIC
/begin CHARACTERISTIC CT_AFRCrankLPG "cal comments" CURVE 0x9974 2D_Array_UB 0.0 CM_AFR_8bit 0.0 31.875
 /begin AXIS_DESCR FIX_AXIS NO_INPUT_QUANTITY CM_Equaloutput1 9 -28.0 92.0 MAX_GRAD 0.0 /begin FIX_AXIS_PAR_LIST -16 -4 8 20 32 44 56 68 80 /end FIX_AXIS_PAR_LIST /end AXIS_DESCR
/end CHARACTERISTIC
/begin CHARACTERISTIC CT_AFRCrankBaroComp "cal comments" CURVE 0x9732 2D_Array_SB 0.0 CM_AFR_n4to4 -4.0 3.96875
 /begin AXIS_DESCR FIX_AXIS NO_INPUT_QUANTITY CM_Equaloutput1 6 55.0 105.0 MAX_GRAD 0.0 /begin FIX_AXIS_PAR_LIST 55 65 75 85 95 105 /end FIX_AXIS_PAR_LIST /end AXIS_DESCR
/end CHARACTERISTIC
/begin CHARACTERISTIC C_AFRCrankToRunDecayFactor "cal comments" VALUE 0x99CC Scalar_UW 0.0 CM_FactorRatio 0.0 0.9999847412109375 /end CHARACTERISTIC
/begin CHARACTERISTIC CT_AFRCrankToRunDecayInterval "cal comments" CURVE 0x99BA 2D_Array_UB 0.0 CM_Second_0to8 0.0 7.96875
 /begin AXIS_DESCR FIX_AXIS NO_INPUT_QUANTITY CM_Equaloutput1 17 -28.0 164.0 MAX_GRAD 0.0 /begin FIX_AXIS_PAR_LIST -28 -16 -4 8 20 32 44 56 68 80 92 104 116 128 140 152 164 /end FIX_AXIS_PAR_LIST /end AXIS_DESCR
/end CHARACTERISTIC
/begin CHARACTERISTIC CT_AFRLeanLimit "cal comments" CURVE 0x9230 2D_Array_UB 0.0 CM_AFR_8bit 0.0 31.875
 /begin AXIS_DESCR FIX_AXIS NO_INPUT_QUANTITY CM_Equaloutput1 17 -28.0 164.0 MAX_GRAD 0.0 /begin FIX_AXIS_PAR_LIST -28 -16 -4 8 20 32 44 56 68 80 92 104 116 128 140 152 164 /end FIX_AXIS_PAR_LIST /end AXIS_DESCR
/end CHARACTERISTIC
/begin CHARACTERISTIC CT_AFRLeanLimitForColdIdleEnrich "cal comments" CURVE 0x9243 2D_Array_UB 0.0 CM_AFR_8bit 0.0 31.875
 /begin AXIS_DESCR FIX_AXIS NO_INPUT_QUANTITY CM_Equaloutput1 17 -28.0 164.0 MAX_GRAD 0.0 /begin FIX_AXIS_PAR_LIST -28 -16 -4 8 20 32 44 56 68 80 92 104 116 128 140 152 164 /end FIX_AXIS_PAR_LIST /end AXIS_DESCR
/end CHARACTERISTIC
/begin CHARACTERISTIC CT_AFROpenLoopInPEIdle "cal comments" CURVE 0x9824 2D_Array_UB 0.0 CM_AFR_8bit 0.0 31.875
 /begin AXIS_DESCR COM_AXIS NO_INPUT_QUANTITY CM_RPM_0to16384 4 0.0 16383.75 AXIS_PTS_REF CA_EngSpd4Step1 MAX_GRAD 0.0 /end AXIS_DESCR
/end CHARACTERISTIC
/begin CHARACTERISTIC CT_AFRPECoolTempMult "cal comments" CURVE 0x98FC 2D_Array_UB 0.0 CM_Mult0_to_2_ratio 0.0 1.9921875
 /begin AXIS_DESCR FIX_AXIS NO_INPUT_QUANTITY CM_Equaloutput1 17 -28.0 164.0 MAX_GRAD 0.0 /begin FIX_AXIS_PAR_LIST -28 -16 -4 8 20 32 44 56 68 80 92 104 116 128 140 152 164 /end FIX_AXIS_PAR_LIST /end AXIS_DESCR
/end CHARACTERISTIC
/begin CHARACTERISTIC CT_AFRPowerEnrich "cal comments" MAP 0x9910 3D_Array_UB 0.0 CM_AFR_8bit 0.0 31.875
 /begin AXIS_DESCR COM_AXIS NO_INPUT_QUANTITY CM_Percent_0to200_2 4 0.0 199.9969024658203 AXIS_PTS_REF CA_Percent1 MAX_GRAD 0.0 /end AXIS_DESCR
 /begin AXIS_DESCR COM_AXIS NO_INPUT_QUANTITY CM_RPM_0to16384 17 0.0 16383.75 AXIS_PTS_REF CA_EngSpd17Step1 MAX_GRAD 0.0 /end AXIS_DESCR
/end CHARACTERISTIC
/begin CHARACTERISTIC CT_AFRWarmUpOffsetBaroCompIdle "cal comments" CURVE 0x9742 2D_Array_SB 0.0 CM_AFR_n4to4 -4.0 3.96875
 /begin AXIS_DESCR FIX_AXIS NO_INPUT_QUANTITY CM_Equaloutput1 6 55.0 105.0 MAX_GRAD 0.0 /begin FIX_AXIS_PAR_LIST 55 65 75 85 95 105 /end FIX_AXIS_PAR_LIST /end AXIS_DESCR
/end CHARACTERISTIC
/begin CHARACTERISTIC CT_AFRWarmUpOffsetBaroCompRun "cal comments" CURVE 0x973A 2D_Array_SB 0.0 CM_AFR_n4to4 -4.0 3.96875
 /begin AXIS_DESCR FIX_AXIS NO_INPUT_QUANTITY CM_Equaloutput1 6 55.0 105.0 MAX_GRAD 0.0 /begin FIX_AXIS_PAR_LIST 55 65 75 85 95 105 /end FIX_AXIS_PAR_LIST /end AXIS_DESCR
/end CHARACTERISTIC
/begin CHARACTERISTIC CT_AFRWarmUpOffsetDecayIntervel "cal comments" CURVE 0x997F 2D_Array_UB 0.0 CM_Second_0to8 0.0 7.96875
 /begin AXIS_DESCR FIX_AXIS NO_INPUT_QUANTITY CM_Equaloutput1 17 -28.0 164.0 MAX_GRAD 0.0 /begin FIX_AXIS_PAR_LIST -28 -16 -4 8 20 32 44 56 68 80 92 104 116 128 140 152 164 /end FIX_AXIS_PAR_LIST /end AXIS_DESCR
/end CHARACTERISTIC
/begin CHARACTERISTIC CT_AFRWarmUpOffsetIdle "cal comments" CURVE 0x9994 2D_Array_UB 0.0 CM_AFR_8bit 0.0 31.875
 /begin AXIS_DESCR FIX_AXIS NO_INPUT_QUANTITY CM_Equaloutput1 17 -28.0 164.0 MAX_GRAD 0.0 /begin FIX_AXIS_PAR_LIST -28 -16 -4 8 20 32 44 56 68 80 92 104 116 128 140 152 164 /end FIX_AXIS_PAR_LIST /end AXIS_DESCR
/end CHARACTERISTIC
/begin CHARACTERISTIC CT_AFRWarmUpOffsetRun "cal comments" CURVE 0x99A7 2D_Array_UB 0.0 CM_AFR_8bit 0.0 31.875
 /begin AXIS_DESCR FIX_AXIS NO_INPUT_QUANTITY CM_Equaloutput1 17 -28.0 164.0 MAX_GRAD 0.0 /begin FIX_AXIS_PAR_LIST -28 -16 -4 8 20 32 44 56 68 80 92 104 116 128 140 152 164 /end FIX_AXIS_PAR_LIST /end AXIS_DESCR
/end CHARACTERISTIC
/begin CHARACTERISTIC CT_AirFuelRatioBase "cal comments" MAP 0x974B 3D_Array_UB 0.0 CM_AFR_8bit 0.0 31.875
 /begin AXIS_DESCR COM_AXIS NO_INPUT_QUANTITY CM_RPM_0to16384 17 0.0 16383.75 AXIS_PTS_REF CA_EngSpd17Step2 MAX_GRAD 0.0 /end AXIS_DESCR
 /begin AXIS_DESCR COM_AXIS NO_INPUT_QUANTITY CM_kpa_0to256_1 10 0.0 255.99609375 AXIS_PTS_REF CA_MAP10Step1 MAX_GRAD 0.0 /end AXIS_DESCR
/end CHARACTERISTIC
/begin CHARACTERISTIC CT_AirFuelRatioBaseCoolTempMult "cal comments" CURVE 0x99D0 2D_Array_UB 0.0 CM_Mult0_to_2_ratio 0.0 1.9921875
 /begin AXIS_DESCR FIX_AXIS NO_INPUT_QUANTITY CM_Equaloutput1 17 -28.0 164.0 MAX_GRAD 0.0 /begin FIX_AXIS_PAR_LIST -28 -16 -4 8 20 32 44 56 68 80 92 104 116 128 140 152 164 /end FIX_AXIS_PAR_LIST /end AXIS_DESCR
/end CHARACTERISTIC
/begin CHARACTERISTIC CT_AltMAPCalcMult "cal comments" CURVE 0xB7E4 2D_Array_UB 0.0 CM_Mult0_to_2_ratio 0.0 1.9921875
 /begin AXIS_DESCR FIX_AXIS NO_INPUT_QUANTITY CM_Equaloutput1 11 55.0 105.0 MAX_GRAD 0.0 /begin FIX_AXIS_PAR_LIST 55 60 65 70 75 80 85 90 95 100 105 /end FIX_AXIS_PAR_LIST /end AXIS_DESCR
/end CHARACTERISTIC
/begin CHARACTERISTIC CT_BaroReadTooth "cal comments" CURVE 0xB80C 2D_Array_UB 0.0 CM_Count3 0.0 255.0
 /begin AXIS_DESCR COM_AXIS NO_INPUT_QUANTITY CM_RPM_0to16384 9 0.0 16383.75 AXIS_PTS_REF CA_EngSpd9Step1 MAX_GRAD 0.0 /end AXIS_DESCR
/end CHARACTERISTIC
/begin CHARACTERISTIC C_MapBaroUsed "cal comments" VALUE 0xB815 Scalar_UB 0.0 CM_Boolean4 0.0 1.0 /end CHARACTERISTIC
/begin CHARACTERISTIC CT_BaroUpdtEngRunOfstMain "cal comments" MAP 0xB849 3D_Array_UB 0.0 CM_kpa_8bit 0.0 127.5
 /begin AXIS_DESCR FIX_AXIS NO_INPUT_QUANTITY CM_Equaloutput1 9 0.0 100.0 MAX_GRAD 0.0 /begin FIX_AXIS_PAR_LIST 0 12.5 25 37.5 50 62.5 75 87.5 100 /end FIX_AXIS_PAR_LIST /end AXIS_DESCR
 /begin AXIS_DESCR COM_AXIS NO_INPUT_QUANTITY CM_RPM_0to16384 9 0.0 16383.75 AXIS_PTS_REF CA_EngSpd9Step1 MAX_GRAD 0.0 /end AXIS_DESCR
/end CHARACTERISTIC
/begin CHARACTERISTIC CT_BaroUpdtEngRunTPSMaxThresh "cal comments" CURVE 0xB833 2D_Array_UB 0.0 CM_Percent_0to200_3 0.0 199.21875
 /begin AXIS_DESCR COM_AXIS NO_INPUT_QUANTITY CM_RPM_0to16384 17 0.0 16383.75 AXIS_PTS_REF CA_EngSpd17Step1 MAX_GRAD 0.0 /end AXIS_DESCR
/end CHARACTERISTIC
/begin CHARACTERISTIC CT_BaroUpdtEngRunTPSMinThresh "cal comments" CURVE 0xB820 2D_Array_UB 0.0 CM_Percent_0to200_3 0.0 199.21875
 /begin AXIS_DESCR COM_AXIS NO_INPUT_QUANTITY CM_RPM_0to16384 17 0.0 16383.75 AXIS_PTS_REF CA_EngSpd17Step1 MAX_GRAD 0.0 /end AXIS_DESCR
/end CHARACTERISTIC
/begin CHARACTERISTIC CT_CATFactorCLTIATCorr "cal comments" MAP 0x8F02 D_Array_SB 0.0 CM_Ratio_n2to2 -2.0 1.984375
 /begin AXIS_DESCR FIX_AXIS NO_INPUT_QUANTITY CM_Equaloutput1 6 -28.0 92.0 MAX_GRAD 0.0 /begin FIX_AXIS_PAR_LIST -28 -4 20 44 68 92 /end FIX_AXIS_PAR_LIST /end AXIS_DESCR
 /begin AXIS_DESCR FIX_AXIS NO_INPUT_QUANTITY CM_Equaloutput1 9 -28.0 164.0 MAX_GRAD 0.0 /begin FIX_AXIS_PAR_LIST -28 -4 20 44 68 92 116 140 164 /end FIX_AXIS_PAR_LIST /end AXIS_DESCR
/end CHARACTERISTIC
/begin CHARACTERISTIC CT_ChargeAirTempFactorCyl1 "cal comments" MAP 0x829D D_Array_SB 0.0 CM_Ratio_n2to2 -2.0 1.984375
 /begin AXIS_DESCR FIX_AXIS NO_INPUT_QUANTITY CM_Equaloutput1 9 25.0 105.0 MAX_GRAD 0.0 /begin FIX_AXIS_PAR_LIST 25 35 45 55 65 75 85 95 105 /end FIX_AXIS_PAR_LIST /end AXIS_DESCR
 /begin AXIS_DESCR COM_AXIS NO_INPUT_QUANTITY CM_RPM_0to16384 10 0.0 16383.75 AXIS_PTS_REF CA_EngSpd10Step1 MAX_GRAD 0.0 /end AXIS_DESCR
/end CHARACTERISTIC
/begin CHARACTERISTIC CT_ColdEngFPWMultIdle "cal comments" CURVE 0x96F8 2D_Array_UB 0.0 CM_Mult0_to_2_ratio 0.0 1.9921875
 /begin AXIS_DESCR FIX_AXIS NO_INPUT_QUANTITY CM_Equaloutput1 17 -28.0 164.0 MAX_GRAD 0.0 /begin FIX_AXIS_PAR_LIST -28 -16 -4 8 20 32 44 56 68 80 92 104 116 128 140 152 164 /end FIX_AXIS_PAR_LIST /end AXIS_DESCR
/end CHARACTERISTIC
/begin CHARACTERISTIC CT_ColdEngFPWMultRun "cal comments" CURVE 0x970B 2D_Array_UB 0.0 CM_Mult0_to_2_ratio 0.0 1.9921875
 /begin AXIS_DESCR FIX_AXIS NO_INPUT_QUANTITY CM_Equaloutput1 17 -28.0 164.0 MAX_GRAD 0.0 /begin FIX_AXIS_PAR_LIST -28 -16 -4 8 20 32 44 56 68 80 92 104 116 128 140 152 164 /end FIX_AXIS_PAR_LIST /end AXIS_DESCR
/end CHARACTERISTIC
/begin CHARACTERISTIC CT_ColdEngFPWMultGas "cal comments" CURVE 0x971E 2D_Array_UB 0.0 CM_Mult0_to_2_ratio 0.0 1.9921875
 /begin AXIS_DESCR FIX_AXIS NO_INPUT_QUANTITY CM_Equaloutput1 17 -28.0 164.0 MAX_GRAD 0.0 /begin FIX_AXIS_PAR_LIST -28 -16 -4 8 20 32 44 56 68 80 92 104 116 128 140 152 164 /end FIX_AXIS_PAR_LIST /end AXIS_DESCR
/end CHARACTERISTIC
/begin CHARACTERISTIC CT_CoolantTemp "cal comments" CURVE 0xB72C 2D_Array_SW 0.0 CM_DegC_N256to256 -256.0 255.9921875
 /begin AXIS_DESCR FIX_AXIS NO_INPUT_QUANTITY CM_Equaloutput1 33 0.0 100.0 MAX_GRAD 0.0
  /begin FIX_AXIS_PAR_LIST 0 3.125 6.25 9.375 12.5 15.625 18.75 21.875 25 28.125 31.25 34.375 37.5 40.625 43.75 46.875 50 53.125 56.25 59.375 62.5 65.625 68.75 71.875 75 78.125 81.25 84.375 87.5 90.625 93.75 96.875 100 /end FIX_AXIS_PAR_LIST
 /end AXIS_DESCR
/end CHARACTERISTIC
/begin CHARACTERISTIC CT_DecEnleanDecayFactorCoolTemp "cal comments" CURVE 0x98C3 2D_Array_UB 0.0 CM_Mult_0to1 0.0 0.99609375
 /begin AXIS_DESCR FIX_AXIS NO_INPUT_QUANTITY CM_Equaloutput1 17 -28.0 164.0 MAX_GRAD 0.0 /begin FIX_AXIS_PAR_LIST -28 -16 -4 8 20 32 44 56 68 80 92 104 116 128 140 152 164 /end FIX_AXIS_PAR_LIST /end AXIS_DESCR
/end CHARACTERISTIC
/begin CHARACTERISTIC CT_DecEnleanDecayFactorEngSpd "cal comments" CURVE 0x93AB 2D_Array_UB 0.0 CM_Mult_0to1_2 0.0 0.99609375
 /begin AXIS_DESCR COM_AXIS NO_INPUT_QUANTITY CM_RPM_0to16384 17 0.0 16383.75 AXIS_PTS_REF CA_EngSpd17Step1 MAX_GRAD 0.0 /end AXIS_DESCR
/end CHARACTERISTIC
/begin CHARACTERISTIC CT_DEDeltaFuelMultBase "cal comments" CURVE 0x93E4 2D_Array_UW 0.0 CM_Grams0to8 0.0 7.999755859375
 /begin AXIS_DESCR FIX_AXIS NO_INPUT_QUANTITY CM_Equaloutput1 18 0.0 1.700000092387199e-002 MAX_GRAD 0.0
  /begin FIX_AXIS_PAR_LIST 0 1.e-003 2.e-003 3.e-003 4.e-003 5.e-003 6.e-003 7.e-003 8.e-003 8.999999999999999e-003 1.e-002 1.1e-002 1.2e-002 1.3e-002 1.4e-002 1.5e-002 1.6e-002 1.7e-002 /end FIX_AXIS_PAR_LIST
 /end AXIS_DESCR
/end CHARACTERISTIC
/begin CHARACTERISTIC CT_DEDeltaFuelMultCoolTemp "cal comments" CURVE 0x98E9 2D_Array_UB 0.0 CM_mult_0to4 0.0 3.984375
 /begin AXIS_DESCR FIX_AXIS NO_INPUT_QUANTITY CM_Equaloutput1 17 -28.0 164.0 MAX_GRAD 0.0 /begin FIX_AXIS_PAR_LIST -28 -16 -4 8 20 32 44 56 68 80 92 104 116 128 140 152 164 /end FIX_AXIS_PAR_LIST /end AXIS_DESCR
/end CHARACTERISTIC
/begin CHARACTERISTIC CT_DEDeltaFuelMultSpeedLoad "cal comments" MAP 0x9564 3D_Array_UW 0.0 CM_Grams0to2 0.0 1.99993896484375
 /begin AXIS_DESCR COM_AXIS NO_INPUT_QUANTITY CM_RPM_0to16384 17 0.0 16383.75 AXIS_PTS_REF CA_EngSpd17Step2 MAX_GRAD 0.0 /end AXIS_DESCR
 /begin AXIS_DESCR FIX_AXIS NO_INPUT_QUANTITY CM_Equaloutput1 10 15.0 105.0 MAX_GRAD 0.0 /begin FIX_AXIS_PAR_LIST 15 25 35 45 55 65 75 85 95 105 /end FIX_AXIS_PAR_LIST /end AXIS_DESCR
/end CHARACTERISTIC
/begin CHARACTERISTIC CT_DefaultTPS "cal comments" CURVE 0xB6BA 2D_Array_UW 0.0 CM_Percent_0to200_2 0.0 199.9969024658203
 /begin AXIS_DESCR FIX_AXIS NO_INPUT_QUANTITY CM_Equaloutput1 17 0.0 6400.0 MAX_GRAD 0.0
  /begin FIX_AXIS_PAR_LIST 0 400 800 1200 1600 2000 2400 2800 3200 3600 4000 4400 4800 5200 5600 6000 6400 /end FIX_AXIS_PAR_LIST
 /end AXIS_DESCR
/end CHARACTERISTIC
/begin CHARACTERISTIC CT_DesireEngineSpeed "cal comments" CURVE 0x9E7C 2D_Array_UW 0.0 udf_CM_18586 0.0 16383.75
 /begin AXIS_DESCR FIX_AXIS NO_INPUT_QUANTITY CM_Equaloutput1 5 1.0 5.0 MAX_GRAD 0.0 /begin FIX_AXIS_PAR_LIST 1 2 3 4 5 /end FIX_AXIS_PAR_LIST /end AXIS_DESCR
/end CHARACTERISTIC
/begin CHARACTERISTIC CT_DesireEngSpdLinear "cal comments" CURVE 0x9E8E 2D_Array_UW 0.0 CM_RPM_0to16384 0.0 16383.75
 /begin AXIS_DESCR COM_AXIS NO_INPUT_QUANTITY CM_Percent_0to200_2 2 0.0 199.9969024658203 AXIS_PTS_REF CA_Percent2 MAX_GRAD 0.0 /end AXIS_DESCR
/end CHARACTERISTIC
/begin CHARACTERISTIC CT_DesireEngSpdLinear2 "cal comments" CURVE 0x9E94 2D_Array_UW 0.0 CM_RPM_0to16384 0.0 16383.75
 /begin AXIS_DESCR COM_AXIS NO_INPUT_QUANTITY CM_Percent_0to200_2 2 0.0 199.9969024658203 AXIS_PTS_REF CA_Percent2 MAX_GRAD 0.0 /end AXIS_DESCR
/end CHARACTERISTIC
/begin CHARACTERISTIC CT_EstimatedTorque "cal comments" MAP 0x4 udf_RL_19771 0.0 udf_CM_18544 -128.0 127.99609375
 /begin AXIS_DESCR COM_AXIS NO_INPUT_QUANTITY CM_kpa_0to256_1 18 0.0 255.99609375 AXIS_PTS_REF CA_MAP18Step1 MAX_GRAD 0.0 /end AXIS_DESCR
 /begin AXIS_DESCR COM_AXIS NO_INPUT_QUANTITY CM_RPM_0to16384 17 0.0 16383.75 AXIS_PTS_REF CA_EngSpd17Step1 MAX_GRAD 0.0 /end AXIS_DESCR
/end CHARACTERISTIC
/begin CHARACTERISTIC CT_FPWCorrFactorForFPVolt "cal comments" CURVE 0x92E7 2D_Array_UB 0.0 CM_Mult0_to_2_ratio 0.0 1.9921875
 /begin AXIS_DESCR FIX_AXIS NO_INPUT_QUANTITY CM_Equaloutput1 9 6.400000095367432 19.20000076293945 MAX_GRAD 0.0 /begin FIX_AXIS_PAR_LIST 6.4 8 9.6 11.2 12.8 14.4 16 17.6 19.2 /end FIX_AXIS_PAR_LIST /end AXIS_DESCR
/end CHARACTERISTIC
/begin CHARACTERISTIC CT_FPWCorrFactorForFPVoltGas "cal comments" CURVE 0x92F2 2D_Array_UB 0.0 CM_Mult0_to_2_ratio 0.0 1.9921875
 /begin AXIS_DESCR FIX_AXIS NO_INPUT_QUANTITY CM_Equaloutput1 9 6.400000095367432 19.20000076293945 MAX_GRAD 0.0 /begin FIX_AXIS_PAR_LIST 6.4 8 9.6 11.2 12.8 14.4 16 17.6 19.2 /end FIX_AXIS_PAR_LIST /end AXIS_DESCR
/end CHARACTERISTIC
/begin CHARACTERISTIC CT_FPWCorrFactorForFuelPressure_NG "cal comments" MAP 0x92FE 3D_Array_UB 0.0 CM_Mult0_to_4_ratio 0.0 3.984375
 /begin AXIS_DESCR COM_AXIS NO_INPUT_QUANTITY CM_kpa_0to256_1 9 0.0 255.99609375 AXIS_PTS_REF CA_MAP9Step1 MAX_GRAD 0.0 /end AXIS_DESCR
 /begin AXIS_DESCR COM_AXIS NO_INPUT_QUANTITY CM_kpa_n256to256_1 8 -256 255.9921875 AXIS_PTS_REF CA_MAP8Step1 MAX_GRAD 0.0 /end AXIS_DESCR
/end CHARACTERISTIC
/begin CHARACTERISTIC CT_FPWCorrFactorForFuelPressure_LPG "cal comments" MAP 0x9349 3D_Array_UB 0.0 CM_Mult0_to_4_ratio 0.0 3.984375
 /begin AXIS_DESCR COM_AXIS NO_INPUT_QUANTITY CM_kpa_0to256_1 9 0.0 255.99609375 AXIS_PTS_REF CA_MAP9Step1 MAX_GRAD 0.0 /end AXIS_DESCR
 /begin AXIS_DESCR COM_AXIS NO_INPUT_QUANTITY CM_kpa_n256to256_1 8 -256 255.9921875 AXIS_PTS_REF CA_MAP8Step1 MAX_GRAD 0.0 /end AXIS_DESCR
/end CHARACTERISTIC
/begin CHARACTERISTIC CT_FuelCLEnbCoolTempThrsh "cal comments" CURVE 0x9A32 2D_Array_SW 0.0 CM_DegC_N256to256 -256.0 255.9921875
 /begin AXIS_DESCR FIX_AXIS NO_INPUT_QUANTITY CM_Equaloutput1 17 -28.0 164.0 MAX_GRAD 0.0 /begin FIX_AXIS_PAR_LIST -28 -16 -4 8 20 32 44 56 68 80 92 104 116 128 140 152 164 /end FIX_AXIS_PAR_LIST /end AXIS_DESCR
/end CHARACTERISTIC
/begin CHARACTERISTIC CT_FuelCLIntDelayO2ErrMult "cal comments" CURVE 0x9AEE 2D_Array_UB 0.0 CM_Mult_0to1_2 0.0 0.99609375
 /begin AXIS_DESCR FIX_AXIS NO_INPUT_QUANTITY CM_Equaloutput1 6 0.0 347.5 MAX_GRAD 0.0 /begin FIX_AXIS_PAR_LIST 0 69.5 139 208.5 278 347.5 /end FIX_AXIS_PAR_LIST /end AXIS_DESCR
/end CHARACTERISTIC
/begin CHARACTERISTIC CT_FuelCLIntLearningDelay "cal comments" CURVE 0x9AE8 2D_Array_UB 0.0 CM_Second_0to4 0.0 3.984375
 /begin AXIS_DESCR COM_AXIS NO_INPUT_QUANTITY CM_RPM_0to16384 4 0.0 16383.75 AXIS_PTS_REF CA_EngSpd4Step1 MAX_GRAD 0.0 /end AXIS_DESCR
/end CHARACTERISTIC
/begin CHARACTERISTIC CT_FuelEOICrank "cal comments" CURVE 0x92BA 2D_Array_UW 0.0 CM_CrankAngle_0to1024 0.0 1023.984375
 /begin AXIS_DESCR FIX_AXIS NO_INPUT_QUANTITY CM_Equaloutput1 9 -40.0 152.0 MAX_GRAD 0.0 /begin FIX_AXIS_PAR_LIST -40 -16 8 32 56 80 104 128 152 /end FIX_AXIS_PAR_LIST /end AXIS_DESCR
/end CHARACTERISTIC
/begin CHARACTERISTIC CT_FuelEOIRun "cal comments" CURVE 0x92CE 2D_Array_UW 0.0 CM_CrankAngle_0to1024 0.0 1023.984375
 /begin AXIS_DESCR COM_AXIS NO_INPUT_QUANTITY CM_RPM_0to16384 6 0.0 16383.75 AXIS_PTS_REF CA_EngSpd6Step2 MAX_GRAD 0.0 /end AXIS_DESCR
/end CHARACTERISTIC
/begin CHARACTERISTIC CT_FuelEOITrimPulse "cal comments" CURVE 0x9C48 2D_Array_UW 0.0 CM_CrankAngle_0to1024 0.0 1023.984375
 /begin AXIS_DESCR FIX_AXIS NO_INPUT_QUANTITY CM_Equaloutput1 9 -40.0 152.0 MAX_GRAD 0.0 /begin FIX_AXIS_PAR_LIST -40 -16 8 32 56 80 104 128 152 /end FIX_AXIS_PAR_LIST /end AXIS_DESCR
/end CHARACTERISTIC
/begin CHARACTERISTIC C_TrimPulseBeforeCIDsucceed "cal comments" VALUE 0x9C5A Scalar_UB 0.0 CM_Boolean1 0.0 1.0 /end CHARACTERISTIC
/begin CHARACTERISTIC C_TrimPulseEnbTPSThresh "cal comments" VALUE 0x9C5C Scalar_UW 0.0 CM_Percent_0to200_2 0.0 199.9969024658203 /end CHARACTERISTIC
/begin CHARACTERISTIC CT_FuelO2RichLeanThreshBase "cal comments" MAP 0x9A65 3D_Array_UB 0.0 CM_mVolt 0.0 1016.0
 /begin AXIS_DESCR COM_AXIS NO_INPUT_QUANTITY CM_kpa_0to256_1 9 0.0 255.99609375 AXIS_PTS_REF CA_MAP9Step3 MAX_GRAD 0.0 /end AXIS_DESCR
 /begin AXIS_DESCR COM_AXIS NO_INPUT_QUANTITY CM_RPM_0to16384 4 0.0 16383.75 AXIS_PTS_REF CA_EngSpd4Step1 MAX_GRAD 0.0 /end AXIS_DESCR
/end CHARACTERISTIC
/begin CHARACTERISTIC CT_FuelO2RichLeanThreshBase_NG "cal comments" MAP 0x9A8C 3D_Array_UB 0.0 CM_mVolt 0.0 1016.0
 /begin AXIS_DESCR COM_AXIS NO_INPUT_QUANTITY CM_kpa_0to256_1 9 0.0 255.99609375 AXIS_PTS_REF CA_MAP9Step3 MAX_GRAD 0.0 /end AXIS_DESCR
 /begin AXIS_DESCR COM_AXIS NO_INPUT_QUANTITY CM_RPM_0to16384 4 0.0 16383.75 AXIS_PTS_REF CA_EngSpd4Step1 MAX_GRAD 0.0 /end AXIS_DESCR
/end CHARACTERISTIC
/begin CHARACTERISTIC CT_FuelO2RichLeanThreshBase_LPG "cal comments" MAP 0x9AB3 3D_Array_UB 0.0 CM_mVolt 0.0 1016.0
 /begin AXIS_DESCR COM_AXIS NO_INPUT_QUANTITY CM_kpa_0to256_1 9 0.0 255.99609375 AXIS_PTS_REF CA_MAP9Step3 MAX_GRAD 0.0 /end AXIS_DESCR
 /begin AXIS_DESCR COM_AXIS NO_INPUT_QUANTITY CM_RPM_0to16384 4 0.0 16383.75 AXIS_PTS_REF CA_EngSpd4Step1 MAX_GRAD 0.0 /end AXIS_DESCR
/end CHARACTERISTIC
/begin CHARACTERISTIC CT_FuelPropLeanToRich "cal comments" MAP 0x9B44 3D_Array_UB 0.0 CM_Percent_0to100 0.0 99.609375
 /begin AXIS_DESCR COM_AXIS NO_INPUT_QUANTITY CM_kpa_0to256_1 9 0.0 255.99609375 AXIS_PTS_REF CA_MAP9Step3 MAX_GRAD 0.0 /end AXIS_DESCR
 /begin AXIS_DESCR COM_AXIS NO_INPUT_QUANTITY CM_RPM_0to16384 4 0.0 16383.75 AXIS_PTS_REF CA_EngSpd4Step1 MAX_GRAD 0.0 /end AXIS_DESCR
/end CHARACTERISTIC
/begin CHARACTERISTIC CT_FuelPropMinDuration "cal comments" CURVE 0x9B6C 2D_Array_UB 0.0 CM_Second_0to4 0.0 3.984375
 /begin AXIS_DESCR COM_AXIS NO_INPUT_QUANTITY CM_RPM_0to16384 4 0.0 16383.75 AXIS_PTS_REF CA_EngSpd4Step1 MAX_GRAD 0.0 /end AXIS_DESCR
/end CHARACTERISTIC
/begin CHARACTERISTIC CT_FuelPropO2ErrMult "cal comments" CURVE 0x9AFE 2D_Array_UW 0.0 CM_FactorRatio 0.0 0.9999847412109375
 /begin AXIS_DESCR FIX_AXIS NO_INPUT_QUANTITY CM_Equaloutput1 6 0.0 347.5 MAX_GRAD 0.0 /begin FIX_AXIS_PAR_LIST 0 69.5 139 208.5 278 347.5 /end FIX_AXIS_PAR_LIST /end AXIS_DESCR
/end CHARACTERISTIC
/begin CHARACTERISTIC CT_FuelPropRichBiasHoldTimeGain "cal comments" CURVE 0x9B72 2D_Array_UB 0.0 CM_Mult0_to_2_ratio 0.0 1.9921875
 /begin AXIS_DESCR COM_AXIS NO_INPUT_QUANTITY CM_RPM_0to16384 4 0.0 16383.75 AXIS_PTS_REF CA_EngSpd4Step1 MAX_GRAD 0.0 /end AXIS_DESCR
/end CHARACTERISTIC
/begin CHARACTERISTIC CT_FuelPropRichToLean "cal comments" MAP 0x9B1D 3D_Array_UB 0.0 CM_Percent_0to100 0.0 99.609375
 /begin AXIS_DESCR COM_AXIS NO_INPUT_QUANTITY CM_kpa_0to256_1 9 0.0 255.99609375 AXIS_PTS_REF CA_MAP9Step3 MAX_GRAD 0.0 /end AXIS_DESCR
 /begin AXIS_DESCR COM_AXIS NO_INPUT_QUANTITY CM_RPM_0to16384 4 0.0 16383.75 AXIS_PTS_REF CA_EngSpd4Step1 MAX_GRAD 0.0 /end AXIS_DESCR
/end CHARACTERISTIC
/begin CHARACTERISTIC CT_FuelPumpDutyCycle "cal comments" CURVE 0x9296 2D_Array_UW 0.0 CM_Percent_0to200_2 0.0 199.9969024658203
 /begin AXIS_DESCR FIX_AXIS NO_INPUT_QUANTITY CM_Equaloutput1 17 6.0 18.79999923706055 MAX_GRAD 0.0
  /begin FIX_AXIS_PAR_LIST 6 6.8 7.6 8.4 9.199999999999999 10 10.8 11.6 12.4 13.2 14 14.8 15.6 16.4 17.2 18 18.8 /end FIX_AXIS_PAR_LIST
 /end AXIS_DESCR
/end CHARACTERISTIC
/begin CHARACTERISTIC CT_FuelPumpWorkTimeForPP "cal comments" CURVE 0x91F2 2D_Array_UW 0.0 CM_Second_0to512 0.0 511.9921875
 /begin AXIS_DESCR FIX_AXIS NO_INPUT_QUANTITY CM_Equaloutput1 17 -28.0 164.0 MAX_GRAD 0.0 /begin FIX_AXIS_PAR_LIST -28 -16 -4 8 20 32 44 56 68 80 92 104 116 128 140 152 164 /end FIX_AXIS_PAR_LIST /end AXIS_DESCR
/end CHARACTERISTIC
/begin CHARACTERISTIC C_BLM_Enb "cal comments" VALUE 0x99E2 Scalar_UB 0.0 CM_Boolean4 0.0 1.0 /end CHARACTERISTIC
/begin CHARACTERISTIC C_BLM_FCV_Enb "cal comments" VALUE 0x99E3 Scalar_UB 0.0 CM_Boolean4 0.0 1.0 /end CHARACTERISTIC
/begin CHARACTERISTIC C_BLM_CellRst "cal comments" VALUE 0x99E4 Scalar_UB 0.0 CM_Boolean4 0.0 1.0 /end CHARACTERISTIC
/begin CHARACTERISTIC C_BLM_AllRst "cal comments" VALUE 0x99E5 Scalar_UB 0.0 CM_Boolean4 0.0 1.0 /end CHARACTERISTIC
/begin CHARACTERISTIC C_BLM_RstValue "cal comments" VALUE 0x99E6 Scalar_UW 0.0 CM_Ratio_0to2_2 0.0 1.999969482421875 /end CHARACTERISTIC
/begin CHARACTERISTIC C_BLM_CoolTempMin "cal comments" VALUE 0x99FC Scalar_SW 0.0 CM_DegC_N256to256 -256.0 255.9921875 /end CHARACTERISTIC
/begin CHARACTERISTIC C_BLM_CoolTempMax "cal comments" VALUE 0x99FE Scalar_SW 0.0 CM_DegC_N256to256 -256.0 255.9921875 /end CHARACTERISTIC
/begin CHARACTERISTIC C_BLM_LrnLeanThrsh "cal comments" VALUE 0x9A00 Scalar_SW 0.0 CM_SignedWord_n32768to32768_2 -32768.0 32766.0 /end CHARACTERISTIC
/begin CHARACTERISTIC C_BLM_LrnRichThrsh "cal comments" VALUE 0x9A02 Scalar_SW 0.0 CM_SignedWord_n32768to32768_2 -32768.0 32766.0 /end CHARACTERISTIC
/begin CHARACTERISTIC C_BLM_LrnStep "cal comments" VALUE 0x9A04 Scalar_UW 0.0 CM_Ratio_0to2_2 0.0 1.999969482421875 /end CHARACTERISTIC
/begin CHARACTERISTIC C_BLM_LrnMax "cal comments" VALUE 0x9A06 Scalar_UW 0.0 CM_Ratio_0to2_2 0.0 1.999969482421875 /end CHARACTERISTIC
/begin CHARACTERISTIC C_BLM_LrnMin "cal comments" VALUE 0x9A08 Scalar_UW 0.0 CM_Ratio_0to2_2 0.0 1.999969482421875 /end CHARACTERISTIC
/begin CHARACTERISTIC C_BLM_AirFlowMin "cal comments" VALUE 0x99E8 Scalar_UW 0.0 CM_GramPerSecond_1 0.0 511.9921875 /end CHARACTERISTIC
/begin CHARACTERISTIC C_BLM_AirFlowMax "cal comments" VALUE 0x99EA Scalar_UW 0.0 CM_GramPerSecond_1 0.0 511.9921875 /end CHARACTERISTIC
/begin CHARACTERISTIC C_BLM_AirFlowHyst "cal comments" VALUE 0x99EC Scalar_UW 0.0 CM_GramPerSecond_1 0.0 511.9921875 /end CHARACTERISTIC
/begin CHARACTERISTIC C_BLM_AirFlowDelta "cal comments" VALUE 0x99EE Scalar_UW 0.0 CM_GramPerSecond_1 0.0 511.9921875 /end CHARACTERISTIC
/begin CHARACTERISTIC C_BLM_EngSpeedMin "cal comments" VALUE 0x99F2 Scalar_UW 0.0 CM_RPM_0to16384 0.0 16383.75 /end CHARACTERISTIC
/begin CHARACTERISTIC C_BLM_EngSpeedMax "cal comments" VALUE 0x99F4 Scalar_UW 0.0 CM_RPM_0to16384 0.0 16383.75 /end CHARACTERISTIC
/begin CHARACTERISTIC C_BLM_EngSpeedHyst "cal comments" VALUE 0x99F6 Scalar_UW 0.0 CM_RPM_0to16384 0.0 16383.75 /end CHARACTERISTIC
/begin CHARACTERISTIC C_BLM_EngSpeedDelta "cal comments" VALUE 0x99F8 Scalar_UW 0.0 CM_RPM_0to16384 0.0 16383.75 /end CHARACTERISTIC
/begin CHARACTERISTIC C_BLM_AirFlowCoef "cal comments" VALUE 0x99F0 Scalar_UW 0.0 CM_FiltCoef 0.0 0.9999847412109375 /end CHARACTERISTIC
/begin CHARACTERISTIC C_BLM_EngSpeedCoef "cal comments" VALUE 0x99FA Scalar_UW 0.0 CM_FiltCoef 0.0 0.9999847412109375 /end CHARACTERISTIC
/begin CHARACTERISTIC CT_BLM_RampMax "cal comments" CURVE 0x9A20 Scalar_UW 0.0 CM_Ratio_0to2_2 0.0 1.999969482421875
 /begin AXIS_DESCR FIX_AXIS NO_INPUT_QUANTITY CM_Equaloutput1 5 0.0 0.4 MAX_GRAD 0.0 /begin FIX_AXIS_PAR_LIST 0.0 0.1 0.2 0.3 0.4 /end FIX_AXIS_PAR_LIST /end AXIS_DESCR
/end CHARACTERISTIC
/begin CHARACTERISTIC CT_BLM_LrnDelay "cal comments" CURVE 0x9A0C Scalar_UW 0.0 CM_Second_0to4096 0.0 4095.9375
 /begin AXIS_DESCR FIX_AXIS NO_INPUT_QUANTITY CM_Equaloutput1 9 0 32 MAX_GRAD 0.0 /begin FIX_AXIS_PAR_LIST 0 4 8 12 16 20 24 28 32 /end FIX_AXIS_PAR_LIST /end AXIS_DESCR
/end CHARACTERISTIC
/begin CHARACTERISTIC CT_IdleAirflowColdOffset "cal comments" CURVE 0x9F28 2D_Array_UB 0.0 CM_Percent_0to100 0.0 99.609375
 /begin AXIS_DESCR FIX_AXIS NO_INPUT_QUANTITY CM_Equaloutput1 17 -28.0 164.0 MAX_GRAD 0.0 /begin FIX_AXIS_PAR_LIST -28 -16 -4 8 20 32 44 56 68 80 92 104 116 128 140 152 164 /end FIX_AXIS_PAR_LIST /end AXIS_DESCR
/end CHARACTERISTIC
/begin CHARACTERISTIC CT_IdleDerivEngSpdHigh "cal comments" CURVE 0x2 2D_Array_UB 0.0 CM_Percent_0to100 0.0 99.609375
 /begin AXIS_DESCR FIX_AXIS NO_INPUT_QUANTITY CM_Equaloutput1 17 0.0 128.0 MAX_GRAD 0.0 /begin FIX_AXIS_PAR_LIST 0 8 16 24 32 40 48 56 64 72 80 88 96 104 112 120 128 /end FIX_AXIS_PAR_LIST /end AXIS_DESCR
/end CHARACTERISTIC
/begin CHARACTERISTIC CT_IdleDerivEngSpdLow "cal comments" CURVE 0x2 2D_Array_UB 0.0 CM_Percent_0to100 0.0 99.609375
 /begin AXIS_DESCR FIX_AXIS NO_INPUT_QUANTITY CM_Equaloutput1 17 0.0 128.0 MAX_GRAD 0.0 /begin FIX_AXIS_PAR_LIST 0 8 16 24 32 40 48 56 64 72 80 88 96 104 112 120 128 /end FIX_AXIS_PAR_LIST /end AXIS_DESCR
/end CHARACTERISTIC
/begin CHARACTERISTIC C_IdleDesireSpdStartup "cal comments" VALUE 0x9EA4 Scalar_UW 0.0 udf_CM_18586 0.0 16383.75 /end CHARACTERISTIC
/begin CHARACTERISTIC CT_IdleIntGainEngSpdHigh "cal comments" CURVE 0x2 2D_Array_UB 0.0 CM_Mult0_to_2_ratio1 0.0 1.9921875
 /begin AXIS_DESCR COM_AXIS NO_INPUT_QUANTITY CM_RPM_0to16384 11 0.0 16383.75 AXIS_PTS_REF CA_EngSpd11Step2 MAX_GRAD 0.0 /end AXIS_DESCR
/end CHARACTERISTIC
/begin CHARACTERISTIC CT_IdleIntGainEngSpdLow "cal comments" CURVE 0x2 2D_Array_UB 0.0 CM_Mult0_to_2_ratio1 0.0 1.9921875
 /begin AXIS_DESCR COM_AXIS NO_INPUT_QUANTITY CM_RPM_0to16384 11 0.0 16383.75 AXIS_PTS_REF CA_EngSpd11Step2 MAX_GRAD 0.0 /end AXIS_DESCR
/end CHARACTERISTIC
/begin CHARACTERISTIC CT_IdlePropEngSpdHigh "cal comments" CURVE 0x2 2D_Array_UB 0.0 CM_Percent_0to100 0.0 99.609375
 /begin AXIS_DESCR COM_AXIS NO_INPUT_QUANTITY CM_RPM_0to16384 17 0.0 16383.75 AXIS_PTS_REF CA_EngSpd17Step4 MAX_GRAD 0.0 /end AXIS_DESCR
/end CHARACTERISTIC
/begin CHARACTERISTIC CT_IdlePropEngSpdLow "cal comments" CURVE 0x2 2D_Array_UB 0.0 CM_Percent_0to100 0.0 99.609375
 /begin AXIS_DESCR COM_AXIS NO_INPUT_QUANTITY CM_RPM_0to16384 17 0.0 16383.75 AXIS_PTS_REF CA_EngSpd17Step4 MAX_GRAD 0.0 /end AXIS_DESCR
/end CHARACTERISTIC
/begin CHARACTERISTIC CT_InjectorOffset "cal comments" CURVE 0x92DC 2D_Array_UB 0.0 CM_msec_0to4 0.0 3.984375
 /begin AXIS_DESCR FIX_AXIS NO_INPUT_QUANTITY CM_Equaloutput1 9 6.400000095367432 19.20000076293945 MAX_GRAD 0.0 /begin FIX_AXIS_PAR_LIST 6.4 8 9.6 11.2 12.8 14.4 16 17.6 19.2 /end FIX_AXIS_PAR_LIST /end AXIS_DESCR
/end CHARACTERISTIC
/begin CHARACTERISTIC CT_IntakeAirTemp "cal comments" CURVE 0xB6E8 2D_Array_SW 0.0 CM_DegC_N256to256 -256.0 255.9921875
 /begin AXIS_DESCR FIX_AXIS NO_INPUT_QUANTITY CM_Equaloutput1 33 0.0 100.0 MAX_GRAD 0.0
  /begin FIX_AXIS_PAR_LIST 0 3.125 6.25 9.375 12.5 15.625 18.75 21.875 25 28.125 31.25 34.375 37.5 40.625 43.75 46.875 50 53.125 56.25 59.375 62.5 65.625 68.75 71.875 75 78.125 81.25 84.375 87.5 90.625 93.75 96.875 100 /end FIX_AXIS_PAR_LIST
 /end AXIS_DESCR
/end CHARACTERISTIC
/begin CHARACTERISTIC CT_MAPCIDEnableMAPThresh "cal comments" CURVE 0xB770 2D_Array_UB 0.0 CM_kpa_8bit 0.0 127.5
 /begin AXIS_DESCR FIX_AXIS NO_INPUT_QUANTITY CM_Equaloutput1 17 0.0 12800.0 MAX_GRAD 0.0
  /begin FIX_AXIS_PAR_LIST 0 800 1600 2400 3200 4000 4800 5600 6400 7200 8000 8800 9600 10400 11200 12000 12800 /end FIX_AXIS_PAR_LIST
 /end AXIS_DESCR
/end CHARACTERISTIC
/begin CHARACTERISTIC CT_MAPDefault "cal comments" CURVE 0xB7CA 2D_Array_UW 0.0 CM_kpa_0to256_1 0.0 255.99609375
 /begin AXIS_DESCR FIX_AXIS NO_INPUT_QUANTITY CM_Equaloutput1 11 55.0 105.0 MAX_GRAD 0.0 /begin FIX_AXIS_PAR_LIST 55 60 65 70 75 80 85 90 95 100 105 /end FIX_AXIS_PAR_LIST /end AXIS_DESCR
/end CHARACTERISTIC
/begin CHARACTERISTIC CT_MAPEstimateMain "cal comments" MAP 0xB429 3D_Array_UB 0.0 CM_kpa_8bit 0.0 127.5
 /begin AXIS_DESCR COM_AXIS NO_INPUT_QUANTITY CM_RPM_0to16384 17 0.0 16383.75 AXIS_PTS_REF CA_EngSpd17Step2 MAX_GRAD 0.0 /end AXIS_DESCR
 /begin AXIS_DESCR FIX_AXIS NO_INPUT_QUANTITY CM_Equaloutput1 33 0.0 100.0 MAX_GRAD 0.0
  /begin FIX_AXIS_PAR_LIST 0 3.125 6.25 9.375 12.5 15.625 18.75 21.875 25 28.125 31.25 34.375 37.5 40.625 43.75 46.875 50 53.125 56.25 59.375 62.5 65.625 68.75 71.875 75 78.125 81.25 84.375 87.5 90.625 93.75 96.875 100 /end FIX_AXIS_PAR_LIST
 /end AXIS_DESCR
/end CHARACTERISTIC
/begin CHARACTERISTIC CT_MAPReadAngleMain "cal comments" MAP 0xB384 3D_Array_UW 0.0 CM_CrankAngle_0to1024 0.0 1023.984375
 /begin AXIS_DESCR COM_AXIS NO_INPUT_QUANTITY CM_kpa_0to256_1 9 0.0 255.99609375 AXIS_PTS_REF CA_MAP9Step1 MAX_GRAD 0.0 /end AXIS_DESCR
 /begin AXIS_DESCR COM_AXIS NO_INPUT_QUANTITY CM_RPM_0to16384 9 0.0 16383.75 AXIS_PTS_REF CA_EngSpd9Step1 MAX_GRAD 0.0 /end AXIS_DESCR
/end CHARACTERISTIC
/begin CHARACTERISTIC CT_O2ErrorCalcOffset "cal comments" CURVE 0x9AE0 2D_Array_UB 0.0 CM_mVolt 0.0 1016.0
 /begin AXIS_DESCR COM_AXIS NO_INPUT_QUANTITY CM_RPM_0to16384 4 0.0 16383.75 AXIS_PTS_REF CA_EngSpd4Step1 MAX_GRAD 0.0 /end AXIS_DESCR
/end CHARACTERISTIC
/begin CHARACTERISTIC CT_O2HeaterAccFuelMassThresh "cal comments" CURVE 0x91C2 2D_Array_UW 0.0 CM_Grams0to8_1 0.0 7.999755859375
 /begin AXIS_DESCR FIX_AXIS NO_INPUT_QUANTITY CM_Equaloutput1 17 -28.0 164.0 MAX_GRAD 0.0 /begin FIX_AXIS_PAR_LIST -28 -16 -4 8 20 32 44 56 68 80 92 104 116 128 140 152 164 /end FIX_AXIS_PAR_LIST /end AXIS_DESCR
/end CHARACTERISTIC
/begin CHARACTERISTIC CT_O2HeaterDutyCycleMain "cal comments" CURVE 0xB34A 2D_Array_UW 0.0 CM_Percent_0to200_2 0.0 199.9969024658203
 /begin AXIS_DESCR FIX_AXIS NO_INPUT_QUANTITY CM_Equaloutput1 17 -28.0 164.0 MAX_GRAD 0.0 /begin FIX_AXIS_PAR_LIST -28 -16 -4 8 20 32 44 56 68 80 92 104 116 128 140 152 164 /end FIX_AXIS_PAR_LIST /end AXIS_DESCR
/end CHARACTERISTIC
/begin CHARACTERISTIC CT_O2SignalFiltCoef "cal comments" CURVE 0x9A5C 2D_Array_UB 0.0 CM_FiltCoef_1 0.0 0.99609375
 /begin AXIS_DESCR COM_AXIS NO_INPUT_QUANTITY CM_RPM_0to16384 4 0.0 16383.75 AXIS_PTS_REF CA_EngSpd4Step1 MAX_GRAD 0.0 /end AXIS_DESCR
/end CHARACTERISTIC
/begin CHARACTERISTIC CT_PowerEnrichDelayTime "cal comments" CURVE 0x96C8 2D_Array_UW 0.0 CM_Second_0to1024 0.0 1023.984375
 /begin AXIS_DESCR FIX_AXIS NO_INPUT_QUANTITY CM_Equaloutput1 17 0.0 12800.0 MAX_GRAD 0.0
  /begin FIX_AXIS_PAR_LIST 0 800 1600 2400 3200 4000 4800 5600 6400 7200 8000 8800 9600 10400 11200 12000 12800 /end FIX_AXIS_PAR_LIST
 /end AXIS_DESCR
/end CHARACTERISTIC
/begin CHARACTERISTIC CT_PowerEnrichEnbTPSThresh "cal comments" CURVE 0x9BE8 2D_Array_UB 0.0 CM_Percent_0to200_3 0.0 199.21875
 /begin AXIS_DESCR COM_AXIS NO_INPUT_QUANTITY CM_RPM_0to16384 17 0.0 16383.75 AXIS_PTS_REF CA_EngSpd17Step1 MAX_GRAD 0.0 /end AXIS_DESCR
/end CHARACTERISTIC
/begin CHARACTERISTIC CT_PowerEnrichExitDelay "cal comments" CURVE 0x9800 2D_Array_UW 0.0 CM_Second_0to1024 0.0 1023.984375
 /begin AXIS_DESCR FIX_AXIS NO_INPUT_QUANTITY CM_Equaloutput1 17 0.0 12800.0 MAX_GRAD 0.0
  /begin FIX_AXIS_PAR_LIST 0 800 1600 2400 3200 4000 4800 5600 6400 7200 8000 8800 9600 10400 11200 12000 12800 /end FIX_AXIS_PAR_LIST
 /end AXIS_DESCR
/end CHARACTERISTIC
/begin CHARACTERISTIC CT_PrimePulseBaroMult "cal comments" CURVE 0x928E 2D_Array_UB 0.0 CM_Mult0_to_2_ratio 0.0 1.9921875
 /begin AXIS_DESCR FIX_AXIS NO_INPUT_QUANTITY CM_Equaloutput1 6 55.0 105.0 MAX_GRAD 0.0 /begin FIX_AXIS_PAR_LIST 55 65 75 85 95 105 /end FIX_AXIS_PAR_LIST /end AXIS_DESCR
/end CHARACTERISTIC
/begin CHARACTERISTIC CT_PrimePulseDelay "cal comments" CURVE 0x9256 2D_Array_UB 0.0 CM_Mult0_to_2_second 0.0 1.9921875
 /begin AXIS_DESCR FIX_AXIS NO_INPUT_QUANTITY CM_Equaloutput1 17 -28.0 164.0 MAX_GRAD 0.0 /begin FIX_AXIS_PAR_LIST -28 -16 -4 8 20 32 44 56 68 80 92 104 116 128 140 152 164 /end FIX_AXIS_PAR_LIST /end AXIS_DESCR
/end CHARACTERISTIC
/begin CHARACTERISTIC CT_PrimePulseWidth "cal comments" CURVE 0x9844 2D_Array_UW 0.0 CM_msec_0to1024 0.0 1023.984375
 /begin AXIS_DESCR FIX_AXIS NO_INPUT_QUANTITY CM_Equaloutput1 17 -28.0 164.0 MAX_GRAD 0.0 /begin FIX_AXIS_PAR_LIST -28 -16 -4 8 20 32 44 56 68 80 92 104 116 128 140 152 164 /end FIX_AXIS_PAR_LIST /end AXIS_DESCR
/end CHARACTERISTIC
/begin CHARACTERISTIC CT_PrimePulseWidth_NG "cal comments" CURVE 0x9868 2D_Array_UW 0.0 CM_msec_0to1024 0.0 1023.984375
 /begin AXIS_DESCR FIX_AXIS NO_INPUT_QUANTITY CM_Equaloutput1 17 -28.0 164.0 MAX_GRAD 0.0 /begin FIX_AXIS_PAR_LIST -28 -16 -4 8 20 32 44 56 68 80 92 104 116 128 140 152 164 /end FIX_AXIS_PAR_LIST /end AXIS_DESCR
/end CHARACTERISTIC
/begin CHARACTERISTIC CT_PrimePulseWidth_LPG "cal comments" CURVE 0x988C 2D_Array_UW 0.0 CM_msec_0to1024 0.0 1023.984375
 /begin AXIS_DESCR FIX_AXIS NO_INPUT_QUANTITY CM_Equaloutput1 17 -28.0 164.0 MAX_GRAD 0.0 /begin FIX_AXIS_PAR_LIST -28 -16 -4 8 20 32 44 56 68 80 92 104 116 128 140 152 164 /end FIX_AXIS_PAR_LIST /end AXIS_DESCR
/end CHARACTERISTIC
/begin CHARACTERISTIC CT_RunTimeThreshToEnbNextPrimePulse "cal comments" CURVE 0x926A 2D_Array_UW 0.0 CM_Second_0to512 0.0 511.9921875
 /begin AXIS_DESCR FIX_AXIS NO_INPUT_QUANTITY CM_Equaloutput1 17 -28.0 164.0 MAX_GRAD 0.0 /begin FIX_AXIS_PAR_LIST -28 -16 -4 8 20 32 44 56 68 80 92 104 116 128 140 152 164 /end FIX_AXIS_PAR_LIST /end AXIS_DESCR
/end CHARACTERISTIC
/begin CHARACTERISTIC CT_SACoolTempOfst "cal comments" MAP 0xA515 D_Array_SB 0.0 CM_Angle_8bit -64.0 63.5
 /begin AXIS_DESCR FIX_AXIS NO_INPUT_QUANTITY CM_Equaloutput1 17 -28.0 164.0 MAX_GRAD 0.0 /begin FIX_AXIS_PAR_LIST -28 -16 -4 8 20 32 44 56 68 80 92 104 116 128 140 152 164 /end FIX_AXIS_PAR_LIST /end AXIS_DESCR
 /begin AXIS_DESCR FIX_AXIS NO_INPUT_QUANTITY CM_Equaloutput1 9 15.0 115.0 MAX_GRAD 0.0 /begin FIX_AXIS_PAR_LIST 15 27.5 40 52.5 65 77.5 90 102.5 115 /end FIX_AXIS_PAR_LIST /end AXIS_DESCR
/end CHARACTERISTIC
/begin CHARACTERISTIC CT_SACrankBaroOffset "cal comments" CURVE 0xB021 2D_Array_SB 0.0 CM_Angle_8bit -64.0 63.5
 /begin AXIS_DESCR FIX_AXIS NO_INPUT_QUANTITY CM_Equaloutput1 11 55.0 105.0 MAX_GRAD 0.0 /begin FIX_AXIS_PAR_LIST 55 60 65 70 75 80 85 90 95 100 105 /end FIX_AXIS_PAR_LIST /end AXIS_DESCR
/end CHARACTERISTIC
/begin CHARACTERISTIC CT_SACrankMain "cal comments" CURVE 0xAFFB 2D_Array_SB 0.0 CM_Angle_8bit -64.0 63.5
 /begin AXIS_DESCR FIX_AXIS NO_INPUT_QUANTITY CM_Equaloutput1 17 -28.0 164.0 MAX_GRAD 0.0 /begin FIX_AXIS_PAR_LIST -28 -16 -4 8 20 32 44 56 68 80 92 104 116 128 140 152 164 /end FIX_AXIS_PAR_LIST /end AXIS_DESCR
/end CHARACTERISTIC
/begin CHARACTERISTIC CT_SAIntakeAirTempOfst "cal comments" MAP 0xA479 D_Array_SB 0.0 CM_Angle_8bit -64.0 63.5
 /begin AXIS_DESCR FIX_AXIS NO_INPUT_QUANTITY CM_Equaloutput1 17 -28.0 164.0 MAX_GRAD 0.0 /begin FIX_AXIS_PAR_LIST -28 -16 -4 8 20 32 44 56 68 80 92 104 116 128 140 152 164 /end FIX_AXIS_PAR_LIST /end AXIS_DESCR
 /begin AXIS_DESCR FIX_AXIS NO_INPUT_QUANTITY CM_Equaloutput1 9 15.0 115.0 MAX_GRAD 0.0 /begin FIX_AXIS_PAR_LIST 15 27.5 40 52.5 65 77.5 90 102.5 115 /end FIX_AXIS_PAR_LIST /end AXIS_DESCR
/end CHARACTERISTIC
/begin CHARACTERISTIC CT_SparkAdvanceMain "cal comments" MAP 0xA5B1 D_Array_SB 0.0 CM_Angle_8bit -64.0 63.5
 /begin AXIS_DESCR COM_AXIS NO_INPUT_QUANTITY CM_kpa_0to256_1 18 0.0 255.99609375 AXIS_PTS_REF CA_MAP18Step1 MAX_GRAD 0.0 /end AXIS_DESCR
 /begin AXIS_DESCR COM_AXIS NO_INPUT_QUANTITY CM_RPM_0to16384 17 0.0 16383.75 AXIS_PTS_REF CA_EngSpd17Step1 MAX_GRAD 0.0 /end AXIS_DESCR
/end CHARACTERISTIC
/begin CHARACTERISTIC CT_SparkAdvanceCyl2Offset2Main "cal comments" MAP 0xA6E6 D_Array_SB 0.0 CM_Angle_8bit -64.0 63.5
 /begin AXIS_DESCR COM_AXIS NO_INPUT_QUANTITY CM_kpa_0to256_1 18 0.0 255.99609375 AXIS_PTS_REF CA_MAP18Step1 MAX_GRAD 0.0 /end AXIS_DESCR
 /begin AXIS_DESCR COM_AXIS NO_INPUT_QUANTITY CM_RPM_0to16384 17 0.0 16383.75 AXIS_PTS_REF CA_EngSpd17Step1 MAX_GRAD 0.0 /end AXIS_DESCR
/end CHARACTERISTIC
/begin CHARACTERISTIC CT_SparkAdvanceCyl3Offset2Main "cal comments" MAP 0xA81B D_Array_SB 0.0 CM_Angle_8bit -64.0 63.5
 /begin AXIS_DESCR COM_AXIS NO_INPUT_QUANTITY CM_kpa_0to256_1 18 0.0 255.99609375 AXIS_PTS_REF CA_MAP18Step1 MAX_GRAD 0.0 /end AXIS_DESCR
 /begin AXIS_DESCR COM_AXIS NO_INPUT_QUANTITY CM_RPM_0to16384 17 0.0 16383.75 AXIS_PTS_REF CA_EngSpd17Step1 MAX_GRAD 0.0 /end AXIS_DESCR
/end CHARACTERISTIC
/begin CHARACTERISTIC CT_SparkAdvanceCyl4Offset2Main "cal comments" MAP 0xA950 D_Array_SB 0.0 CM_Angle_8bit -64.0 63.5
 /begin AXIS_DESCR COM_AXIS NO_INPUT_QUANTITY CM_kpa_0to256_1 18 0.0 255.99609375 AXIS_PTS_REF CA_MAP18Step1 MAX_GRAD 0.0 /end AXIS_DESCR
 /begin AXIS_DESCR COM_AXIS NO_INPUT_QUANTITY CM_RPM_0to16384 17 0.0 16383.75 AXIS_PTS_REF CA_EngSpd17Step1 MAX_GRAD 0.0 /end AXIS_DESCR
/end CHARACTERISTIC
/begin CHARACTERISTIC CT_SparkAdvanceSub "cal comments" MAP 0xAA85 D_Array_SB 0.0 CM_Angle_8bit -64.0 63.5
 /begin AXIS_DESCR COM_AXIS NO_INPUT_QUANTITY CM_kpa_0to256_1 18 0.0 255.99609375 AXIS_PTS_REF CA_MAP18Step1 MAX_GRAD 0.0 /end AXIS_DESCR
 /begin AXIS_DESCR COM_AXIS NO_INPUT_QUANTITY CM_RPM_0to16384 17 0.0 16383.75 AXIS_PTS_REF CA_EngSpd17Step1 MAX_GRAD 0.0 /end AXIS_DESCR
/end CHARACTERISTIC
/begin CHARACTERISTIC CT_SparkAdvanceCyl2Offset2Sub "cal comments" MAP 0xABBA D_Array_SB 0.0 CM_Angle_8bit -64.0 63.5
 /begin AXIS_DESCR COM_AXIS NO_INPUT_QUANTITY CM_kpa_0to256_1 18 0.0 255.99609375 AXIS_PTS_REF CA_MAP18Step1 MAX_GRAD 0.0 /end AXIS_DESCR
 /begin AXIS_DESCR COM_AXIS NO_INPUT_QUANTITY CM_RPM_0to16384 17 0.0 16383.75 AXIS_PTS_REF CA_EngSpd17Step1 MAX_GRAD 0.0 /end AXIS_DESCR
/end CHARACTERISTIC
/begin CHARACTERISTIC CT_SparkAdvanceCyl3Offset2Sub "cal comments" MAP 0xACEF D_Array_SB 0.0 CM_Angle_8bit -64.0 63.5
 /begin AXIS_DESCR COM_AXIS NO_INPUT_QUANTITY CM_kpa_0to256_1 18 0.0 255.99609375 AXIS_PTS_REF CA_MAP18Step1 MAX_GRAD 0.0 /end AXIS_DESCR
 /begin AXIS_DESCR COM_AXIS NO_INPUT_QUANTITY CM_RPM_0to16384 17 0.0 16383.75 AXIS_PTS_REF CA_EngSpd17Step1 MAX_GRAD 0.0 /end AXIS_DESCR
/end CHARACTERISTIC
/begin CHARACTERISTIC CT_SparkAdvanceCyl4Offset2Sub "cal comments" MAP 0xAE24 D_Array_SB 0.0 CM_Angle_8bit -64.0 63.5
 /begin AXIS_DESCR COM_AXIS NO_INPUT_QUANTITY CM_kpa_0to256_1 18 0.0 255.99609375 AXIS_PTS_REF CA_MAP18Step1 MAX_GRAD 0.0 /end AXIS_DESCR
 /begin AXIS_DESCR COM_AXIS NO_INPUT_QUANTITY CM_RPM_0to16384 17 0.0 16383.75 AXIS_PTS_REF CA_EngSpd17Step1 MAX_GRAD 0.0 /end AXIS_DESCR
/end CHARACTERISTIC
/begin CHARACTERISTIC C_PickupTooth2TDCAngle "cal comments" VALUE 0x800C Scalar_SW 0.0 CM_SparkAngle_N256to256 -256.0 255.9921875 /end CHARACTERISTIC
/begin CHARACTERISTIC CT_SAIdleMain "cal comments" CURVE 0xB00E 2D_Array_SB 0.0 CM_Angle_8bit -64.0 63.5
 /begin AXIS_DESCR FIX_AXIS NO_INPUT_QUANTITY CM_Equaloutput1 17 -28.0 164.0 MAX_GRAD 0.0 /begin FIX_AXIS_PAR_LIST -28 -16 -4 8 20 32 44 56 68 80 92 104 116 128 140 152 164 /end FIX_AXIS_PAR_LIST /end AXIS_DESCR
/end CHARACTERISTIC
/begin CHARACTERISTIC CT_SAIdleLimit "cal comments" CURVE 0xAF58 2D_Array_SB 0.0 CM_Angle_8bit -64.0 63.5
 /begin AXIS_DESCR COM_AXIS NO_INPUT_QUANTITY CM_RPM_0to16384 6 0.0 16383.75 AXIS_PTS_REF CA_EngSpd6Step1 MAX_GRAD 0.0 /end AXIS_DESCR
/end CHARACTERISTIC
/begin CHARACTERISTIC CT_SAIdleRPMoffset "cal comments" CURVE 0xAFB8 2D_Array_SB 0.0 CM_Angle_8bit -64.0 63.5
 /begin AXIS_DESCR COM_AXIS NO_INPUT_QUANTITY CM_RPM_0to16384 6 0.0 16383.75 AXIS_PTS_REF CA_EngSpd6Step1 MAX_GRAD 0.0 /end AXIS_DESCR
/end CHARACTERISTIC
/begin CHARACTERISTIC CT_SAIdleBaroComp "cal comments" CURVE 0xAF60 2D_Array_SB 0.0 CM_Angle_8bit -64.0 63.5
 /begin AXIS_DESCR FIX_AXIS NO_INPUT_QUANTITY CM_Equaloutput1 11 55.0 105.0 MAX_GRAD 0.0 /begin FIX_AXIS_PAR_LIST 55 60 65 70 75 80 85 90 95 100 105 /end FIX_AXIS_PAR_LIST /end AXIS_DESCR
/end CHARACTERISTIC
/begin CHARACTERISTIC CT_SAIdleBattComp "cal comments" CURVE 0xAF6D 2D_Array_SB 0.0 CM_Angle_8bit -64.0 63.5
 /begin AXIS_DESCR FIX_AXIS NO_INPUT_QUANTITY CM_Equaloutput1 17 6.0 18.79999923706055 MAX_GRAD 0.0
  /begin FIX_AXIS_PAR_LIST 6 6.8 7.6 8.4 9.199999999999999 10 10.8 11.6 12.4 13.2 14 14.8 15.6 16.4 17.2 18 18.8 /end FIX_AXIS_PAR_LIST
 /end AXIS_DESCR
/end CHARACTERISTIC
/begin CHARACTERISTIC CT_SAIdleDyn "cal comments" CURVE 0xAF80 2D_Array_SB 0.0 CM_Angle_8bit -64.0 63.5
 /begin AXIS_DESCR FIX_AXIS NO_INPUT_QUANTITY CM_Equaloutput1 33 -512.0 512.0 MAX_GRAD 0.0
  /begin FIX_AXIS_PAR_LIST -512 -480 -448 -416 -384 -352 -320 -288 -256 -224 -192 -160 -128 -96 -64 -32 0 32 64 96 128 160 192 224 256 288 320 352 384 416 448 480 512 /end FIX_AXIS_PAR_LIST
 /end AXIS_DESCR
/end CHARACTERISTIC
/begin CHARACTERISTIC C_SPRK_t_CtoIDLE_DelayTime "cal comments" VALUE 0xAFA2 Scalar_UW 0.0 CM_Seconds_1 0.0 2047.96875 /end CHARACTERISTIC
/begin CHARACTERISTIC C_SPRK_t_RtoIDLE_DelayTime "cal comments" VALUE 0xAFA4 Scalar_UW 0.0 CM_Seconds_1 0.0 2047.96875 /end CHARACTERISTIC
/begin CHARACTERISTIC CT_SparkDwellIntakeAirTempMult "cal comments" CURVE 0xAFC0 2D_Array_UB 0.0 CM_Mult0_to_2_ratio 0.0 1.9921875
 /begin AXIS_DESCR FIX_AXIS NO_INPUT_QUANTITY CM_Equaloutput1 9 -28.0 36.0 MAX_GRAD 0.0 /begin FIX_AXIS_PAR_LIST -28 -20 -12 -4 4 12 20 28 36 /end FIX_AXIS_PAR_LIST /end AXIS_DESCR
/end CHARACTERISTIC
/begin CHARACTERISTIC CT_SparkDwellMain "cal comments" MAP 0xA355 3D_Array_UB 0.0 CM_msec 0.0 15.9375
 /begin AXIS_DESCR FIX_AXIS NO_INPUT_QUANTITY CM_Equaloutput1 17 6.0 18.79999923706055 MAX_GRAD 0.0
  /begin FIX_AXIS_PAR_LIST 6 6.8 7.6 8.4 9.199999999999999 10 10.8 11.6 12.4 13.2 14 14.8 15.6 16.4 17.2 18 18.8 /end FIX_AXIS_PAR_LIST
 /end AXIS_DESCR
 /begin AXIS_DESCR FIX_AXIS NO_INPUT_QUANTITY CM_Equaloutput1 17 0.0 12800.0 MAX_GRAD 0.0
  /begin FIX_AXIS_PAR_LIST 0 800 1600 2400 3200 4000 4800 5600 6400 7200 8000 8800 9600 10400 11200 12000 12800 /end FIX_AXIS_PAR_LIST
 /end AXIS_DESCR
/end CHARACTERISTIC
/begin CHARACTERISTIC CT_SparkDwellMaxLimit "cal comments" CURVE 0xAFA8 2D_Array_UB 0.0 CM_msec 0.0 15.9375
 /begin AXIS_DESCR FIX_AXIS NO_INPUT_QUANTITY CM_Equaloutput1 9 0.0 12800.0 MAX_GRAD 0.0 /begin FIX_AXIS_PAR_LIST 0 1600 3200 4800 6400 8000 9600 11200 12800 /end FIX_AXIS_PAR_LIST /end AXIS_DESCR
/end CHARACTERISTIC
/begin CHARACTERISTIC CT_SpeedControlFlowBaroMult "cal comments" CURVE 0x9F3B 2D_Array_UB 0.0 CM_Mult_0to8 0.0 7.96875
 /begin AXIS_DESCR FIX_AXIS NO_INPUT_QUANTITY CM_Equaloutput1 6 55.0 105.0 MAX_GRAD 0.0 /begin FIX_AXIS_PAR_LIST 55 65 75 85 95 105 /end FIX_AXIS_PAR_LIST /end AXIS_DESCR
/end CHARACTERISTIC
/begin CHARACTERISTIC CT_ThrottleFlow "cal comments" CURVE 0x9EAE 2D_Array_UW 0.0 udf_CM_18698 0.0 511.9921875
 /begin AXIS_DESCR COM_AXIS NO_INPUT_QUANTITY CM_Percent_0to200_2 21 0.0 199.9969024658203 AXIS_PTS_REF CA_PercentStep21 MAX_GRAD 0.0 /end AXIS_DESCR
/end CHARACTERISTIC
/begin CHARACTERISTIC CT_ThrottleFlow_Reverse "cal comments" CURVE 0x9EDA 2D_Array_UW 0.0 CM_Percent_0to200_2 0.0 199.9969024658203
 /begin AXIS_DESCR COM_AXIS NO_INPUT_QUANTITY udf_CM_18705 21 0.0 511.9921875 AXIS_PTS_REF CA_GramStep21 MAX_GRAD 0.0 /end AXIS_DESCR
/end CHARACTERISTIC
/begin CHARACTERISTIC CT_TimpPulseWidthMult "cal comments" MAP 0x9C01 3D_Array_UB 0.0 CM_Mult_0to8 0.0 7.96875
 /begin AXIS_DESCR FIX_AXIS NO_INPUT_QUANTITY CM_Equaloutput1 9 -28.0 164.0 MAX_GRAD 0.0 /begin FIX_AXIS_PAR_LIST -28 -4 20 44 68 92 116 140 164 /end FIX_AXIS_PAR_LIST /end AXIS_DESCR
 /begin AXIS_DESCR FIX_AXIS NO_INPUT_QUANTITY CM_Equaloutput1 6 800.0 2800.0 MAX_GRAD 0.0 /begin FIX_AXIS_PAR_LIST 800 1200 1600 2000 2400 2800 /end FIX_AXIS_PAR_LIST /end AXIS_DESCR
/end CHARACTERISTIC
/begin CHARACTERISTIC CT_VEAltCorrFactor "cal comments" MAP 0x8EBD 3D_Array_UB 0.0 CM_Mult0_to_2_ratio 0.0 1.9921875
 /begin AXIS_DESCR COM_AXIS NO_INPUT_QUANTITY CM_kpa_0to256_1 6 0.0 255.99609375 AXIS_PTS_REF CA_VELoad6Step MAX_GRAD 0.0 /end AXIS_DESCR
 /begin AXIS_DESCR FIX_AXIS NO_INPUT_QUANTITY CM_Equaloutput1 11 55.0 105.0 MAX_GRAD 0.0 /begin FIX_AXIS_PAR_LIST 55 60 65 70 75 80 85 90 95 100 105 /end FIX_AXIS_PAR_LIST /end AXIS_DESCR
/end CHARACTERISTIC
/begin CHARACTERISTIC CT_VEMainHighLoadCyl1 "cal comments" MAP 0x82FC 3D_Array_UW 0.0 CM_Percent_0to200_2 0.0 199.9969024658203
 /begin AXIS_DESCR COM_AXIS NO_INPUT_QUANTITY CM_kpa_0to256_1 22 0.0 255.99609375 AXIS_PTS_REF CA_MAP22Step1 MAX_GRAD 0.0 /end AXIS_DESCR
 /begin AXIS_DESCR COM_AXIS NO_INPUT_QUANTITY CM_RPM_0to16384 17 0.0 16383.75 AXIS_PTS_REF CA_EngSpd17Step1 MAX_GRAD 0.0 /end AXIS_DESCR
/end CHARACTERISTIC
/begin CHARACTERISTIC CT_VEMainHighLoadCyl2 "cal comments" MAP 0x85EC 3D_Array_UW 0.0 CM_Percent_0to200_2 0.0 199.9969024658203
 /begin AXIS_DESCR COM_AXIS NO_INPUT_QUANTITY CM_kpa_0to256_1 22 0.0 255.99609375 AXIS_PTS_REF CA_MAP22Step1 MAX_GRAD 0.0 /end AXIS_DESCR
 /begin AXIS_DESCR COM_AXIS NO_INPUT_QUANTITY CM_RPM_0to16384 17 0.0 16383.75 AXIS_PTS_REF CA_EngSpd17Step1 MAX_GRAD 0.0 /end AXIS_DESCR
/end CHARACTERISTIC
/begin CHARACTERISTIC CT_VEMainHighLoadCyl3 "cal comments" MAP 0x88DC 3D_Array_UW 0.0 CM_Percent_0to200_2 0.0 199.9969024658203
 /begin AXIS_DESCR COM_AXIS NO_INPUT_QUANTITY CM_kpa_0to256_1 22 0.0 255.99609375 AXIS_PTS_REF CA_MAP22Step1 MAX_GRAD 0.0 /end AXIS_DESCR
 /begin AXIS_DESCR COM_AXIS NO_INPUT_QUANTITY CM_RPM_0to16384 17 0.0 16383.75 AXIS_PTS_REF CA_EngSpd17Step1 MAX_GRAD 0.0 /end AXIS_DESCR
/end CHARACTERISTIC
/begin CHARACTERISTIC CT_VEMainHighLoadCyl4 "cal comments" MAP 0x8BCC 3D_Array_UW 0.0 CM_Percent_0to200_2 0.0 199.9969024658203
 /begin AXIS_DESCR COM_AXIS NO_INPUT_QUANTITY CM_kpa_0to256_1 22 0.0 255.99609375 AXIS_PTS_REF CA_MAP22Step1 MAX_GRAD 0.0 /end AXIS_DESCR
 /begin AXIS_DESCR COM_AXIS NO_INPUT_QUANTITY CM_RPM_0to16384 17 0.0 16383.75 AXIS_PTS_REF CA_EngSpd17Step1 MAX_GRAD 0.0 /end AXIS_DESCR
/end CHARACTERISTIC
/begin CHARACTERISTIC C_VESynForCalEn "cal comments" VALUE 0x8EB8 Scalar_UB 0.0 CM_Boolean6 0.0 255.0 /end CHARACTERISTIC
/begin CHARACTERISTIC C_VETriFuelEn "cal comments" VALUE 0x8EB9 Scalar_UB 0.0 CM_Boolean6 0.0 255.0 /end CHARACTERISTIC
/begin CHARACTERISTIC CT_VirtualTPS "cal comments" CURVE 0xB376 2D_Array_UB 0.0 CM_Percent_0to200_3 0.0 199.21875
 /begin AXIS_DESCR COM_AXIS NO_INPUT_QUANTITY CM_kpa_0to256_1 10 0.0 255.99609375 AXIS_PTS_REF CA_MAP10Step1 MAX_GRAD 0.0 /end AXIS_DESCR
/end CHARACTERISTIC
/begin CHARACTERISTIC D_BatteryVoltTooHighThresh "cal comments" VALUE 0xC452 Scalar_UW 0.0 CM_Volt_0to32_2 0.0 31.99900627136231 /end CHARACTERISTIC
/begin CHARACTERISTIC D_BatteryVoltTooLowThresh "cal comments" VALUE 0xC454 Scalar_UW 0.0 CM_Volt_0to32_2 0.0 31.99900627136231 /end CHARACTERISTIC
/begin CHARACTERISTIC D_BatVoltDiagPassTimeThrsh "cal comments" VALUE 0xC492 Scalar_UW 0.0 CM_Count_0to65535_2 0.0 65535.0 /end CHARACTERISTIC
/begin CHARACTERISTIC D_BatVoltEnb "cal comments" VALUE 0xC498 Scalar_UB 0.0 CM_Boolean6 0.0 255.0 /end CHARACTERISTIC
/begin CHARACTERISTIC D_BatVoltHighFailTimeThrsh "cal comments" VALUE 0xC490 Scalar_UW 0.0 CM_Count_0to65535_2 0.0 65535.0 /end CHARACTERISTIC
/begin CHARACTERISTIC D_BatVoltLowFailTimeThrsh "cal comments" VALUE 0xC48E Scalar_UW 0.0 CM_Count_0to65535_2 0.0 65535.0 /end CHARACTERISTIC
/begin CHARACTERISTIC D_BatVoltRangeThreshHi "cal comments" VALUE 0xC496 Scalar_UW 0.0 CM_Volt_0to32_1 0.0 31.99900627136231 /end CHARACTERISTIC
/begin CHARACTERISTIC D_BatVoltRangeThreshLo "cal comments" VALUE 0xC494 Scalar_UW 0.0 CM_Volt_0to32_1 0.0 31.99900627136231 /end CHARACTERISTIC
/begin CHARACTERISTIC D_GENVDiagPassTimeThrsh "cal comments" VALUE 0x0 Scalar_UW 0.0 CM_Count_0to65535_2 0.0 65535.0 /end CHARACTERISTIC
/begin CHARACTERISTIC D_GENVEnb "cal comments" VALUE 0x0 Scalar_UB 0.0 CM_Boolean6 0.0 255.0 /end CHARACTERISTIC
/begin CHARACTERISTIC D_GENVHighFailTimeThrsh "cal comments" VALUE 0x0 Scalar_UW 0.0 CM_Count_0to65535_2 0.0 65535.0 /end CHARACTERISTIC
/begin CHARACTERISTIC D_GENVLowFailTimeThrsh "cal comments" VALUE 0x0 Scalar_UW 0.0 CM_Count_0to65535_2 0.0 65535.0 /end CHARACTERISTIC
/begin CHARACTERISTIC D_GENVRangeThreshHi "cal comments" VALUE 0x0 Scalar_UW 0.0 CM_Volt_0to1024_1 0.0 1023.984375 /end CHARACTERISTIC
/begin CHARACTERISTIC D_GENVRangeThreshLo "cal comments" VALUE 0x0 Scalar_UW 0.0 CM_Volt_0to1024_1 0.0 1023.984375 /end CHARACTERISTIC
/begin CHARACTERISTIC D_CoolTempShortEnb "cal comments" VALUE 0xC2B4 Scalar_UB 0.0 CM_Boolean6 0.0 255.0 /end CHARACTERISTIC
/begin CHARACTERISTIC D_CoolTempFailTimeThrsh "cal comments" VALUE 0xC2A8 Scalar_UW 0.0 CM_Count_0to65535_1 0.0 65535.0 /end CHARACTERISTIC
/begin CHARACTERISTIC D_CoolTempPassTimeThrsh "cal comments" VALUE 0xC2AA Scalar_UW 0.0 CM_Count_0to65535_1 0.0 65535.0 /end CHARACTERISTIC
/begin CHARACTERISTIC D_CoolTempShortRangeThreshHi "cal comments" VALUE 0xC2AC Scalar_UW 0.0 CM_Percent_0to100_1 0.0 99.9984130859375 /end CHARACTERISTIC
/begin CHARACTERISTIC D_CoolTempShortRangeThreshLo "cal comments" VALUE 0xC2AE Scalar_UW 0.0 CM_Percent_0to100_1 0.0 99.9984130859375 /end CHARACTERISTIC
/begin CHARACTERISTIC D_CoolTempOverHeatThresh "cal comments" VALUE 0xC2B0 Scalar_SW 0.0 CM_DegC_N256to256 -256.0 255.9921875 /end CHARACTERISTIC
/begin CHARACTERISTIC D_CoolTempOverHeat2Thresh "cal comments" VALUE 0xC2B2 Scalar_SW 0.0 CM_DegC_N256to256 -256.0 255.9921875 /end CHARACTERISTIC
/begin CHARACTERISTIC D_CoolTemp2ShortEnb "cal comments" VALUE 0xC2C6 Scalar_UB 0.0 CM_Boolean6 0.0 255.0 /end CHARACTERISTIC
/begin CHARACTERISTIC D_CoolTemp2FailTimeThrsh "cal comments" VALUE 0xC2BE Scalar_UW 0.0 CM_Count_0to65535_1 0.0 65535.0 /end CHARACTERISTIC
/begin CHARACTERISTIC D_CoolTemp2PassTimeThrsh "cal comments" VALUE 0xC2C0 Scalar_UW 0.0 CM_Count_0to65535_1 0.0 65535.0 /end CHARACTERISTIC
/begin CHARACTERISTIC D_CoolTemp2ShortRangeThreshHi "cal comments" VALUE 0xC2C2 Scalar_UW 0.0 CM_Percent_0to100_1 0.0 99.9984130859375 /end CHARACTERISTIC
/begin CHARACTERISTIC D_CoolTemp2ShortRangeThreshLo "cal comments" VALUE 0xC2C4 Scalar_UW 0.0 CM_Percent_0to100_1 0.0 99.9984130859375 /end CHARACTERISTIC
/begin CHARACTERISTIC D_FPShortEnb "cal comments" VALUE 0xC34A Scalar_UB 0.0 CM_Boolean6 0.0 255.0 /end CHARACTERISTIC
/begin CHARACTERISTIC D_FPShrtFailTimeThrsh "cal comments" VALUE 0xC33E Scalar_UB 0.0 CM_Count3 0.0 255.0 /end CHARACTERISTIC
/begin CHARACTERISTIC D_FPHLFailTimeThrsh "cal comments" VALUE 0xC33F Scalar_UB 0.0 CM_Count3 0.0 255.0 /end CHARACTERISTIC
/begin CHARACTERISTIC D_FPPassTimeThrsh "cal comments" VALUE 0xC340 Scalar_UB 0.0 CM_Count3 0.0 255.0 /end CHARACTERISTIC
/begin CHARACTERISTIC D_FPShortRangeThreshHi "cal comments" VALUE 0xC342 Scalar_UW 0.0 CM_Percent_0to100_1 0.0 99.9984130859375 /end CHARACTERISTIC
/begin CHARACTERISTIC D_FPShortRangeThreshLo "cal comments" VALUE 0xC344 Scalar_UW 0.0 CM_Percent_0to100_1 0.0 99.9984130859375 /end CHARACTERISTIC
/begin CHARACTERISTIC D_FPRangeThreshHi "cal comments" VALUE 0xC346 Scalar_SW 0.0 CM_kpa_n256to256_1 -256 255.9921875 /end CHARACTERISTIC
/begin CHARACTERISTIC D_FPRangeThreshLo "cal comments" VALUE 0xC348 Scalar_SW 0.0 CM_kpa_n256to256_1 -256 255.9921875 /end CHARACTERISTIC
/begin CHARACTERISTIC D_CrankNoisySignalFailTimeThrsh "cal comments" VALUE 0xC30C Scalar_UW 0.0 CM_Count_0to65535 0.0 65535.0 /end CHARACTERISTIC
/begin CHARACTERISTIC D_CrankNoisySignalPassTimeThrsh "cal comments" VALUE 0xC30E Scalar_UW 0.0 CM_Count_0to65535 0.0 65535.0 /end CHARACTERISTIC
/begin CHARACTERISTIC D_CrankNoisySignalToothErrThrsh "cal comments" VALUE 0xC30A Scalar_UW 0.0 CM_Count_0to65535 0.0 65535.0 /end CHARACTERISTIC
/begin CHARACTERISTIC D_CrankNoSignalDeltaIGNVoltThrsh "cal comments" VALUE 0xC314 Scalar_UW 0.0 CM_Volt_0to32_1 0.0 31.99900627136231 /end CHARACTERISTIC
/begin CHARACTERISTIC D_CrankNoSignalDeltaMAPThrsh "cal comments" VALUE 0xC310 Scalar_UW 0.0 CM_kpa_0to256_1 0.0 255.99609375 /end CHARACTERISTIC
/begin CHARACTERISTIC D_CrankNoSignalFailTimeThrsh "cal comments" VALUE 0xC312 Scalar_UW 0.0 CM_Second_0to512_1 0.0 511.9921875 /end CHARACTERISTIC
/begin CHARACTERISTIC D_CrankNoSignalPassTimeThrsh "cal comments" VALUE 0xC316 Scalar_UW 0.0 CM_Second_0to512_1 0.0 511.9921875 /end CHARACTERISTIC
/begin CHARACTERISTIC D_CrankSignalEnb "cal comments" VALUE 0xC318 Scalar_UB 0.0 CM_Boolean6 0.0 255.0 /end CHARACTERISTIC
/begin CHARACTERISTIC D_FuelPumpShortEnb "cal comments" VALUE 0xC331 Scalar_UB 0.0 CM_Boolean6 0.0 255.0 /end CHARACTERISTIC
/begin CHARACTERISTIC D_FuelPumpShortFailThresh "cal comments" VALUE 0xC332 Scalar_UB 0.0 CM_Count1 0.0 255.0 /end CHARACTERISTIC
/begin CHARACTERISTIC D_FuelPumpShortPassThresh "cal comments" VALUE 0xC333 Scalar_UB 0.0 CM_Count1 0.0 255.0 /end CHARACTERISTIC
/begin CHARACTERISTIC D_DCMShortEnb "cal comments" VALUE 0xC296 Scalar_UB 0.0 CM_Boolean6 0.0 255.0 /end CHARACTERISTIC
/begin CHARACTERISTIC D_DCMShortFailThresh "cal comments" VALUE 0xC297 Scalar_UB 0.0 CM_Count1 0.0 255.0 /end CHARACTERISTIC
/begin CHARACTERISTIC D_DCMShortPassThresh "cal comments" VALUE 0xC298 Scalar_UB 0.0 CM_Count1 0.0 255.0 /end CHARACTERISTIC
/begin CHARACTERISTIC D_CCPShortEnb "cal comments" VALUE 0x0 Scalar_UB 0.0 CM_Boolean6 0.0 255.0 /end CHARACTERISTIC
/begin CHARACTERISTIC D_CCPShortFailThresh "cal comments" VALUE 0x0 Scalar_UB 0.0 CM_Count1 0.0 255.0 /end CHARACTERISTIC
/begin CHARACTERISTIC D_CCPShortPassThresh "cal comments" VALUE 0x0 Scalar_UB 0.0 CM_Count1 0.0 255.0 /end CHARACTERISTIC
/begin CHARACTERISTIC D_IgnitionCoilEnb "cal comments" CURVE 0xC31D 2D_Array_UB 0.0 CM_Count1 0.0 1.0
 /begin AXIS_DESCR FIX_AXIS NO_INPUT_QUANTITY CM_EOI 4 0.0 4.0 MAX_GRAD 0.0 /begin FIX_AXIS_PAR_LIST 0 1 2 3 /end FIX_AXIS_PAR_LIST /end AXIS_DESCR
/end CHARACTERISTIC
/begin CHARACTERISTIC D_InjCyShortFailThresh "cal comments" CURVE 0xC45F 2D_Array_UB 0.0 CM_Count1 0.0 255.0
 /begin AXIS_DESCR FIX_AXIS NO_INPUT_QUANTITY CM_EOI 4 0.0 4.0 MAX_GRAD 0.0 /begin FIX_AXIS_PAR_LIST 0 1 2 3 /end FIX_AXIS_PAR_LIST /end AXIS_DESCR
/end CHARACTERISTIC
/begin CHARACTERISTIC D_InjCyShortPassThresh "cal comments" CURVE 0xC463 2D_Array_UB 0.0 CM_Count1 0.0 255.0
 /begin AXIS_DESCR FIX_AXIS NO_INPUT_QUANTITY CM_EOI 4 0.0 4.0 MAX_GRAD 0.0 /begin FIX_AXIS_PAR_LIST 0 1 2 3 /end FIX_AXIS_PAR_LIST /end AXIS_DESCR
/end CHARACTERISTIC
/begin CHARACTERISTIC D_InjectorCylEnb "cal comments" CURVE 0xC40F 2D_Array_UB 0.0 CM_Count1 0.0 1.0
 /begin AXIS_DESCR FIX_AXIS NO_INPUT_QUANTITY CM_EOI 4 0.0 4.0 MAX_GRAD 0.0 /begin FIX_AXIS_PAR_LIST 0 1 2 3 /end FIX_AXIS_PAR_LIST /end AXIS_DESCR
/end CHARACTERISTIC
/begin CHARACTERISTIC D_IntakeAirTempShortEnb "cal comments" VALUE 0xC3B4 Scalar_UB 0.0 CM_Boolean6 0.0 255.0 /end CHARACTERISTIC
/begin CHARACTERISTIC D_IntakeAirTempFailTimeThrsh "cal comments" VALUE 0xC3A9 Scalar_UB 0.0 CM_Count3 0.0 255.0 /end CHARACTERISTIC
/begin CHARACTERISTIC D_IntakeAirTempHiExpFailTimeThrsh "cal comments" VALUE 0xC3AA Scalar_UB 0.0 CM_Count3 0.0 255.0 /end CHARACTERISTIC
/begin CHARACTERISTIC D_IntakeAirTempPassTimeThrsh "cal comments" VALUE 0xC3AB Scalar_UB 0.0 CM_Count3 0.0 255.0 /end CHARACTERISTIC
/begin CHARACTERISTIC D_IntakeAirTempDiagRunTimeThrsh "cal comments" VALUE 0xC3A8 Scalar_UB 0.0 CM_Count3 0.0 255.0 /end CHARACTERISTIC
/begin CHARACTERISTIC D_IntakeAirTempShortRangeThreshHi "cal comments" VALUE 0xC3AC Scalar_UW 0.0 CM_Percent_0to100_1 0.0 99.9984130859375 /end CHARACTERISTIC
/begin CHARACTERISTIC D_IntakeAirTempShortRangeThreshLo "cal comments" VALUE 0xC3AE Scalar_UW 0.0 CM_Percent_0to100_1 0.0 99.9984130859375 /end CHARACTERISTIC
/begin CHARACTERISTIC D_IntakeAirOverTemp1Thresh "cal comments" VALUE 0xC3B0 Scalar_SW 0.0 CM_DegC_N256to256 -256.0 255.9921875 /end CHARACTERISTIC
/begin CHARACTERISTIC D_IntakeAirOverTemp2Thresh "cal comments" VALUE 0xC3B2 Scalar_SW 0.0 CM_DegC_N256to256 -256.0 255.9921875 /end CHARACTERISTIC
/begin CHARACTERISTIC D_SCIShortEnb "cal comments" VALUE 0xC3C6 Scalar_UB 0.0 CM_Boolean6 0.0 255.0 /end CHARACTERISTIC
/begin CHARACTERISTIC D_SCIFailTimeThrsh "cal comments" VALUE 0xC3BE Scalar_UW 0.0 CM_Count_0to65535_1 0.0 65535.0 /end CHARACTERISTIC
/begin CHARACTERISTIC D_SCIPassTimeThrsh "cal comments" VALUE 0xC3C0 Scalar_UW 0.0 CM_Count_0to65535_3 0.0 65535.0 /end CHARACTERISTIC
/begin CHARACTERISTIC D_SCIShortRangeThreshHi "cal comments" VALUE 0xC3C2 Scalar_UW 0.0 CM_Percent_0to100_1 0.0 99.9984130859375 /end CHARACTERISTIC
/begin CHARACTERISTIC D_SCIShortRangeThreshLo "cal comments" VALUE 0xC3C4 Scalar_UW 0.0 CM_Percent_0to100_1 0.0 99.9984130859375 /end CHARACTERISTIC
/begin CHARACTERISTIC D_ACSShortHighFailTimeThrsh "cal comments" VALUE 0xC3CC Scalar_UW 0.0 CM_Count_0to65535_1 0.0 65535.0 /end CHARACTERISTIC
/begin CHARACTERISTIC D_ACSShortHighPassTimeThrsh "cal comments" VALUE 0xC3CE Scalar_UW 0.0 CM_Count_0to65535_1 0.0 65535.0 /end CHARACTERISTIC
/begin CHARACTERISTIC D_ACSShortLowFailTimeThrsh "cal comments" VALUE 0xC3D0 Scalar_UW 0.0 CM_Count_0to65535_1 0.0 65535.0 /end CHARACTERISTIC
/begin CHARACTERISTIC D_ACSShortLowPassTimeThrsh "cal comments" VALUE 0xC3D2 Scalar_UW 0.0 CM_Count_0to65535_1 0.0 65535.0 /end CHARACTERISTIC
/begin CHARACTERISTIC D_ACSShortRangeThreshHi "cal comments" VALUE 0xC3D4 Scalar_UW 0.0 CM_Percent_0to100_1 0.0 99.9984130859375 /end CHARACTERISTIC
/begin CHARACTERISTIC D_ACSShortRangeThreshLo "cal comments" VALUE 0xC3D6 Scalar_UW 0.0 CM_Percent_0to100_1 0.0 99.9984130859375 /end CHARACTERISTIC
/begin CHARACTERISTIC D_ACSShortEnb "cal comments" VALUE 0xC3D8 Scalar_UB 0.0 CM_Boolean6 0.0 255.0 /end CHARACTERISTIC
/begin CHARACTERISTIC D_WPSShortHighFailTimeThrsh "cal comments" VALUE 0xC3DE Scalar_UW 0.0 CM_Count_0to65535_1 0.0 65535.0 /end CHARACTERISTIC
/begin CHARACTERISTIC D_WPSShortHighPassTimeThrsh "cal comments" VALUE 0xC3E0 Scalar_UW 0.0 CM_Count_0to65535_1 0.0 65535.0 /end CHARACTERISTIC
/begin CHARACTERISTIC D_WPSShortLowFailTimeThrsh "cal comments" VALUE 0xC3E2 Scalar_UW 0.0 CM_Count_0to65535_1 0.0 65535.0 /end CHARACTERISTIC
/begin CHARACTERISTIC D_WPSShortLowPassTimeThrsh "cal comments" VALUE 0xC3E4 Scalar_UW 0.0 CM_Count_0to65535_1 0.0 65535.0 /end CHARACTERISTIC
/begin CHARACTERISTIC D_WPSShortRangeThreshHi "cal comments" VALUE 0xC3E6 Scalar_UW 0.0 CM_Percent_0to100_1 0.0 99.9984130859375 /end CHARACTERISTIC
/begin CHARACTERISTIC D_WPSShortRangeThreshLo "cal comments" VALUE 0xC3E8 Scalar_UW 0.0 CM_Percent_0to100_1 0.0 99.9984130859375 /end CHARACTERISTIC
/begin CHARACTERISTIC D_WPSShortEnb "cal comments" VALUE 0xC3EA Scalar_UB 0.0 CM_Boolean6 0.0 255.0 /end CHARACTERISTIC
/begin CHARACTERISTIC D_MAPShortEnb "cal comments" VALUE 0xC43E Scalar_UB 0.0 CM_Boolean6 0.0 255.0 /end CHARACTERISTIC
/begin CHARACTERISTIC D_MAPShortHiDiagFailThrsh "cal comments" VALUE 0xC43C Scalar_UW 0.0 CM_Percent_0to100_1 0.0 99.9984130859375 /end CHARACTERISTIC
/begin CHARACTERISTIC D_MAPShortHiEngSpdThrsh "cal comments" VALUE 0xC434 Scalar_UW 0.0 CM_RPM_0to16384 0.0 16383.75 /end CHARACTERISTIC
/begin CHARACTERISTIC D_MAPShortHighFailTimeThrsh "cal comments" VALUE 0xC42C Scalar_UW 0.0 CM_Count_0to65535_2 0.0 65535.0 /end CHARACTERISTIC
/begin CHARACTERISTIC D_MAPShortHighPassTimeThrsh "cal comments" VALUE 0xC42E Scalar_UW 0.0 CM_Count_0to65535_2 0.0 65535.0 /end CHARACTERISTIC
/begin CHARACTERISTIC D_MAPShortHiSpdHiTPSThrsh "cal comments" VALUE 0xC426 Scalar_UW 0.0 CM_Percent_0to200_2 0.0 199.9969024658203 /end CHARACTERISTIC
/begin CHARACTERISTIC D_MAPShortHiSpdLoTPSThrsh "cal comments" VALUE 0xC424 Scalar_UW 0.0 CM_Percent_0to200_2 0.0 199.9969024658203 /end CHARACTERISTIC
/begin CHARACTERISTIC D_MAPShortLoDiagFailThrsh "cal comments" VALUE 0xC43A Scalar_UW 0.0 CM_Percent_0to100_1 0.0 99.9984130859375 /end CHARACTERISTIC
/begin CHARACTERISTIC D_MAPShortLoEngSpdThrsh "cal comments" VALUE 0xC436 Scalar_UW 0.0 CM_RPM_0to16384 0.0 16383.75 /end CHARACTERISTIC
/begin CHARACTERISTIC D_MAPShortLoSpdHiTPSThrsh "cal comments" VALUE 0xC428 Scalar_UW 0.0 CM_Percent_0to200_2 0.0 199.9969024658203 /end CHARACTERISTIC
/begin CHARACTERISTIC D_MAPShortLoSpdLoTPSThrsh "cal comments" VALUE 0xC42A Scalar_UW 0.0 CM_Percent_0to200_2 0.0 199.9969024658203 /end CHARACTERISTIC
/begin CHARACTERISTIC D_MAPShortHiRunTimeThrsh "cal comments" VALUE 0xC438 Scalar_UW 0.0 CM_Count_0to65535_2 0.0 65535.0 /end CHARACTERISTIC
/begin CHARACTERISTIC D_MAPShortLowFailTimeThrsh "cal comments" VALUE 0xC430 Scalar_UW 0.0 CM_Count_0to65535_2 0.0 65535.0 /end CHARACTERISTIC
/begin CHARACTERISTIC D_MAPShortLowPassTimeThrsh "cal comments" VALUE 0xC432 Scalar_UW 0.0 CM_Count_0to65535_2 0.0 65535.0 /end CHARACTERISTIC
/begin CHARACTERISTIC D_BSTPShortEnb "cal comments" VALUE 0xC40A Scalar_UB 0.0 CM_Boolean6 0.0 255.0 /end CHARACTERISTIC
/begin CHARACTERISTIC D_BSTPShortHiDiagFailThrsh "cal comments" VALUE 0xC408 Scalar_UW 0.0 CM_Percent_0to100_1 0.0 99.9984130859375 /end CHARACTERISTIC
/begin CHARACTERISTIC D_BSTPShortHiEngSpdThrsh "cal comments" VALUE 0xC400 Scalar_UW 0.0 CM_RPM_0to16384 0.0 16383.75 /end CHARACTERISTIC
/begin CHARACTERISTIC D_BSTPShortHighFailTimeThrsh "cal comments" VALUE 0xC3F8 Scalar_UW 0.0 CM_Count_0to65535_2 0.0 65535.0 /end CHARACTERISTIC
/begin CHARACTERISTIC D_BSTPShortHighPassTimeThrsh "cal comments" VALUE 0xC3FA Scalar_UW 0.0 CM_Count_0to65535_2 0.0 65535.0 /end CHARACTERISTIC
/begin CHARACTERISTIC D_BSTPShortHiSpdHiTPSThrsh "cal comments" VALUE 0xC3F2 Scalar_UW 0.0 CM_Percent_0to200_2 0.0 199.9969024658203 /end CHARACTERISTIC
/begin CHARACTERISTIC D_BSTPShortHiSpdLoTPSThrsh "cal comments" VALUE 0xC3F0 Scalar_UW 0.0 CM_Percent_0to200_2 0.0 199.9969024658203 /end CHARACTERISTIC
/begin CHARACTERISTIC D_BSTPShortLoDiagFailThrsh "cal comments" VALUE 0xC406 Scalar_UW 0.0 CM_Percent_0to100_1 0.0 99.9984130859375 /end CHARACTERISTIC
/begin CHARACTERISTIC D_BSTPShortLoEngSpdThrsh "cal comments" VALUE 0xC402 Scalar_UW 0.0 CM_RPM_0to16384 0.0 16383.75 /end CHARACTERISTIC
/begin CHARACTERISTIC D_BSTPShortLoSpdHiTPSThrsh "cal comments" VALUE 0xC3F4 Scalar_UW 0.0 CM_Percent_0to200_2 0.0 199.9969024658203 /end CHARACTERISTIC
/begin CHARACTERISTIC D_BSTPShortLoSpdLoTPSThrsh "cal comments" VALUE 0xC3F6 Scalar_UW 0.0 CM_Percent_0to200_2 0.0 199.9969024658203 /end CHARACTERISTIC
/begin CHARACTERISTIC D_BSTPShortLowFailTimeThrsh "cal comments" VALUE 0xC3FC Scalar_UW 0.0 CM_Count_0to65535_2 0.0 65535.0 /end CHARACTERISTIC
/begin CHARACTERISTIC D_BSTPShortLowPassTimeThrsh "cal comments" VALUE 0xC3FE Scalar_UW 0.0 CM_Count_0to65535_2 0.0 65535.0 /end CHARACTERISTIC
/begin CHARACTERISTIC D_BSTPShortHiRunTimeThrsh "cal comments" VALUE 0xC404 Scalar_UW 0.0 CM_Count_0to65535_2 0.0 65535.0 /end CHARACTERISTIC
/begin CHARACTERISTIC D_O21ShortDiagCoolTempThrsh "cal comments" VALUE 0xC2D0 Scalar_SW 0.0 CM_DegC_N256to256 -256.0 255.9921875 /end CHARACTERISTIC
/begin CHARACTERISTIC D_O21ShortDiagEnableDelay "cal comments" VALUE 0xC2D2 Scalar_UW 0.0 CM_Second_0to65535 0.0 65535.0 /end CHARACTERISTIC
/begin CHARACTERISTIC D_O21ShortDiagIGNVoltThrsh "cal comments" VALUE 0xC2CE Scalar_UW 0.0 CM_Volt_0to32_1 0.0 31.99900627136231 /end CHARACTERISTIC
/begin CHARACTERISTIC D_O21ShortDiagPassTimeThrsh "cal comments" VALUE 0xC2DC Scalar_UW 0.0 CM_Count_0to65535_1 0.0 65535.0 /end CHARACTERISTIC
/begin CHARACTERISTIC D_O21ShortDiagSingalFiltCoef "cal comments" VALUE 0xC2CC Scalar_UW 0.0 CM_FiltCoef 0.0 0.9999847412109375 /end CHARACTERISTIC
/begin CHARACTERISTIC D_O21ShortEnb "cal comments" VALUE 0xC2DE Scalar_UB 0.0 CM_Boolean6 0.0 255.0 /end CHARACTERISTIC
/begin CHARACTERISTIC D_O21ShortHighFailTimeThrsh "cal comments" VALUE 0xC2DA Scalar_UW 0.0 CM_Count_0to65535_1 0.0 65535.0 /end CHARACTERISTIC
/begin CHARACTERISTIC D_O21ShortLowFailTimeThrsh "cal comments" VALUE 0xC2D8 Scalar_UW 0.0 CM_Count_0to65535_1 0.0 65535.0 /end CHARACTERISTIC
/begin CHARACTERISTIC D_O21ShortRangeThreshHi "cal comments" VALUE 0xC2D6 Scalar_UW 0.0 CM_mVolt_2 0.0 1023.96875 /end CHARACTERISTIC
/begin CHARACTERISTIC D_O21ShortRangeThreshLo "cal comments" VALUE 0xC2D4 Scalar_UW 0.0 CM_mVolt_2 0.0 1023.96875 /end CHARACTERISTIC
/begin CHARACTERISTIC D_RO21ShortDiagCoolTempThrsh "cal comments" VALUE 0xC2E8 Scalar_SW 0.0 CM_DegC_N256to256 -256.0 255.9921875 /end CHARACTERISTIC
/begin CHARACTERISTIC D_RO21ShortDiagEnableDelay "cal comments" VALUE 0xC2EA Scalar_UW 0.0 CM_Second_0to65535 0.0 65535.0 /end CHARACTERISTIC
/begin CHARACTERISTIC D_RO21ShortDiagIGNVoltThrsh "cal comments" VALUE 0xC2E6 Scalar_UW 0.0 CM_Volt_0to32_1 0.0 31.99900627136231 /end CHARACTERISTIC
/begin CHARACTERISTIC D_RO21ShortDiagPassTimeThrsh "cal comments" VALUE 0xC2F4 Scalar_UW 0.0 CM_Count_0to65535_1 0.0 65535.0 /end CHARACTERISTIC
/begin CHARACTERISTIC D_RO21ShortDiagSingalFiltCoef "cal comments" VALUE 0xC2E4 Scalar_UW 0.0 CM_FiltCoef 0.0 0.9999847412109375 /end CHARACTERISTIC
/begin CHARACTERISTIC D_RO21ShortEnb "cal comments" VALUE 0xC2F6 Scalar_UB 0.0 CM_Boolean6 0.0 255.0 /end CHARACTERISTIC
/begin CHARACTERISTIC D_RO21ShortHighFailTimeThrsh "cal comments" VALUE 0xC2F2 Scalar_UW 0.0 CM_Count_0to65535_1 0.0 65535.0 /end CHARACTERISTIC
/begin CHARACTERISTIC D_RO21ShortLowFailTimeThrsh "cal comments" VALUE 0xC2F0 Scalar_UW 0.0 CM_Count_0to65535_1 0.0 65535.0 /end CHARACTERISTIC
/begin CHARACTERISTIC D_RO21ShortRangeThreshHi "cal comments" VALUE 0xC2EE Scalar_UW 0.0 CM_mVolt_2 0.0 1023.96875 /end CHARACTERISTIC
/begin CHARACTERISTIC D_RO21ShortRangeThreshLo "cal comments" VALUE 0xC2EC Scalar_UW 0.0 CM_mVolt_2 0.0 1023.96875 /end CHARACTERISTIC
/begin CHARACTERISTIC D_O2HeaterShortEnb "cal comments" VALUE 0xC362 Scalar_UB 0.0 CM_Boolean6 0.0 255.0 /end CHARACTERISTIC
/begin CHARACTERISTIC D_O2HeaterShortFailThresh "cal comments" VALUE 0xC363 Scalar_UB 0.0 CM_Count1 0.0 255.0 /end CHARACTERISTIC
/begin CHARACTERISTIC D_O2HeaterShortPassThresh "cal comments" VALUE 0xC364 Scalar_UB 0.0 CM_Count1 0.0 255.0 /end CHARACTERISTIC
/begin CHARACTERISTIC D_RO2Heater1ShortEnb "cal comments" VALUE 0xC369 Scalar_UB 0.0 CM_Boolean6 0.0 255.0 /end CHARACTERISTIC
/begin CHARACTERISTIC D_RO2Heater1ShortFailThresh "cal comments" VALUE 0xC36A Scalar_UB 0.0 CM_Count1 0.0 255.0 /end CHARACTERISTIC
/begin CHARACTERISTIC D_RO2Heater1ShortPassThresh "cal comments" VALUE 0xC36B Scalar_UB 0.0 CM_Count1 0.0 255.0 /end CHARACTERISTIC
/begin CHARACTERISTIC D_BSTCShortEnb "cal comments" VALUE 0xC393 Scalar_UB 0.0 CM_Boolean6 0.0 255.0 /end CHARACTERISTIC
/begin CHARACTERISTIC D_BSTCShortFailThresh "cal comments" VALUE 0xC394 Scalar_UB 0.0 CM_Count1 0.0 255.0 /end CHARACTERISTIC
/begin CHARACTERISTIC D_BSTCShortPassThresh "cal comments" VALUE 0xC395 Scalar_UB 0.0 CM_Count1 0.0 255.0 /end CHARACTERISTIC
/begin CHARACTERISTIC D_REF1ShortEnb "cal comments" VALUE 0xC385 Scalar_UB 0.0 CM_Boolean6 0.0 255.0 /end CHARACTERISTIC
/begin CHARACTERISTIC D_REF1ShortFailThresh "cal comments" VALUE 0xC386 Scalar_UB 0.0 CM_Count1 0.0 255.0 /end CHARACTERISTIC
/begin CHARACTERISTIC D_REF1ShortPassThresh "cal comments" VALUE 0xC387 Scalar_UB 0.0 CM_Count1 0.0 255.0 /end CHARACTERISTIC
/begin CHARACTERISTIC D_REF2ShortEnb "cal comments" VALUE 0xC38C Scalar_UB 0.0 CM_Boolean6 0.0 255.0 /end CHARACTERISTIC
/begin CHARACTERISTIC D_REF2ShortFailThresh "cal comments" VALUE 0xC38D Scalar_UB 0.0 CM_Count1 0.0 255.0 /end CHARACTERISTIC
/begin CHARACTERISTIC D_REF2ShortPassThresh "cal comments" VALUE 0xC38E Scalar_UB 0.0 CM_Count1 0.0 255.0 /end CHARACTERISTIC
/begin CHARACTERISTIC D_BLM_TrimEnb "cal comments" VALUE 0xC2FC Scalar_UB 0.0 CM_Boolean6 0.0 255.0 /end CHARACTERISTIC
/begin CHARACTERISTIC D_BLM_FailThresh "cal comments" VALUE 0xC302 Scalar_UB 0.0 CM_Count1 0.0 255.0 /end CHARACTERISTIC
/begin CHARACTERISTIC D_BLM_PassThresh "cal comments" VALUE 0xC304 Scalar_UB 0.0 CM_Count1 0.0 255.0 /end CHARACTERISTIC
/begin CHARACTERISTIC D_BLM_TrimHiLimit "cal comments" VALUE 0xC2FE Scalar_UW 0.0 CM_Ratio_0to2_2 0.0 1.999969482421875 /end CHARACTERISTIC
/begin CHARACTERISTIC D_BLM_TrimLoLimit "cal comments" VALUE 0xC300 Scalar_UW 0.0 CM_Ratio_0to2_2 0.0 1.999969482421875 /end CHARACTERISTIC
/begin CHARACTERISTIC D_BLM_CellCntThresh "cal comments" VALUE 0xC2FD Scalar_UB 0.0 CM_Count1 0.0 255.0 /end CHARACTERISTIC
/begin CHARACTERISTIC D_FCV1ShortEnb "cal comments" VALUE 0xC377 Scalar_UB 0.0 CM_Boolean6 0.0 255.0 /end CHARACTERISTIC
/begin CHARACTERISTIC D_IACVShortEnb "cal comments" VALUE 0xC370 Scalar_UB 0.0 CM_Boolean6 0.0 255.0 /end CHARACTERISTIC
/begin CHARACTERISTIC D_IACVShortFailThresh "cal comments" VALUE 0xC371 Scalar_UB 0.0 CM_Count1 0.0 255.0 /end CHARACTERISTIC
/begin CHARACTERISTIC D_IACVShortPassThresh "cal comments" VALUE 0xC372 Scalar_UB 0.0 CM_Count1 0.0 255.0 /end CHARACTERISTIC
/begin CHARACTERISTIC D_FCV1ShortFailThresh "cal comments" VALUE 0xC378 Scalar_UB 0.0 CM_Count1 0.0 255.0 /end CHARACTERISTIC
/begin CHARACTERISTIC D_FCV1ShortPassThresh "cal comments" VALUE 0xC379 Scalar_UB 0.0 CM_Count1 0.0 255.0 /end CHARACTERISTIC
/begin CHARACTERISTIC D_FCV2ShortEnb "cal comments" VALUE 0xC37E Scalar_UB 0.0 CM_Boolean6 0.0 255.0 /end CHARACTERISTIC
/begin CHARACTERISTIC D_FCV2ShortFailThresh "cal comments" VALUE 0xC37F Scalar_UB 0.0 CM_Count1 0.0 255.0 /end CHARACTERISTIC
/begin CHARACTERISTIC D_FCV2ShortPassThresh "cal comments" VALUE 0xC380 Scalar_UB 0.0 CM_Count1 0.0 255.0 /end CHARACTERISTIC
/begin CHARACTERISTIC D_OutputDiagEnableDelay "cal comments" VALUE 0xC456 Scalar_UB 0.0 CM_Second_0to64 0.0 63.75 /end CHARACTERISTIC
/begin CHARACTERISTIC D_SoftwareErrorEnb "cal comments" VALUE 0xC46C Scalar_UB 0.0 CM_Boolean6 0.0 255.0 /end CHARACTERISTIC
/begin CHARACTERISTIC D_SoftwareErrorFailTimeThrsh "cal comments" VALUE 0xC468 Scalar_UW 0.0 CM_Count_0to65535_2 0.0 65535.0 /end CHARACTERISTIC
/begin CHARACTERISTIC D_SoftwareErrorPassTimeThrsh "cal comments" VALUE 0xC46A Scalar_UW 0.0 CM_Count_0to65535_2 0.0 65535.0 /end CHARACTERISTIC
/begin CHARACTERISTIC D_FPFeedbackInputEnb "cal comments" VALUE 0xC33A Scalar_UB 0.0 CM_Boolean6 0.0 255.0 /end CHARACTERISTIC
/begin CHARACTERISTIC D_FPFeedbackShortFailThresh "cal comments" VALUE 0xC338 Scalar_UB 0.0 CM_Count3 0.0 255.0 /end CHARACTERISTIC
/begin CHARACTERISTIC D_FPFeedbackShortPassThresh "cal comments" VALUE 0xC339 Scalar_UB 0.0 CM_Count3 0.0 255.0 /end CHARACTERISTIC
/begin AXIS_PTS CA_TPS11Step "AXIS comments" 0xA296 NO_INPUT_QUANTITY AxisPtsX_UW 0.0 CM_Percent_0to200_2 11 0.0 199.9969024658203 /end AXIS_PTS
/begin AXIS_PTS CA_GENV11Step "AXIS comments" 0x2 NO_INPUT_QUANTITY AxisPtsX_UW 0.0 CM_Volt_0to1024_1 11 0.0 1023.984375 /end AXIS_PTS
/begin AXIS_PTS CA_WPGOV9Step "AXIS comments" 0x2 NO_INPUT_QUANTITY AxisPtsX_UW 0.0 CM_mpa_0to16_1 9 0.0 15.999755859375 /end AXIS_PTS
/begin AXIS_PTS CA_EngSpd10Step1 "AXIS comments" 0x8076 NO_INPUT_QUANTITY AxisPtsX_UW 0.0 CM_RPM_0to16384 10 0.0 16383.75 /end AXIS_PTS
/begin AXIS_PTS CA_EngSpd17Step1 "AXIS comments" 0x80BC NO_INPUT_QUANTITY AxisPtsX_UW 0.0 CM_RPM_0to16384 17 0.0 16383.75 /end AXIS_PTS
/begin AXIS_PTS CA_EngSpd17Step2 "AXIS comments" 0x8196 NO_INPUT_QUANTITY AxisPtsX_UW 0.0 CM_RPM_0to16384 17 0.0 16383.75 /end AXIS_PTS
/begin AXIS_PTS CA_EngSpd17Step4 "AXIS comments" 0x81BA NO_INPUT_QUANTITY AxisPtsX_UW 0.0 CM_RPM_0to16384 17 0.0 16383.75 /end AXIS_PTS
/begin AXIS_PTS CA_EngSpd11Step1 "AXIS comments" 0xB02E NO_INPUT_QUANTITY AxisPtsX_UW 0.0 CM_RPM_0to16384 11 0.0 16383.75 /end AXIS_PTS
/begin AXIS_PTS CA_EngSpd11Step2 "AXIS comments" 0x808C NO_INPUT_QUANTITY AxisPtsX_UW 0.0 CM_RPM_0to16384 11 0.0 16383.75 /end AXIS_PTS
/begin AXIS_PTS CA_EngSpd11Step3 "AXIS comments" 0x80A4 NO_INPUT_QUANTITY AxisPtsX_UW 0.0 CM_RPM_0to16384 11 0.0 16383.75 /end AXIS_PTS
/begin AXIS_PTS CA_EngSpd11Step4 "AXIS comments" 0xB046 NO_INPUT_QUANTITY AxisPtsX_UW 0.0 CM_RPM_0to16384 11 0.0 16383.75 /end AXIS_PTS
/begin AXIS_PTS CA_EngSpd4Step1 "AXIS comments" 0x8204 NO_INPUT_QUANTITY AxisPtsX_UW 0.0 CM_RPM_0to16384 4 0.0 16383.75 /end AXIS_PTS
/begin AXIS_PTS CA_EngSpd6Step1 "AXIS comments" 0x81F6 NO_INPUT_QUANTITY AxisPtsX_UW 0.0 CM_RPM_0to16384 6 0.0 16383.75 /end AXIS_PTS
/begin AXIS_PTS CA_EngSpd6Step2 "AXIS comments" 0x81DE NO_INPUT_QUANTITY AxisPtsX_UW 0.0 CM_RPM_0to16384 6 0.0 16383.75 /end AXIS_PTS
/begin AXIS_PTS CA_EngSpd9Step1 "AXIS comments" 0x8062 NO_INPUT_QUANTITY AxisPtsX_UW 0.0 CM_RPM_0to16384 9 0.0 16383.75 /end AXIS_PTS
/begin AXIS_PTS CA_GramStep21 "AXIS comments" 0x825E NO_INPUT_QUANTITY AxisPtsX_UW 0.0 udf_CM_18705 21 0.0 511.9921875 /end AXIS_PTS
/begin AXIS_PTS CA_AirGramStep17 "AXIS comments" 0x823A NO_INPUT_QUANTITY AxisPtsX_UW 0.0 udf_CM_18705 17 0.0 511.9921875 /end AXIS_PTS
/begin AXIS_PTS CA_FuelGramStep17 "AXIS comments" 0xB934 NO_INPUT_QUANTITY AxisPtsX_UW 0.0 udf_CM_16444 17 0.0 15.999755859375 /end AXIS_PTS
/begin AXIS_PTS CA_MAP10Step1 "AXIS comments" 0x812C NO_INPUT_QUANTITY AxisPtsX_UW 0.0 CM_kpa_0to256_1 10 0.0 255.99609375 /end AXIS_PTS
/begin AXIS_PTS CA_MAP18Step1 "AXIS comments" 0x8142 NO_INPUT_QUANTITY AxisPtsX_UW 0.0 CM_kpa_0to256_1 18 0.0 255.99609375 /end AXIS_PTS
/begin AXIS_PTS CA_MAP15Step1 "AXIS comments" 0xC01C NO_INPUT_QUANTITY AxisPtsX_UW 0.0 CM_kpa_0to256_1 15 0.0 255.99609375 /end AXIS_PTS
/begin AXIS_PTS CA_MAP22Step1 "AXIS comments" 0x8168 NO_INPUT_QUANTITY AxisPtsX_UW 0.0 CM_kpa_0to256_1 22 0.0 255.99609375 /end AXIS_PTS
/begin AXIS_PTS CA_MAP8Step1 "AXIS comments" 0x811A NO_INPUT_QUANTITY AxisPtsX_SW 0.0 CM_kpa_n256to256_1 8 -256 255.9921875 /end AXIS_PTS
/begin AXIS_PTS CA_MAP8Step2 "AXIS comments" 0xB922 NO_INPUT_QUANTITY AxisPtsX_UW 0.0 CM_kpa_0to256_1 8 0.0 255.99609375 /end AXIS_PTS
/begin AXIS_PTS CA_MAP8Step3 "AXIS comments" 0x8108 NO_INPUT_QUANTITY AxisPtsX_UW 0.0 CM_kpa_0to256_1 8 0.0 255.99609375 /end AXIS_PTS
/begin AXIS_PTS CA_MAP9Step1 "AXIS comments" 0x80E0 NO_INPUT_QUANTITY AxisPtsX_UW 0.0 CM_kpa_0to256_1 9 0.0 255.99609375 /end AXIS_PTS
/begin AXIS_PTS CA_MAP9Step3 "AXIS comments" 0x80F4 NO_INPUT_QUANTITY AxisPtsX_UW 0.0 CM_kpa_0to256_1 9 0.0 255.99609375 /end AXIS_PTS
/begin AXIS_PTS CA_MAP9Step2 "AXIS comments" 0x8F3A NO_INPUT_QUANTITY AxisPtsX_UW 0.0 CM_kpa_0to256_1 9 0.0 255.99609375 /end AXIS_PTS
/begin AXIS_PTS CA_Percent1 "AXIS comments" 0x81EC NO_INPUT_QUANTITY AxisPtsX_UW 0.0 CM_Percent_0to200_2 4 0.0 199.9969024658203 /end AXIS_PTS
/begin AXIS_PTS CA_Percent2 "AXIS comments" 0x9E88 NO_INPUT_QUANTITY AxisPtsX_UW 0.0 CM_Percent_0to200_2 2 0.0 199.9969024658203 /end AXIS_PTS
/begin AXIS_PTS CA_PercentStep21 "AXIS comments" 0x820E NO_INPUT_QUANTITY AxisPtsX_UW 0.0 CM_Percent_0to200_2 21 0.0 199.9969024658203 /end AXIS_PTS
/begin AXIS_PTS CA_VELoad6Step "AXIS comments" 0x828A NO_INPUT_QUANTITY AxisPtsX_UW 0.0 CM_kpa_0to256_1 6 0.0 255.99609375 /end AXIS_PTS
/begin COMPU_METHOD udf_CM_15471 "Ax + B" RAT_FUNC "%4.0" "None" COEFFS 0 1 0 0 0 1 /end COMPU_METHOD
/begin COMPU_METHOD udf_CM_15478 "Ax + B" RAT_FUNC "%4.0" "None" COEFFS 0 1 0 0 0 1 /end COMPU_METHOD
/begin COMPU_METHOD CM_Boolean1 "" RAT_FUNC "%1.0" "bool" COEFFS 0 1 0 0 0 1 /end COMPU_METHOD
/begin COMPU_METHOD CM_Boolean2 "" RAT_FUNC "%1.0" "boolean" COEFFS 0 1 0 0 0 1 /end COMPU_METHOD
/begin COMPU_METHOD CM_Boolean4 "" RAT_FUNC "%1.0" "None" COEFFS 0 1 0 0 0 1 /end COMPU_METHOD
/begin COMPU_METHOD udf_CM_15709 "Ax + B" RAT_FUNC "%4.0" "None" COEFFS 0 1 0 0 0 1 /end COMPU_METHOD
/begin COMPU_METHOD CM_VERSION1 "" RAT_FUNC "%10.0" "Date" COEFFS 0 1 0 0 0 1 /end COMPU_METHOD
/begin COMPU_METHOD CM_Count1 "" RAT_FUNC "%3.0" "count" COEFFS 0 1 0 0 0 1 /end COMPU_METHOD
/begin COMPU_METHOD CM_Count2 "" RAT_FUNC "%3.0" "counts" COEFFS 0 1 0 0 0 1 /end COMPU_METHOD
/begin COMPU_METHOD CM_Count3 "" RAT_FUNC "%3.0" "None" COEFFS 0 1 0 0 0 1 /end COMPU_METHOD
/begin COMPU_METHOD CM_Count4 "" RAT_FUNC "%3.0" "steps" COEFFS 0 1 0 0 0 1 /end COMPU_METHOD
/begin COMPU_METHOD CM_EOI "" TAB_VERB "%10.4" "" COMPU_TAB_REF CM_EOI_TAB /end COMPU_METHOD
/begin COMPU_METHOD CM_FUEL_TYPE "" TAB_VERB "%10.4" "" COMPU_TAB_REF CM_FUEL_TYPE_TAB /end COMPU_METHOD
/begin COMPU_METHOD udf_CM_16066 "Ax + B" RAT_FUNC "%4.4" "rpm" COEFFS 0.0 4.0 0.0 0.0 0.0 1.0 /end COMPU_METHOD
/begin COMPU_METHOD udf_CM_16276 "Ax + B" RAT_FUNC "%4.0" "boolean" COEFFS 0 1 0 0 0 1 /end COMPU_METHOD
/begin COMPU_METHOD udf_CM_16444 "Ax + B" RAT_FUNC "%4.4" "grm" COEFFS 0.0 4096.0 0.0 0.0 0.0 1.0 /end COMPU_METHOD
/begin COMPU_METHOD udf_CM_16542 "Ax + B" RAT_FUNC "%4.0" "None" COEFFS 0 1 0 0 0 1 /end COMPU_METHOD
/begin COMPU_METHOD udf_CM_16549 "Ax + B" RAT_FUNC "%4.0" "Counts" COEFFS 0 1 0 0 0 1 /end COMPU_METHOD
/begin COMPU_METHOD udf_CM_16556 "Ax + B" RAT_FUNC "%4.0" "None" COEFFS 0 1 0 0 0 1 /end COMPU_METHOD
/begin COMPU_METHOD udf_CM_16563 "Ax + B" RAT_FUNC "%4.0" "None" COEFFS 0 1 0 0 0 1 /end COMPU_METHOD
/begin COMPU_METHOD udf_CM_16570 "Ax + B" RAT_FUNC "%4.0" "None" COEFFS 0 1 0 0 0 1 /end COMPU_METHOD
/begin COMPU_METHOD udf_CM_16577 "Ax + B" RAT_FUNC "%4.0" "Counts" COEFFS 0 1 0 0 0 1 /end COMPU_METHOD
/begin COMPU_METHOD udf_CM_16584 "Ax + B" RAT_FUNC "%4.0" "None" COEFFS 0 1 0 0 0 1 /end COMPU_METHOD
/begin COMPU_METHOD udf_CM_16591 "Ax + B" RAT_FUNC "%4.0" "None" COEFFS 0 1 0 0 0 1 /end COMPU_METHOD
/begin COMPU_METHOD udf_CM_16696 "Ax + B" RAT_FUNC "%4.0" "None" COEFFS 0 1 0 0 0 1 /end COMPU_METHOD
/begin COMPU_METHOD udf_CM_16878 "Ax + B" RAT_FUNC "%4.4" "msec" COEFFS 0.0 64.0 0.0 0.0 0.0 1.0 /end COMPU_METHOD
/begin COMPU_METHOD udf_CM_16948 "Ax + B" RAT_FUNC "%4.0" "None" COEFFS 0 1 0 0 0 1 /end COMPU_METHOD
/begin COMPU_METHOD udf_CM_16955 "Ax + B" RAT_FUNC "%4.0" "None" COEFFS 0 1 0 0 0 1 /end COMPU_METHOD
/begin COMPU_METHOD udf_CM_16997 "Ax + B" RAT_FUNC "%4.0" "Counts" COEFFS 0 1 0 0 0 1 /end COMPU_METHOD
/begin COMPU_METHOD udf_CM_17004 "Ax + B" RAT_FUNC "%4.0" "None" COEFFS 0 1 0 0 0 1 /end COMPU_METHOD
/begin COMPU_METHOD udf_CM_17011 "Ax + B" RAT_FUNC "%4.0" "None" COEFFS 0 1 0 0 0 1 /end COMPU_METHOD
/begin COMPU_METHOD udf_CM_17018 "Ax + B" RAT_FUNC "%4.0" "None" COEFFS 0 1 0 0 0 1 /end COMPU_METHOD
/begin COMPU_METHOD udf_CM_17025 "Ax + B" RAT_FUNC "%4.0" "Counts" COEFFS 0 1 0 0 0 1 /end COMPU_METHOD
/begin COMPU_METHOD CM_Mult0_to_2_ratio "" RAT_FUNC "%5.4" "ratio" COEFFS 0.0 128.0 0.0 0.0 0.0 1.0 /end COMPU_METHOD
/begin COMPU_METHOD CM_Mult0_to_2_ratio1 "" RAT_FUNC "%5.4" "ratio/512rpm" COEFFS 0.0 128.0 0.0 0.0 0.0 1.0 /end COMPU_METHOD
/begin COMPU_METHOD CM_Mult0_to_4_ratio "" RAT_FUNC "%5.4" "ratio" COEFFS 0.0 64.0 0.0 0.0 0.0 1.0 /end COMPU_METHOD
/begin COMPU_METHOD CM_Mult0_to_2_second "" RAT_FUNC "%5.4" "sec" COEFFS 0.0 128.0 0.0 0.0 0.0 1.0 /end COMPU_METHOD
/begin COMPU_METHOD CM_Equaloutput1 "Default N=E compu method" RAT_FUNC "%10.4" "" COEFFS 0 1 0 0 0 1 /end COMPU_METHOD
/begin COMPU_METHOD CM_Boolean6 "Default N=E compu method" RAT_FUNC "%10.4" "Boolean" COEFFS 0 1 0 0 0 1 /end COMPU_METHOD
/begin COMPU_METHOD CM_Enum_0to4 "" RAT_FUNC "%1.0" "enum" COEFFS 0 1 0 0 0 1 /end COMPU_METHOD
/begin COMPU_METHOD CM_AFR_8bit "" RAT_FUNC "%4.2" "afr" COEFFS 0.0 8.0 0.0 0.0 0.0 1.0 /end COMPU_METHOD
/begin COMPU_METHOD CM_AFR_n4to4 "" RAT_FUNC "%4.3" "afr" COEFFS 0.0 32.0 0.0 0.0 0.0 1.0 /end COMPU_METHOD
/begin COMPU_METHOD CM_Angle_8bit "" RAT_FUNC "%3.1" "angle" COEFFS 0.0 2.0 0.0 0.0 0.0 1.0 /end COMPU_METHOD
/begin COMPU_METHOD CM_Grams0to2 "" RAT_FUNC "%6.5" "gms" COEFFS 0.0 32768.00013421773 0.0 0.0 0.0 1.0 /end COMPU_METHOD
/begin COMPU_METHOD CM_Grams0to8 "" RAT_FUNC "%6.5" "gms" COEFFS 0.0 8192.000033554432 0.0 0.0 0.0 1.0 /end COMPU_METHOD
/begin COMPU_METHOD CM_Grams0to8_1 "" RAT_FUNC "%6.5" "grams" COEFFS 0.0 8192.000033554432 0.0 0.0 0.0 1.0 /end COMPU_METHOD
/begin COMPU_METHOD CM_FiltCoef "" RAT_FUNC "%7.6" "coef" COEFFS 0.0 65536.00026843546 0.0 0.0 0.0 1.0 /end COMPU_METHOD
/begin COMPU_METHOD CM_FactorRatio "" RAT_FUNC "%7.6" "ratio" COEFFS 0.0 65536.00026843546 0.0 0.0 0.0 1.0 /end COMPU_METHOD
/begin COMPU_METHOD CM_FactorRatio_N1to1 "" RAT_FUNC "%7.6" "ratio" COEFFS 0.0 32768.00013421773 0.0 0.0 0.0 1.0 /end COMPU_METHOD
/begin COMPU_METHOD CM_GramPerSecond "" RAT_FUNC "%7.5" "grams/sec" COEFFS 0.0 4096.0 0.0 0.0 0.0 1.0 /end COMPU_METHOD
/begin COMPU_METHOD CM_GramPerSecond_1 "" RAT_FUNC "%7.5" "grams/sec" COEFFS 0.0 128.0 0.0 0.0 0.0 1.0 /end COMPU_METHOD
/begin COMPU_METHOD udf_CM_18376 "" RAT_FUNC "%7.5" "ratio" COEFFS 0.0 4096.0 0.0 0.0 0.0 1.0 /end COMPU_METHOD
/begin COMPU_METHOD CM_kpa_8bit "" RAT_FUNC "%4.1" "kpa" COEFFS 0.0 2.0 0.0 0.0 0.0 1.0 /end COMPU_METHOD
/begin COMPU_METHOD CM_kpa_0_256_8bit "" RAT_FUNC "%4.1" "kpa" COEFFS 0.0 1.0 0.0 0.0 0.0 1.0 /end COMPU_METHOD
/begin COMPU_METHOD CM_msec "" RAT_FUNC "%5.3" "msec" COEFFS 0.0 16.0 0.0 0.0 0.0 1.0 /end COMPU_METHOD
/begin COMPU_METHOD CM_mVolt "" RAT_FUNC "%4.0" "millivolt" COEFFS 0.0 0.25 0.0 0.0 0.0 1.0 /end COMPU_METHOD
/begin COMPU_METHOD CM_mVolt_1 "" RAT_FUNC "%7.3" "millivolt" COEFFS 0.0 64.0 0.0 0.0 0.0 1.0 /end COMPU_METHOD
/begin COMPU_METHOD CM_mVolt_2 "" RAT_FUNC "%7.3" "mvolt" COEFFS 0.0 64.0 0.0 0.0 0.0 1.0 /end COMPU_METHOD
/begin COMPU_METHOD CM_Ratio_0to2_1 "" RAT_FUNC "%6.5" "msec/count" COEFFS 0.0 32768.00013421773 0.0 0.0 0.0 1.0 /end COMPU_METHOD
/begin COMPU_METHOD CM_Ratio_0to2_2 "" RAT_FUNC "%6.5" "ratio" COEFFS 0.0 32768.00013421773 0.0 0.0 0.0 1.0 /end COMPU_METHOD
/begin COMPU_METHOD CM_Seconds_1 "" RAT_FUNC "%7.3" "sec" COEFFS 0.0 32.0 0.0 0.0 0.0 1.0 /end COMPU_METHOD
/begin COMPU_METHOD CM_Percent_N200to200 "" RAT_FUNC "%7.4" "percent" COEFFS 0.0 163.8400167772177 0.0 0.0 0.0 1.0 /end COMPU_METHOD
/begin COMPU_METHOD CM_SparkAngle_N256to256 "" RAT_FUNC "%7.4" "angle" COEFFS 0.0 128.0 0.0 0.0 0.0 1.0 /end COMPU_METHOD
/begin COMPU_METHOD CM_DegC_N256to256 "" RAT_FUNC "%7.4" "degC" COEFFS 0.0 128.0 0.0 0.0 0.0 1.0 /end COMPU_METHOD
/begin COMPU_METHOD CM_FiltCoef_1 "" RAT_FUNC "%5.4" "coef" COEFFS 0.0 256.0 0.0 0.0 0.0 1.0 /end COMPU_METHOD
/begin COMPU_METHOD CM_Mult_0to1 "" RAT_FUNC "%5.4" "not_specified" COEFFS 0.0 256.0 0.0 0.0 0.0 1.0 /end COMPU_METHOD
/begin COMPU_METHOD CM_Mult_0to1_2 "" RAT_FUNC "%5.4" "ratio" COEFFS 0.0 256.0 0.0 0.0 0.0 1.0 /end COMPU_METHOD
/begin COMPU_METHOD CM_Percent_0to200 "" RAT_FUNC "%8.5" "percent/count" COEFFS 0.0 327.6800000536871 0.0 0.0 0.0 1.0 /end COMPU_METHOD
/begin COMPU_METHOD CM_Percent_0to100 "" RAT_FUNC "%5.3" "percent" COEFFS 0.0 2.56 0.0 0.0 0.0 1.0 /end COMPU_METHOD
/begin COMPU_METHOD CM_Percent_0to100_1 "" RAT_FUNC "%6.4" "percent" COEFFS 0.0 655.3603892316423 0.0 0.0 0.0 1.0 /end COMPU_METHOD
/begin COMPU_METHOD CM_Percent_0to200_1 "" RAT_FUNC "%7.4" "" COEFFS 0.0 327.6800872415464 0.0 0.0 0.0 1.0 /end COMPU_METHOD
/begin COMPU_METHOD CM_Percent_0to200_2 "" RAT_FUNC "%7.4" "percent" COEFFS 0.0 327.6800872415464 0.0 0.0 0.0 1.0 /end COMPU_METHOD
/begin COMPU_METHOD CM_Percent_0to200_3 "" RAT_FUNC "%6.3" "percent" COEFFS 0.0 1.28 0.0 0.0 0.0 1.0 /end COMPU_METHOD
/begin COMPU_METHOD CM_Ratio_0to8 "" RAT_FUNC "%6.5" "ratio" COEFFS 0.0 8192.0 0.0 0.0 0.0 1.0 /end COMPU_METHOD
/begin COMPU_METHOD CM_Ratio_n256to256 "" RAT_FUNC "%7.4" "amps" COEFFS 0.0 128.0 0.0 0.0 0.0 1.0 /end COMPU_METHOD
/begin COMPU_METHOD CM_Ratio_n128to128 "" RAT_FUNC "%7.4" "kpa" COEFFS 0.0 256.0 0.0 0.0 0.0 1.0 /end COMPU_METHOD
/begin COMPU_METHOD CM_Ratio_n8to8 "" RAT_FUNC "%7.4" "mpa" COEFFS 0.0 4096.0 0.0 0.0 0.0 1.0 /end COMPU_METHOD
/begin COMPU_METHOD udf_CM_18544 "" RAT_FUNC "%7.4" "NM" COEFFS 0.0 256.0 0.0 0.0 0.0 1.0 /end COMPU_METHOD
/begin COMPU_METHOD CM_Ratio_n2to2 "" RAT_FUNC "%4.3" "ratio" COEFFS 0.0 64.0 0.0 0.0 0.0 1.0 /end COMPU_METHOD
/begin COMPU_METHOD CM_RPM_n8192to8192 "" RAT_FUNC "%6.2" "rpm" COEFFS 0.0 4.0 0.0 0.0 0.0 1.0 /end COMPU_METHOD
/begin COMPU_METHOD CM_RPM_0to16384_1 "" RAT_FUNC "%7.2" "" COEFFS 0.0 4.0 0.0 0.0 0.0 1.0 /end COMPU_METHOD
/begin COMPU_METHOD CM_Hz_0to16384 "" RAT_FUNC "%7.2" "hertz" COEFFS 0.0 4.0 0.0 0.0 0.0 1.0 /end COMPU_METHOD
/begin COMPU_METHOD CM_RPM_0to16384 "" RAT_FUNC "%7.2" "rpm" COEFFS 0.0 4.0 0.0 0.0 0.0 1.0 /end COMPU_METHOD
/begin COMPU_METHOD udf_CM_18586 "" RAT_FUNC "%7.2" "RPM" COEFFS 0.0 4.0 0.0 0.0 0.0 1.0 /end COMPU_METHOD
/begin COMPU_METHOD CM_amp_0to512_1 "" RAT_FUNC "%7.4" "amp" COEFFS 0.0 128.0 0.0 0.0 0.0 1.0 /end COMPU_METHOD
/begin COMPU_METHOD CM_kpa_0to512_1 "" RAT_FUNC "%7.4" "kpa" COEFFS 0.0 128.0 0.0 0.0 0.0 1.0 /end COMPU_METHOD
/begin COMPU_METHOD CM_kpa_n256to256_1 "" RAT_FUNC "%7.4" "kpa" COEFFS 0.0 128.0 0.0 0.0 0.0 1.0 /end COMPU_METHOD
/begin COMPU_METHOD CM_kpa_0to256_1 "" RAT_FUNC "%7.4" "kpa" COEFFS 0.0 256.0 0.0 0.0 0.0 1.0 /end COMPU_METHOD
/begin COMPU_METHOD CM_mpa_0to16_1 "" RAT_FUNC "%7.4" "mpa" COEFFS 0.0 4096.0 0.0 0.0 0.0 1.0 /end COMPU_METHOD
/begin COMPU_METHOD CM_Second_0to64 "" RAT_FUNC "%4.2" "milliseconds" COEFFS 0.0 4.0 0.0 0.0 0.0 1.0 /end COMPU_METHOD
/begin COMPU_METHOD CM_CrankAngle_0to1024 "" RAT_FUNC "%7.3" "angle" COEFFS 0.0 64.0 0.0 0.0 0.0 1.0 /end COMPU_METHOD
/begin COMPU_METHOD CM_milliliter_0to1024 "" RAT_FUNC "%7.3" "milliliter" COEFFS 0.0 64.0 0.0 0.0 0.0 1.0 /end COMPU_METHOD
/begin COMPU_METHOD CM_msec_0to1024 "" RAT_FUNC "%7.3" "msec" COEFFS 0.0 64.0 0.0 0.0 0.0 1.0 /end COMPU_METHOD
/begin COMPU_METHOD CM_Second_0to1024 "" RAT_FUNC "%7.3" "sec" COEFFS 0.0 64.0 0.0 0.0 0.0 1.0 /end COMPU_METHOD
/begin COMPU_METHOD CM_Second_0to8192 "" RAT_FUNC "%7.3" "sec" COEFFS 0.0 8.0 0.0 0.0 0.0 1.0 /end COMPU_METHOD
/begin COMPU_METHOD CM_SignedWord_n32768to32768_2 "" RAT_FUNC "%5.0" "counts" COEFFS 0 1 0 0 0 1 /end COMPU_METHOD
/begin COMPU_METHOD CM_AFR_0to32 "" RAT_FUNC "%6.4" "afr" COEFFS 0.0 2048.001048576537 0.0 0.0 0.0 1.0 /end COMPU_METHOD
/begin COMPU_METHOD CM_Volt_0to32_1 "" RAT_FUNC "%6.4" "volt" COEFFS 0.0 2048.001048576537 0.0 0.0 0.0 1.0 /end COMPU_METHOD
/begin COMPU_METHOD CM_Volt_0to1024_1 "" RAT_FUNC "%6.4" "volt" COEFFS 0.0 64.0 0.0 0.0 0.0 1.0 /end COMPU_METHOD
/begin COMPU_METHOD CM_Volt_0to32_2 "" RAT_FUNC "%6.4" "volts" COEFFS 0.0 2048.001048576537 0.0 0.0 0.0 1.0 /end COMPU_METHOD
/begin COMPU_METHOD CM_Second_0to4096 "" RAT_FUNC "%7.3" "sec" COEFFS 0.0 16.0 0.0 0.0 0.0 1.0 /end COMPU_METHOD
/begin COMPU_METHOD CM_Second_us_0to80 "" RAT_FUNC "%7.3" "us" COEFFS 0.0 6.4 0.0 0.0 0.0 1.0 /end COMPU_METHOD
/begin COMPU_METHOD CM_KPH_0to512 "" RAT_FUNC "%7.4" "kph" COEFFS 0.0 128.0 0.0 0.0 0.0 1.0 /end COMPU_METHOD
/begin COMPU_METHOD udf_CM_18698 "" RAT_FUNC "%7.4" "gram" COEFFS 0.0 128.0 0.0 0.0 0.0 1.0 /end COMPU_METHOD
/begin COMPU_METHOD udf_CM_18705 "" RAT_FUNC "%7.4" "grams" COEFFS 0.0 128.0 0.0 0.0 0.0 1.0 /end COMPU_METHOD
/begin COMPU_METHOD CM_Second_0to512 "" RAT_FUNC "%7.4" "sec" COEFFS 0.0 128.0 0.0 0.0 0.0 1.0 /end COMPU_METHOD
/begin COMPU_METHOD CM_Second_0to512_1 "" RAT_FUNC "%7.4" "seconds" COEFFS 0.0 128.0 0.0 0.0 0.0 1.0 /end COMPU_METHOD
/begin COMPU_METHOD CM_Count_0to65535 "" RAT_FUNC "%5.0" "count" COEFFS 0 1 0 0 0 1 /end COMPU_METHOD
/begin COMPU_METHOD CM_Count_0to65535_1 "" RAT_FUNC "%5.0" "counts" COEFFS 0 1 0 0 0 1 /end COMPU_METHOD
/begin COMPU_METHOD CM_Count_0to65535_2 "" RAT_FUNC "%5.0" "None" COEFFS 0 1 0 0 0 1 /end COMPU_METHOD
/begin COMPU_METHOD CM_Count_0to65535_3 "" RAT_FUNC "%5.0" "percent" COEFFS 0 1 0 0 0 1 /end COMPU_METHOD
/begin COMPU_METHOD CM_Second_0to65535 "" RAT_FUNC "%5.0" "sec" COEFFS 0 1 0 0 0 1 /end COMPU_METHOD
/begin COMPU_METHOD CM_msec_0to4 "" RAT_FUNC "%4.3" "msec" COEFFS 0.0 64.0 0.0 0.0 0.0 1.0 /end COMPU_METHOD
/begin COMPU_METHOD CM_mult_0to4 "" RAT_FUNC "%4.3" "not_specified" COEFFS 0.0 64.0 0.0 0.0 0.0 1.0 /end COMPU_METHOD
/begin COMPU_METHOD CM_Second_0to4 "" RAT_FUNC "%4.3" "sec" COEFFS 0.0 64.0 0.0 0.0 0.0 1.0 /end COMPU_METHOD
/begin COMPU_METHOD CM_Mult_0to8 "" RAT_FUNC "%4.3" "ratio" COEFFS 0.0 32.0 0.0 0.0 0.0 1.0 /end COMPU_METHOD
/begin COMPU_METHOD CM_Second_0to8 "" RAT_FUNC "%4.3" "sec" COEFFS 0.0 32.0 0.0 0.0 0.0 1.0 /end COMPU_METHOD
/begin COMPU_VTAB CM_EOI_TAB "" TAB_VERB 4 0 "Cyl1" 1 "Cyl2" 2 "Cyl3" 3 "Cyl4" /end COMPU_VTAB
/begin COMPU_VTAB CM_FUEL_TYPE_TAB "" TAB_VERB 3 0 "Gasoline" 1 "NG" 2 "LPG" /end COMPU_VTAB
/begin RECORD_LAYOUT 2D_Array_SB FNC_VALUES 1 SBYTE COLUMN_DIR DIRECT ALIGNMENT_WORD 1 ALIGNMENT_LONG 2 /end RECORD_LAYOUT
/begin RECORD_LAYOUT 2D_Array_SW FNC_VALUES 1 SWORD COLUMN_DIR DIRECT ALIGNMENT_WORD 1 ALIGNMENT_LONG 2 /end RECORD_LAYOUT
/begin RECORD_LAYOUT 2D_Array_UB FNC_VALUES 1 UBYTE COLUMN_DIR DIRECT ALIGNMENT_WORD 1 ALIGNMENT_LONG 2 /end RECORD_LAYOUT
/begin RECORD_LAYOUT 2D_Array_UW FNC_VALUES 1 UWORD COLUMN_DIR DIRECT ALIGNMENT_WORD 1 ALIGNMENT_LONG 2 /end RECORD_LAYOUT
/begin RECORD_LAYOUT D_Array_SB FNC_VALUES 1 SBYTE COLUMN_DIR DIRECT ALIGNMENT_WORD 1 ALIGNMENT_LONG 2 /end RECORD_LAYOUT
/begin RECORD_LAYOUT udf_RL_19771 FNC_VALUES 1 SWORD COLUMN_DIR DIRECT ALIGNMENT_WORD 1 ALIGNMENT_LONG 2 /end RECORD_LAYOUT
/begin RECORD_LAYOUT 3D_Array_UB FNC_VALUES 1 UBYTE COLUMN_DIR DIRECT ALIGNMENT_WORD 1 ALIGNMENT_LONG 2 /end RECORD_LAYOUT
/begin RECORD_LAYOUT 3D_Array_UW FNC_VALUES 1 UWORD COLUMN_DIR DIRECT ALIGNMENT_WORD 1 ALIGNMENT_LONG 2 /end RECORD_LAYOUT
/begin RECORD_LAYOUT AxisPtsX_UW AXIS_PTS_X 1 UWORD INDEX_INCR DIRECT ALIGNMENT_WORD 1 ALIGNMENT_LONG 2 /end RECORD_LAYOUT
/begin RECORD_LAYOUT AxisPtsX_SW AXIS_PTS_X 1 SWORD INDEX_INCR DIRECT ALIGNMENT_WORD 1 ALIGNMENT_LONG 2 /end RECORD_LAYOUT
/begin RECORD_LAYOUT Scalar_SW FNC_VALUES 1 SWORD COLUMN_DIR DIRECT ALIGNMENT_WORD 1 ALIGNMENT_LONG 2 /end RECORD_LAYOUT
/begin RECORD_LAYOUT Scalar_UB FNC_VALUES 1 UBYTE COLUMN_DIR DIRECT ALIGNMENT_WORD 1 ALIGNMENT_LONG 2 /end RECORD_LAYOUT
/begin RECORD_LAYOUT Scalar_UW FNC_VALUES 1 UWORD COLUMN_DIR DIRECT ALIGNMENT_WORD 1 ALIGNMENT_LONG 2 /end RECORD_LAYOUT
/begin RECORD_LAYOUT ValueBlock_UW FNC_VALUES 1 UWORD COLUMN_DIR DIRECT ALIGNMENT_WORD 1 ALIGNMENT_LONG 2 /end RECORD_LAYOUT
/end MODULE
/end PROJECT
