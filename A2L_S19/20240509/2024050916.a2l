ASAP2_VERSION 1 40
/begin PROJECT RS19_Prod ""
/begin HEADER "" VERSION "" /end HEADER
/begin MODULE RS19_Prod ""
/begin MOD_COMMON "" BYTE_ORDER MSB_FIRST ALIGNMENT_BYTE 1 ALIGNMENT_WORD 1 ALIGNMENT_LONG 2 ALIGNMENT_FLOAT32_IEEE 4 ALIGNMENT_FLOAT64_IEEE 8 /end MOD_COMMON
/begin CHARACTERISTIC D_OilPressureInputEnb "cal comments" VALUE 0xC447 Scalar_UB 0.0 CM_Boolean6 0.0 255.0 /end CHARACTERISTIC
/begin CHARACTERISTIC D_OilPressureShortFailThresh "cal comments" VALUE 0xC445 Scalar_UB 0.0 CM_Count3 0.0 255.0 /end CHARACTERISTIC
/begin CHARACTERISTIC D_OilPressureShortPassThresh "cal comments" VALUE 0xC446 Scalar_UB 0.0 CM_Count3 0.0 255.0 /end CHARACTERISTIC
/begin CHARACTERISTIC D_OilPressureShortDetectDelay "cal comments" VALUE 0xC444 Scalar_UB 0.0 CM_Count3 0.0 255.0 /end CHARACTERISTIC
/begin CHARACTERISTIC D_OilSWLowActive "cal comments" VALUE 0xC448 Scalar_UB 0.0 CM_Boolean6 0.0 255.0 /end CHARACTERISTIC
/begin CHARACTERISTIC D_OilSWDiagKeyOn "cal comments" VALUE 0xC449 Scalar_UB 0.0 CM_Boolean6 0.0 255.0 /end CHARACTERISTIC
/begin CHARACTERISTIC D_OilSWAnalogused "cal comments" VALUE 0xC44A Scalar_UB 0.0 CM_Boolean6 0.0 255.0 /end CHARACTERISTIC
/begin CHARACTERISTIC D_OilSWShortRangeThreshLo "cal comments" VALUE 0xC44C Scalar_UW 0.0 CM_Percent_0to100_1 0.0 99.9984130859375 /end CHARACTERISTIC
/begin CHARACTERISTIC D_OilSWShortRangeThreshHi "cal comments" VALUE 0xC44E Scalar_UW 0.0 CM_Percent_0to100_1 0.0 99.9984130859375 /end CHARACTERISTIC
/begin CHARACTERISTIC D_SpkCoilShortFailThresh "cal comments" CURVE 0xC457 2D_Array_UB 0.0 CM_Count1 0.0 255.0
 /begin AXIS_DESCR FIX_AXIS NO_INPUT_QUANTITY CM_EOI 4 0.0 4.0 MAX_GRAD 0.0 /begin FIX_AXIS_PAR_LIST 0 1 2 3 /end FIX_AXIS_PAR_LIST /end AXIS_DESCR
/end CHARACTERISTIC
/begin CHARACTERISTIC D_SpkCoilShortPassThresh "cal comments" CURVE 0xC45B 2D_Array_UB 0.0 CM_Count1 0.0 255.0
 /begin AXIS_DESCR FIX_AXIS NO_INPUT_QUANTITY CM_EOI 4 0.0 4.0 MAX_GRAD 0.0 /begin FIX_AXIS_PAR_LIST 0 1 2 3 /end FIX_AXIS_PAR_LIST /end AXIS_DESCR
/end CHARACTERISTIC
/begin CHARACTERISTIC D_TPSMotorControlEnb "cal comments" VALUE 0xC39A Scalar_UB 0.0 CM_Boolean6 0.0 255.0 /end CHARACTERISTIC
/begin CHARACTERISTIC D_TPSMotorDiagFailTimeThresh "cal comments" VALUE 0xC39C Scalar_UW 0.0 CM_Count_0to65535_1 0.0 65535.0 /end CHARACTERISTIC
/begin CHARACTERISTIC D_TPSMotorDiagPassTimeThresh "cal comments" VALUE 0xC39E Scalar_UW 0.0 CM_Count_0to65535_1 0.0 65535.0 /end CHARACTERISTIC
/begin CHARACTERISTIC D_TPSMotorDiagTPSErrThresh "cal comments" VALUE 0xC3A4 Scalar_UW 0.0 CM_Percent_0to200_2 0.0 199.9969024658203 /end CHARACTERISTIC
/begin CHARACTERISTIC D_TPSMotorDynErrThrDecayStep "cal comments" VALUE 0xC3A2 Scalar_UW 0.0 CM_Percent_0to200_2 0.0 199.9969024658203 /end CHARACTERISTIC
/begin CHARACTERISTIC D_TPSMotorDynErrThrshGain "cal comments" VALUE 0xC3A0 Scalar_UW 0.0 udf_CM_18376 0.0 15.999755859375 /end CHARACTERISTIC
/begin CHARACTERISTIC D_FCVMotorControlEnb "cal comments" VALUE 0xC354 Scalar_UB 0.0 CM_Boolean6 0.0 255.0 /end CHARACTERISTIC
/begin CHARACTERISTIC D_FCVMotorDiagFailTimeThresh "cal comments" VALUE 0xC356 Scalar_UW 0.0 CM_Count_0to65535_1 0.0 65535.0 /end CHARACTERISTIC
/begin CHARACTERISTIC D_FCVMotorDiagPassTimeThresh "cal comments" VALUE 0xC358 Scalar_UW 0.0 CM_Count_0to65535_1 0.0 65535.0 /end CHARACTERISTIC
/begin CHARACTERISTIC D_FCVMotorDiagFCVPSErrThresh "cal comments" VALUE 0xC35E Scalar_UW 0.0 CM_Percent_0to200_2 0.0 199.9969024658203 /end CHARACTERISTIC
/begin CHARACTERISTIC D_FCVMotorDynErrThrDecayStep "cal comments" VALUE 0xC35C Scalar_UW 0.0 CM_Percent_0to200_2 0.0 199.9969024658203 /end CHARACTERISTIC
/begin CHARACTERISTIC D_FCVMotorDynErrThrshGain "cal comments" VALUE 0xC35A Scalar_UW 0.0 udf_CM_18376 0.0 15.999755859375 /end CHARACTERISTIC
/begin CHARACTERISTIC D_SWLOnMinDuration "cal comments" VALUE 0xC29D Scalar_UB 0.0 CM_Seconds 0.0 127.5 /end CHARACTERISTIC
/begin CHARACTERISTIC D_IGNOffInitDDMS "cal comments" VALUE 0xC29E Scalar_UB 0.0 CM_Boolean1 0.0 1.0 /end CHARACTERISTIC
/begin CHARACTERISTIC D_StopLightKillEn "cal comments" VALUE 0xC29F Scalar_UB 0.0 CM_Boolean1 0.0 1.0 /end CHARACTERISTIC
/begin CHARACTERISTIC D_O21ShortLoLightType "cal comments" VALUE 0xC2DF Scalar_UB 0.0 CM_LIGHT_TYPE 0.0 4.0 /end CHARACTERISTIC
/begin CHARACTERISTIC D_O21ShortHiLightType "cal comments" VALUE 0xC2E0 Scalar_UB 0.0 CM_LIGHT_TYPE 0.0 4.0 /end CHARACTERISTIC
/begin CHARACTERISTIC D_RO21ShortLoLightType "cal comments" VALUE 0xC2F7 Scalar_UB 0.0 CM_LIGHT_TYPE 0.0 4.0 /end CHARACTERISTIC
/begin CHARACTERISTIC D_RO21ShortHiLightType "cal comments" VALUE 0xC2F8 Scalar_UB 0.0 CM_LIGHT_TYPE 0.0 4.0 /end CHARACTERISTIC
/begin CHARACTERISTIC D_O2HeaterShortLoLightType "cal comments" VALUE 0xC365 Scalar_UB 0.0 CM_LIGHT_TYPE 0.0 4.0 /end CHARACTERISTIC
/begin CHARACTERISTIC D_O2HeaterShortHiLightType "cal comments" VALUE 0xC366 Scalar_UB 0.0 CM_LIGHT_TYPE 0.0 4.0 /end CHARACTERISTIC
/begin CHARACTERISTIC D_RO21ShortLoLightType "cal comments" VALUE 0xC2F7 Scalar_UB 0.0 CM_LIGHT_TYPE 0.0 4.0 /end CHARACTERISTIC
/begin CHARACTERISTIC D_RO21ShortHiLightType "cal comments" VALUE 0xC2F8 Scalar_UB 0.0 CM_LIGHT_TYPE 0.0 4.0 /end CHARACTERISTIC
/begin CHARACTERISTIC D_RO2Heater1ShortLoLightType "cal comments" VALUE 0xC36C Scalar_UB 0.0 CM_LIGHT_TYPE 0.0 4.0 /end CHARACTERISTIC
/begin CHARACTERISTIC D_RO2Heater1ShortHiLightType "cal comments" VALUE 0xC36D Scalar_UB 0.0 CM_LIGHT_TYPE 0.0 4.0 /end CHARACTERISTIC
/begin CHARACTERISTIC D_CoolTempShortLoLightType "cal comments" VALUE 0xC2B5 Scalar_UB 0.0 CM_LIGHT_TYPE 0.0 4.0 /end CHARACTERISTIC
/begin CHARACTERISTIC D_CoolTempShortHiLightType "cal comments" VALUE 0xC2B6 Scalar_UB 0.0 CM_LIGHT_TYPE 0.0 4.0 /end CHARACTERISTIC
/begin CHARACTERISTIC D_CoolTempOverHeatExp1LightType "cal comments" VALUE 0xC2B7 Scalar_UB 0.0 CM_LIGHT_TYPE 0.0 4.0 /end CHARACTERISTIC
/begin CHARACTERISTIC D_CoolTempOverHeatExp2LightType "cal comments" VALUE 0xC2B8 Scalar_UB 0.0 CM_LIGHT_TYPE 0.0 4.0 /end CHARACTERISTIC
/begin CHARACTERISTIC D_IntakeAirTempShortLoLightType "cal comments" VALUE 0xC3B5 Scalar_UB 0.0 CM_LIGHT_TYPE 0.0 4.0 /end CHARACTERISTIC
/begin CHARACTERISTIC D_IntakeAirTempShortHiLightType "cal comments" VALUE 0xC3B6 Scalar_UB 0.0 CM_LIGHT_TYPE 0.0 4.0 /end CHARACTERISTIC
/begin CHARACTERISTIC D_IntakeAirTempHiExp1LightType "cal comments" VALUE 0xC3B7 Scalar_UB 0.0 CM_LIGHT_TYPE 0.0 4.0 /end CHARACTERISTIC
/begin CHARACTERISTIC D_IntakeAirTempHiExp2LightType "cal comments" VALUE 0xC3B8 Scalar_UB 0.0 CM_LIGHT_TYPE 0.0 4.0 /end CHARACTERISTIC
/begin CHARACTERISTIC D_SCIShortLoLightType "cal comments" VALUE 0xC3C7 Scalar_UB 0.0 CM_LIGHT_TYPE 0.0 4.0 /end CHARACTERISTIC
/begin CHARACTERISTIC D_SCIShortHiLightType "cal comments" VALUE 0xC3C8 Scalar_UB 0.0 CM_LIGHT_TYPE 0.0 4.0 /end CHARACTERISTIC
/begin CHARACTERISTIC D_BSTPShortLoLightType "cal comments" VALUE 0xC40B Scalar_UB 0.0 CM_LIGHT_TYPE 0.0 4.0 /end CHARACTERISTIC
/begin CHARACTERISTIC D_BSTPShortHiLightType "cal comments" VALUE 0xC40C Scalar_UB 0.0 CM_LIGHT_TYPE 0.0 4.0 /end CHARACTERISTIC
/begin CHARACTERISTIC D_BSTCShortLoLightType "cal comments" VALUE 0xC396 Scalar_UB 0.0 CM_LIGHT_TYPE 0.0 4.0 /end CHARACTERISTIC
/begin CHARACTERISTIC D_BSTCShortHiLightType "cal comments" VALUE 0xC397 Scalar_UB 0.0 CM_LIGHT_TYPE 0.0 4.0 /end CHARACTERISTIC
/begin CHARACTERISTIC D_MAPShortLoLightType "cal comments" VALUE 0xC43F Scalar_UB 0.0 CM_LIGHT_TYPE 0.0 4.0 /end CHARACTERISTIC
/begin CHARACTERISTIC D_MAPShortHiLightType "cal comments" VALUE 0xC440 Scalar_UB 0.0 CM_LIGHT_TYPE 0.0 4.0 /end CHARACTERISTIC
/begin CHARACTERISTIC D_FPShortLoLightType "cal comments" VALUE 0xC34B Scalar_UB 0.0 CM_LIGHT_TYPE 0.0 4.0 /end CHARACTERISTIC
/begin CHARACTERISTIC D_FPShortHiLightType "cal comments" VALUE 0xC34C Scalar_UB 0.0 CM_LIGHT_TYPE 0.0 4.0 /end CHARACTERISTIC
/begin CHARACTERISTIC D_FPLoLightType "cal comments" VALUE 0xC34E Scalar_UB 0.0 CM_LIGHT_TYPE 0.0 4.0 /end CHARACTERISTIC
/begin CHARACTERISTIC D_FPHiLightType "cal comments" VALUE 0xC34D Scalar_UB 0.0 CM_LIGHT_TYPE 0.0 4.0 /end CHARACTERISTIC
/begin CHARACTERISTIC D_OilPressureLightType "cal comments" VALUE 0xC450 Scalar_UB 0.0 CM_LIGHT_TYPE 0.0 4.0 /end CHARACTERISTIC
/begin CHARACTERISTIC D_TPSShortLoLightType "cal comments" VALUE 0xC47B Scalar_UB 0.0 CM_LIGHT_TYPE 0.0 4.0 /end CHARACTERISTIC
/begin CHARACTERISTIC D_TPSShortHiLightType "cal comments" VALUE 0xC47C Scalar_UB 0.0 CM_LIGHT_TYPE 0.0 4.0 /end CHARACTERISTIC
/begin CHARACTERISTIC D_DCMShortLoLightType "cal comments" VALUE 0xC299 Scalar_UB 0.0 CM_LIGHT_TYPE 0.0 4.0 /end CHARACTERISTIC
/begin CHARACTERISTIC D_DCMShortHiLightType "cal comments" VALUE 0xC29A Scalar_UB 0.0 CM_LIGHT_TYPE 0.0 4.0 /end CHARACTERISTIC
/begin CHARACTERISTIC D_TPSMotorControlLightType "cal comments" VALUE 0xC3A6 Scalar_UB 0.0 CM_LIGHT_TYPE 0.0 4.0 /end CHARACTERISTIC
/begin CHARACTERISTIC D_FCVPSShortLoLightType "cal comments" VALUE 0xC489 Scalar_UB 0.0 CM_LIGHT_TYPE 0.0 4.0 /end CHARACTERISTIC
/begin CHARACTERISTIC D_FCVPSShortHiLightType "cal comments" VALUE 0xC48A Scalar_UB 0.0 CM_LIGHT_TYPE 0.0 4.0 /end CHARACTERISTIC
/begin CHARACTERISTIC D_FCVMShortLoLightType "cal comments" VALUE 0xC2A0 Scalar_UB 0.0 CM_LIGHT_TYPE 0.0 4.0 /end CHARACTERISTIC
/begin CHARACTERISTIC D_FCVMShortHiLightType "cal comments" VALUE 0xC2A1 Scalar_UB 0.0 CM_LIGHT_TYPE 0.0 4.0 /end CHARACTERISTIC
/begin CHARACTERISTIC D_FCVMotorControlLightType "cal comments" VALUE 0xC360 Scalar_UB 0.0 CM_LIGHT_TYPE 0.0 4.0 /end CHARACTERISTIC
/begin CHARACTERISTIC D_FCV1ShortLoLightType "cal comments" VALUE 0xC37A Scalar_UB 0.0 CM_LIGHT_TYPE 0.0 4.0 /end CHARACTERISTIC
/begin CHARACTERISTIC D_FCV1ShortHiLightType "cal comments" VALUE 0xC37B Scalar_UB 0.0 CM_LIGHT_TYPE 0.0 4.0 /end CHARACTERISTIC
/begin CHARACTERISTIC D_FCV2ShortLoLightType "cal comments" VALUE 0xC381 Scalar_UB 0.0 CM_LIGHT_TYPE 0.0 4.0 /end CHARACTERISTIC
/begin CHARACTERISTIC D_FCV2ShortHiLightType "cal comments" VALUE 0xC382 Scalar_UB 0.0 CM_LIGHT_TYPE 0.0 4.0 /end CHARACTERISTIC
/begin CHARACTERISTIC D_REF1ShortLoLightType "cal comments" VALUE 0xC388 Scalar_UB 0.0 CM_LIGHT_TYPE 0.0 4.0 /end CHARACTERISTIC
/begin CHARACTERISTIC D_REF1ShortHiLightType "cal comments" VALUE 0xC389 Scalar_UB 0.0 CM_LIGHT_TYPE 0.0 4.0 /end CHARACTERISTIC
/begin CHARACTERISTIC D_REF2ShortLoLightType "cal comments" VALUE 0xC38F Scalar_UB 0.0 CM_LIGHT_TYPE 0.0 4.0 /end CHARACTERISTIC
/begin CHARACTERISTIC D_REF2ShortHiLightType "cal comments" VALUE 0xC390 Scalar_UB 0.0 CM_LIGHT_TYPE 0.0 4.0 /end CHARACTERISTIC
/begin CHARACTERISTIC D_BLM_TrimLoLightType "cal comments" VALUE 0xC306 Scalar_UB 0.0 CM_LIGHT_TYPE 0.0 4.0 /end CHARACTERISTIC
/begin CHARACTERISTIC D_BLM_TrimHiLightType "cal comments" VALUE 0xC307 Scalar_UB 0.0 CM_LIGHT_TYPE 0.0 4.0 /end CHARACTERISTIC
/begin CHARACTERISTIC D_IgnitionCoil1LoLightType "cal comments" VALUE 0xC321 Scalar_UB 0.0 CM_LIGHT_TYPE 0.0 4.0 /end CHARACTERISTIC
/begin CHARACTERISTIC D_IgnitionCoil1HiLightType "cal comments" VALUE 0xC322 Scalar_UB 0.0 CM_LIGHT_TYPE 0.0 4.0 /end CHARACTERISTIC
/begin CHARACTERISTIC D_IgnitionCoil2LoLightType "cal comments" VALUE 0xC323 Scalar_UB 0.0 CM_LIGHT_TYPE 0.0 4.0 /end CHARACTERISTIC
/begin CHARACTERISTIC D_IgnitionCoil2HiLightType "cal comments" VALUE 0xC324 Scalar_UB 0.0 CM_LIGHT_TYPE 0.0 4.0 /end CHARACTERISTIC
/begin CHARACTERISTIC D_IgnitionCoil3LoLightType "cal comments" VALUE 0xC325 Scalar_UB 0.0 CM_LIGHT_TYPE 0.0 4.0 /end CHARACTERISTIC
/begin CHARACTERISTIC D_IgnitionCoil3HiLightType "cal comments" VALUE 0xC326 Scalar_UB 0.0 CM_LIGHT_TYPE 0.0 4.0 /end CHARACTERISTIC
/begin CHARACTERISTIC D_IgnitionCoil4LoLightType "cal comments" VALUE 0xC327 Scalar_UB 0.0 CM_LIGHT_TYPE 0.0 4.0 /end CHARACTERISTIC
/begin CHARACTERISTIC D_IgnitionCoil4HiLightType "cal comments" VALUE 0xC328 Scalar_UB 0.0 CM_LIGHT_TYPE 0.0 4.0 /end CHARACTERISTIC
/begin CHARACTERISTIC D_InjectorCyl1LoLightType "cal comments" VALUE 0xC413 Scalar_UB 0.0 CM_LIGHT_TYPE 0.0 4.0 /end CHARACTERISTIC
/begin CHARACTERISTIC D_InjectorCyl1HiLoLightType "cal comments" VALUE 0xC414 Scalar_UB 0.0 CM_LIGHT_TYPE 0.0 4.0 /end CHARACTERISTIC
/begin CHARACTERISTIC D_InjectorCyl2LoLightType "cal comments" VALUE 0xC415 Scalar_UB 0.0 CM_LIGHT_TYPE 0.0 4.0 /end CHARACTERISTIC
/begin CHARACTERISTIC D_InjectorCyl2HiLoLightType "cal comments" VALUE 0xC416 Scalar_UB 0.0 CM_LIGHT_TYPE 0.0 4.0 /end CHARACTERISTIC
/begin CHARACTERISTIC D_InjectorCyl3LoLightType "cal comments" VALUE 0xC417 Scalar_UB 0.0 CM_LIGHT_TYPE 0.0 4.0 /end CHARACTERISTIC
/begin CHARACTERISTIC D_InjectorCyl3HiLoLightType "cal comments" VALUE 0xC418 Scalar_UB 0.0 CM_LIGHT_TYPE 0.0 4.0 /end CHARACTERISTIC
/begin CHARACTERISTIC D_InjectorCyl4LoLightType "cal comments" VALUE 0xC419 Scalar_UB 0.0 CM_LIGHT_TYPE 0.0 4.0 /end CHARACTERISTIC
/begin CHARACTERISTIC D_InjectorCyl4HiLoLightType "cal comments" VALUE 0xC41A Scalar_UB 0.0 CM_LIGHT_TYPE 0.0 4.0 /end CHARACTERISTIC
/begin CHARACTERISTIC D_CrankSignalLossLightType "cal comments" VALUE 0xC319 Scalar_UB 0.0 CM_LIGHT_TYPE 0.0 4.0 /end CHARACTERISTIC
/begin CHARACTERISTIC D_CrankSignalNoiseLightType "cal comments" VALUE 0xC31A Scalar_UB 0.0 CM_LIGHT_TYPE 0.0 4.0 /end CHARACTERISTIC
/begin CHARACTERISTIC D_BatVoltLoLightType "cal comments" VALUE 0xC499 Scalar_UB 0.0 CM_LIGHT_TYPE 0.0 4.0 /end CHARACTERISTIC
/begin CHARACTERISTIC D_BatVoltHiLightType "cal comments" VALUE 0xC49A Scalar_UB 0.0 CM_LIGHT_TYPE 0.0 4.0 /end CHARACTERISTIC
/begin CHARACTERISTIC D_Knock1SignalLightType "cal comments" VALUE 0xC2A2 Scalar_UB 0.0 CM_LIGHT_TYPE 0.0 4.0 /end CHARACTERISTIC
/begin CHARACTERISTIC D_Knock2SignalLightType "cal comments" VALUE 0xC2A3 Scalar_UB 0.0 CM_LIGHT_TYPE 0.0 4.0 /end CHARACTERISTIC
/begin CHARACTERISTIC D_IACVShortLoLightType "cal comments" VALUE 0xC373 Scalar_UB 0.0 CM_LIGHT_TYPE 0.0 4.0 /end CHARACTERISTIC
/begin CHARACTERISTIC D_IACVShortHiLightType "cal comments" VALUE 0xC374 Scalar_UB 0.0 CM_LIGHT_TYPE 0.0 4.0 /end CHARACTERISTIC
/begin CHARACTERISTIC D_FuelPumpShortLoLightType "cal comments" VALUE 0xC334 Scalar_UB 0.0 CM_LIGHT_TYPE 0.0 4.0 /end CHARACTERISTIC
/begin CHARACTERISTIC D_FuelPumpShortHiLightType "cal comments" VALUE 0xC335 Scalar_UB 0.0 CM_LIGHT_TYPE 0.0 4.0 /end CHARACTERISTIC
/begin CHARACTERISTIC D_FPFeedbackLightType "cal comments" VALUE 0xC33B Scalar_UB 0.0 CM_LIGHT_TYPE 0.0 4.0 /end CHARACTERISTIC
/begin CHARACTERISTIC D_CoolTemp2ShortLoLightType "cal comments" VALUE 0xC2C7 Scalar_UB 0.0 CM_LIGHT_TYPE 0.0 4.0 /end CHARACTERISTIC
/begin CHARACTERISTIC D_CoolTemp2ShortHiLightType "cal comments" VALUE 0xC2C8 Scalar_UB 0.0 CM_LIGHT_TYPE 0.0 4.0 /end CHARACTERISTIC
/begin CHARACTERISTIC D_CCPShortLoLightType "cal comments" VALUE 0x0 Scalar_UB 0.0 CM_LIGHT_TYPE 0.0 4.0 /end CHARACTERISTIC
/begin CHARACTERISTIC D_CCPShortHiLightType "cal comments" VALUE 0x0 Scalar_UB 0.0 CM_LIGHT_TYPE 0.0 4.0 /end CHARACTERISTIC
/begin CHARACTERISTIC D_SoftwareErrorLightType "cal comments" VALUE 0xC46D Scalar_UB 0.0 CM_LIGHT_TYPE 0.0 4.0 /end CHARACTERISTIC
/begin CHARACTERISTIC D_ACSShortLoLightType "cal comments" VALUE 0xC3D9 Scalar_UB 0.0 CM_LIGHT_TYPE 0.0 4.0 /end CHARACTERISTIC
/begin CHARACTERISTIC D_ACSShortHiLightType "cal comments" VALUE 0xC3DA Scalar_UB 0.0 CM_LIGHT_TYPE 0.0 4.0 /end CHARACTERISTIC
/begin CHARACTERISTIC D_WPSShortLoLightType "cal comments" VALUE 0xC3EB Scalar_UB 0.0 CM_LIGHT_TYPE 0.0 4.0 /end CHARACTERISTIC
/begin CHARACTERISTIC D_WPSShortHiLightType "cal comments" VALUE 0xC3EC Scalar_UB 0.0 CM_LIGHT_TYPE 0.0 4.0 /end CHARACTERISTIC
/begin CHARACTERISTIC D_GENVLoLightType "cal comments" VALUE 0x0 Scalar_UB 0.0 CM_LIGHT_TYPE 0.0 4.0 /end CHARACTERISTIC
/begin CHARACTERISTIC D_GENVHiLightType "cal comments" VALUE 0x0 Scalar_UB 0.0 CM_LIGHT_TYPE 0.0 4.0 /end CHARACTERISTIC
/begin CHARACTERISTIC D_O21ShortLoFMIType "cal comments" VALUE 0xC2E1 Scalar_UB 0.0 CM_Count1 0.0 255.0 /end CHARACTERISTIC
/begin CHARACTERISTIC D_O21ShortHiFMIType "cal comments" VALUE 0xC2E2 Scalar_UB 0.0 CM_Count1 0.0 255.0 /end CHARACTERISTIC
/begin CHARACTERISTIC D_RO21ShortLoFMIType "cal comments" VALUE 0xC2F9 Scalar_UB 0.0 CM_Count1 0.0 255.0 /end CHARACTERISTIC
/begin CHARACTERISTIC D_RO21ShortHiFMIType "cal comments" VALUE 0xC2FA Scalar_UB 0.0 CM_Count1 0.0 255.0 /end CHARACTERISTIC
/begin CHARACTERISTIC D_O2HeaterShortLoFMIType "cal comments" VALUE 0xC367 Scalar_UB 0.0 CM_Count1 0.0 255.0 /end CHARACTERISTIC
/begin CHARACTERISTIC D_O2HeaterShortHiFMIType "cal comments" VALUE 0xC368 Scalar_UB 0.0 CM_Count1 0.0 255.0 /end CHARACTERISTIC
/begin CHARACTERISTIC D_RO21ShortLoFMIType "cal comments" VALUE 0xC2F9 Scalar_UB 0.0 CM_Count1 0.0 255.0 /end CHARACTERISTIC
/begin CHARACTERISTIC D_RO21ShortHiFMIType "cal comments" VALUE 0xC2FA Scalar_UB 0.0 CM_Count1 0.0 255.0 /end CHARACTERISTIC
/begin CHARACTERISTIC D_RO2Heater1ShortLoFMIType "cal comments" VALUE 0xC36E Scalar_UB 0.0 CM_Count1 0.0 255.0 /end CHARACTERISTIC
/begin CHARACTERISTIC D_RO2Heater1ShortHiFMIType "cal comments" VALUE 0xC36F Scalar_UB 0.0 CM_Count1 0.0 255.0 /end CHARACTERISTIC
/begin CHARACTERISTIC D_CoolTempShortLoFMIType "cal comments" VALUE 0xC2B9 Scalar_UB 0.0 CM_Count1 0.0 255.0 /end CHARACTERISTIC
/begin CHARACTERISTIC D_CoolTempShortHiFMIType "cal comments" VALUE 0xC2BA Scalar_UB 0.0 CM_Count1 0.0 255.0 /end CHARACTERISTIC
/begin CHARACTERISTIC D_CoolTempOverHeatExp1FMIType "cal comments" VALUE 0xC2BB Scalar_UB 0.0 CM_Count1 0.0 255.0 /end CHARACTERISTIC
/begin CHARACTERISTIC D_CoolTempOverHeatExp2FMIType "cal comments" VALUE 0xC2BC Scalar_UB 0.0 CM_Count1 0.0 255.0 /end CHARACTERISTIC
/begin CHARACTERISTIC D_IntakeAirTempShortLoFMIType "cal comments" VALUE 0xC3B9 Scalar_UB 0.0 CM_Count1 0.0 255.0 /end CHARACTERISTIC
/begin CHARACTERISTIC D_IntakeAirTempShortHiFMIType "cal comments" VALUE 0xC3BA Scalar_UB 0.0 CM_Count1 0.0 255.0 /end CHARACTERISTIC
/begin CHARACTERISTIC D_IntakeAirTempHiExp1FMIType "cal comments" VALUE 0xC3BB Scalar_UB 0.0 CM_Count1 0.0 255.0 /end CHARACTERISTIC
/begin CHARACTERISTIC D_IntakeAirTempHiExp2FMIType "cal comments" VALUE 0xC3BC Scalar_UB 0.0 CM_Count1 0.0 255.0 /end CHARACTERISTIC
/begin CHARACTERISTIC D_SCIShortLoFMIType "cal comments" VALUE 0xC3C9 Scalar_UB 0.0 CM_Count1 0.0 255.0 /end CHARACTERISTIC
/begin CHARACTERISTIC D_SCIShortHiFMIType "cal comments" VALUE 0xC3CA Scalar_UB 0.0 CM_Count1 0.0 255.0 /end CHARACTERISTIC
/begin CHARACTERISTIC D_BSTPShortLoFMIType "cal comments" VALUE 0xC40D Scalar_UB 0.0 CM_Count1 0.0 255.0 /end CHARACTERISTIC
/begin CHARACTERISTIC D_BSTPShortHiFMIType "cal comments" VALUE 0xC40E Scalar_UB 0.0 CM_Count1 0.0 255.0 /end CHARACTERISTIC
/begin CHARACTERISTIC D_BSTCShortLoFMIType "cal comments" VALUE 0xC398 Scalar_UB 0.0 CM_Count1 0.0 255.0 /end CHARACTERISTIC
/begin CHARACTERISTIC D_BSTCShortHiFMIType "cal comments" VALUE 0xC399 Scalar_UB 0.0 CM_Count1 0.0 255.0 /end CHARACTERISTIC
/begin CHARACTERISTIC D_MAPShortLoFMIType "cal comments" VALUE 0xC441 Scalar_UB 0.0 CM_Count1 0.0 255.0 /end CHARACTERISTIC
/begin CHARACTERISTIC D_MAPShortHiFMIType "cal comments" VALUE 0xC442 Scalar_UB 0.0 CM_Count1 0.0 255.0 /end CHARACTERISTIC
/begin CHARACTERISTIC D_FPShortLoFMIType "cal comments" VALUE 0xC34F Scalar_UB 0.0 CM_Count1 0.0 255.0 /end CHARACTERISTIC
/begin CHARACTERISTIC D_FPShortHiFMIType "cal comments" VALUE 0xC350 Scalar_UB 0.0 CM_Count1 0.0 255.0 /end CHARACTERISTIC
/begin CHARACTERISTIC D_FPLoFMIType "cal comments" VALUE 0xC351 Scalar_UB 0.0 CM_Count1 0.0 255.0 /end CHARACTERISTIC
/begin CHARACTERISTIC D_FPHiFMIType "cal comments" VALUE 0xC352 Scalar_UB 0.0 CM_Count1 0.0 255.0 /end CHARACTERISTIC
/begin CHARACTERISTIC D_OilPressureFMIType "cal comments" VALUE 0xC451 Scalar_UB 0.0 CM_Count1 0.0 255.0 /end CHARACTERISTIC
/begin CHARACTERISTIC D_TPSShortLoFMIType "cal comments" VALUE 0xC47D Scalar_UB 0.0 CM_Count1 0.0 255.0 /end CHARACTERISTIC
/begin CHARACTERISTIC D_TPSShortHiFMIType "cal comments" VALUE 0xC47E Scalar_UB 0.0 CM_Count1 0.0 255.0 /end CHARACTERISTIC
/begin CHARACTERISTIC D_DCMShortLoFMIType "cal comments" VALUE 0xC29B Scalar_UB 0.0 CM_Count1 0.0 255.0 /end CHARACTERISTIC
/begin CHARACTERISTIC D_DCMShortHiFMIType "cal comments" VALUE 0xC29C Scalar_UB 0.0 CM_Count1 0.0 255.0 /end CHARACTERISTIC
/begin CHARACTERISTIC D_TPSMotorControlFMIType "cal comments" VALUE 0xC3A7 Scalar_UB 0.0 CM_Count1 0.0 255.0 /end CHARACTERISTIC
/begin CHARACTERISTIC D_FCVPSShortLoFMIType "cal comments" VALUE 0xC48B Scalar_UB 0.0 CM_Count1 0.0 255.0 /end CHARACTERISTIC
/begin CHARACTERISTIC D_FCVPSShortHiFMIType "cal comments" VALUE 0xC48C Scalar_UB 0.0 CM_Count1 0.0 255.0 /end CHARACTERISTIC
/begin CHARACTERISTIC D_FCVMShortLoFMIType "cal comments" VALUE 0xC2A4 Scalar_UB 0.0 CM_Count1 0.0 255.0 /end CHARACTERISTIC
/begin CHARACTERISTIC D_FCVMShortHiFMIType "cal comments" VALUE 0xC2A5 Scalar_UB 0.0 CM_Count1 0.0 255.0 /end CHARACTERISTIC
/begin CHARACTERISTIC D_FCVMotorControlFMIType "cal comments" VALUE 0xC361 Scalar_UB 0.0 CM_Count1 0.0 255.0 /end CHARACTERISTIC
/begin CHARACTERISTIC D_FCV1ShortLoFMIType "cal comments" VALUE 0xC37C Scalar_UB 0.0 CM_Count1 0.0 255.0 /end CHARACTERISTIC
/begin CHARACTERISTIC D_FCV1ShortHiFMIType "cal comments" VALUE 0xC37D Scalar_UB 0.0 CM_Count1 0.0 255.0 /end CHARACTERISTIC
/begin CHARACTERISTIC D_FCV2ShortLoFMIType "cal comments" VALUE 0xC383 Scalar_UB 0.0 CM_Count1 0.0 255.0 /end CHARACTERISTIC
/begin CHARACTERISTIC D_FCV2ShortHiFMIType "cal comments" VALUE 0xC384 Scalar_UB 0.0 CM_Count1 0.0 255.0 /end CHARACTERISTIC
/begin CHARACTERISTIC D_REF1ShortLoFMIType "cal comments" VALUE 0xC38A Scalar_UB 0.0 CM_Count1 0.0 255.0 /end CHARACTERISTIC
/begin CHARACTERISTIC D_REF1ShortHiFMIType "cal comments" VALUE 0xC38B Scalar_UB 0.0 CM_Count1 0.0 255.0 /end CHARACTERISTIC
/begin CHARACTERISTIC D_REF2ShortLoFMIType "cal comments" VALUE 0xC391 Scalar_UB 0.0 CM_Count1 0.0 255.0 /end CHARACTERISTIC
/begin CHARACTERISTIC D_REF2ShortHiFMIType "cal comments" VALUE 0xC392 Scalar_UB 0.0 CM_Count1 0.0 255.0 /end CHARACTERISTIC
/begin CHARACTERISTIC D_BLM_TrimLoFMIType "cal comments" VALUE 0xC308 Scalar_UB 0.0 CM_Count1 0.0 255.0 /end CHARACTERISTIC
/begin CHARACTERISTIC D_BLM_TrimHiFMIType "cal comments" VALUE 0xC309 Scalar_UB 0.0 CM_Count1 0.0 255.0 /end CHARACTERISTIC
/begin CHARACTERISTIC D_IgnitionCoil1LoFMIType "cal comments" VALUE 0xC329 Scalar_UB 0.0 CM_Count1 0.0 255.0 /end CHARACTERISTIC
/begin CHARACTERISTIC D_IgnitionCoil1HiFMIType "cal comments" VALUE 0xC32A Scalar_UB 0.0 CM_Count1 0.0 255.0 /end CHARACTERISTIC
/begin CHARACTERISTIC D_IgnitionCoil2LoFMIType "cal comments" VALUE 0xC32B Scalar_UB 0.0 CM_Count1 0.0 255.0 /end CHARACTERISTIC
/begin CHARACTERISTIC D_IgnitionCoil2HiFMIType "cal comments" VALUE 0xC32C Scalar_UB 0.0 CM_Count1 0.0 255.0 /end CHARACTERISTIC
/begin CHARACTERISTIC D_IgnitionCoil3LoFMIType "cal comments" VALUE 0xC32D Scalar_UB 0.0 CM_Count1 0.0 255.0 /end CHARACTERISTIC
/begin CHARACTERISTIC D_IgnitionCoil3HiFMIType "cal comments" VALUE 0xC32E Scalar_UB 0.0 CM_Count1 0.0 255.0 /end CHARACTERISTIC
/begin CHARACTERISTIC D_IgnitionCoil4LoFMIType "cal comments" VALUE 0xC32F Scalar_UB 0.0 CM_Count1 0.0 255.0 /end CHARACTERISTIC
/begin CHARACTERISTIC D_IgnitionCoil4HiFMIType "cal comments" VALUE 0xC330 Scalar_UB 0.0 CM_Count1 0.0 255.0 /end CHARACTERISTIC
/begin CHARACTERISTIC D_InjectorCyl1LoFMIType "cal comments" VALUE 0xC41B Scalar_UB 0.0 CM_Count1 0.0 255.0 /end CHARACTERISTIC
/begin CHARACTERISTIC D_InjectorCyl1HiLoFMIType "cal comments" VALUE 0xC41C Scalar_UB 0.0 CM_Count1 0.0 255.0 /end CHARACTERISTIC
/begin CHARACTERISTIC D_InjectorCyl2LoFMIType "cal comments" VALUE 0xC41D Scalar_UB 0.0 CM_Count1 0.0 255.0 /end CHARACTERISTIC
/begin CHARACTERISTIC D_InjectorCyl2HiLoFMIType "cal comments" VALUE 0xC41E Scalar_UB 0.0 CM_Count1 0.0 255.0 /end CHARACTERISTIC
/begin CHARACTERISTIC D_InjectorCyl3LoFMIType "cal comments" VALUE 0xC41F Scalar_UB 0.0 CM_Count1 0.0 255.0 /end CHARACTERISTIC
/begin CHARACTERISTIC D_InjectorCyl3HiLoFMIType "cal comments" VALUE 0xC420 Scalar_UB 0.0 CM_Count1 0.0 255.0 /end CHARACTERISTIC
/begin CHARACTERISTIC D_InjectorCyl4LoFMIType "cal comments" VALUE 0xC421 Scalar_UB 0.0 CM_Count1 0.0 255.0 /end CHARACTERISTIC
/begin CHARACTERISTIC D_InjectorCyl4HiLoFMIType "cal comments" VALUE 0xC422 Scalar_UB 0.0 CM_Count1 0.0 255.0 /end CHARACTERISTIC
/begin CHARACTERISTIC D_CrankSignalLossFMIType "cal comments" VALUE 0xC31B Scalar_UB 0.0 CM_Count1 0.0 255.0 /end CHARACTERISTIC
/begin CHARACTERISTIC D_CrankSignalNoiseFMIType "cal comments" VALUE 0xC31C Scalar_UB 0.0 CM_Count1 0.0 255.0 /end CHARACTERISTIC
/begin CHARACTERISTIC D_BatVoltLoFMIType "cal comments" VALUE 0xC49B Scalar_UB 0.0 CM_Count1 0.0 255.0 /end CHARACTERISTIC
/begin CHARACTERISTIC D_BatVoltHiFMIType "cal comments" VALUE 0xC49C Scalar_UB 0.0 CM_Count1 0.0 255.0 /end CHARACTERISTIC
/begin CHARACTERISTIC D_Knock1SignalFMIType "cal comments" VALUE 0xC2A6 Scalar_UB 0.0 CM_Count1 0.0 255.0 /end CHARACTERISTIC
/begin CHARACTERISTIC D_Knock2SignalFMIType "cal comments" VALUE 0xC2A7 Scalar_UB 0.0 CM_Count1 0.0 255.0 /end CHARACTERISTIC
/begin CHARACTERISTIC D_IACVShortLoFMIType "cal comments" VALUE 0xC375 Scalar_UB 0.0 CM_Count1 0.0 255.0 /end CHARACTERISTIC
/begin CHARACTERISTIC D_IACVShortHiFMIType "cal comments" VALUE 0xC376 Scalar_UB 0.0 CM_Count1 0.0 255.0 /end CHARACTERISTIC
/begin CHARACTERISTIC D_FuelPumpShortLoFMIType "cal comments" VALUE 0xC336 Scalar_UB 0.0 CM_Count1 0.0 255.0 /end CHARACTERISTIC
/begin CHARACTERISTIC D_FuelPumpShortHiFMIType "cal comments" VALUE 0xC337 Scalar_UB 0.0 CM_Count1 0.0 255.0 /end CHARACTERISTIC
/begin CHARACTERISTIC D_FPFeedbackFMIType "cal comments" VALUE 0xC33C Scalar_UB 0.0 CM_Count1 0.0 255.0 /end CHARACTERISTIC
/begin CHARACTERISTIC D_CoolTemp2ShortLoFMIType "cal comments" VALUE 0xC2C9 Scalar_UB 0.0 CM_Count1 0.0 255.0 /end CHARACTERISTIC
/begin CHARACTERISTIC D_CoolTemp2ShortHiFMIType "cal comments" VALUE 0xC2CA Scalar_UB 0.0 CM_Count1 0.0 255.0 /end CHARACTERISTIC
/begin CHARACTERISTIC D_CCPShortLoFMIType "cal comments" VALUE 0x0 Scalar_UB 0.0 CM_Count1 0.0 255.0 /end CHARACTERISTIC
/begin CHARACTERISTIC D_CCPShortHiFMIType "cal comments" VALUE 0x0 Scalar_UB 0.0 CM_Count1 0.0 255.0 /end CHARACTERISTIC
/begin CHARACTERISTIC D_SoftwareErrorFMIType "cal comments" VALUE 0xC46E Scalar_UB 0.0 CM_Count1 0.0 255.0 /end CHARACTERISTIC
/begin CHARACTERISTIC D_ACSShortLoFMIType "cal comments" VALUE 0xC3DB Scalar_UB 0.0 CM_Count1 0.0 255.0 /end CHARACTERISTIC
/begin CHARACTERISTIC D_ACSShortHiFMIType "cal comments" VALUE 0xC3DC Scalar_UB 0.0 CM_Count1 0.0 255.0 /end CHARACTERISTIC
/begin CHARACTERISTIC D_WPSShortLoFMIType "cal comments" VALUE 0xC3ED Scalar_UB 0.0 CM_Count1 0.0 255.0 /end CHARACTERISTIC
/begin CHARACTERISTIC D_WPSShortHiFMIType "cal comments" VALUE 0xC3EE Scalar_UB 0.0 CM_Count1 0.0 255.0 /end CHARACTERISTIC
/begin CHARACTERISTIC D_GENVLoFMIType "cal comments" VALUE 0x0 Scalar_UB 0.0 CM_Count1 0.0 255.0 /end CHARACTERISTIC
/begin CHARACTERISTIC D_GENVHiFMIType "cal comments" VALUE 0x0 Scalar_UB 0.0 CM_Count1 0.0 255.0 /end CHARACTERISTIC
/begin CHARACTERISTIC D_TPSShortDiagPassTimeThrsh "cal comments" VALUE 0xC474 Scalar_UW 0.0 CM_Count_0to65535_2 0.0 65535.0 /end CHARACTERISTIC
/begin CHARACTERISTIC D_TPSShortEnb "cal comments" VALUE 0xC47A Scalar_UB 0.0 CM_Boolean6 0.0 255.0 /end CHARACTERISTIC
/begin CHARACTERISTIC D_TPSShortHighFailTimeThrsh "cal comments" VALUE 0xC470 Scalar_UW 0.0 CM_Count_0to65535_2 0.0 65535.0 /end CHARACTERISTIC
/begin CHARACTERISTIC D_TPSShortLowFailTimeThrsh "cal comments" VALUE 0xC472 Scalar_UW 0.0 CM_Count_0to65535_2 0.0 65535.0 /end CHARACTERISTIC
/begin CHARACTERISTIC D_TPSShortRangeThreshHi "cal comments" VALUE 0xC478 Scalar_UW 0.0 CM_Percent_0to100_1 0.0 99.9984130859375 /end CHARACTERISTIC
/begin CHARACTERISTIC D_TPSShortRangeThreshLo "cal comments" VALUE 0xC476 Scalar_UW 0.0 CM_Percent_0to100_1 0.0 99.9984130859375 /end CHARACTERISTIC
/begin CHARACTERISTIC D_FCVPSShortEnb "cal comments" VALUE 0xC488 Scalar_UB 0.0 CM_Boolean6 0.0 255.0 /end CHARACTERISTIC
/begin CHARACTERISTIC D_FCVPSFailTimeThrsh "cal comments" VALUE 0xC480 Scalar_UW 0.0 CM_Count_0to65535_2 0.0 65535.0 /end CHARACTERISTIC
/begin CHARACTERISTIC D_FCVPSPassTimeThrsh "cal comments" VALUE 0xC482 Scalar_UW 0.0 CM_Count_0to65535_2 0.0 65535.0 /end CHARACTERISTIC
/begin CHARACTERISTIC D_FCVPSShortRangeThreshHi "cal comments" VALUE 0xC486 Scalar_UW 0.0 CM_Percent_0to100_1 0.0 99.9984130859375 /end CHARACTERISTIC
/begin CHARACTERISTIC D_FCVPSShortRangeThreshLo "cal comments" VALUE 0xC484 Scalar_UW 0.0 CM_Percent_0to100_1 0.0 99.9984130859375 /end CHARACTERISTIC
/begin MEASUREMENT AFRRamped "var comments" UWORD udf_CM_15464 0 0.0 0.0 31.99951171875 ECU_ADDRESS 0x4000260A /end MEASUREMENT
/begin MEASUREMENT AFRBase "var comments" UWORD udf_CM_15422 0 0.0 0.0 31.99951171875 ECU_ADDRESS 0x400026D8 /end MEASUREMENT
/begin MEASUREMENT AFRCrankToRun "var comments" UBYTE udf_CM_15436 0 0.0 0.0 255.0 ECU_ADDRESS 0x40002606 /end MEASUREMENT
/begin MEASUREMENT AFRWarmUpEnb "var comments" UBYTE udf_CM_15513 0 0.0 0.0 255.0 ECU_ADDRESS 0x40002614 /end MEASUREMENT
/begin MEASUREMENT AFRWarmUp "var comments" UWORD udf_CM_15506 0 0.0 0.0 31.99951171875 ECU_ADDRESS 0x40002612 /end MEASUREMENT
/begin MEASUREMENT AFRWarmUpIdle "var comments" UWORD udf_CM_15520 0 0.0 0.0 31.99951171875 ECU_ADDRESS 0x4000260E /end MEASUREMENT
/begin MEASUREMENT AFRWarmUpRun "var comments" UWORD udf_CM_15527 0 0.0 0.0 31.99951171875 ECU_ADDRESS 0x40002610 /end MEASUREMENT
/begin MEASUREMENT AFRCrank "var comments" UWORD udf_CM_15429 0 0.0 0.0 31.99951171875 ECU_ADDRESS 0x400026D2 /end MEASUREMENT
/begin MEASUREMENT AFRFinal "var comments" UWORD udf_CM_15450 0 0.0 0.0 31.99951171875 ECU_ADDRESS 0x40002618 /end MEASUREMENT
/begin MEASUREMENT AFRPE "var comments" UWORD udf_CM_15457 0 0.0 0.0 31.99951171875 ECU_ADDRESS 0x4000261A /end MEASUREMENT
/begin MEASUREMENT AFRTarget "var comments" UWORD udf_CM_15485 0 0.0 0.0 31.99951171875 ECU_ADDRESS 0x40002608 /end MEASUREMENT
/begin MEASUREMENT AirFlowCyl1 "var comments" UWORD udf_CM_15534 0 0.0 0.0 511.9921875 DISPLAY_IDENTIFIER AirFlowCyl[0] ECU_ADDRESS 0x40002578 /end MEASUREMENT
/begin MEASUREMENT AirFlowCyl2 "var comments" UWORD udf_CM_15541 0 0.0 0.0 511.9921875 DISPLAY_IDENTIFIER AirFlowCyl[1] ECU_ADDRESS 0x4000257A /end MEASUREMENT
/begin MEASUREMENT AFRVolt1Unfilt "var comments" UWORD udf_CM_15492 0 0.0 0.0 31.99951171875 ECU_ADDRESS 0x0 /end MEASUREMENT
/begin MEASUREMENT AFRVolt2Unfilt "var comments" UWORD udf_CM_15499 0 0.0 0.0 31.99951171875 ECU_ADDRESS 0x0 /end MEASUREMENT
/begin MEASUREMENT AFRVolt1 "var comments" UWORD udf_CM_15492 0 0.0 0.0 31.99951171875 ECU_ADDRESS 0x0 /end MEASUREMENT
/begin MEASUREMENT AFRVolt2 "var comments" UWORD udf_CM_15499 0 0.0 0.0 31.99951171875 ECU_ADDRESS 0x0 /end MEASUREMENT
/begin MEASUREMENT ClTDiagEnb "var comments" UBYTE udf_CM_15674 0 0.0 0.0 255.0 ECU_ADDRESS 0x40002B80 /end MEASUREMENT
/begin MEASUREMENT ClTSHFailCount "var comments" UWORD udf_CM_15681 0 0.0 0.0 65535.0 ECU_ADDRESS 0x40002B90 /end MEASUREMENT
/begin MEASUREMENT ClTSHFailMet "var comments" UBYTE udf_CM_15688 0 0.0 0.0 255.0 ECU_ADDRESS 0x40002B82 /end MEASUREMENT
/begin MEASUREMENT ClTSHPassCount "var comments" UWORD udf_CM_15695 0 0.0 0.0 65535.0 ECU_ADDRESS 0x40002B92 /end MEASUREMENT
/begin MEASUREMENT ClTSHTestFail "var comments" UBYTE udf_CM_15702 0 0.0 0.0 255.0 ECU_ADDRESS 0x40002B88 /end MEASUREMENT
/begin MEASUREMENT ClTSLFailCount "var comments" UWORD udf_CM_15716 0 0.0 0.0 65535.0 ECU_ADDRESS 0x40002B8C /end MEASUREMENT
/begin MEASUREMENT ClTSLFailMet "var comments" UBYTE udf_CM_15723 0 0.0 0.0 255.0 ECU_ADDRESS 0x40002B81 /end MEASUREMENT
/begin MEASUREMENT ClTSLPassCount "var comments" UWORD udf_CM_15730 0 0.0 0.0 65535.0 ECU_ADDRESS 0x40002B8E /end MEASUREMENT
/begin MEASUREMENT ClTSLTestFail "var comments" UBYTE udf_CM_15737 0 0.0 0.0 255.0 ECU_ADDRESS 0x40002B87 /end MEASUREMENT
/begin MEASUREMENT ClTOH1FailCount "var comments" UWORD udf_CM_15716 0 0.0 0.0 65535.0 ECU_ADDRESS 0x40002B94 /end MEASUREMENT
/begin MEASUREMENT ClTOH1FailMet "var comments" UBYTE udf_CM_15723 0 0.0 0.0 255.0 ECU_ADDRESS 0x40002B8B /end MEASUREMENT
/begin MEASUREMENT ClTOH1PassCount "var comments" UWORD udf_CM_15730 0 0.0 0.0 65535.0 ECU_ADDRESS 0x40002B96 /end MEASUREMENT
/begin MEASUREMENT ClTOH1TestFail "var comments" UBYTE udf_CM_15737 0 0.0 0.0 255.0 ECU_ADDRESS 0x40002B89 /end MEASUREMENT
/begin MEASUREMENT ClTOH2FailCount "var comments" UWORD udf_CM_15716 0 0.0 0.0 65535.0 ECU_ADDRESS 0x40002B98 /end MEASUREMENT
/begin MEASUREMENT ClTOH2FailMet "var comments" UBYTE udf_CM_15723 0 0.0 0.0 255.0 ECU_ADDRESS 0x40002B7E /end MEASUREMENT
/begin MEASUREMENT ClTOH2PassCount "var comments" UWORD udf_CM_15730 0 0.0 0.0 65535.0 ECU_ADDRESS 0x40002B9A /end MEASUREMENT
/begin MEASUREMENT ClTOH2TestFail "var comments" UBYTE udf_CM_15737 0 0.0 0.0 255.0 ECU_ADDRESS 0x40002B8A /end MEASUREMENT
/begin MEASUREMENT FPDiagEnb "var comments" UBYTE udf_CM_17382 0 0.0 0.0 255.0 ECU_ADDRESS 0x40002C5A /end MEASUREMENT
/begin MEASUREMENT FPSLFailMet "var comments" UBYTE udf_CM_17410 0 0.0 0.0 255.0 ECU_ADDRESS 0x40002C63 /end MEASUREMENT
/begin MEASUREMENT FPSLTestComp "var comments" UBYTE udf_CM_17424 0 0.0 0.0 255.0 ECU_ADDRESS 0x40002C5B /end MEASUREMENT
/begin MEASUREMENT FPSLTestFail "var comments" UBYTE udf_CM_17431 0 0.0 0.0 255.0 ECU_ADDRESS 0x40002C5F /end MEASUREMENT
/begin MEASUREMENT FPSLFailCount "var comments" UWORD udf_CM_17389 0 0.0 0.0 65535.0 ECU_ADDRESS 0x40002C64 /end MEASUREMENT
/begin MEASUREMENT FPSLPassCount "var comments" UWORD udf_CM_17417 0 0.0 0.0 65535.0 ECU_ADDRESS 0x40002C66 /end MEASUREMENT
/begin MEASUREMENT FPSHFailMet "var comments" UBYTE udf_CM_17410 0 0.0 0.0 255.0 ECU_ADDRESS 0x40002C56 /end MEASUREMENT
/begin MEASUREMENT FPSHTestComp "var comments" UBYTE udf_CM_17424 0 0.0 0.0 255.0 ECU_ADDRESS 0x40002C5C /end MEASUREMENT
/begin MEASUREMENT FPSHTestFail "var comments" UBYTE udf_CM_17431 0 0.0 0.0 255.0 ECU_ADDRESS 0x40002C60 /end MEASUREMENT
/begin MEASUREMENT FPSHFailCount "var comments" UWORD udf_CM_17389 0 0.0 0.0 65535.0 ECU_ADDRESS 0x40002C68 /end MEASUREMENT
/begin MEASUREMENT FPSHPassCount "var comments" UWORD udf_CM_17417 0 0.0 0.0 65535.0 ECU_ADDRESS 0x40002C6A /end MEASUREMENT
/begin MEASUREMENT FPLoFailMet "var comments" UBYTE udf_CM_17410 0 0.0 0.0 255.0 ECU_ADDRESS 0x40002C57 /end MEASUREMENT
/begin MEASUREMENT FPLoTestComp "var comments" UBYTE udf_CM_17424 0 0.0 0.0 255.0 ECU_ADDRESS 0x40002C5D /end MEASUREMENT
/begin MEASUREMENT FPLoTestFail "var comments" UBYTE udf_CM_17431 0 0.0 0.0 255.0 ECU_ADDRESS 0x40002C61 /end MEASUREMENT
/begin MEASUREMENT FPLoFailCount "var comments" UWORD udf_CM_17389 0 0.0 0.0 65535.0 ECU_ADDRESS 0x40002C6C /end MEASUREMENT
/begin MEASUREMENT FPLoPassCount "var comments" UWORD udf_CM_17417 0 0.0 0.0 65535.0 ECU_ADDRESS 0x40002C6E /end MEASUREMENT
/begin MEASUREMENT FPHiFailMet "var comments" UBYTE udf_CM_17410 0 0.0 0.0 255.0 ECU_ADDRESS 0x40002C58 /end MEASUREMENT
/begin MEASUREMENT FPHiTestComp "var comments" UBYTE udf_CM_17424 0 0.0 0.0 255.0 ECU_ADDRESS 0x40002C5E /end MEASUREMENT
/begin MEASUREMENT FPHiTestFail "var comments" UBYTE udf_CM_17431 0 0.0 0.0 255.0 ECU_ADDRESS 0x40002C62 /end MEASUREMENT
/begin MEASUREMENT FPHiFailCount "var comments" UWORD udf_CM_17389 0 0.0 0.0 65535.0 ECU_ADDRESS 0x40002C70 /end MEASUREMENT
/begin MEASUREMENT FPHiPassCount "var comments" UWORD udf_CM_17417 0 0.0 0.0 65535.0 ECU_ADDRESS 0x40002C72 /end MEASUREMENT
/begin MEASUREMENT Coil1DiagEnb "var comments" UBYTE udf_CM_18019 0 0.0 0.0 255.0 DISPLAY_IDENTIFIER CoilDiagEnb[0] ECU_ADDRESS 0x40002CAE /end MEASUREMENT
/begin MEASUREMENT Coil1SLFailMet "var comments" UBYTE udf_CM_18047 0 0.0 0.0 255.0 DISPLAY_IDENTIFIER CoilSLFailMet[0] ECU_ADDRESS 0x40002CB2 /end MEASUREMENT
/begin MEASUREMENT Coil1SLTestComp "var comments" UBYTE udf_CM_18061 0 0.0 0.0 255.0 DISPLAY_IDENTIFIER CoilSLTestComp[0] ECU_ADDRESS 0x40002CBA /end MEASUREMENT
/begin MEASUREMENT Coil1SLTestFail "var comments" UBYTE udf_CM_18068 0 0.0 0.0 255.0 DISPLAY_IDENTIFIER CoilSLTestFail[0] ECU_ADDRESS 0x40002CE2 /end MEASUREMENT
/begin MEASUREMENT Coil1SLFailCount "var comments" UWORD udf_CM_18026 0 0.0 0.0 65535.0 DISPLAY_IDENTIFIER CoilSLFailCount[0] ECU_ADDRESS 0x40002CC2 /end MEASUREMENT
/begin MEASUREMENT Coil1SLPassCount "var comments" UWORD udf_CM_18054 0 0.0 0.0 65535.0 DISPLAY_IDENTIFIER CoilSLPassCount[0] ECU_ADDRESS 0x40002CCA /end MEASUREMENT
/begin MEASUREMENT Coil1SHFailMet "var comments" UBYTE udf_CM_18047 0 0.0 0.0 255.0 DISPLAY_IDENTIFIER CoilSHFailMet[0] ECU_ADDRESS 0x40002CB6 /end MEASUREMENT
/begin MEASUREMENT Coil1SHTestComp "var comments" UBYTE udf_CM_18061 0 0.0 0.0 255.0 DISPLAY_IDENTIFIER CoilSHTestComp[0] ECU_ADDRESS 0x40002CBE /end MEASUREMENT
/begin MEASUREMENT Coil1SHTestFail "var comments" UBYTE udf_CM_18068 0 0.0 0.0 255.0 DISPLAY_IDENTIFIER CoilSHTestFail[0] ECU_ADDRESS 0x40002CE6 /end MEASUREMENT
/begin MEASUREMENT Coil1SHFailCount "var comments" UWORD udf_CM_18026 0 0.0 0.0 65535.0 DISPLAY_IDENTIFIER CoilSHFailCount[0] ECU_ADDRESS 0x40002CD2 /end MEASUREMENT
/begin MEASUREMENT Coil1SHPassCount "var comments" UWORD udf_CM_18054 0 0.0 0.0 65535.0 DISPLAY_IDENTIFIER CoilSHPassCount[0] ECU_ADDRESS 0x40002CDA /end MEASUREMENT
/begin MEASUREMENT Coil2DiagEnb "var comments" UBYTE udf_CM_18019 0 0.0 0.0 255.0 DISPLAY_IDENTIFIER CoilDiagEnb[1] ECU_ADDRESS 0x40002CAF /end MEASUREMENT
/begin MEASUREMENT Coil2SLFailMet "var comments" UBYTE udf_CM_18047 0 0.0 0.0 255.0 DISPLAY_IDENTIFIER CoilSLFailMet[1] ECU_ADDRESS 0x40002CB3 /end MEASUREMENT
/begin MEASUREMENT Coil2SLTestComp "var comments" UBYTE udf_CM_18061 0 0.0 0.0 255.0 DISPLAY_IDENTIFIER CoilSLTestComp[1] ECU_ADDRESS 0x40002CBB /end MEASUREMENT
/begin MEASUREMENT Coil2SLTestFail "var comments" UBYTE udf_CM_18068 0 0.0 0.0 255.0 DISPLAY_IDENTIFIER CoilSLTestFail[1] ECU_ADDRESS 0x40002CE3 /end MEASUREMENT
/begin MEASUREMENT Coil2SLFailCount "var comments" UWORD udf_CM_18026 0 0.0 0.0 65535.0 DISPLAY_IDENTIFIER CoilSLFailCount[1] ECU_ADDRESS 0x40002CC4 /end MEASUREMENT
/begin MEASUREMENT Coil2SLPassCount "var comments" UWORD udf_CM_18054 0 0.0 0.0 65535.0 DISPLAY_IDENTIFIER CoilSLPassCount[1] ECU_ADDRESS 0x40002CCC /end MEASUREMENT
/begin MEASUREMENT Coil2SHFailMet "var comments" UBYTE udf_CM_18047 0 0.0 0.0 255.0 DISPLAY_IDENTIFIER CoilSHFailMet[1] ECU_ADDRESS 0x40002CB7 /end MEASUREMENT
/begin MEASUREMENT Coil2SHTestComp "var comments" UBYTE udf_CM_18061 0 0.0 0.0 255.0 DISPLAY_IDENTIFIER CoilSHTestComp[1] ECU_ADDRESS 0x40002CBF /end MEASUREMENT
/begin MEASUREMENT Coil2SHTestFail "var comments" UBYTE udf_CM_18068 0 0.0 0.0 255.0 DISPLAY_IDENTIFIER CoilSHTestFail[1] ECU_ADDRESS 0x40002CE7 /end MEASUREMENT
/begin MEASUREMENT Coil2SHFailCount "var comments" UWORD udf_CM_18026 0 0.0 0.0 65535.0 DISPLAY_IDENTIFIER CoilSHFailCount[1] ECU_ADDRESS 0x40002CD4 /end MEASUREMENT
/begin MEASUREMENT Coil2SHPassCount "var comments" UWORD udf_CM_18054 0 0.0 0.0 65535.0 DISPLAY_IDENTIFIER CoilSHPassCount[1] ECU_ADDRESS 0x40002CDC /end MEASUREMENT
/begin MEASUREMENT Coil3DiagEnb "var comments" UBYTE udf_CM_18019 0 0.0 0.0 255.0 DISPLAY_IDENTIFIER CoilDiagEnb[2] ECU_ADDRESS 0x40002CB0 /end MEASUREMENT
/begin MEASUREMENT Coil3SLFailMet "var comments" UBYTE udf_CM_18047 0 0.0 0.0 255.0 DISPLAY_IDENTIFIER CoilSLFailMet[2] ECU_ADDRESS 0x40002CB4 /end MEASUREMENT
/begin MEASUREMENT Coil3SLTestComp "var comments" UBYTE udf_CM_18061 0 0.0 0.0 255.0 DISPLAY_IDENTIFIER CoilSLTestComp[2] ECU_ADDRESS 0x40002CBC /end MEASUREMENT
/begin MEASUREMENT Coil3SLTestFail "var comments" UBYTE udf_CM_18068 0 0.0 0.0 255.0 DISPLAY_IDENTIFIER CoilSLTestFail[2] ECU_ADDRESS 0x40002CE4 /end MEASUREMENT
/begin MEASUREMENT Coil3SLFailCount "var comments" UWORD udf_CM_18026 0 0.0 0.0 65535.0 DISPLAY_IDENTIFIER CoilSLFailCount[2] ECU_ADDRESS 0x40002CC6 /end MEASUREMENT
/begin MEASUREMENT Coil3SLPassCount "var comments" UWORD udf_CM_18054 0 0.0 0.0 65535.0 DISPLAY_IDENTIFIER CoilSLPassCount[2] ECU_ADDRESS 0x40002CCE /end MEASUREMENT
/begin MEASUREMENT Coil3SHFailMet "var comments" UBYTE udf_CM_18047 0 0.0 0.0 255.0 DISPLAY_IDENTIFIER CoilSHFailMet[2] ECU_ADDRESS 0x40002CB8 /end MEASUREMENT
/begin MEASUREMENT Coil3SHTestComp "var comments" UBYTE udf_CM_18061 0 0.0 0.0 255.0 DISPLAY_IDENTIFIER CoilSHTestComp[2] ECU_ADDRESS 0x40002CC0 /end MEASUREMENT
/begin MEASUREMENT Coil3SHTestFail "var comments" UBYTE udf_CM_18068 0 0.0 0.0 255.0 DISPLAY_IDENTIFIER CoilSHTestFail[2] ECU_ADDRESS 0x40002CE8 /end MEASUREMENT
/begin MEASUREMENT Coil3SHFailCount "var comments" UWORD udf_CM_18026 0 0.0 0.0 65535.0 DISPLAY_IDENTIFIER CoilSHFailCount[2] ECU_ADDRESS 0x40002CD6 /end MEASUREMENT
/begin MEASUREMENT Coil3SHPassCount "var comments" UWORD udf_CM_18054 0 0.0 0.0 65535.0 DISPLAY_IDENTIFIER CoilSHPassCount[2] ECU_ADDRESS 0x40002CDE /end MEASUREMENT
/begin MEASUREMENT Coil4DiagEnb "var comments" UBYTE udf_CM_18019 0 0.0 0.0 255.0 DISPLAY_IDENTIFIER CoilDiagEnb[3] ECU_ADDRESS 0x40002CB1 /end MEASUREMENT
/begin MEASUREMENT Coil4SLFailMet "var comments" UBYTE udf_CM_18047 0 0.0 0.0 255.0 DISPLAY_IDENTIFIER CoilSLFailMet[3] ECU_ADDRESS 0x40002CB5 /end MEASUREMENT
/begin MEASUREMENT Coil4SLTestComp "var comments" UBYTE udf_CM_18061 0 0.0 0.0 255.0 DISPLAY_IDENTIFIER CoilSLTestComp[3] ECU_ADDRESS 0x40002CBD /end MEASUREMENT
/begin MEASUREMENT Coil4SLTestFail "var comments" UBYTE udf_CM_18068 0 0.0 0.0 255.0 DISPLAY_IDENTIFIER CoilSLTestFail[3] ECU_ADDRESS 0x40002CE5 /end MEASUREMENT
/begin MEASUREMENT Coil4SLFailCount "var comments" UWORD udf_CM_18026 0 0.0 0.0 65535.0 DISPLAY_IDENTIFIER CoilSLFailCount[3] ECU_ADDRESS 0x40002CC8 /end MEASUREMENT
/begin MEASUREMENT Coil4SLPassCount "var comments" UWORD udf_CM_18054 0 0.0 0.0 65535.0 DISPLAY_IDENTIFIER CoilSLPassCount[3] ECU_ADDRESS 0x40002CD0 /end MEASUREMENT
/begin MEASUREMENT Coil4SHFailMet "var comments" UBYTE udf_CM_18047 0 0.0 0.0 255.0 DISPLAY_IDENTIFIER CoilSHFailMet[3] ECU_ADDRESS 0x40002CB9 /end MEASUREMENT
/begin MEASUREMENT Coil4SHTestComp "var comments" UBYTE udf_CM_18061 0 0.0 0.0 255.0 DISPLAY_IDENTIFIER CoilSHTestComp[3] ECU_ADDRESS 0x40002CC1 /end MEASUREMENT
/begin MEASUREMENT Coil4SHTestFail "var comments" UBYTE udf_CM_18068 0 0.0 0.0 255.0 DISPLAY_IDENTIFIER CoilSHTestFail[3] ECU_ADDRESS 0x40002CE9 /end MEASUREMENT
/begin MEASUREMENT Coil4SHFailCount "var comments" UWORD udf_CM_18026 0 0.0 0.0 65535.0 DISPLAY_IDENTIFIER CoilSHFailCount[3] ECU_ADDRESS 0x40002CD8 /end MEASUREMENT
/begin MEASUREMENT Coil4SHPassCount "var comments" UWORD udf_CM_18054 0 0.0 0.0 65535.0 DISPLAY_IDENTIFIER CoilSHPassCount[3] ECU_ADDRESS 0x40002CE0 /end MEASUREMENT
/begin MEASUREMENT CrkDiagTmrEnb "var comments" UBYTE udf_CM_15849 0 0.0 0.0 255.0 DISPLAY_IDENTIFIER CrkDiag_7p8TimerEnbl[0] ECU_ADDRESS 0x40002BD2 /end MEASUREMENT
/begin MEASUREMENT CrkNoSigDiagEnb "var comments" UBYTE udf_CM_15905 0 0.0 0.0 255.0 ECU_ADDRESS 0x40002BDE /end MEASUREMENT
/begin MEASUREMENT CrkNoSigFailMet "var comments" UBYTE udf_CM_15912 0 0.0 0.0 255.0 ECU_ADDRESS 0x40002BCE /end MEASUREMENT
/begin MEASUREMENT CrkDiagTmr1 "var comments" UWORD udf_CM_15842 0 0.0 0.0 511.9921875 DISPLAY_IDENTIFIER CrkDiag_7p8TimerArray[1] ECU_ADDRESS 0x40002BD6 /end MEASUREMENT
/begin MEASUREMENT CrkNoSigTestFail "var comments" UBYTE udf_CM_15926 0 0.0 0.0 255.0 ECU_ADDRESS 0x40002BDC /end MEASUREMENT
/begin MEASUREMENT CrkNoSigTestComp "var comments" UBYTE udf_CM_15919 0 0.0 0.0 255.0 ECU_ADDRESS 0x40002BDA /end MEASUREMENT
/begin MEASUREMENT CrkDiagTmr0 "var comments" UWORD udf_CM_15835 0 0.0 0.0 511.9921875 DISPLAY_IDENTIFIER CrkDiag_7p8TimerArray[0] ECU_ADDRESS 0x40002BD4 /end MEASUREMENT
/begin MEASUREMENT CrkNoSigTestReported "var comments" UBYTE udf_CM_15933 0 0.0 0.0 255.0 ECU_ADDRESS 0x40002BCF /end MEASUREMENT
/begin MEASUREMENT CrkNoisyDiagEnb "var comments" UBYTE udf_CM_15856 0 0.0 0.0 255.0 ECU_ADDRESS 0x40002BD9 /end MEASUREMENT
/begin MEASUREMENT CrkNoisyFailCnt "var comments" UWORD udf_CM_15863 0 0.0 0.0 65535.0 ECU_ADDRESS 0x40002BE4 /end MEASUREMENT
/begin MEASUREMENT CrkNoisyFailMet "var comments" UBYTE udf_CM_15870 0 0.0 0.0 255.0 ECU_ADDRESS 0x40002BDF /end MEASUREMENT
/begin MEASUREMENT CrkNoisyPassCnt "var comments" UWORD udf_CM_15877 0 0.0 0.0 65535.0 ECU_ADDRESS 0x40002BE2 /end MEASUREMENT
/begin MEASUREMENT CrkNoisyTestComp "var comments" UBYTE udf_CM_15884 0 0.0 0.0 255.0 ECU_ADDRESS 0x40002BD8 /end MEASUREMENT
/begin MEASUREMENT CrkNoisyTestFail "var comments" UBYTE udf_CM_15891 0 0.0 0.0 255.0 ECU_ADDRESS 0x40002BDD /end MEASUREMENT
/begin MEASUREMENT CrkNoisyTestReported "var comments" UBYTE udf_CM_15898 0 0.0 0.0 255.0 ECU_ADDRESS 0x40002BD0 /end MEASUREMENT
/begin MEASUREMENT IgnVoltAtKeyOn "var comments" UWORD udf_CM_16920 0 0.0 0.0 31.99951171875 ECU_ADDRESS 0x40002BE6 /end MEASUREMENT
/begin MEASUREMENT CrankToRunMet "var comments" UBYTE udf_CM_15821 0 0.0 0.0 255.0 ECU_ADDRESS 0x40002941 /end MEASUREMENT
/begin MEASUREMENT CrankToStallMet "var comments" UBYTE udf_CM_15828 0 0.0 0.0 255.0 ECU_ADDRESS 0x40002942 /end MEASUREMENT
/begin MEASUREMENT MAPCIDEnb "var comments" UBYTE udf_CM_17095 0 0.0 0.0 255.0 ECU_ADDRESS 0x40002925 /end MEASUREMENT
/begin MEASUREMENT DesireTPS "var comments" UWORD udf_CM_15989 0 0.0 0.0 199.9969482421875 ECU_ADDRESS 0x40002A98 /end MEASUREMENT
/begin MEASUREMENT DiagWarningLamp "var comments" UBYTE udf_CM_16010 0 0.0 0.0 1.0 ECU_ADDRESS 0x40002B10 /end MEASUREMENT
/begin MEASUREMENT IdlDsrdEngSpdStep "var comments" UWORD udf_CM_16787 0 0.0 0.0 16383.75 ECU_ADDRESS 0x400027AC /end MEASUREMENT
/begin MEASUREMENT IdlDsrdEngSpdTarget "var comments" UWORD udf_CM_16794 0 0.0 0.0 16383.75 ECU_ADDRESS 0x400027A8 /end MEASUREMENT
/begin MEASUREMENT DsrdThrFlow "var comments" UWORD udf_CM_15982 0 0.0 0.0 511.9921875 ECU_ADDRESS 0x40002AAE /end MEASUREMENT
/begin MEASUREMENT DesireTPSOld "var comments" UWORD udf_CM_15996 0 0.0 0.0 199.9969482421875 ECU_ADDRESS 0x40002AB0 /end MEASUREMENT
/begin MEASUREMENT EngSpdOld0 "var comments" UWORD udf_CM_16073 0 0.0 0.0 16383.75 DISPLAY_IDENTIFIER EngineSpeedOld[0] ECU_ADDRESS 0x40002A3A /end MEASUREMENT
/begin MEASUREMENT EngSpdOld1 "var comments" UWORD udf_CM_16122 0 0.0 0.0 16383.75 DISPLAY_IDENTIFIER EngineSpeedOld[1] ECU_ADDRESS 0x40002A3C /end MEASUREMENT
/begin MEASUREMENT EngSpdOld10 "var comments" UWORD udf_CM_16080 0 0.0 0.0 16383.75 DISPLAY_IDENTIFIER EngineSpeedOld[10] ECU_ADDRESS 0x40002A4E /end MEASUREMENT
/begin MEASUREMENT EngSpdOld11 "var comments" UWORD udf_CM_16087 0 0.0 0.0 16383.75 DISPLAY_IDENTIFIER EngineSpeedOld[11] ECU_ADDRESS 0x40002A50 /end MEASUREMENT
/begin MEASUREMENT EngSpdOld12 "var comments" UWORD udf_CM_16094 0 0.0 0.0 16383.75 DISPLAY_IDENTIFIER EngineSpeedOld[12] ECU_ADDRESS 0x40002A52 /end MEASUREMENT
/begin MEASUREMENT EngSpdOld13 "var comments" UWORD udf_CM_16101 0 0.0 0.0 16383.75 DISPLAY_IDENTIFIER EngineSpeedOld[13] ECU_ADDRESS 0x40002A54 /end MEASUREMENT
/begin MEASUREMENT EngSpdOld14 "var comments" UWORD udf_CM_16108 0 0.0 0.0 16383.75 DISPLAY_IDENTIFIER EngineSpeedOld[14] ECU_ADDRESS 0x40002A56 /end MEASUREMENT
/begin MEASUREMENT EngSpdOld15 "var comments" UWORD udf_CM_16115 0 0.0 0.0 16383.75 DISPLAY_IDENTIFIER EngineSpeedOld[15] ECU_ADDRESS 0x40002A58 /end MEASUREMENT
/begin MEASUREMENT EngSpdOld2 "var comments" UWORD udf_CM_16129 0 0.0 0.0 16383.75 DISPLAY_IDENTIFIER EngineSpeedOld[2] ECU_ADDRESS 0x40002A3E /end MEASUREMENT
/begin MEASUREMENT EngSpdOld3 "var comments" UWORD udf_CM_16136 0 0.0 0.0 16383.75 DISPLAY_IDENTIFIER EngineSpeedOld[3] ECU_ADDRESS 0x40002A40 /end MEASUREMENT
/begin MEASUREMENT EngSpdOld4 "var comments" UWORD udf_CM_16143 0 0.0 0.0 16383.75 DISPLAY_IDENTIFIER EngineSpeedOld[4] ECU_ADDRESS 0x40002A42 /end MEASUREMENT
/begin MEASUREMENT EngSpdOld5 "var comments" UWORD udf_CM_16150 0 0.0 0.0 16383.75 DISPLAY_IDENTIFIER EngineSpeedOld[5] ECU_ADDRESS 0x40002A44 /end MEASUREMENT
/begin MEASUREMENT EngSpdOld6 "var comments" UWORD udf_CM_16157 0 0.0 0.0 16383.75 DISPLAY_IDENTIFIER EngineSpeedOld[6] ECU_ADDRESS 0x40002A46 /end MEASUREMENT
/begin MEASUREMENT EngSpdOld7 "var comments" UWORD udf_CM_16164 0 0.0 0.0 16383.75 DISPLAY_IDENTIFIER EngineSpeedOld[7] ECU_ADDRESS 0x40002A48 /end MEASUREMENT
/begin MEASUREMENT EngSpdOld8 "var comments" UWORD udf_CM_16171 0 0.0 0.0 16383.75 DISPLAY_IDENTIFIER EngineSpeedOld[8] ECU_ADDRESS 0x40002A4A /end MEASUREMENT
/begin MEASUREMENT EngSpdOld9 "var comments" UWORD udf_CM_16178 0 0.0 0.0 16383.75 DISPLAY_IDENTIFIER EngineSpeedOld[9] ECU_ADDRESS 0x40002A4C /end MEASUREMENT
/begin MEASUREMENT MultFuelType "var comments" UBYTE udf_CM_16193 0 0.0 0.0 255.0 ECU_ADDRESS 0x40002A84 /end MEASUREMENT
/begin MEASUREMENT MultFuelSeq "var comments" UBYTE udf_CM_18012 0 0.0 0.0 255.0 ECU_ADDRESS 0x40002A85 /end MEASUREMENT
/begin MEASUREMENT EngineState "var comments" UBYTE udf_CM_16192 0 0.0 0.0 255.0 ECU_ADDRESS 0x4000293E /end MEASUREMENT
/begin MEASUREMENT EngTorque "var comments" SWORD udf_CM_16059 0 0.0 -128.0 127.99609375 DISPLAY_IDENTIFIER EngineFlywheelTorq ECU_ADDRESS 0x400025EC /end MEASUREMENT
/begin MEASUREMENT EngineTuning "var comments" UBYTE udf_CM_16199 0 0.0 0.0 255.0 ECU_ADDRESS 0x4000294C /end MEASUREMENT
/begin MEASUREMENT O2_1_SHTestFail "var comments" UBYTE udf_CM_17508 0 0.0 0.0 255.0 ECU_ADDRESS 0x40002BB2 /end MEASUREMENT
/begin MEASUREMENT O2_1_ShrtDiagEnb "var comments" UBYTE udf_CM_17494 0 0.0 0.0 255.0 ECU_ADDRESS 0x40002BB0 /end MEASUREMENT
/begin MEASUREMENT O2_1_SHFailMet "var comments" UBYTE udf_CM_17487 0 0.0 0.0 255.0 ECU_ADDRESS 0x40002BB6 /end MEASUREMENT
/begin MEASUREMENT O2_1_SHFailCount "var comments" UWORD udf_CM_17480 0 0.0 0.0 65535.0 ECU_ADDRESS 0x40002BB8 /end MEASUREMENT
/begin MEASUREMENT O2_1_SLFailMet "var comments" UBYTE udf_CM_17522 0 0.0 0.0 255.0 ECU_ADDRESS 0x40002BB5 /end MEASUREMENT
/begin MEASUREMENT O2_1_SLFailCount "var comments" UWORD udf_CM_17515 0 0.0 0.0 65535.0 ECU_ADDRESS 0x40002BBA /end MEASUREMENT
/begin MEASUREMENT O2_1_SLTestFail "var comments" UBYTE udf_CM_17529 0 0.0 0.0 255.0 ECU_ADDRESS 0x40002BB3 /end MEASUREMENT
/begin MEASUREMENT O2_1_ShrtPassCount "var comments" UWORD udf_CM_17501 0 0.0 0.0 65535.0 ECU_ADDRESS 0x40002BBC /end MEASUREMENT
/begin MEASUREMENT RO2_1_SHTestFail "var comments" UBYTE udf_CM_17508 0 0.0 0.0 255.0 ECU_ADDRESS 0x40002BC1 /end MEASUREMENT
/begin MEASUREMENT RO2_1_ShrtDiagEnb "var comments" UBYTE udf_CM_17494 0 0.0 0.0 255.0 ECU_ADDRESS 0x40002BBE /end MEASUREMENT
/begin MEASUREMENT RO2_1_SHFailMet "var comments" UBYTE udf_CM_17487 0 0.0 0.0 255.0 ECU_ADDRESS 0x40002BC4 /end MEASUREMENT
/begin MEASUREMENT RO2_1_SHFailCount "var comments" UWORD udf_CM_17480 0 0.0 0.0 65535.0 ECU_ADDRESS 0x40002BC6 /end MEASUREMENT
/begin MEASUREMENT RO2_1_SLFailMet "var comments" UBYTE udf_CM_17522 0 0.0 0.0 255.0 ECU_ADDRESS 0x40002BC3 /end MEASUREMENT
/begin MEASUREMENT RO2_1_SLFailCount "var comments" UWORD udf_CM_17515 0 0.0 0.0 65535.0 ECU_ADDRESS 0x40002BC8 /end MEASUREMENT
/begin MEASUREMENT RO2_1_SLTestFail "var comments" UBYTE udf_CM_17529 0 0.0 0.0 255.0 ECU_ADDRESS 0x40002BC0 /end MEASUREMENT
/begin MEASUREMENT RO2_1_ShrtPassCount "var comments" UWORD udf_CM_17501 0 0.0 0.0 65535.0 ECU_ADDRESS 0x40002BCA /end MEASUREMENT
/begin MEASUREMENT BaseFPWCyl1 "var comments" UWORD udf_CM_15597 0 0.0 0.0 1023.984375 DISPLAY_IDENTIFIER BaseFPWCyl ECU_ADDRESS 0x400025FA /end MEASUREMENT
/begin MEASUREMENT BaseFuelMassCyl1 "var comments" UWORD udf_CM_15604 0 0.0 0.0 0.9999849796295166 DISPLAY_IDENTIFIER BaseFuelMassCyl ECU_ADDRESS 0x400025F8 /end MEASUREMENT
/begin MEASUREMENT BaseFMPrevCyl1 "var comments" UWORD udf_CM_15590 0 0.0 0.0 0.9999849796295166 DISPLAY_IDENTIFIER BaseFMPrevCyl ECU_ADDRESS 0x40002604 /end MEASUREMENT
/begin MEASUREMENT FPWClCorrCyl1 "var comments" UWORD udf_CM_16409 0 0.0 0.0 1023.984375 DISPLAY_IDENTIFIER FPWClCorrCyl[0] ECU_ADDRESS 0x400025EE /end MEASUREMENT
/begin MEASUREMENT FPWClCorrCyl2 "var comments" UWORD udf_CM_16416 0 0.0 0.0 1023.984375 DISPLAY_IDENTIFIER FPWClCorrCyl[1] ECU_ADDRESS 0x400025F0 /end MEASUREMENT
/begin MEASUREMENT ChrgAirTmpCyl1 "var comments" SWORD udf_CM_15646 0 0.0 -256.0 255.9921875 DISPLAY_IDENTIFIER ChrgAirTmpCyl ECU_ADDRESS 0x40002584 /end MEASUREMENT
/begin MEASUREMENT FuelCLTermCyl1 "var comments" SWORD udf_CM_16437 0 0.0 -4.0 3.9998779296875 DISPLAY_IDENTIFIER FuelCLTermCyl ECU_ADDRESS 0x40002712 /end MEASUREMENT
/begin MEASUREMENT FuelCLEnbCyl1 "var comments" UBYTE udf_CM_16423 0 0.0 0.0 255.0 DISPLAY_IDENTIFIER FuelCLEnbCyl ECU_ADDRESS 0x40002721 /end MEASUREMENT
/begin MEASUREMENT FuelINTCyl1 "var comments" SWORD udf_CM_16500 0 0.0 -32768.0 32767.0 DISPLAY_IDENTIFIER FuelINTCyl ECU_ADDRESS 0x4000271E /end MEASUREMENT
/begin MEASUREMENT FuelINTDlyCyl1 "var comments" UWORD udf_CM_16507 0 0.0 0.0 1023.984375 DISPLAY_IDENTIFIER FuelINTDlyCyl ECU_ADDRESS 0x40002732 /end MEASUREMENT
/begin MEASUREMENT FPropMinDurEnb "var comments" UBYTE udf_CM_16395 0 0.0 0.0 255.0 ECU_ADDRESS 0x4000272C /end MEASUREMENT
/begin MEASUREMENT FRichBiasHold1 "var comments" SWORD udf_CM_17067 0 0.0 -32.0 31.9990234375 DISPLAY_IDENTIFIER INTRatioCyl ECU_ADDRESS 0x4000270E /end MEASUREMENT
/begin MEASUREMENT RawO2RLThresh "var comments" UWORD udf_CM_17648 0 0.0 0.0 1023.984375 ECU_ADDRESS 0x40002738 /end MEASUREMENT
/begin MEASUREMENT FPropLoLoadCond "var comments" UBYTE udf_CM_19230 0 0.0 0.0 255.0 DISPLAY_IDENTIFIER VbFUEL_PropTerm_LowLoad ECU_ADDRESS 0x4000272B /end MEASUREMENT
/begin MEASUREMENT FPropAddFuelCyl1 "var comments" UBYTE udf_CM_16381 0 0.0 0.0 255.0 DISPLAY_IDENTIFIER FPropAddFuelCyl[0] ECU_ADDRESS 0x4000273A /end MEASUREMENT
/begin MEASUREMENT FuelINTRstCyl1 "var comments" UBYTE udf_CM_16521 0 0.0 0.0 255.0 DISPLAY_IDENTIFIER FuelINTRstCyl ECU_ADDRESS 0x40002718 /end MEASUREMENT
/begin MEASUREMENT FuelINTDlyPass1 "var comments" UBYTE udf_CM_16514 0 0.0 0.0 255.0 DISPLAY_IDENTIFIER FuelINTDlyPass ECU_ADDRESS 0x4000272D /end MEASUREMENT
/begin MEASUREMENT INTRatioCyl1 "var comments" UWORD udf_CM_19048 0 0.0 0.0 1.999969005584717 DISPLAY_IDENTIFIER VaFUEL_ClosedLoop_Mult ECU_ADDRESS 0x40002710 /end MEASUREMENT
/begin MEASUREMENT FPropRichHold1 "var comments" UBYTE udf_CM_16402 0 0.0 0.0 255.0 DISPLAY_IDENTIFIER FPropRichHold ECU_ADDRESS 0x4000271C /end MEASUREMENT
/begin MEASUREMENT FuelPropCyl1 "var comments" UWORD udf_CM_16535 0 0.0 0.0 199.9969482421875 DISPLAY_IDENTIFIER FuelPropCyl ECU_ADDRESS 0x40002724 /end MEASUREMENT
/begin MEASUREMENT FuelCLRstCyl1 "var comments" UBYTE udf_CM_16430 0 0.0 0.0 255.0 DISPLAY_IDENTIFIER FuelCLRstCyl ECU_ADDRESS 0x40002727 /end MEASUREMENT
/begin MEASUREMENT CATFactorCyl1 "var comments" SWORD udf_CM_15639 0 0.0 -1.998847961425781 1.998787045478821 DISPLAY_IDENTIFIER CATFactorCyl ECU_ADDRESS 0x40002582 /end MEASUREMENT
/begin MEASUREMENT FuelEOI "var comments" UWORD udf_CM_16465 0 0.0 0.0 1023.984375 ECU_ADDRESS 0x40002690 /end MEASUREMENT
/begin MEASUREMENT FuelEOITarget "var comments" UWORD udf_CM_16472 0 0.0 0.0 1023.984375 ECU_ADDRESS 0x4000269C /end MEASUREMENT
/begin MEASUREMENT FuelEOITrim "var comments" UWORD udf_CM_16479 0 0.0 0.0 1023.984375 ECU_ADDRESS 0x400026A2 /end MEASUREMENT
/begin MEASUREMENT O2HeaterOutputEnable "var comments" UBYTE udf_CM_17452 0 0.0 0.0 255.0 ECU_ADDRESS 0x400025DF /end MEASUREMENT
/begin MEASUREMENT FuelInj1Enb "var comments" UBYTE udf_CM_16486 0 0.0 0.0 255.0 DISPLAY_IDENTIFIER FuelInjEnb[0] ECU_ADDRESS 0x4000269E /end MEASUREMENT
/begin MEASUREMENT FuelInj2Enb "var comments" UBYTE udf_CM_16493 0 0.0 0.0 255.0 DISPLAY_IDENTIFIER FuelInjEnb[1] ECU_ADDRESS 0x4000269F /end MEASUREMENT
/begin MEASUREMENT InjectorOffset "var comments" UWORD udf_CM_17046 0 0.0 0.0 1023.984375 ECU_ADDRESS 0x400026A8 /end MEASUREMENT
/begin MEASUREMENT FO21Filt "var comments" UWORD udf_CM_16325 0 0.0 0.0 1023.984375 DISPLAY_IDENTIFIER FO2Filt ECU_ADDRESS 0x40002730 /end MEASUREMENT
/begin MEASUREMENT FO21Ready "var comments" UBYTE udf_CM_16339 0 0.0 0.0 255.0 DISPLAY_IDENTIFIER FO2Ready ECU_ADDRESS 0x40002726 /end MEASUREMENT
/begin MEASUREMENT FO21RichOld "var comments" UBYTE udf_CM_16311 0 0.0 0.0 1.0 ECU_ADDRESS 0x4000271A /end MEASUREMENT
/begin MEASUREMENT FO21FiltRich "var comments" UBYTE udf_CM_16332 0 0.0 0.0 1.0 DISPLAY_IDENTIFIER FO2FiltRich ECU_ADDRESS 0x40002719 /end MEASUREMENT
/begin MEASUREMENT FO21Rich "var comments" UBYTE udf_CM_16346 0 0.0 0.0 1.0 DISPLAY_IDENTIFIER FO2Rich ECU_ADDRESS 0x40002720 /end MEASUREMENT
/begin MEASUREMENT FO2RLThresh "var comments" UWORD udf_CM_16360 0 0.0 0.0 1023.984375 ECU_ADDRESS 0x40002722 /end MEASUREMENT
/begin MEASUREMENT FO21RLChange "var comments" UBYTE udf_CM_16353 0 0.0 0.0 255.0 DISPLAY_IDENTIFIER FO2RLChange ECU_ADDRESS 0x4000272A /end MEASUREMENT
/begin MEASUREMENT O2HeaterEnb "var comments" UBYTE udf_CM_17445 0 0.0 0.0 255.0 DISPLAY_IDENTIFIER O2HeaterEnable ECU_ADDRESS 0x400025DE /end MEASUREMENT
/begin MEASUREMENT ExtPEModeEnb "var comments" UBYTE udf_CM_16269 0 0.0 0.0 255.0 ECU_ADDRESS 0x40002615 /end MEASUREMENT
/begin MEASUREMENT FuelPumpEnb "var comments" UBYTE udf_CM_16605 0 0.0 0.0 255.0 ECU_ADDRESS 0x400026AF /end MEASUREMENT
/begin MEASUREMENT PowerEnrich "var comments" UBYTE udf_CM_17613 0 0.0 0.0 255.0 ECU_ADDRESS 0x400026AA /end MEASUREMENT
/begin MEASUREMENT FuelCOADMult "var comments" SWORD udf_CM_15262 0 0.0 -1.0 0.999969482421875 ECU_ADDRESS 0x40000170 /end MEASUREMENT
/begin MEASUREMENT FuelCOAdjFactor "var comments" SWORD udf_CM_15262 0 0.0 -1.0 0.999969482421875 ECU_ADDRESS 0x40002748 /end MEASUREMENT
/begin MEASUREMENT FuelCOAdjEn "var comments" UBYTE udf_CM_16710 0 0.0 0.0 255.0 ECU_ADDRESS 0x40002746 /end MEASUREMENT
/begin MEASUREMENT FuelPumpDiagEnb "var comments" UBYTE udf_CM_17382 0 0.0 0.0 255.0 ECU_ADDRESS 0x40002CF0 /end MEASUREMENT
/begin MEASUREMENT FuelPumpSLFailMet "var comments" UBYTE udf_CM_17410 0 0.0 0.0 255.0 ECU_ADDRESS 0x40002CF1 /end MEASUREMENT
/begin MEASUREMENT FuelPumpSLTestComp "var comments" UBYTE udf_CM_17424 0 0.0 0.0 255.0 ECU_ADDRESS 0x40002CF3 /end MEASUREMENT
/begin MEASUREMENT FuelPumpSLTestFail "var comments" UBYTE udf_CM_17431 0 0.0 0.0 255.0 ECU_ADDRESS 0x40002CF5 /end MEASUREMENT
/begin MEASUREMENT FuelPumpSLFailCount "var comments" UWORD udf_CM_17389 0 0.0 0.0 65535.0 ECU_ADDRESS 0x40002CF6 /end MEASUREMENT
/begin MEASUREMENT FuelPumpSLPassCount "var comments" UWORD udf_CM_17417 0 0.0 0.0 65535.0 ECU_ADDRESS 0x40002CFA /end MEASUREMENT
/begin MEASUREMENT FuelPumpSHFailMet "var comments" UBYTE udf_CM_17410 0 0.0 0.0 255.0 ECU_ADDRESS 0x40002CF2 /end MEASUREMENT
/begin MEASUREMENT FuelPumpSHTestComp "var comments" UBYTE udf_CM_17424 0 0.0 0.0 255.0 ECU_ADDRESS 0x40002CF4 /end MEASUREMENT
/begin MEASUREMENT FuelPumpSHTestFail "var comments" UBYTE udf_CM_17431 0 0.0 0.0 255.0 ECU_ADDRESS 0x40002CFE /end MEASUREMENT
/begin MEASUREMENT FuelPumpSHFailCount "var comments" UWORD udf_CM_17389 0 0.0 0.0 65535.0 ECU_ADDRESS 0x40002CF8 /end MEASUREMENT
/begin MEASUREMENT FuelPumpSHPassCount "var comments" UWORD udf_CM_17417 0 0.0 0.0 65535.0 ECU_ADDRESS 0x40002CFC /end MEASUREMENT
/begin MEASUREMENT FuelPumpRunEnb "var comments" UBYTE udf_CM_16619 0 0.0 0.0 255.0 ECU_ADDRESS 0x400026AD /end MEASUREMENT
/begin MEASUREMENT FuelPumpDC "var comments" UWORD udf_CM_16598 0 0.0 0.0 199.9969482421875 ECU_ADDRESS 0x400026B0 /end MEASUREMENT
/begin MEASUREMENT FuelPumpPPDsrd "var comments" UBYTE udf_CM_19244 0 0.0 0.0 255.0 DISPLAY_IDENTIFIER VbFUEL_PumpPrimeForPP_Dsrd ECU_ADDRESS 0x400026B9 /end MEASUREMENT
/begin MEASUREMENT FuelPumpPrmEnb "var comments" UBYTE udf_CM_16612 0 0.0 0.0 255.0 ECU_ADDRESS 0x400026AC /end MEASUREMENT
/begin MEASUREMENT FuelVoltCorr "var comments" UWORD udf_CM_16626 0 0.0 0.0 1.999969005584717 ECU_ADDRESS 0x400026A4 /end MEASUREMENT
/begin MEASUREMENT FuelPressureCorr "var comments" UWORD udf_CM_16627 0 0.0 0.0 3.99993896484375 ECU_ADDRESS 0x400026A6 /end MEASUREMENT
/begin MEASUREMENT FinalFPWCyl1 "var comments" UWORD udf_CM_16283 0 0.0 0.0 1023.984375 DISPLAY_IDENTIFIER FinalFPWCyl[0] ECU_ADDRESS 0x40002694 /end MEASUREMENT
/begin MEASUREMENT FinalFPWCyl2 "var comments" UWORD udf_CM_16290 0 0.0 0.0 1023.984375 DISPLAY_IDENTIFIER FinalFPWCyl[1] ECU_ADDRESS 0x40002696 /end MEASUREMENT
/begin MEASUREMENT FinalFPWCyl3 "var comments" UWORD udf_CM_16290 0 0.0 0.0 1023.984375 DISPLAY_IDENTIFIER FinalFPWCyl[2] ECU_ADDRESS 0x40002698 /end MEASUREMENT
/begin MEASUREMENT FinalFPWCyl4 "var comments" UWORD udf_CM_16290 0 0.0 0.0 1023.984375 DISPLAY_IDENTIFIER FinalFPWCyl[3] ECU_ADDRESS 0x4000269A /end MEASUREMENT
/begin MEASUREMENT O2HtAccFuelMassPrevious "var comments" UWORD udf_CM_17466 0 0.0 0.0 7.9998779296875 ECU_ADDRESS 0x400025E2 /end MEASUREMENT
/begin MEASUREMENT O2HtAccFuelMass "var comments" UWORD udf_CM_17459 0 0.0 0.0 7.9998779296875 ECU_ADDRESS 0x400025E0 /end MEASUREMENT
/begin MEASUREMENT O2HeaterDC "var comments" UWORD udf_CM_17438 0 0.0 0.0 199.9969482421875 DISPLAY_IDENTIFIER O2HeaterDutyCycle ECU_ADDRESS 0x40002950 /end MEASUREMENT
/begin MEASUREMENT O2HtAccFuelMassThresh "var comments" UWORD udf_CM_17473 0 0.0 0.0 7.9998779296875 ECU_ADDRESS 0x400025E4 /end MEASUREMENT
/begin MEASUREMENT AEDecayFactor "var comments" UWORD udf_CM_15261 0 0.0 0.0 0.9999849796295166 ECU_ADDRESS 0x400026C2 /end MEASUREMENT
/begin MEASUREMENT AECancelled "var comments" UBYTE udf_CM_15254 0 0.0 0.0 255.0 ECU_ADDRESS 0x400026C8 /end MEASUREMENT
/begin MEASUREMENT AEFuelCyl1 "var comments" UWORD udf_CM_15268 0 0.0 0.0 7.9998779296875 DISPLAY_IDENTIFIER AEFuelCyl ECU_ADDRESS 0x400026BA /end MEASUREMENT
/begin MEASUREMENT AccEnrich "var comments" UBYTE udf_CM_15240 0 0.0 0.0 255.0 ECU_ADDRESS 0x400026C6 /end MEASUREMENT
/begin MEASUREMENT DEDecayFactor "var comments" UWORD udf_CM_15961 0 0.0 0.0 0.9999849796295166 ECU_ADDRESS 0x400026C4 /end MEASUREMENT
/begin MEASUREMENT DEFuelCyl1 "var comments" UWORD udf_CM_15968 0 0.0 0.0 7.9998779296875 DISPLAY_IDENTIFIER DEFuelCyl ECU_ADDRESS 0x400026BC /end MEASUREMENT
/begin MEASUREMENT DECancelled "var comments" UBYTE udf_CM_15947 0 0.0 0.0 255.0 ECU_ADDRESS 0x400026C9 /end MEASUREMENT
/begin MEASUREMENT DecEnlean "var comments" UBYTE udf_CM_15954 0 0.0 0.0 255.0 ECU_ADDRESS 0x400026C7 /end MEASUREMENT
/begin MEASUREMENT DeltaFuelCyl1 "var comments" UWORD udf_CM_15975 0 0.0 0.0 0.9999849796295166 DISPLAY_IDENTIFIER DeltaFuelCyl ECU_ADDRESS 0x400026C0 /end MEASUREMENT
/begin MEASUREMENT TranFuelDltCyl1 "var comments" SWORD udf_CM_18908 0 0.0 -8.0 7.999755859375 DISPLAY_IDENTIFIER TranFuelDltCyl ECU_ADDRESS 0x400026BE /end MEASUREMENT
/begin MEASUREMENT FuelCutOff "var comments" UBYTE udf_CM_16451 0 0.0 0.0 255.0 ECU_ADDRESS 0x40002628 /end MEASUREMENT
/begin MEASUREMENT SparkCutOff "var comments" UBYTE udf_CM_16451 0 0.0 0.0 255.0 ECU_ADDRESS 0x40002629 /end MEASUREMENT
/begin MEASUREMENT VbFUEL_ClearFloodEnbl "var comments" UBYTE udf_CM_15723 0 0.0 0.0 255.0 ECU_ADDRESS 0x0 /end MEASUREMENT
/begin MEASUREMENT DFCO_TPS_Thrsh "var comments" UWORD udf_CM_16871 0 0.0 0.0 199.9969482421875 ECU_ADDRESS 0x0 /end MEASUREMENT
/begin MEASUREMENT DFCO_FuelCritMet "var comments" UBYTE udf_CM_15723 0 0.0 0.0 255.0 ECU_ADDRESS 0x4000262A /end MEASUREMENT
/begin MEASUREMENT DFCO_FuelEnabled "var comments" UBYTE udf_CM_15723 0 0.0 0.0 255.0 ECU_ADDRESS 0x4000262B /end MEASUREMENT
/begin MEASUREMENT DFCO_FuelExitEnbl "var comments" UBYTE udf_CM_15723 0 0.0 0.0 255.0 ECU_ADDRESS 0x4000262C /end MEASUREMENT
/begin MEASUREMENT DFCO_FuelRampOutEn "var comments" UBYTE udf_CM_15723 0 0.0 0.0 255.0 ECU_ADDRESS 0x4000262D /end MEASUREMENT
/begin MEASUREMENT DFCO_SparkCritMet "var comments" UBYTE udf_CM_15723 0 0.0 0.0 255.0 ECU_ADDRESS 0x4000262E /end MEASUREMENT
/begin MEASUREMENT DFCO_SparkEnabled "var comments" UBYTE udf_CM_15723 0 0.0 0.0 255.0 ECU_ADDRESS 0x4000262F /end MEASUREMENT
/begin MEASUREMENT DFCO_EM_Disable "var comments" UBYTE udf_CM_15723 0 0.0 0.0 255.0 ECU_ADDRESS 0x40002624 /end MEASUREMENT
/begin MEASUREMENT DFCO_MAPThrsh "var comments" UWORD udf_CM_15401 0 0.0 0.0 255.99609375 ECU_ADDRESS 0x40002620 /end MEASUREMENT
/begin MEASUREMENT DFCO_FuelRampoutFact "var comments" UWORD udf_CM_16626 0 0.0 0.0 1.999969005584717 ECU_ADDRESS 0x40002630 /end MEASUREMENT
/begin MEASUREMENT DFCO_ExitFuel "var comments" UWORD udf_CM_16283 0 0.0 0.0 1023.984375 ECU_ADDRESS 0x40002632 /end MEASUREMENT
/begin MEASUREMENT FuelConsump "var comments" UWORD udf_CM_16444 0 0.0 0.0 15.999755859375 ECU_ADDRESS 0x400025F6 /end MEASUREMENT
/begin MEASUREMENT FuelConsumpTotal "var comments" ULONG udf_CM_16446 0 0.0 0.0 2147483647.5 ECU_ADDRESS 0x400002AC /end MEASUREMENT
/begin MEASUREMENT FuelRate "var comments" UWORD udf_CM_16445 0 0.0 0.0 4095.9375 ECU_ADDRESS 0x40002602 /end MEASUREMENT
/begin MEASUREMENT InjectorFlow "var comments" UWORD udf_CM_16444 0 0.0 0.0 15.999755859375 ECU_ADDRESS 0x40002A88 /end MEASUREMENT
/begin MEASUREMENT FuelDlvMode "var comments" UBYTE udf_CM_16458 0 0.0 0.0 255.0 ECU_ADDRESS 0x40002692 /end MEASUREMENT
/begin MEASUREMENT BLM_LrnActive "var comments" UBYTE udf_CM_17158 0 0.0 0.0 255.0 ECU_ADDRESS 0x400026FE /end MEASUREMENT
/begin MEASUREMENT BLM_Updated "var comments" UBYTE udf_CM_17158 0 0.0 0.0 255.0 ECU_ADDRESS 0x400026FF /end MEASUREMENT
/begin MEASUREMENT BLM_LrnAllowed "var comments" UBYTE udf_CM_17158 0 0.0 0.0 255.0 ECU_ADDRESS 0x40002700 /end MEASUREMENT
/begin MEASUREMENT BLM_RPM_DeltaMet "var comments" UBYTE udf_CM_17158 0 0.0 0.0 255.0 ECU_ADDRESS 0x40002701 /end MEASUREMENT
/begin MEASUREMENT BLM_AirFlowDeltaMet "var comments" UBYTE udf_CM_17158 0 0.0 0.0 255.0 ECU_ADDRESS 0x40002702 /end MEASUREMENT
/begin MEASUREMENT BLM_EngSpeedFilt "var comments" UWORD udf_CM_16185 0 0.0 0.0 16383.75 ECU_ADDRESS 0x40002706 /end MEASUREMENT
/begin MEASUREMENT BLM_EngSpeedDelta "var comments" UWORD udf_CM_16185 0 0.0 0.0 16383.75 ECU_ADDRESS 0x4000270A /end MEASUREMENT
/begin MEASUREMENT BLM_AirFlowFilt "var comments" UWORD udf_CM_15534 0 0.0 0.0 511.9921875 ECU_ADDRESS 0x40002704 /end MEASUREMENT
/begin MEASUREMENT BLM_AirFlowDelta "var comments" UWORD udf_CM_15534 0 0.0 0.0 511.9921875 ECU_ADDRESS 0x40002708 /end MEASUREMENT
/begin MEASUREMENT FUEL_BLM_Base "var comments" UWORD udf_CM_16626 0 0.0 0.0 1.999969005584717 ECU_ADDRESS 0x400026FA /end MEASUREMENT
/begin MEASUREMENT FUEL_BLM_FCV "var comments" UWORD udf_CM_16626 0 0.0 0.0 1.999969005584717 ECU_ADDRESS 0x400026FC /end MEASUREMENT
/begin MEASUREMENT BLM_CellChange "var comments" UBYTE udf_CM_17158 0 0.0 0.0 255.0 ECU_ADDRESS 0x400026F8 /end MEASUREMENT
/begin MEASUREMENT BLM_CellChangeLrnDly "var comments" UBYTE udf_CM_17158 0 0.0 0.0 255.0 ECU_ADDRESS 0x400026F9 /end MEASUREMENT
/begin MEASUREMENT BLM_CellRow "var comments" UBYTE udf_CM_15247 0 0.0 0.0 255.0 ECU_ADDRESS 0x400026F5 /end MEASUREMENT
/begin MEASUREMENT BLM_CellCol "var comments" UBYTE udf_CM_15247 0 0.0 0.0 255.0 ECU_ADDRESS 0x400026F3 /end MEASUREMENT
/begin MEASUREMENT BLM_Cell_Petrol "var comments" UWORD udf_CM_16626 0 0.0 0.0 1.999969005584717 LAYOUT COLUMN_DIR MATRIX_DIM 17 3 ECU_ADDRESS 0x40000176 /end MEASUREMENT
/begin MEASUREMENT BLM_Cell_NG "var comments" UWORD udf_CM_16626 0 0.0 0.0 1.999969005584717 LAYOUT COLUMN_DIR MATRIX_DIM 17 3 ECU_ADDRESS 0x400001DC /end MEASUREMENT
/begin MEASUREMENT BLM_Cell_LPG "var comments" UWORD udf_CM_16626 0 0.0 0.0 1.999969005584717 LAYOUT COLUMN_DIR MATRIX_DIM 17 3 ECU_ADDRESS 0x40000242 /end MEASUREMENT
/begin MEASUREMENT VECyl1 "var comments" UWORD udf_CM_19398 0 0.0 0.0 199.9969482421875 DISPLAY_IDENTIFIER VECyl[0] ECU_ADDRESS 0x40002586 /end MEASUREMENT
/begin MEASUREMENT VECyl2 "var comments" UWORD udf_CM_19398 0 0.0 0.0 199.9969482421875 DISPLAY_IDENTIFIER VECyl[1] ECU_ADDRESS 0x40002588 /end MEASUREMENT
/begin MEASUREMENT VECyl3 "var comments" UWORD udf_CM_19398 0 0.0 0.0 199.9969482421875 DISPLAY_IDENTIFIER VECyl[2] ECU_ADDRESS 0x4000258A /end MEASUREMENT
/begin MEASUREMENT VECyl4 "var comments" UWORD udf_CM_19398 0 0.0 0.0 199.9969482421875 DISPLAY_IDENTIFIER VECyl[3] ECU_ADDRESS 0x4000258C /end MEASUREMENT
/begin MEASUREMENT AirPerCyl1 "var comments" UWORD udf_CM_15548 0 0.0 0.0 3.99993896484375 DISPLAY_IDENTIFIER AirPerCyl[0] ECU_ADDRESS 0x40002570 /end MEASUREMENT
/begin MEASUREMENT AirPerCyl2 "var comments" UWORD udf_CM_15555 0 0.0 0.0 3.99993896484375 DISPLAY_IDENTIFIER AirPerCyl[1] ECU_ADDRESS 0x40002572 /end MEASUREMENT
/begin MEASUREMENT IDLEMoveDirct "var comments" UBYTE udf_CM_16668 0 0.0 0.0 2.0 ECU_ADDRESS 0x40002A96 /end MEASUREMENT
/begin MEASUREMENT IDLEMode "var comments" UBYTE udf_CM_16640 0 0.0 0.0 255.0 ECU_ADDRESS 0x40002799 /end MEASUREMENT
/begin MEASUREMENT IDLEMotorState "var comments" UBYTE udf_CM_16661 0 0.0 0.0 3.0 ECU_ADDRESS 0x40002A9C /end MEASUREMENT
/begin MEASUREMENT ActIDLEPosition "var comments" UBYTE udf_CM_15247 0 0.0 0.0 255.0 ECU_ADDRESS 0x40002A9A /end MEASUREMENT
/begin MEASUREMENT IdlDerivTerm "var comments" SWORD udf_CM_16773 0 0.0 -200.0 199.993896484375 ECU_ADDRESS 0x40002772 /end MEASUREMENT
/begin MEASUREMENT IdlDerivTermEnh "var comments" SWORD udf_CM_16773 0 0.0 -200.0 199.993896484375 ECU_ADDRESS 0x40002770 /end MEASUREMENT
/begin MEASUREMENT IdlDsrdSpdStOfst "var comments" UWORD udf_CM_16801 0 0.0 0.0 16383.75 ECU_ADDRESS 0x400027B2 /end MEASUREMENT
/begin MEASUREMENT IdlEngSpdHigh "var comments" UBYTE udf_CM_16850 0 0.0 0.0 255.0 ECU_ADDRESS 0x400027B1 /end MEASUREMENT
/begin MEASUREMENT IdlINTDelta "var comments" UWORD udf_CM_16864 0 0.0 0.0 199.9969482421875 ECU_ADDRESS 0x40002776 /end MEASUREMENT
/begin MEASUREMENT IdlINTTerm "var comments" UWORD udf_CM_16871 0 0.0 0.0 199.9969482421875 ECU_ADDRESS 0x4000276E /end MEASUREMENT
/begin MEASUREMENT NrmIdlDlyTmr "var comments" UWORD udf_CM_17368 0 0.0 0.0 1023.984375 ECU_ADDRESS 0x400027AA /end MEASUREMENT
/begin MEASUREMENT IdlPropTerm "var comments" SWORD udf_CM_16885 0 0.0 -200.0 199.993896484375 ECU_ADDRESS 0x40002778 /end MEASUREMENT
/begin MEASUREMENT IdlDsrdEngSpd "var comments" UWORD udf_CM_16780 0 0.0 0.0 16383.75 ECU_ADDRESS 0x400027AE /end MEASUREMENT
/begin MEASUREMENT IdlEngSpdError "var comments" UWORD udf_CM_16843 0 0.0 0.0 16383.75 ECU_ADDRESS 0x400027B4 /end MEASUREMENT
/begin MEASUREMENT IACVResetInProg "var comments" UBYTE udf_CM_16682 0 0.0 0.0 255.0 ECU_ADDRESS 0x40002824 /end MEASUREMENT
/begin MEASUREMENT DsrdIACV_MtrPstn "var comments" UBYTE udf_CM_15247 0 0.0 0.0 255.0 ECU_ADDRESS 0x40002AC2 /end MEASUREMENT
/begin MEASUREMENT IACVResetCmplt "var comments" UBYTE udf_CM_16675 0 0.0 0.0 255.0 ECU_ADDRESS 0x4000282A /end MEASUREMENT
/begin MEASUREMENT IACVMotorLost "var comments" UBYTE udf_CM_16647 0 0.0 0.0 255.0 ECU_ADDRESS 0x40002827 /end MEASUREMENT
/begin MEASUREMENT IACVMotorReset "var comments" UBYTE udf_CM_16654 0 0.0 0.0 255.0 ECU_ADDRESS 0x40002826 /end MEASUREMENT
/begin MEASUREMENT IACVOLFlow "var comments" UWORD udf_CM_16808 0 0.0 0.0 199.9969482421875 ECU_ADDRESS 0x40002812 /end MEASUREMENT
/begin MEASUREMENT IACVCLFlow "var comments" UWORD udf_CM_16808 0 0.0 0.0 199.9969482421875 ECU_ADDRESS 0x400027CC /end MEASUREMENT
/begin MEASUREMENT IACVFlow "var comments" UWORD udf_CM_16808 0 0.0 0.0 199.9969482421875 ECU_ADDRESS 0x400027D4 /end MEASUREMENT
/begin MEASUREMENT IACVFlowCoolOffset "var comments" UWORD udf_CM_16808 0 0.0 0.0 199.9969482421875 ECU_ADDRESS 0x40002806 /end MEASUREMENT
/begin MEASUREMENT IACVFlowCoolOffsetMax "var comments" UWORD udf_CM_16808 0 0.0 0.0 199.9969482421875 ECU_ADDRESS 0x40002808 /end MEASUREMENT
/begin MEASUREMENT IACVFlowCrankOffset "var comments" UWORD udf_CM_16808 0 0.0 0.0 199.9969482421875 ECU_ADDRESS 0x40002804 /end MEASUREMENT
/begin MEASUREMENT IACVFlowTFOffset "var comments" UWORD udf_CM_16808 0 0.0 0.0 199.9969482421875 ECU_ADDRESS 0x40002814 /end MEASUREMENT
/begin MEASUREMENT IACVFlowBattOffset "var comments" UWORD udf_CM_16808 0 0.0 0.0 199.9969482421875 ECU_ADDRESS 0x4000280A /end MEASUREMENT
/begin MEASUREMENT IACVFlowDsrdTF "var comments" UWORD udf_CM_16808 0 0.0 0.0 199.9969482421875 ECU_ADDRESS 0x40002816 /end MEASUREMENT
/begin MEASUREMENT IACVFlowCoolFactor "var comments" UWORD udf_CM_15261 0 0.0 0.0 0.9999849796295166 ECU_ADDRESS 0x40002810 /end MEASUREMENT
/begin MEASUREMENT IACVFlowCoolantDecayTime "var comments" UWORD udf_CM_16507 0 0.0 0.0 1023.984375 ECU_ADDRESS 0x4000280C /end MEASUREMENT
/begin MEASUREMENT IACVAlternatorLoadStat "var comments" UBYTE udf_CM_16423 0 0.0 0.0 255.0 ECU_ADDRESS 0x4000280E /end MEASUREMENT
/begin MEASUREMENT IACVCLCondMet "var comments" UBYTE udf_CM_16857 0 0.0 0.0 255.0 ECU_ADDRESS 0x400027FD /end MEASUREMENT
/begin MEASUREMENT IACVMode "var comments" UBYTE udf_CM_16640 0 0.0 0.0 255.0 ECU_ADDRESS 0x400027FC /end MEASUREMENT
/begin MEASUREMENT ActIACVPosition "var comments" UBYTE udf_CM_15247 0 0.0 0.0 255.0 ECU_ADDRESS 0x40002AB5 /end MEASUREMENT
/begin MEASUREMENT IACVMoveDirct "var comments" UBYTE udf_CM_16668 0 0.0 0.0 2.0 ECU_ADDRESS 0x40002AB4 /end MEASUREMENT
/begin MEASUREMENT IACVMotorState "var comments" UBYTE udf_CM_16661 0 0.0 0.0 3.0 ECU_ADDRESS 0x40002AB9 /end MEASUREMENT
/begin MEASUREMENT IACVDerivTerm "var comments" SWORD udf_CM_16773 0 0.0 -200.0 199.993896484375 ECU_ADDRESS 0x400027C8 /end MEASUREMENT
/begin MEASUREMENT IACVDsrdSpdStOfst "var comments" UWORD udf_CM_16801 0 0.0 0.0 16383.75 ECU_ADDRESS 0x40002818 /end MEASUREMENT
/begin MEASUREMENT IACVEngSpdHigh "var comments" UBYTE udf_CM_16850 0 0.0 0.0 255.0 ECU_ADDRESS 0x4000281D /end MEASUREMENT
/begin MEASUREMENT IACVINTDelta "var comments" UWORD udf_CM_16864 0 0.0 0.0 199.9969482421875 ECU_ADDRESS 0x400027BE /end MEASUREMENT
/begin MEASUREMENT IACVINTTerm "var comments" UWORD udf_CM_16871 0 0.0 0.0 199.9969482421875 ECU_ADDRESS 0x400027BA /end MEASUREMENT
/begin MEASUREMENT NrmIACVDlyTmr "var comments" UWORD udf_CM_17368 0 0.0 0.0 1023.984375 ECU_ADDRESS 0x400027FE /end MEASUREMENT
/begin MEASUREMENT IACVPropTerm "var comments" SWORD udf_CM_16885 0 0.0 -200.0 199.993896484375 ECU_ADDRESS 0x400027CA /end MEASUREMENT
/begin MEASUREMENT IACVDsrdEngSpd "var comments" UWORD udf_CM_16780 0 0.0 0.0 16383.75 ECU_ADDRESS 0x4000281E /end MEASUREMENT
/begin MEASUREMENT IACVEngSpdError "var comments" UWORD udf_CM_16843 0 0.0 0.0 16383.75 ECU_ADDRESS 0x40002822 /end MEASUREMENT
/begin MEASUREMENT BSTPDsrd "var comments" UWORD udf_CM_15562 0 0.0 0.0 255.99609375 ECU_ADDRESS 0x400025C0 /end MEASUREMENT
/begin MEASUREMENT BSTPCommand "var comments" UWORD udf_CM_15562 0 0.0 0.0 255.99609375 ECU_ADDRESS 0x400025CC /end MEASUREMENT
/begin MEASUREMENT BSTPError "var comments" UWORD udf_CM_15562 0 0.0 0.0 255.99609375 ECU_ADDRESS 0x400025BE /end MEASUREMENT
/begin MEASUREMENT BSTPCntrCL "var comments" UWORD udf_CM_15562 0 0.0 0.0 255.99609375 ECU_ADDRESS 0x400025CA /end MEASUREMENT
/begin MEASUREMENT BSTPErrorHigh "var comments" UBYTE udf_CM_16850 0 0.0 0.0 255.0 ECU_ADDRESS 0x400025BA /end MEASUREMENT
/begin MEASUREMENT BSTPINTTerm "var comments" UWORD udf_CM_16871 0 0.0 0.0 199.9969482421875 ECU_ADDRESS 0x400025BC /end MEASUREMENT
/begin MEASUREMENT BSTPPropTerm "var comments" SWORD udf_CM_16885 0 0.0 -200.0 199.993896484375 ECU_ADDRESS 0x400025C4 /end MEASUREMENT
/begin MEASUREMENT BSTPCntrCLTerm "var comments" UWORD udf_CM_16808 0 0.0 0.0 199.9969482421875 ECU_ADDRESS 0x400025C2 /end MEASUREMENT
/begin MEASUREMENT BSTPINTDelta "var comments" UWORD udf_CM_16864 0 0.0 0.0 199.9969482421875 ECU_ADDRESS 0x400025C6 /end MEASUREMENT
/begin MEASUREMENT BSTPActual "var comments" UWORD udf_CM_17291 0 0.0 0.0 255.99609375 ECU_ADDRESS 0x40002B0A /end MEASUREMENT
/begin MEASUREMENT BSTPUnfilt "var comments" UWORD udf_CM_17291 0 0.0 0.0 255.99609375 ECU_ADDRESS 0x40002B0C /end MEASUREMENT
/begin MEASUREMENT BSTCDutyCycle "var comments" UWORD udf_CM_18726 0 0.0 0.0 199.9969482421875 ECU_ADDRESS 0x40002B08 /end MEASUREMENT
/begin MEASUREMENT BSTPMode "var comments" UBYTE udf_CM_16640 0 0.0 0.0 255.0 ECU_ADDRESS 0x400025D5 /end MEASUREMENT
/begin MEASUREMENT BSTPCondMet "var comments" UBYTE udf_CM_16815 0 0.0 0.0 255.0 ECU_ADDRESS 0x400025D4 /end MEASUREMENT
/begin MEASUREMENT ACLoadMet "var comments" UBYTE udf_CM_17214 0 0.0 0.0 255.0 ECU_ADDRESS 0x40002A82 /end MEASUREMENT
/begin MEASUREMENT GenDCCurrent "var comments" UWORD udf_CM_17294 0 0.0 0.0 255.99609375 ECU_ADDRESS 0x40002A80 /end MEASUREMENT
/begin MEASUREMENT IATSHTestFail "var comments" UBYTE udf_CM_16724 0 0.0 0.0 255.0 ECU_ADDRESS 0x40002C1E /end MEASUREMENT
/begin MEASUREMENT IATSHFailCount "var comments" UWORD udf_CM_16703 0 0.0 0.0 65535.0 ECU_ADDRESS 0x40002C26 /end MEASUREMENT
/begin MEASUREMENT IATSHFailMet "var comments" UBYTE udf_CM_16710 0 0.0 0.0 255.0 ECU_ADDRESS 0x40002C18 /end MEASUREMENT
/begin MEASUREMENT IATSHPassCount "var comments" UWORD udf_CM_16717 0 0.0 0.0 65535.0 ECU_ADDRESS 0x40002C28 /end MEASUREMENT
/begin MEASUREMENT IATDiagEnb "var comments" UBYTE udf_CM_16731 0 0.0 0.0 255.0 ECU_ADDRESS 0x40002C16 /end MEASUREMENT
/begin MEASUREMENT IATSLFailCount "var comments" UWORD udf_CM_16738 0 0.0 0.0 65535.0 ECU_ADDRESS 0x40002C22 /end MEASUREMENT
/begin MEASUREMENT IATSLFailMet "var comments" UBYTE udf_CM_16745 0 0.0 0.0 255.0 ECU_ADDRESS 0x40002C17 /end MEASUREMENT
/begin MEASUREMENT IATSLPassCount "var comments" UWORD udf_CM_16752 0 0.0 0.0 65535.0 ECU_ADDRESS 0x40002C24 /end MEASUREMENT
/begin MEASUREMENT IATSLTestFail "var comments" UBYTE udf_CM_16759 0 0.0 0.0 255.0 ECU_ADDRESS 0x40002C1D /end MEASUREMENT
/begin MEASUREMENT IATOH1FailCount "var comments" UWORD udf_CM_16738 0 0.0 0.0 65535.0 ECU_ADDRESS 0x40002C2A /end MEASUREMENT
/begin MEASUREMENT IATOH1FailMet "var comments" UBYTE udf_CM_16745 0 0.0 0.0 255.0 ECU_ADDRESS 0x40002C21 /end MEASUREMENT
/begin MEASUREMENT IATOH1PassCount "var comments" UWORD udf_CM_16752 0 0.0 0.0 65535.0 ECU_ADDRESS 0x40002C2C /end MEASUREMENT
/begin MEASUREMENT IATOH1TestFail "var comments" UBYTE udf_CM_16759 0 0.0 0.0 255.0 ECU_ADDRESS 0x40002C1F /end MEASUREMENT
/begin MEASUREMENT IATOH2FailCount "var comments" UWORD udf_CM_16738 0 0.0 0.0 65535.0 ECU_ADDRESS 0x40002C2E /end MEASUREMENT
/begin MEASUREMENT IATOH2FailMet "var comments" UBYTE udf_CM_16745 0 0.0 0.0 255.0 ECU_ADDRESS 0x40002C14 /end MEASUREMENT
/begin MEASUREMENT IATOH2PassCount "var comments" UWORD udf_CM_16752 0 0.0 0.0 65535.0 ECU_ADDRESS 0x40002C30 /end MEASUREMENT
/begin MEASUREMENT IATOH2TestFail "var comments" UBYTE udf_CM_16759 0 0.0 0.0 255.0 ECU_ADDRESS 0x40002C20 /end MEASUREMENT
/begin MEASUREMENT SCISHTestFail "var comments" UBYTE udf_CM_16724 0 0.0 0.0 255.0 ECU_ADDRESS 0x40002C36 /end MEASUREMENT
/begin MEASUREMENT SCISHFailCount "var comments" UWORD udf_CM_16703 0 0.0 0.0 65535.0 ECU_ADDRESS 0x40002C3C /end MEASUREMENT
/begin MEASUREMENT SCISHFailMet "var comments" UBYTE udf_CM_16710 0 0.0 0.0 255.0 ECU_ADDRESS 0x40002C40 /end MEASUREMENT
/begin MEASUREMENT SCISHPassCount "var comments" UWORD udf_CM_16717 0 0.0 0.0 65535.0 ECU_ADDRESS 0x40002C3E /end MEASUREMENT
/begin MEASUREMENT SCIDiagEnb "var comments" UBYTE udf_CM_16731 0 0.0 0.0 255.0 ECU_ADDRESS 0x40002C32 /end MEASUREMENT
/begin MEASUREMENT SCISLFailCount "var comments" UWORD udf_CM_16738 0 0.0 0.0 65535.0 ECU_ADDRESS 0x40002C38 /end MEASUREMENT
/begin MEASUREMENT SCISLFailMet "var comments" UBYTE udf_CM_16745 0 0.0 0.0 255.0 ECU_ADDRESS 0x40002C37 /end MEASUREMENT
/begin MEASUREMENT SCISLPassCount "var comments" UWORD udf_CM_16752 0 0.0 0.0 65535.0 ECU_ADDRESS 0x40002C3A /end MEASUREMENT
/begin MEASUREMENT SCISLTestFail "var comments" UBYTE udf_CM_16759 0 0.0 0.0 255.0 ECU_ADDRESS 0x40002C35 /end MEASUREMENT
/begin MEASUREMENT ACSSLFailMet "var comments" UBYTE udf_CM_16710 0 0.0 0.0 255.0 ECU_ADDRESS 0x40002E0D /end MEASUREMENT
/begin MEASUREMENT ACSSHFailMet "var comments" UBYTE udf_CM_16710 0 0.0 0.0 255.0 ECU_ADDRESS 0x40002E16 /end MEASUREMENT
/begin MEASUREMENT ACSSLTestFail "var comments" UBYTE udf_CM_16759 0 0.0 0.0 255.0 ECU_ADDRESS 0x40002E0B /end MEASUREMENT
/begin MEASUREMENT ACSSHTestFail "var comments" UBYTE udf_CM_16759 0 0.0 0.0 255.0 ECU_ADDRESS 0x40002E0C /end MEASUREMENT
/begin MEASUREMENT ACSSLFailCount "var comments" UWORD udf_CM_16717 0 0.0 0.0 65535.0 ECU_ADDRESS 0x40002E0E /end MEASUREMENT
/begin MEASUREMENT ACSSLPassCount "var comments" UWORD udf_CM_16717 0 0.0 0.0 65535.0 ECU_ADDRESS 0x40002E10 /end MEASUREMENT
/begin MEASUREMENT ACSSHFailCount "var comments" UWORD udf_CM_16717 0 0.0 0.0 65535.0 ECU_ADDRESS 0x40002E12 /end MEASUREMENT
/begin MEASUREMENT ACSSHPassCount "var comments" UWORD udf_CM_16717 0 0.0 0.0 65535.0 ECU_ADDRESS 0x40002E14 /end MEASUREMENT
/begin MEASUREMENT ACSShrtDiagEnb "var comments" UBYTE udf_CM_16731 0 0.0 0.0 255.0 ECU_ADDRESS 0x40002E08 /end MEASUREMENT
/begin MEASUREMENT WPSSLFailMet "var comments" UBYTE udf_CM_16710 0 0.0 0.0 255.0 ECU_ADDRESS 0x40002E26 /end MEASUREMENT
/begin MEASUREMENT WPSSHFailMet "var comments" UBYTE udf_CM_16710 0 0.0 0.0 255.0 ECU_ADDRESS 0x40002E27 /end MEASUREMENT
/begin MEASUREMENT WPSSLTestFail "var comments" UBYTE udf_CM_16759 0 0.0 0.0 255.0 ECU_ADDRESS 0x40002E1A /end MEASUREMENT
/begin MEASUREMENT WPSSHTestFail "var comments" UBYTE udf_CM_16759 0 0.0 0.0 255.0 ECU_ADDRESS 0x40002E1B /end MEASUREMENT
/begin MEASUREMENT WPSSLFailCount "var comments" UWORD udf_CM_16717 0 0.0 0.0 65535.0 ECU_ADDRESS 0x40002E1C /end MEASUREMENT
/begin MEASUREMENT WPSSLPassCount "var comments" UWORD udf_CM_16717 0 0.0 0.0 65535.0 ECU_ADDRESS 0x40002E1E /end MEASUREMENT
/begin MEASUREMENT WPSSHFailCount "var comments" UWORD udf_CM_16717 0 0.0 0.0 65535.0 ECU_ADDRESS 0x40002E20 /end MEASUREMENT
/begin MEASUREMENT WPSSHPassCount "var comments" UWORD udf_CM_16717 0 0.0 0.0 65535.0 ECU_ADDRESS 0x40002E22 /end MEASUREMENT
/begin MEASUREMENT WPSShrtHDiagEnb "var comments" UBYTE udf_CM_16731 0 0.0 0.0 255.0 ECU_ADDRESS 0x40002E24 /end MEASUREMENT
/begin MEASUREMENT WPSShrtLDiagEnb "var comments" UBYTE udf_CM_16731 0 0.0 0.0 255.0 ECU_ADDRESS 0x40002E25 /end MEASUREMENT
/begin MEASUREMENT VbCCPS_CCPEnable "var comments" UBYTE udf_CM_16857 0 0.0 0.0 255.0 ECU_ADDRESS 0x0 /end MEASUREMENT
/begin MEASUREMENT VfCCPS_Pct_CCPDutyCycle "var comments" UWORD udf_CM_16808 0 0.0 0.0 199.9969482421875 ECU_ADDRESS 0x0 /end MEASUREMENT
/begin MEASUREMENT IdleFlow "var comments" UWORD udf_CM_16836 0 0.0 0.0 199.9969482421875 ECU_ADDRESS 0x40002782 /end MEASUREMENT
/begin MEASUREMENT IdleCLFlow "var comments" UWORD udf_CM_16808 0 0.0 0.0 199.9969482421875 ECU_ADDRESS 0x4000277E /end MEASUREMENT
/begin MEASUREMENT IDLECondMet "var comments" UBYTE udf_CM_16815 0 0.0 0.0 255.0 ECU_ADDRESS 0x40002780 /end MEASUREMENT
/begin MEASUREMENT IdleSwitch "var comments" UBYTE udf_CM_16857 0 0.0 0.0 255.0 ECU_ADDRESS 0x400027A5 /end MEASUREMENT
/begin MEASUREMENT FL_UpHillFlag "var comments" UBYTE udf_CM_16857 0 0.0 0.0 255.0 ECU_ADDRESS 0x0 /end MEASUREMENT
/begin MEASUREMENT Inj1SHFailMet "var comments" UBYTE udf_CM_16962 0 0.0 0.0 255.0 DISPLAY_IDENTIFIER InjSHFailMet[0] ECU_ADDRESS 0x40002D30 /end MEASUREMENT
/begin MEASUREMENT Inj1SHTestComp "var comments" UBYTE udf_CM_16976 0 0.0 0.0 255.0 DISPLAY_IDENTIFIER InjSHTestComp[0] ECU_ADDRESS 0x40002D38 /end MEASUREMENT
/begin MEASUREMENT Inj1SHTestFail "var comments" UBYTE udf_CM_16983 0 0.0 0.0 255.0 DISPLAY_IDENTIFIER InjSHTestFail[0] ECU_ADDRESS 0x40002D60 /end MEASUREMENT
/begin MEASUREMENT Inj1SHFailCount "var comments" UWORD udf_CM_16941 0 0.0 0.0 65535.0 DISPLAY_IDENTIFIER InjSHFailCount[0] ECU_ADDRESS 0x40002D4C /end MEASUREMENT
/begin MEASUREMENT Inj1SHPassCount "var comments" UWORD udf_CM_16969 0 0.0 0.0 65535.0 DISPLAY_IDENTIFIER InjSHPassCount[0] ECU_ADDRESS 0x40002D54 /end MEASUREMENT
/begin MEASUREMENT Inj1SLFailMet "var comments" UBYTE udf_CM_16962 0 0.0 0.0 255.0 DISPLAY_IDENTIFIER InjSLFailMet[0] ECU_ADDRESS 0x40002D2C /end MEASUREMENT
/begin MEASUREMENT Inj1SLTestComp "var comments" UBYTE udf_CM_16976 0 0.0 0.0 255.0 DISPLAY_IDENTIFIER InjSLTestComp[0] ECU_ADDRESS 0x40002D34 /end MEASUREMENT
/begin MEASUREMENT Inj1SLTestFail "var comments" UBYTE udf_CM_16983 0 0.0 0.0 255.0 DISPLAY_IDENTIFIER InjSLTestFail[0] ECU_ADDRESS 0x40002D5C /end MEASUREMENT
/begin MEASUREMENT Inj1SLFailCount "var comments" UWORD udf_CM_16941 0 0.0 0.0 65535.0 DISPLAY_IDENTIFIER InjSLFailCount[0] ECU_ADDRESS 0x40002D3C /end MEASUREMENT
/begin MEASUREMENT Inj1SLPassCount "var comments" UWORD udf_CM_16969 0 0.0 0.0 65535.0 DISPLAY_IDENTIFIER InjSLPassCount[0] ECU_ADDRESS 0x40002D44 /end MEASUREMENT
/begin MEASUREMENT Inj2SHFailMet "var comments" UBYTE udf_CM_16962 0 0.0 0.0 255.0 DISPLAY_IDENTIFIER InjSHFailMet[1] ECU_ADDRESS 0x40002D31 /end MEASUREMENT
/begin MEASUREMENT Inj2SHTestComp "var comments" UBYTE udf_CM_16976 0 0.0 0.0 255.0 DISPLAY_IDENTIFIER InjSHTestComp[1] ECU_ADDRESS 0x40002D39 /end MEASUREMENT
/begin MEASUREMENT Inj2SHTestFail "var comments" UBYTE udf_CM_16983 0 0.0 0.0 255.0 DISPLAY_IDENTIFIER InjSHTestFail[1] ECU_ADDRESS 0x40002D61 /end MEASUREMENT
/begin MEASUREMENT Inj2SHFailCount "var comments" UWORD udf_CM_16941 0 0.0 0.0 65535.0 DISPLAY_IDENTIFIER InjSHFailCount[1] ECU_ADDRESS 0x40002D4E /end MEASUREMENT
/begin MEASUREMENT Inj2SHPassCount "var comments" UWORD udf_CM_16969 0 0.0 0.0 65535.0 DISPLAY_IDENTIFIER InjSHPassCount[1] ECU_ADDRESS 0x40002D56 /end MEASUREMENT
/begin MEASUREMENT Inj2SLFailMet "var comments" UBYTE udf_CM_16962 0 0.0 0.0 255.0 DISPLAY_IDENTIFIER InjSLFailMet[1] ECU_ADDRESS 0x40002D2D /end MEASUREMENT
/begin MEASUREMENT Inj2SLTestComp "var comments" UBYTE udf_CM_16976 0 0.0 0.0 255.0 DISPLAY_IDENTIFIER InjSLTestComp[1] ECU_ADDRESS 0x40002D35 /end MEASUREMENT
/begin MEASUREMENT Inj2SLTestFail "var comments" UBYTE udf_CM_16983 0 0.0 0.0 255.0 DISPLAY_IDENTIFIER InjSLTestFail[1] ECU_ADDRESS 0x40002D5D /end MEASUREMENT
/begin MEASUREMENT Inj2SLFailCount "var comments" UWORD udf_CM_16941 0 0.0 0.0 65535.0 DISPLAY_IDENTIFIER InjSLFailCount[1] ECU_ADDRESS 0x40002D3E /end MEASUREMENT
/begin MEASUREMENT Inj2SLPassCount "var comments" UWORD udf_CM_16969 0 0.0 0.0 65535.0 DISPLAY_IDENTIFIER InjSLPassCount[1] ECU_ADDRESS 0x40002D46 /end MEASUREMENT
/begin MEASUREMENT Inj3SHFailMet "var comments" UBYTE udf_CM_16962 0 0.0 0.0 255.0 DISPLAY_IDENTIFIER InjSHFailMet[2] ECU_ADDRESS 0x40002D32 /end MEASUREMENT
/begin MEASUREMENT Inj3SHTestComp "var comments" UBYTE udf_CM_16976 0 0.0 0.0 255.0 DISPLAY_IDENTIFIER InjSHTestComp[2] ECU_ADDRESS 0x40002D3A /end MEASUREMENT
/begin MEASUREMENT Inj3SHTestFail "var comments" UBYTE udf_CM_16983 0 0.0 0.0 255.0 DISPLAY_IDENTIFIER InjSHTestFail[2] ECU_ADDRESS 0x40002D62 /end MEASUREMENT
/begin MEASUREMENT Inj3SHFailCount "var comments" UWORD udf_CM_16941 0 0.0 0.0 65535.0 DISPLAY_IDENTIFIER InjSHFailCount[2] ECU_ADDRESS 0x40002D50 /end MEASUREMENT
/begin MEASUREMENT Inj3SHPassCount "var comments" UWORD udf_CM_16969 0 0.0 0.0 65535.0 DISPLAY_IDENTIFIER InjSHPassCount[2] ECU_ADDRESS 0x40002D58 /end MEASUREMENT
/begin MEASUREMENT Inj3SLFailMet "var comments" UBYTE udf_CM_16962 0 0.0 0.0 255.0 DISPLAY_IDENTIFIER InjSLFailMet[2] ECU_ADDRESS 0x40002D2E /end MEASUREMENT
/begin MEASUREMENT Inj3SLTestComp "var comments" UBYTE udf_CM_16976 0 0.0 0.0 255.0 DISPLAY_IDENTIFIER InjSLTestComp[2] ECU_ADDRESS 0x40002D36 /end MEASUREMENT
/begin MEASUREMENT Inj3SLTestFail "var comments" UBYTE udf_CM_16983 0 0.0 0.0 255.0 DISPLAY_IDENTIFIER InjSLTestFail[2] ECU_ADDRESS 0x40002D5E /end MEASUREMENT
/begin MEASUREMENT Inj3SLFailCount "var comments" UWORD udf_CM_16941 0 0.0 0.0 65535.0 DISPLAY_IDENTIFIER InjSLFailCount[2] ECU_ADDRESS 0x40002D40 /end MEASUREMENT
/begin MEASUREMENT Inj3SLPassCount "var comments" UWORD udf_CM_16969 0 0.0 0.0 65535.0 DISPLAY_IDENTIFIER InjSLPassCount[2] ECU_ADDRESS 0x40002D48 /end MEASUREMENT
/begin MEASUREMENT Inj4SHFailMet "var comments" UBYTE udf_CM_16962 0 0.0 0.0 255.0 DISPLAY_IDENTIFIER InjSHFailMet[3] ECU_ADDRESS 0x40002D33 /end MEASUREMENT
/begin MEASUREMENT Inj4SHTestComp "var comments" UBYTE udf_CM_16976 0 0.0 0.0 255.0 DISPLAY_IDENTIFIER InjSHTestComp[3] ECU_ADDRESS 0x40002D3B /end MEASUREMENT
/begin MEASUREMENT Inj4SHTestFail "var comments" UBYTE udf_CM_16983 0 0.0 0.0 255.0 DISPLAY_IDENTIFIER InjSHTestFail[3] ECU_ADDRESS 0x40002D63 /end MEASUREMENT
/begin MEASUREMENT Inj4SHFailCount "var comments" UWORD udf_CM_16941 0 0.0 0.0 65535.0 DISPLAY_IDENTIFIER InjSHFailCount[3] ECU_ADDRESS 0x40002D52 /end MEASUREMENT
/begin MEASUREMENT Inj4SHPassCount "var comments" UWORD udf_CM_16969 0 0.0 0.0 65535.0 DISPLAY_IDENTIFIER InjSHPassCount[3] ECU_ADDRESS 0x40002D5A /end MEASUREMENT
/begin MEASUREMENT Inj4SLFailMet "var comments" UBYTE udf_CM_16962 0 0.0 0.0 255.0 DISPLAY_IDENTIFIER InjSLFailMet[3] ECU_ADDRESS 0x40002D2F /end MEASUREMENT
/begin MEASUREMENT Inj4SLTestComp "var comments" UBYTE udf_CM_16976 0 0.0 0.0 255.0 DISPLAY_IDENTIFIER InjSLTestComp[3] ECU_ADDRESS 0x40002D37 /end MEASUREMENT
/begin MEASUREMENT Inj4SLTestFail "var comments" UBYTE udf_CM_16983 0 0.0 0.0 255.0 DISPLAY_IDENTIFIER InjSLTestFail[3] ECU_ADDRESS 0x40002D5F /end MEASUREMENT
/begin MEASUREMENT Inj4SLFailCount "var comments" UWORD udf_CM_16941 0 0.0 0.0 65535.0 DISPLAY_IDENTIFIER InjSLFailCount[3] ECU_ADDRESS 0x40002D42 /end MEASUREMENT
/begin MEASUREMENT Inj4SLPassCount "var comments" UWORD udf_CM_16969 0 0.0 0.0 65535.0 DISPLAY_IDENTIFIER InjSLPassCount[3] ECU_ADDRESS 0x40002D4A /end MEASUREMENT
/begin MEASUREMENT OSWPFilt "var comments" UWORD udf_CM_18005 0 0.0 0.0 99.99847412109375 ECU_ADDRESS 0x40002A8C /end MEASUREMENT
/begin MEASUREMENT WPOutRawSignal "var comments" UWORD udf_CM_18005 0 0.0 0.0 99.99847412109375 ECU_ADDRESS 0x40002AFA /end MEASUREMENT
/begin MEASUREMENT PCodeActive "var comments" UWORD udf_CM_17592 0 0.0 0.0 65535.0 ECU_ADDRESS 0x40002B22 /end MEASUREMENT
/begin MEASUREMENT MAPSHDiagEnb "var comments" UBYTE udf_CM_17214 0 0.0 0.0 255.0 ECU_ADDRESS 0x40002C44 /end MEASUREMENT
/begin MEASUREMENT MAPSHFailCount "var comments" UWORD udf_CM_17221 0 0.0 0.0 65535.0 ECU_ADDRESS 0x40002C4E /end MEASUREMENT
/begin MEASUREMENT MAPSHFailMet "var comments" UBYTE udf_CM_17228 0 0.0 0.0 255.0 ECU_ADDRESS 0x40002C53 /end MEASUREMENT
/begin MEASUREMENT MAPSHPassCount "var comments" UWORD udf_CM_17242 0 0.0 0.0 65535.0 ECU_ADDRESS 0x40002C50 /end MEASUREMENT
/begin MEASUREMENT MAPSHTestFail "var comments" UBYTE udf_CM_17249 0 0.0 0.0 255.0 ECU_ADDRESS 0x40002C49 /end MEASUREMENT
/begin MEASUREMENT MAPSLDiagEnb "var comments" UBYTE udf_CM_17256 0 0.0 0.0 255.0 ECU_ADDRESS 0x40002C45 /end MEASUREMENT
/begin MEASUREMENT MAPSLFailCount "var comments" UWORD udf_CM_17263 0 0.0 0.0 65535.0 ECU_ADDRESS 0x40002C4A /end MEASUREMENT
/begin MEASUREMENT MAPSLFailMet "var comments" UBYTE udf_CM_17270 0 0.0 0.0 255.0 ECU_ADDRESS 0x40002C52 /end MEASUREMENT
/begin MEASUREMENT MAPSLPassCount "var comments" UWORD udf_CM_17277 0 0.0 0.0 65535.0 ECU_ADDRESS 0x40002C4C /end MEASUREMENT
/begin MEASUREMENT MAPSLTestFail "var comments" UBYTE udf_CM_17284 0 0.0 0.0 255.0 ECU_ADDRESS 0x40002C48 /end MEASUREMENT
/begin MEASUREMENT BSTPSHDiagEnb "var comments" UBYTE udf_CM_17214 0 0.0 0.0 255.0 ECU_ADDRESS 0x40002E2C /end MEASUREMENT
/begin MEASUREMENT BSTPSHFailCount "var comments" UWORD udf_CM_17221 0 0.0 0.0 65535.0 ECU_ADDRESS 0x40002E3A /end MEASUREMENT
/begin MEASUREMENT BSTPSHFailMet "var comments" UBYTE udf_CM_17228 0 0.0 0.0 255.0 ECU_ADDRESS 0x40002E30 /end MEASUREMENT
/begin MEASUREMENT BSTPSHPassCount "var comments" UWORD udf_CM_17242 0 0.0 0.0 65535.0 ECU_ADDRESS 0x40002E3C /end MEASUREMENT
/begin MEASUREMENT BSTPSHTestFail "var comments" UBYTE udf_CM_17249 0 0.0 0.0 255.0 ECU_ADDRESS 0x40002E34 /end MEASUREMENT
/begin MEASUREMENT BSTPSLDiagEnb "var comments" UBYTE udf_CM_17256 0 0.0 0.0 255.0 ECU_ADDRESS 0x40002E2E /end MEASUREMENT
/begin MEASUREMENT BSTPSLFailCount "var comments" UWORD udf_CM_17263 0 0.0 0.0 65535.0 ECU_ADDRESS 0x40002E36 /end MEASUREMENT
/begin MEASUREMENT BSTPSLFailMet "var comments" UBYTE udf_CM_17270 0 0.0 0.0 255.0 ECU_ADDRESS 0x40002E2F /end MEASUREMENT
/begin MEASUREMENT BSTPSLPassCount "var comments" UWORD udf_CM_17277 0 0.0 0.0 65535.0 ECU_ADDRESS 0x40002E38 /end MEASUREMENT
/begin MEASUREMENT BSTPSLTestFail "var comments" UBYTE udf_CM_17284 0 0.0 0.0 255.0 ECU_ADDRESS 0x40002E33 /end MEASUREMENT
/begin MEASUREMENT MtrMovDlyCnt "var comments" UBYTE udf_CM_18166 0 0.0 0.0 255.0 DISPLAY_IDENTIFIER IDLE_Motor_StartMoveDelayCount ECU_ADDRESS 0x40002A97 /end MEASUREMENT
/begin MEASUREMENT MtrPauseCnt "var comments" UBYTE udf_CM_18159 0 0.0 0.0 255.0 DISPLAY_IDENTIFIER IDLE_Motor_PauseDelayCount ECU_ADDRESS 0x40002AA2 /end MEASUREMENT
/begin MEASUREMENT MtrStartSteps "var comments" UBYTE udf_CM_18173 0 0.0 0.0 255.0 DISPLAY_IDENTIFIER IDLE_Motor_StartMoveSteps ECU_ADDRESS 0x40002A9B /end MEASUREMENT
/begin MEASUREMENT O2HtDiagEnb "var comments" UBYTE udf_CM_17382 0 0.0 0.0 255.0 ECU_ADDRESS 0x40002D02 /end MEASUREMENT
/begin MEASUREMENT O2HtSLFailMet "var comments" UBYTE udf_CM_17410 0 0.0 0.0 255.0 ECU_ADDRESS 0x40002D03 /end MEASUREMENT
/begin MEASUREMENT O2HtSLTestComp "var comments" UBYTE udf_CM_17424 0 0.0 0.0 255.0 ECU_ADDRESS 0x40002D05 /end MEASUREMENT
/begin MEASUREMENT O2HtSLTestFail "var comments" UBYTE udf_CM_17431 0 0.0 0.0 255.0 ECU_ADDRESS 0x40002D07 /end MEASUREMENT
/begin MEASUREMENT O2HtSLFailCount "var comments" UWORD udf_CM_17389 0 0.0 0.0 65535.0 ECU_ADDRESS 0x40002D08 /end MEASUREMENT
/begin MEASUREMENT O2HtSLPassCount "var comments" UWORD udf_CM_17417 0 0.0 0.0 65535.0 ECU_ADDRESS 0x40002D0C /end MEASUREMENT
/begin MEASUREMENT O2HtSHFailMet "var comments" UBYTE udf_CM_17410 0 0.0 0.0 255.0 ECU_ADDRESS 0x40002D04 /end MEASUREMENT
/begin MEASUREMENT O2HtSHTestComp "var comments" UBYTE udf_CM_17424 0 0.0 0.0 255.0 ECU_ADDRESS 0x40002D06 /end MEASUREMENT
/begin MEASUREMENT O2HtSHTestFail "var comments" UBYTE udf_CM_17431 0 0.0 0.0 255.0 ECU_ADDRESS 0x40002D10 /end MEASUREMENT
/begin MEASUREMENT O2HtSHFailCount "var comments" UWORD udf_CM_17389 0 0.0 0.0 65535.0 ECU_ADDRESS 0x40002D0A /end MEASUREMENT
/begin MEASUREMENT O2HtSHPassCount "var comments" UWORD udf_CM_17417 0 0.0 0.0 65535.0 ECU_ADDRESS 0x40002D0E /end MEASUREMENT
/begin MEASUREMENT RO2Ht1DiagEnb "var comments" UBYTE udf_CM_17382 0 0.0 0.0 255.0 ECU_ADDRESS 0x40002D14 /end MEASUREMENT
/begin MEASUREMENT RO2Ht1SLFailMet "var comments" UBYTE udf_CM_17410 0 0.0 0.0 255.0 ECU_ADDRESS 0x40002D15 /end MEASUREMENT
/begin MEASUREMENT RO2Ht1SLTestComp "var comments" UBYTE udf_CM_17424 0 0.0 0.0 255.0 ECU_ADDRESS 0x40002D17 /end MEASUREMENT
/begin MEASUREMENT RO2Ht1SLTestFail "var comments" UBYTE udf_CM_17431 0 0.0 0.0 255.0 ECU_ADDRESS 0x40002D19 /end MEASUREMENT
/begin MEASUREMENT RO2Ht1SLFailCount "var comments" UWORD udf_CM_17389 0 0.0 0.0 65535.0 ECU_ADDRESS 0x40002D1A /end MEASUREMENT
/begin MEASUREMENT RO2Ht1SLPassCount "var comments" UWORD udf_CM_17417 0 0.0 0.0 65535.0 ECU_ADDRESS 0x40002D1E /end MEASUREMENT
/begin MEASUREMENT RO2Ht1SHFailMet "var comments" UBYTE udf_CM_17410 0 0.0 0.0 255.0 ECU_ADDRESS 0x40002D16 /end MEASUREMENT
/begin MEASUREMENT RO2Ht1SHTestComp "var comments" UBYTE udf_CM_17424 0 0.0 0.0 255.0 ECU_ADDRESS 0x40002D18 /end MEASUREMENT
/begin MEASUREMENT RO2Ht1SHTestFail "var comments" UBYTE udf_CM_17431 0 0.0 0.0 255.0 ECU_ADDRESS 0x40002D22 /end MEASUREMENT
/begin MEASUREMENT RO2Ht1SHFailCount "var comments" UWORD udf_CM_17389 0 0.0 0.0 65535.0 ECU_ADDRESS 0x40002D1C /end MEASUREMENT
/begin MEASUREMENT RO2Ht1SHPassCount "var comments" UWORD udf_CM_17417 0 0.0 0.0 65535.0 ECU_ADDRESS 0x40002D20 /end MEASUREMENT
/begin MEASUREMENT BSTCDiagEnb "var comments" UBYTE udf_CM_17382 0 0.0 0.0 255.0 ECU_ADDRESS 0x40002DA0 /end MEASUREMENT
/begin MEASUREMENT BSTCSLFailMet "var comments" UBYTE udf_CM_17410 0 0.0 0.0 255.0 ECU_ADDRESS 0x40002DA1 /end MEASUREMENT
/begin MEASUREMENT BSTCSLTestComp "var comments" UBYTE udf_CM_17424 0 0.0 0.0 255.0 ECU_ADDRESS 0x40002DA3 /end MEASUREMENT
/begin MEASUREMENT BSTCSLTestFail "var comments" UBYTE udf_CM_17431 0 0.0 0.0 255.0 ECU_ADDRESS 0x40002DA5 /end MEASUREMENT
/begin MEASUREMENT BSTCSLFailCount "var comments" UWORD udf_CM_17389 0 0.0 0.0 65535.0 ECU_ADDRESS 0x40002DA6 /end MEASUREMENT
/begin MEASUREMENT BSTCSLPassCount "var comments" UWORD udf_CM_17417 0 0.0 0.0 65535.0 ECU_ADDRESS 0x40002DAA /end MEASUREMENT
/begin MEASUREMENT BSTCSHFailMet "var comments" UBYTE udf_CM_17410 0 0.0 0.0 255.0 ECU_ADDRESS 0x40002DA2 /end MEASUREMENT
/begin MEASUREMENT BSTCSHTestComp "var comments" UBYTE udf_CM_17424 0 0.0 0.0 255.0 ECU_ADDRESS 0x40002DA4 /end MEASUREMENT
/begin MEASUREMENT BSTCSHTestFail "var comments" UBYTE udf_CM_17431 0 0.0 0.0 255.0 ECU_ADDRESS 0x40002DAE /end MEASUREMENT
/begin MEASUREMENT BSTCSHFailCount "var comments" UWORD udf_CM_17389 0 0.0 0.0 65535.0 ECU_ADDRESS 0x40002DA8 /end MEASUREMENT
/begin MEASUREMENT BSTCSHPassCount "var comments" UWORD udf_CM_17417 0 0.0 0.0 65535.0 ECU_ADDRESS 0x40002DAC /end MEASUREMENT
/begin MEASUREMENT REF1DiagEnb "var comments" UBYTE udf_CM_17382 0 0.0 0.0 255.0 ECU_ADDRESS 0x40002DB2 /end MEASUREMENT
/begin MEASUREMENT REF1SLFailMet "var comments" UBYTE udf_CM_17410 0 0.0 0.0 255.0 ECU_ADDRESS 0x40002DB3 /end MEASUREMENT
/begin MEASUREMENT REF1SLTestComp "var comments" UBYTE udf_CM_17424 0 0.0 0.0 255.0 ECU_ADDRESS 0x40002DB5 /end MEASUREMENT
/begin MEASUREMENT REF1SLTestFail "var comments" UBYTE udf_CM_17431 0 0.0 0.0 255.0 ECU_ADDRESS 0x40002DB7 /end MEASUREMENT
/begin MEASUREMENT REF1SLFailCount "var comments" UWORD udf_CM_17389 0 0.0 0.0 65535.0 ECU_ADDRESS 0x40002DB8 /end MEASUREMENT
/begin MEASUREMENT REF1SLPassCount "var comments" UWORD udf_CM_17417 0 0.0 0.0 65535.0 ECU_ADDRESS 0x40002DBC /end MEASUREMENT
/begin MEASUREMENT REF1SHFailMet "var comments" UBYTE udf_CM_17410 0 0.0 0.0 255.0 ECU_ADDRESS 0x40002DB4 /end MEASUREMENT
/begin MEASUREMENT REF1SHTestComp "var comments" UBYTE udf_CM_17424 0 0.0 0.0 255.0 ECU_ADDRESS 0x40002DB6 /end MEASUREMENT
/begin MEASUREMENT REF1SHTestFail "var comments" UBYTE udf_CM_17431 0 0.0 0.0 255.0 ECU_ADDRESS 0x40002DC0 /end MEASUREMENT
/begin MEASUREMENT REF1SHFailCount "var comments" UWORD udf_CM_17389 0 0.0 0.0 65535.0 ECU_ADDRESS 0x40002DBA /end MEASUREMENT
/begin MEASUREMENT REF1SHPassCount "var comments" UWORD udf_CM_17417 0 0.0 0.0 65535.0 ECU_ADDRESS 0x40002DBE /end MEASUREMENT
/begin MEASUREMENT REF2DiagEnb "var comments" UBYTE udf_CM_17382 0 0.0 0.0 255.0 ECU_ADDRESS 0x40002DC4 /end MEASUREMENT
/begin MEASUREMENT REF2SLFailMet "var comments" UBYTE udf_CM_17410 0 0.0 0.0 255.0 ECU_ADDRESS 0x40002DC5 /end MEASUREMENT
/begin MEASUREMENT REF2SLTestComp "var comments" UBYTE udf_CM_17424 0 0.0 0.0 255.0 ECU_ADDRESS 0x40002DC7 /end MEASUREMENT
/begin MEASUREMENT REF2SLTestFail "var comments" UBYTE udf_CM_17431 0 0.0 0.0 255.0 ECU_ADDRESS 0x40002DC9 /end MEASUREMENT
/begin MEASUREMENT REF2SLFailCount "var comments" UWORD udf_CM_17389 0 0.0 0.0 65535.0 ECU_ADDRESS 0x40002DCA /end MEASUREMENT
/begin MEASUREMENT REF2SLPassCount "var comments" UWORD udf_CM_17417 0 0.0 0.0 65535.0 ECU_ADDRESS 0x40002DCE /end MEASUREMENT
/begin MEASUREMENT REF2SHFailMet "var comments" UBYTE udf_CM_17410 0 0.0 0.0 255.0 ECU_ADDRESS 0x40002DC6 /end MEASUREMENT
/begin MEASUREMENT REF2SHTestComp "var comments" UBYTE udf_CM_17424 0 0.0 0.0 255.0 ECU_ADDRESS 0x40002DC8 /end MEASUREMENT
/begin MEASUREMENT REF2SHTestFail "var comments" UBYTE udf_CM_17431 0 0.0 0.0 255.0 ECU_ADDRESS 0x40002DD2 /end MEASUREMENT
/begin MEASUREMENT REF2SHFailCount "var comments" UWORD udf_CM_17389 0 0.0 0.0 65535.0 ECU_ADDRESS 0x40002DCC /end MEASUREMENT
/begin MEASUREMENT REF2SHPassCount "var comments" UWORD udf_CM_17417 0 0.0 0.0 65535.0 ECU_ADDRESS 0x40002DD0 /end MEASUREMENT
/begin MEASUREMENT BLM_TrimDiagEnb "var comments" UBYTE udf_CM_17382 0 0.0 0.0 255.0 ECU_ADDRESS 0x40002C82 /end MEASUREMENT
/begin MEASUREMENT BLM_TrimLoFailMet "var comments" UBYTE udf_CM_17410 0 0.0 0.0 255.0 ECU_ADDRESS 0x40002C85 /end MEASUREMENT
/begin MEASUREMENT BLM_TrimLoTestComp "var comments" UBYTE udf_CM_17424 0 0.0 0.0 255.0 ECU_ADDRESS 0x40002C80 /end MEASUREMENT
/begin MEASUREMENT BLM_TrimLoTestFail "var comments" UBYTE udf_CM_17431 0 0.0 0.0 255.0 ECU_ADDRESS 0x40002C83 /end MEASUREMENT
/begin MEASUREMENT BLM_TrimLoFailCount "var comments" UWORD udf_CM_17389 0 0.0 0.0 65535.0 ECU_ADDRESS 0x40002C86 /end MEASUREMENT
/begin MEASUREMENT BLM_TrimLoPassCount "var comments" UWORD udf_CM_17417 0 0.0 0.0 65535.0 ECU_ADDRESS 0x40002C88 /end MEASUREMENT
/begin MEASUREMENT BLM_TrimHiFailMet "var comments" UBYTE udf_CM_17410 0 0.0 0.0 255.0 ECU_ADDRESS 0x40002C8E /end MEASUREMENT
/begin MEASUREMENT BLM_TrimHiTestComp "var comments" UBYTE udf_CM_17424 0 0.0 0.0 255.0 ECU_ADDRESS 0x40002C81 /end MEASUREMENT
/begin MEASUREMENT BLM_TrimHiTestFail "var comments" UBYTE udf_CM_17431 0 0.0 0.0 255.0 ECU_ADDRESS 0x40002C84 /end MEASUREMENT
/begin MEASUREMENT BLM_TrimHiFailCount "var comments" UWORD udf_CM_17389 0 0.0 0.0 65535.0 ECU_ADDRESS 0x40002C8A /end MEASUREMENT
/begin MEASUREMENT BLM_TrimHiPassCount "var comments" UWORD udf_CM_17417 0 0.0 0.0 65535.0 ECU_ADDRESS 0x40002C8C /end MEASUREMENT
/begin MEASUREMENT BLM_TrimLoCellCnt "var comments" UWORD udf_CM_17417 0 0.0 0.0 65535.0 ECU_ADDRESS 0x40002C90 /end MEASUREMENT
/begin MEASUREMENT BLM_TrimHiCellCnt "var comments" UWORD udf_CM_17417 0 0.0 0.0 65535.0 ECU_ADDRESS 0x40002C92 /end MEASUREMENT
/begin MEASUREMENT FCV1DiagEnb "var comments" UBYTE udf_CM_17382 0 0.0 0.0 255.0 ECU_ADDRESS 0x40002D6A /end MEASUREMENT
/begin MEASUREMENT FCV1SLFailMet "var comments" UBYTE udf_CM_17410 0 0.0 0.0 255.0 ECU_ADDRESS 0x40002D6B /end MEASUREMENT
/begin MEASUREMENT FCV1SLTestComp "var comments" UBYTE udf_CM_17424 0 0.0 0.0 255.0 ECU_ADDRESS 0x40002D6D /end MEASUREMENT
/begin MEASUREMENT FCV1SLTestFail "var comments" UBYTE udf_CM_17431 0 0.0 0.0 255.0 ECU_ADDRESS 0x40002D6F /end MEASUREMENT
/begin MEASUREMENT FCV1SLFailCount "var comments" UWORD udf_CM_17389 0 0.0 0.0 65535.0 ECU_ADDRESS 0x40002D70 /end MEASUREMENT
/begin MEASUREMENT FCV1SLPassCount "var comments" UWORD udf_CM_17417 0 0.0 0.0 65535.0 ECU_ADDRESS 0x40002D74 /end MEASUREMENT
/begin MEASUREMENT FCV1SHFailMet "var comments" UBYTE udf_CM_17410 0 0.0 0.0 255.0 ECU_ADDRESS 0x40002D6C /end MEASUREMENT
/begin MEASUREMENT FCV1SHTestComp "var comments" UBYTE udf_CM_17424 0 0.0 0.0 255.0 ECU_ADDRESS 0x40002D6E /end MEASUREMENT
/begin MEASUREMENT FCV1SHTestFail "var comments" UBYTE udf_CM_17431 0 0.0 0.0 255.0 ECU_ADDRESS 0x40002D78 /end MEASUREMENT
/begin MEASUREMENT FCV1SHFailCount "var comments" UWORD udf_CM_17389 0 0.0 0.0 65535.0 ECU_ADDRESS 0x40002D72 /end MEASUREMENT
/begin MEASUREMENT FCV1SHPassCount "var comments" UWORD udf_CM_17417 0 0.0 0.0 65535.0 ECU_ADDRESS 0x40002D76 /end MEASUREMENT
/begin MEASUREMENT FCV2DiagEnb "var comments" UBYTE udf_CM_17382 0 0.0 0.0 255.0 ECU_ADDRESS 0x40002D7C /end MEASUREMENT
/begin MEASUREMENT FCV2SLFailMet "var comments" UBYTE udf_CM_17410 0 0.0 0.0 255.0 ECU_ADDRESS 0x40002D7D /end MEASUREMENT
/begin MEASUREMENT FCV2SLTestComp "var comments" UBYTE udf_CM_17424 0 0.0 0.0 255.0 ECU_ADDRESS 0x40002D7F /end MEASUREMENT
/begin MEASUREMENT FCV2SLTestFail "var comments" UBYTE udf_CM_17431 0 0.0 0.0 255.0 ECU_ADDRESS 0x40002D81 /end MEASUREMENT
/begin MEASUREMENT FCV2SLFailCount "var comments" UWORD udf_CM_17389 0 0.0 0.0 65535.0 ECU_ADDRESS 0x40002D82 /end MEASUREMENT
/begin MEASUREMENT FCV2SLPassCount "var comments" UWORD udf_CM_17417 0 0.0 0.0 65535.0 ECU_ADDRESS 0x40002D86 /end MEASUREMENT
/begin MEASUREMENT FCV2SHFailMet "var comments" UBYTE udf_CM_17410 0 0.0 0.0 255.0 ECU_ADDRESS 0x40002D7E /end MEASUREMENT
/begin MEASUREMENT FCV2SHTestComp "var comments" UBYTE udf_CM_17424 0 0.0 0.0 255.0 ECU_ADDRESS 0x40002D80 /end MEASUREMENT
/begin MEASUREMENT FCV2SHTestFail "var comments" UBYTE udf_CM_17431 0 0.0 0.0 255.0 ECU_ADDRESS 0x40002D8A /end MEASUREMENT
/begin MEASUREMENT FCV2SHFailCount "var comments" UWORD udf_CM_17389 0 0.0 0.0 65535.0 ECU_ADDRESS 0x40002D84 /end MEASUREMENT
/begin MEASUREMENT FCV2SHPassCount "var comments" UWORD udf_CM_17417 0 0.0 0.0 65535.0 ECU_ADDRESS 0x40002D88 /end MEASUREMENT
/begin MEASUREMENT IACVDiagEnb "var comments" UBYTE udf_CM_17382 0 0.0 0.0 255.0 ECU_ADDRESS 0x40002D8E /end MEASUREMENT
/begin MEASUREMENT IACVSLFailMet "var comments" UBYTE udf_CM_17410 0 0.0 0.0 255.0 ECU_ADDRESS 0x40002D8F /end MEASUREMENT
/begin MEASUREMENT IACVSLTestComp "var comments" UBYTE udf_CM_17424 0 0.0 0.0 255.0 ECU_ADDRESS 0x40002D91 /end MEASUREMENT
/begin MEASUREMENT IACVSLTestFail "var comments" UBYTE udf_CM_17431 0 0.0 0.0 255.0 ECU_ADDRESS 0x40002D93 /end MEASUREMENT
/begin MEASUREMENT IACVSLFailCount "var comments" UWORD udf_CM_17389 0 0.0 0.0 65535.0 ECU_ADDRESS 0x40002D94 /end MEASUREMENT
/begin MEASUREMENT IACVSLPassCount "var comments" UWORD udf_CM_17417 0 0.0 0.0 65535.0 ECU_ADDRESS 0x40002D98 /end MEASUREMENT
/begin MEASUREMENT IACVSHFailMet "var comments" UBYTE udf_CM_17410 0 0.0 0.0 255.0 ECU_ADDRESS 0x40002D90 /end MEASUREMENT
/begin MEASUREMENT IACVSHTestComp "var comments" UBYTE udf_CM_17424 0 0.0 0.0 255.0 ECU_ADDRESS 0x40002D92 /end MEASUREMENT
/begin MEASUREMENT IACVSHTestFail "var comments" UBYTE udf_CM_17431 0 0.0 0.0 255.0 ECU_ADDRESS 0x40002D9C /end MEASUREMENT
/begin MEASUREMENT IACVSHFailCount "var comments" UWORD udf_CM_17389 0 0.0 0.0 65535.0 ECU_ADDRESS 0x40002D96 /end MEASUREMENT
/begin MEASUREMENT IACVSHPassCount "var comments" UWORD udf_CM_17417 0 0.0 0.0 65535.0 ECU_ADDRESS 0x40002D9A /end MEASUREMENT
/begin MEASUREMENT DCMDiagEnb "var comments" UBYTE udf_CM_17382 0 0.0 0.0 255.0 ECU_ADDRESS 0x40002C9A /end MEASUREMENT
/begin MEASUREMENT DCMSLFailMet "var comments" UBYTE udf_CM_17410 0 0.0 0.0 255.0 ECU_ADDRESS 0x40002C9B /end MEASUREMENT
/begin MEASUREMENT DCMSLTestComp "var comments" UBYTE udf_CM_17424 0 0.0 0.0 255.0 ECU_ADDRESS 0x40002C9D /end MEASUREMENT
/begin MEASUREMENT DCMSLTestFail "var comments" UBYTE udf_CM_17431 0 0.0 0.0 255.0 ECU_ADDRESS 0x40002C9F /end MEASUREMENT
/begin MEASUREMENT DCMSLFailCount "var comments" UWORD udf_CM_17389 0 0.0 0.0 65535.0 ECU_ADDRESS 0x40002CA0 /end MEASUREMENT
/begin MEASUREMENT DCMSLPassCount "var comments" UWORD udf_CM_17417 0 0.0 0.0 65535.0 ECU_ADDRESS 0x40002CA4 /end MEASUREMENT
/begin MEASUREMENT DCMSHFailMet "var comments" UBYTE udf_CM_17410 0 0.0 0.0 255.0 ECU_ADDRESS 0x40002C9C /end MEASUREMENT
/begin MEASUREMENT DCMSHTestComp "var comments" UBYTE udf_CM_17424 0 0.0 0.0 255.0 ECU_ADDRESS 0x40002C9E /end MEASUREMENT
/begin MEASUREMENT DCMSHTestFail "var comments" UBYTE udf_CM_17431 0 0.0 0.0 255.0 ECU_ADDRESS 0x40002CA8 /end MEASUREMENT
/begin MEASUREMENT DCMSHFailCount "var comments" UWORD udf_CM_17389 0 0.0 0.0 65535.0 ECU_ADDRESS 0x40002CA2 /end MEASUREMENT
/begin MEASUREMENT DCMSHPassCount "var comments" UWORD udf_CM_17417 0 0.0 0.0 65535.0 ECU_ADDRESS 0x40002CA6 /end MEASUREMENT
/begin MEASUREMENT CCPDiagEnb "var comments" UBYTE udf_CM_17382 0 0.0 0.0 255.0 ECU_ADDRESS 0x0 /end MEASUREMENT
/begin MEASUREMENT CCPSLFailMet "var comments" UBYTE udf_CM_17410 0 0.0 0.0 255.0 ECU_ADDRESS 0x0 /end MEASUREMENT
/begin MEASUREMENT CCPSLTestComp "var comments" UBYTE udf_CM_17424 0 0.0 0.0 255.0 ECU_ADDRESS 0x0 /end MEASUREMENT
/begin MEASUREMENT CCPSLTestFail "var comments" UBYTE udf_CM_17431 0 0.0 0.0 255.0 ECU_ADDRESS 0x0 /end MEASUREMENT
/begin MEASUREMENT CCPSLFailCount "var comments" UWORD udf_CM_17389 0 0.0 0.0 65535.0 ECU_ADDRESS 0x0 /end MEASUREMENT
/begin MEASUREMENT CCPSLPassCount "var comments" UWORD udf_CM_17417 0 0.0 0.0 65535.0 ECU_ADDRESS 0x0 /end MEASUREMENT
/begin MEASUREMENT CCPSHFailMet "var comments" UBYTE udf_CM_17410 0 0.0 0.0 255.0 ECU_ADDRESS 0x0 /end MEASUREMENT
/begin MEASUREMENT CCPSHTestComp "var comments" UBYTE udf_CM_17424 0 0.0 0.0 255.0 ECU_ADDRESS 0x0 /end MEASUREMENT
/begin MEASUREMENT CCPSHTestFail "var comments" UBYTE udf_CM_17431 0 0.0 0.0 255.0 ECU_ADDRESS 0x0 /end MEASUREMENT
/begin MEASUREMENT CCPSHFailCount "var comments" UWORD udf_CM_17389 0 0.0 0.0 65535.0 ECU_ADDRESS 0x0 /end MEASUREMENT
/begin MEASUREMENT CCPSHPassCount "var comments" UWORD udf_CM_17417 0 0.0 0.0 65535.0 ECU_ADDRESS 0x0 /end MEASUREMENT
/begin MEASUREMENT OutDiagComEnbKeyOn "var comments" UBYTE udf_CM_17557 0 0.0 0.0 255.0 ECU_ADDRESS 0x40002C96 /end MEASUREMENT
/begin MEASUREMENT OutDiagComEnbRun "var comments" UBYTE udf_CM_17564 0 0.0 0.0 255.0 ECU_ADDRESS 0x40002C97 /end MEASUREMENT
/begin MEASUREMENT KeyonToCrankMet "var comments" UBYTE udf_CM_17074 0 0.0 0.0 255.0 ECU_ADDRESS 0x40002944 /end MEASUREMENT
/begin MEASUREMENT PowerDownDelay "var comments" UBYTE udf_CM_17606 0 0.0 0.0 255.0 ECU_ADDRESS 0x40002940 /end MEASUREMENT
/begin MEASUREMENT EOL_Init "var comments" UBYTE udf_CM_17634 0 0.0 0.0 255.0 ECU_ADDRESS 0x40000174 /end MEASUREMENT
/begin MEASUREMENT PPCrtMet "var comments" UBYTE udf_CM_17627 0 0.0 0.0 255.0 ECU_ADDRESS 0x400026B4 /end MEASUREMENT
/begin MEASUREMENT PPComplete "var comments" UBYTE udf_CM_17620 0 0.0 0.0 255.0 ECU_ADDRESS 0x400026B5 /end MEASUREMENT
/begin MEASUREMENT PPDisable "var comments" UBYTE udf_CM_17634 0 0.0 0.0 255.0 ECU_ADDRESS 0x400002A8 /end MEASUREMENT
/begin MEASUREMENT PrimePulseWidth "var comments" UWORD udf_CM_17641 0 0.0 0.0 1023.984375 ECU_ADDRESS 0x400026B6 /end MEASUREMENT
/begin MEASUREMENT RefPeriodHiRes "var comments" ULONG udf_CM_17662 0 0.0 0.0 4294967295 DISPLAY_IDENTIFIER RefPeriod_HiRes ECU_ADDRESS 0x40002A30 /end MEASUREMENT
/begin MEASUREMENT ToothTime_HighRes "var comments" ULONG udf_CM_17662 0 0.0 0.0 4294967295 ECU_ADDRESS 0x40001D1C /end MEASUREMENT
/begin MEASUREMENT TimeBetweenRefEvent1 "var comments" UBYTE udf_CM_15247 0 0.0 0.0 255.0 DISPLAY_IDENTIFIER TimeBetweenRefEvents[0] ECU_ADDRESS 0x40001D00 /end MEASUREMENT
/begin MEASUREMENT ReferencePeriod_HighRes1 "var comments" ULONG udf_CM_17662 0 0.0 0.0 4294967295 DISPLAY_IDENTIFIER ReferencePeriod_HighRes[0] ECU_ADDRESS 0x400017E8 /end MEASUREMENT
/begin MEASUREMENT RunToCrankMet "var comments" UBYTE udf_CM_17697 0 0.0 0.0 255.0 ECU_ADDRESS 0x40002943 /end MEASUREMENT
/begin MEASUREMENT RunCylCount "var comments" UBYTE udf_CM_19377 0 0.0 0.0 255.0 ECU_ADDRESS 0x40002947 /end MEASUREMENT
/begin MEASUREMENT RunModeCount "var comments" UBYTE udf_CM_19384 0 0.0 0.0 255.0 ECU_ADDRESS 0x40002948 /end MEASUREMENT
/begin MEASUREMENT RunTime "var comments" UWORD udf_CM_17683 0 0.0 0.0 65535.0 ECU_ADDRESS 0x40000142 /end MEASUREMENT
/begin MEASUREMENT RunTimeTotal "var comments" ULONG udf_CM_17663 0 0.0 0.0 4294967295 ECU_ADDRESS 0x40000144 /end MEASUREMENT
/begin MEASUREMENT ETCM_TPSHi2Dsr "var comments" UBYTE udf_CM_16353 0 0.0 0.0 255.0 ECU_ADDRESS 0x4000285A /end MEASUREMENT
/begin MEASUREMENT ETCM_TPSHi2Ref "var comments" UBYTE udf_CM_16353 0 0.0 0.0 255.0 ECU_ADDRESS 0x40002862 /end MEASUREMENT
/begin MEASUREMENT ETCM_UnpwrdRefLearned "var comments" UBYTE udf_CM_16353 0 0.0 0.0 255.0 ECU_ADDRESS 0x4000285B /end MEASUREMENT
/begin MEASUREMENT ETCM_ThrotMtrDir "var comments" UBYTE udf_CM_16353 0 0.0 0.0 255.0 ECU_ADDRESS 0x40002855 /end MEASUREMENT
/begin MEASUREMENT ETCM_DutyLimited "var comments" UBYTE udf_CM_16353 0 0.0 0.0 255.0 ECU_ADDRESS 0x40002856 /end MEASUREMENT
/begin MEASUREMENT ETCM_UnpwrdRefThrotPstn "var comments" UWORD udf_CM_18726 0 0.0 0.0 199.9969482421875 ECU_ADDRESS 0x40002860 /end MEASUREMENT
/begin MEASUREMENT ETCM_UnlimitedDutyCycle "var comments" UWORD udf_CM_18726 0 0.0 0.0 199.9969482421875 ECU_ADDRESS 0x4000286C /end MEASUREMENT
/begin MEASUREMENT ETCM_LimitedDutyCycle "var comments" UWORD udf_CM_18726 0 0.0 0.0 199.9969482421875 ECU_ADDRESS 0x40002870 /end MEASUREMENT
/begin MEASUREMENT ETCM_INTDelta "var comments" UWORD udf_CM_18726 0 0.0 0.0 199.9969482421875 ECU_ADDRESS 0x4000286E /end MEASUREMENT
/begin MEASUREMENT ETCM_TPSErr2Dsr "var comments" UWORD udf_CM_18726 0 0.0 0.0 199.9969482421875 ECU_ADDRESS 0x4000285E /end MEASUREMENT
/begin MEASUREMENT ETCM_DesireTPSHi2Ref "var comments" UBYTE udf_CM_16353 0 0.0 0.0 255.0 ECU_ADDRESS 0x40002854 /end MEASUREMENT
/begin MEASUREMENT ETCM_DesireTPSErr2Ref "var comments" UWORD udf_CM_18726 0 0.0 0.0 199.9969482421875 ECU_ADDRESS 0x40002868 /end MEASUREMENT
/begin MEASUREMENT ETCM_CompositeTerm "var comments" SWORD udf_CM_16773 0 0.0 -200.0 199.993896484375 ECU_ADDRESS 0x4000286A /end MEASUREMENT
/begin MEASUREMENT ETCM_SprTerm "var comments" SWORD udf_CM_16773 0 0.0 -200.0 199.993896484375 ECU_ADDRESS 0x40002864 /end MEASUREMENT
/begin MEASUREMENT ETCM_INTTerm "var comments" SWORD udf_CM_16773 0 0.0 -200.0 199.993896484375 ECU_ADDRESS 0x40002858 /end MEASUREMENT
/begin MEASUREMENT ETCM_PropTerm "var comments" SWORD udf_CM_16773 0 0.0 -200.0 199.993896484375 ECU_ADDRESS 0x40002866 /end MEASUREMENT
/begin MEASUREMENT MotorCoilTempFilt "var comments" SWORD udf_CM_15758 0 0.0 -256.0 255.9921875 ECU_ADDRESS 0x0 /end MEASUREMENT
/begin MEASUREMENT GENV1Filt "var comments" UWORD udf_CM_16928 0 0.0 0.0 1023.984375 ECU_ADDRESS 0x0 /end MEASUREMENT
/begin MEASUREMENT GENV2Filt "var comments" UWORD udf_CM_16928 0 0.0 0.0 1023.984375 ECU_ADDRESS 0x0 /end MEASUREMENT
/begin MEASUREMENT GENV3Filt "var comments" UWORD udf_CM_16928 0 0.0 0.0 1023.984375 ECU_ADDRESS 0x0 /end MEASUREMENT
/begin MEASUREMENT GENV_VOLTErr2Dsr "var comments" UWORD udf_CM_16928 0 0.0 0.0 1023.984375 ECU_ADDRESS 0x0 /end MEASUREMENT
/begin MEASUREMENT GENV_VOLTHi2Dsr "var comments" UBYTE udf_CM_16353 0 0.0 0.0 255.0 ECU_ADDRESS 0x0 /end MEASUREMENT
/begin MEASUREMENT GENV_PWM_Out_En "var comments" UBYTE udf_CM_16353 0 0.0 0.0 255.0 ECU_ADDRESS 0x0 /end MEASUREMENT
/begin MEASUREMENT GENV_CompositeTerm "var comments" SWORD udf_CM_16773 0 0.0 -200.0 199.993896484375 ECU_ADDRESS 0x0 /end MEASUREMENT
/begin MEASUREMENT GENV_INTTerm "var comments" SWORD udf_CM_16773 0 0.0 -200.0 199.993896484375 ECU_ADDRESS 0x0 /end MEASUREMENT
/begin MEASUREMENT GENV_PropTerm "var comments" SWORD udf_CM_16773 0 0.0 -200.0 199.993896484375 ECU_ADDRESS 0x0 /end MEASUREMENT
/begin MEASUREMENT GENV_INTDelta "var comments" UWORD udf_CM_18726 0 0.0 0.0 199.9969482421875 ECU_ADDRESS 0x0 /end MEASUREMENT
/begin MEASUREMENT WPGOV_Err2Dsr "var comments" UWORD udf_CM_17292 0 0.0 0.0 15.999755859375 ECU_ADDRESS 0x0 /end MEASUREMENT
/begin MEASUREMENT WPGOVDesired "var comments" UWORD udf_CM_17292 0 0.0 0.0 15.999755859375 ECU_ADDRESS 0x0 /end MEASUREMENT
/begin MEASUREMENT WPGOV_Hi2Dsr "var comments" UBYTE udf_CM_16353 0 0.0 0.0 255.0 ECU_ADDRESS 0x0 /end MEASUREMENT
/begin MEASUREMENT WPGOV_CL_En "var comments" UBYTE udf_CM_16353 0 0.0 0.0 255.0 ECU_ADDRESS 0x0 /end MEASUREMENT
/begin MEASUREMENT WPGOV_CompositeTerm "var comments" SWORD udf_CM_16773 0 0.0 -200.0 199.993896484375 ECU_ADDRESS 0x0 /end MEASUREMENT
/begin MEASUREMENT WPGOV_INTTerm "var comments" SWORD udf_CM_16773 0 0.0 -200.0 199.993896484375 ECU_ADDRESS 0x0 /end MEASUREMENT
/begin MEASUREMENT WPGOV_PropTerm "var comments" SWORD udf_CM_16773 0 0.0 -200.0 199.993896484375 ECU_ADDRESS 0x0 /end MEASUREMENT
/begin MEASUREMENT WPGOV_INTDelta "var comments" UWORD udf_CM_18726 0 0.0 0.0 199.9969482421875 ECU_ADDRESS 0x0 /end MEASUREMENT
/begin MEASUREMENT SABaseRun "var comments" SWORD udf_CM_17711 0 0.0 -256.0 255.9921875 ECU_ADDRESS 0x400028B8 /end MEASUREMENT
/begin MEASUREMENT SACrank "var comments" SWORD udf_CM_17718 0 0.0 -256.0 255.9921875 ECU_ADDRESS 0x400028E8 /end MEASUREMENT
/begin MEASUREMENT SAFinalCyl1 "var comments" SWORD udf_CM_17725 0 0.0 -256.0 255.9921875 DISPLAY_IDENTIFIER SAFinalCyl[0] ECU_ADDRESS 0x400028A0 /end MEASUREMENT
/begin MEASUREMENT SAFinalDlvCyl1 "var comments" SWORD udf_CM_17739 0 0.0 -256.0 255.9921875 DISPLAY_IDENTIFIER SAFinalDlvCyl[0] ECU_ADDRESS 0x400028AC /end MEASUREMENT
/begin MEASUREMENT SAFinalCyl2 "var comments" SWORD udf_CM_17732 0 0.0 -256.0 255.9921875 DISPLAY_IDENTIFIER SAFinalCyl[1] ECU_ADDRESS 0x400028A2 /end MEASUREMENT
/begin MEASUREMENT SAFinalDlvCyl2 "var comments" SWORD udf_CM_17746 0 0.0 -256.0 255.9921875 DISPLAY_IDENTIFIER SAFinalDlvCyl[1] ECU_ADDRESS 0x400028AE /end MEASUREMENT
/begin MEASUREMENT SAGlobal "var comments" SWORD udf_CM_17767 0 0.0 -256.0 255.9921875 ECU_ADDRESS 0x400028C4 /end MEASUREMENT
/begin MEASUREMENT SAPE "var comments" SWORD udf_CM_17781 0 0.0 -256.0 255.9921875 ECU_ADDRESS 0x400028E2 /end MEASUREMENT
/begin MEASUREMENT SAPECorr "var comments" SWORD udf_CM_17711 0 0.0 -256.0 255.9921875 ECU_ADDRESS 0x400028C0 /end MEASUREMENT
/begin MEASUREMENT SAIdleCorr "var comments" SWORD udf_CM_17711 0 0.0 -256.0 255.9921875 ECU_ADDRESS 0x400028BC /end MEASUREMENT
/begin MEASUREMENT SAIdleDyna "var comments" SWORD udf_CM_17711 0 0.0 -256.0 255.9921875 ECU_ADDRESS 0x400028B6 /end MEASUREMENT
/begin MEASUREMENT SAIdleBase "var comments" SWORD udf_CM_17718 0 0.0 -256.0 255.9921875 ECU_ADDRESS 0x400028E6 /end MEASUREMENT
/begin MEASUREMENT SAGovCompositeTerm "var comments" SWORD udf_CM_16773 0 0.0 -200.0 199.993896484375 ECU_ADDRESS 0x400028F0 /end MEASUREMENT
/begin MEASUREMENT SAGovPropTerm "var comments" SWORD udf_CM_16773 0 0.0 -200.0 199.993896484375 ECU_ADDRESS 0x400028EE /end MEASUREMENT
/begin MEASUREMENT SAGovDerivTerm "var comments" SWORD udf_CM_16773 0 0.0 -200.0 199.993896484375 ECU_ADDRESS 0x400028EA /end MEASUREMENT
/begin MEASUREMENT SAGovernor "var comments" SWORD udf_CM_17711 0 0.0 -256.0 255.9921875 ECU_ADDRESS 0x400028F4 /end MEASUREMENT
/begin MEASUREMENT SAGovDerivEnb "var comments" UBYTE udf_CM_16822 0 0.0 0.0 255.0 ECU_ADDRESS 0x400028F6 /end MEASUREMENT
/begin MEASUREMENT SAGovDerivLoopCnt "var comments" UBYTE udf_CM_16829 0 0.0 0.0 255.0 ECU_ADDRESS 0x400028F2 /end MEASUREMENT
/begin MEASUREMENT SAGovMaxLimit "var comments" SWORD udf_CM_17711 0 0.0 -256.0 255.9921875 ECU_ADDRESS 0x400028FA /end MEASUREMENT
/begin MEASUREMENT SAGovMinLimit "var comments" SWORD udf_CM_17711 0 0.0 -256.0 255.9921875 ECU_ADDRESS 0x400028F8 /end MEASUREMENT
/begin MEASUREMENT SAMaxLimit "var comments" SWORD udf_CM_17711 0 0.0 -256.0 255.9921875 ECU_ADDRESS 0x400028A8 /end MEASUREMENT
/begin MEASUREMENT SAMinLimit "var comments" SWORD udf_CM_17711 0 0.0 -256.0 255.9921875 ECU_ADDRESS 0x400028AA /end MEASUREMENT
/begin MEASUREMENT SpdCntlDervEnb "var comments" UBYTE udf_CM_16822 0 0.0 0.0 255.0 ECU_ADDRESS 0x4000277B /end MEASUREMENT
/begin MEASUREMENT SpdCntlDervLoopCnt "var comments" UBYTE udf_CM_16829 0 0.0 0.0 255.0 ECU_ADDRESS 0x40002775 /end MEASUREMENT
/begin MEASUREMENT OPSWSTTestComp "var comments" UBYTE udf_CM_17816 0 0.0 0.0 255.0 ECU_ADDRESS 0x40002C78 /end MEASUREMENT
/begin MEASUREMENT OPSWSTDiagEnb "var comments" UBYTE udf_CM_17494 0 0.0 0.0 255.0 ECU_ADDRESS 0x40002C77 /end MEASUREMENT
/begin MEASUREMENT OPSWSTTestFail "var comments" UBYTE udf_CM_17508 0 0.0 0.0 255.0 ECU_ADDRESS 0x40002C79 /end MEASUREMENT
/begin MEASUREMENT OPSWSTFailCount "var comments" UWORD udf_CM_17515 0 0.0 0.0 65535.0 ECU_ADDRESS 0x40002C7C /end MEASUREMENT
/begin MEASUREMENT OPSWSTFailMet "var comments" UBYTE udf_CM_17522 0 0.0 0.0 255.0 ECU_ADDRESS 0x40002C76 /end MEASUREMENT
/begin MEASUREMENT OPSWSTPassCount "var comments" UWORD udf_CM_17501 0 0.0 0.0 65535.0 ECU_ADDRESS 0x40002C7E /end MEASUREMENT
/begin MEASUREMENT OPSWSTDiagDelay "var comments" UWORD udf_CM_17501 0 0.0 0.0 65535.0 ECU_ADDRESS 0x40002C7A /end MEASUREMENT
/begin MEASUREMENT FPFBNCTComp "var comments" UBYTE udf_CM_17816 0 0.0 0.0 255.0 ECU_ADDRESS 0x40002BFA /end MEASUREMENT
/begin MEASUREMENT FPFBNCTEnb "var comments" UBYTE udf_CM_17494 0 0.0 0.0 255.0 DISPLAY_IDENTIFIER FPFBNCTEnbMet ECU_ADDRESS 0x40002BF8 /end MEASUREMENT
/begin MEASUREMENT FPFBNCTFail "var comments" UBYTE udf_CM_17508 0 0.0 0.0 255.0 ECU_ADDRESS 0x40002BFB /end MEASUREMENT
/begin MEASUREMENT FPFBNCTFC "var comments" UWORD udf_CM_17515 0 0.0 0.0 65535.0 ECU_ADDRESS 0x40002BFC /end MEASUREMENT
/begin MEASUREMENT FPFBNCTFMet "var comments" UBYTE udf_CM_17522 0 0.0 0.0 255.0 ECU_ADDRESS 0x40002BF9 /end MEASUREMENT
/begin MEASUREMENT FPFBNCTPC "var comments" UWORD udf_CM_17501 0 0.0 0.0 65535.0 ECU_ADDRESS 0x40002BFE /end MEASUREMENT
/begin MEASUREMENT ShutDownCmplt "var comments" UBYTE udf_CM_17963 0 0.0 0.0 255.0 ECU_ADDRESS 0x40002946 /end MEASUREMENT
/begin MEASUREMENT IdleMetPrev "var comments" UBYTE udf_CM_17837 0 0.0 0.0 255.0 DISPLAY_IDENTIFIER SbIDLE_IdleCondsMet_Prev ECU_ADDRESS 0x400028C7 /end MEASUREMENT
/begin MEASUREMENT TPSCntrTestComp "var comments" UBYTE udf_CM_18215 0 0.0 0.0 255.0 ECU_ADDRESS 0x40002C06 /end MEASUREMENT
/begin MEASUREMENT TPSErrorDynThresh "var comments" UWORD udf_CM_18180 0 0.0 0.0 199.9969482421875 ECU_ADDRESS 0x40002C04 /end MEASUREMENT
/begin MEASUREMENT TPSCntrDiagEnb "var comments" UBYTE udf_CM_18187 0 0.0 0.0 255.0 ECU_ADDRESS 0x40002C02 /end MEASUREMENT
/begin MEASUREMENT TPSCntrErrorThresh "var comments" UWORD udf_CM_18236 0 0.0 0.0 199.9969482421875 ECU_ADDRESS 0x40002C0C /end MEASUREMENT
/begin MEASUREMENT TPSCntrTestFail "var comments" UBYTE udf_CM_18222 0 0.0 0.0 255.0 ECU_ADDRESS 0x40002C07 /end MEASUREMENT
/begin MEASUREMENT TPSCntrFailCount "var comments" UWORD udf_CM_18194 0 0.0 0.0 65535.0 ECU_ADDRESS 0x40002C0A /end MEASUREMENT
/begin MEASUREMENT TPSCntrFailMet "var comments" UBYTE udf_CM_18201 0 0.0 0.0 255.0 ECU_ADDRESS 0x40002C03 /end MEASUREMENT
/begin MEASUREMENT TPSCntrPassCount "var comments" UWORD udf_CM_18208 0 0.0 0.0 65535.0 ECU_ADDRESS 0x40002C08 /end MEASUREMENT
/begin MEASUREMENT TPSCntrError "var comments" UWORD udf_CM_18229 0 0.0 0.0 199.9969482421875 ECU_ADDRESS 0x40002C10 /end MEASUREMENT
/begin MEASUREMENT FCVPSCntrTestComp "var comments" UBYTE udf_CM_18215 0 0.0 0.0 255.0 ECU_ADDRESS 0x40002BEC /end MEASUREMENT
/begin MEASUREMENT FCVPSErrorDynThresh "var comments" UWORD udf_CM_18180 0 0.0 0.0 199.9969482421875 ECU_ADDRESS 0x40002BEA /end MEASUREMENT
/begin MEASUREMENT FCVPSCntrDiagEnb "var comments" UBYTE udf_CM_18187 0 0.0 0.0 255.0 ECU_ADDRESS 0x40002BE8 /end MEASUREMENT
/begin MEASUREMENT FCVPSCntrErrorThresh "var comments" UWORD udf_CM_18236 0 0.0 0.0 199.9969482421875 ECU_ADDRESS 0x40002BF2 /end MEASUREMENT
/begin MEASUREMENT FCVPSCntrTestFail "var comments" UBYTE udf_CM_18222 0 0.0 0.0 255.0 ECU_ADDRESS 0x40002BED /end MEASUREMENT
/begin MEASUREMENT FCVPSCntrFailCount "var comments" UWORD udf_CM_18194 0 0.0 0.0 65535.0 ECU_ADDRESS 0x40002BF0 /end MEASUREMENT
/begin MEASUREMENT FCVPSCntrFailMet "var comments" UBYTE udf_CM_18201 0 0.0 0.0 255.0 ECU_ADDRESS 0x40002BE9 /end MEASUREMENT
/begin MEASUREMENT FCVPSCntrPassCount "var comments" UWORD udf_CM_18208 0 0.0 0.0 65535.0 ECU_ADDRESS 0x40002BEE /end MEASUREMENT
/begin MEASUREMENT FCVPSCntrError "var comments" UWORD udf_CM_18229 0 0.0 0.0 199.9969482421875 ECU_ADDRESS 0x40002BF6 /end MEASUREMENT
/begin MEASUREMENT SpdCntlLvl "var comments" UBYTE udf_CM_18012 0 0.0 0.0 255.0 DISPLAY_IDENTIFIER SpeedControlLvl ECU_ADDRESS 0x40002798 /end MEASUREMENT
/begin MEASUREMENT SpeedControlInput "var comments" UWORD udf_CM_18005 0 0.0 0.0 99.99847412109375 ECU_ADDRESS 0x4000279A /end MEASUREMENT
/begin MEASUREMENT SparkDwell "var comments" UWORD udf_CM_17991 0 0.0 0.0 1023.984375 ECU_ADDRESS 0x4000287C /end MEASUREMENT
/begin MEASUREMENT SparkMode "var comments" UBYTE udf_CM_17998 0 0.0 0.0 255.0 ECU_ADDRESS 0x400028B4 /end MEASUREMENT
/begin MEASUREMENT StallToCrankMet "var comments" UBYTE udf_CM_18138 0 0.0 0.0 255.0 ECU_ADDRESS 0x40002945 /end MEASUREMENT
/begin MEASUREMENT ThrFlowAtTPSMax "var comments" UWORD udf_CM_18677 0 0.0 0.0 511.9921875 ECU_ADDRESS 0x40002AAA /end MEASUREMENT
/begin MEASUREMENT ThrFlowAtTPSMin "var comments" UWORD udf_CM_18684 0 0.0 0.0 511.9921875 ECU_ADDRESS 0x40002A9E /end MEASUREMENT
/begin MEASUREMENT TPSMinimum "var comments" UWORD udf_CM_18810 0 0.0 0.0 199.9969482421875 ECU_ADDRESS 0x40002AAC /end MEASUREMENT
/begin MEASUREMENT TPSMinLnCNT "var comments" UBYTE udf_CM_18824 0 0.0 0.0 255.0 ECU_ADDRESS 0x40002AA3 /end MEASUREMENT
/begin MEASUREMENT TPSMinLrned "var comments" UBYTE udf_CM_18817 0 0.0 0.0 255.0 ECU_ADDRESS 0x40002A93 /end MEASUREMENT
/begin MEASUREMENT DsrdFuelFlow "var comments" UWORD udf_CM_15982 0 0.0 0.0 511.9921875 ECU_ADDRESS 0x40002ACE /end MEASUREMENT
/begin MEASUREMENT FCVPSMinimum "var comments" UWORD udf_CM_18810 0 0.0 0.0 199.9969482421875 ECU_ADDRESS 0x40002AE4 /end MEASUREMENT
/begin MEASUREMENT FCVPSMinLnCNT "var comments" UBYTE udf_CM_18824 0 0.0 0.0 255.0 ECU_ADDRESS 0x40002AD7 /end MEASUREMENT
/begin MEASUREMENT FCVPSMinLrned "var comments" UBYTE udf_CM_18817 0 0.0 0.0 255.0 ECU_ADDRESS 0x40002AE1 /end MEASUREMENT
/begin MEASUREMENT DesireFCVPS "var comments" UWORD udf_CM_15989 0 0.0 0.0 199.9969482421875 ECU_ADDRESS 0x40002AD4 /end MEASUREMENT
/begin MEASUREMENT FCVMotorState "var comments" UBYTE udf_CM_16661 0 0.0 0.0 3.0 ECU_ADDRESS 0x40002ADA /end MEASUREMENT
/begin MEASUREMENT ActFCVPosition "var comments" UBYTE udf_CM_15247 0 0.0 0.0 255.0 ECU_ADDRESS 0x40002AD3 /end MEASUREMENT
/begin MEASUREMENT FCVMoveDirct "var comments" UBYTE udf_CM_16668 0 0.0 0.0 2.0 ECU_ADDRESS 0x40002AD2 /end MEASUREMENT
/begin MEASUREMENT FCVPS "var comments" UWORD udf_CM_18726 0 0.0 0.0 199.9969482421875 ECU_ADDRESS 0x40002AEE /end MEASUREMENT
/begin MEASUREMENT FCVPSRawSignal "var comments" UWORD udf_CM_18838 0 0.0 0.0 65535.0 ECU_ADDRESS 0x40002AEC /end MEASUREMENT
/begin MEASUREMENT FCVPSDelta "var comments" UWORD udf_CM_18733 0 0.0 0.0 199.9969482421875 ECU_ADDRESS 0x40002AF4 /end MEASUREMENT
/begin MEASUREMENT FCV_FP_CorrForFCVPS "var comments" UWORD udf_CM_15415 0 0.0 0.0 1.999969005584717 ECU_ADDRESS 0x40002AE6 /end MEASUREMENT
/begin MEASUREMENT FCV_Baro_CorrForFCVPS "var comments" UWORD udf_CM_15415 0 0.0 0.0 1.999969005584717 ECU_ADDRESS 0x40002AE8 /end MEASUREMENT
/begin MEASUREMENT VbSMTR_Rotate_Active "var comments" UBYTE udf_CM_16710 0 0.0 0.0 255.0 ECU_ADDRESS 0x4000283D /end MEASUREMENT
/begin MEASUREMENT VbSMTR_Rotate_Command "var comments" UBYTE udf_CM_16710 0 0.0 0.0 255.0 ECU_ADDRESS 0x40002838 /end MEASUREMENT
/begin MEASUREMENT VbSMTR_Rotate_Enable "var comments" UBYTE udf_CM_16710 0 0.0 0.0 255.0 ECU_ADDRESS 0x4000283C /end MEASUREMENT
/begin MEASUREMENT VbSMTR_Rotate_Execute "var comments" UBYTE udf_CM_16710 0 0.0 0.0 255.0 ECU_ADDRESS 0x40002839 /end MEASUREMENT
/begin MEASUREMENT VbSMTR_IGN_StartEn "var comments" UBYTE udf_CM_16710 0 0.0 0.0 255.0 ECU_ADDRESS 0x4000283B /end MEASUREMENT
/begin MEASUREMENT VcSMTR_c_Attempt "var comments" UBYTE udf_CM_18824 0 0.0 0.0 255.0 ECU_ADDRESS 0x40002837 /end MEASUREMENT
/begin MEASUREMENT TPSShrtDiagEnb "var comments" UBYTE udf_CM_18859 0 0.0 0.0 255.0 ECU_ADDRESS 0x40002DDD /end MEASUREMENT
/begin MEASUREMENT TPSSHFailCount "var comments" UWORD udf_CM_18845 0 0.0 0.0 65535.0 ECU_ADDRESS 0x40002DE6 /end MEASUREMENT
/begin MEASUREMENT TPSSHFailMet "var comments" UBYTE udf_CM_18852 0 0.0 0.0 255.0 ECU_ADDRESS 0x40002DDE /end MEASUREMENT
/begin MEASUREMENT TPSSHTestFail "var comments" UBYTE udf_CM_18873 0 0.0 0.0 255.0 ECU_ADDRESS 0x40002DE1 /end MEASUREMENT
/begin MEASUREMENT TPSSLFailCount "var comments" UWORD udf_CM_18880 0 0.0 0.0 65535.0 ECU_ADDRESS 0x40002DE4 /end MEASUREMENT
/begin MEASUREMENT TPSSLFailMet "var comments" UBYTE udf_CM_18887 0 0.0 0.0 255.0 ECU_ADDRESS 0x40002DDC /end MEASUREMENT
/begin MEASUREMENT TPSSLTestFail "var comments" UBYTE udf_CM_18894 0 0.0 0.0 255.0 ECU_ADDRESS 0x40002DE0 /end MEASUREMENT
/begin MEASUREMENT TPSShrtPassCount "var comments" UWORD udf_CM_18866 0 0.0 0.0 65535.0 ECU_ADDRESS 0x40002DE2 /end MEASUREMENT
/begin MEASUREMENT FCVPSDiagEnb "var comments" UBYTE udf_CM_17382 0 0.0 0.0 255.0 ECU_ADDRESS 0x40002DEC /end MEASUREMENT
/begin MEASUREMENT FCVPSSLFailMet "var comments" UBYTE udf_CM_17410 0 0.0 0.0 255.0 ECU_ADDRESS 0x40002DF1 /end MEASUREMENT
/begin MEASUREMENT FCVPSSLTestComp "var comments" UBYTE udf_CM_17424 0 0.0 0.0 255.0 ECU_ADDRESS 0x40002DED /end MEASUREMENT
/begin MEASUREMENT FCVPSSLTestFail "var comments" UBYTE udf_CM_17431 0 0.0 0.0 255.0 ECU_ADDRESS 0x40002DEF /end MEASUREMENT
/begin MEASUREMENT FCVPSSLFailCount "var comments" UWORD udf_CM_17389 0 0.0 0.0 65535.0 ECU_ADDRESS 0x40002DF2 /end MEASUREMENT
/begin MEASUREMENT FCVPSSLPassCount "var comments" UWORD udf_CM_17417 0 0.0 0.0 65535.0 ECU_ADDRESS 0x40002DF4 /end MEASUREMENT
/begin MEASUREMENT FCVPSSHFailMet "var comments" UBYTE udf_CM_17410 0 0.0 0.0 255.0 ECU_ADDRESS 0x40002DFA /end MEASUREMENT
/begin MEASUREMENT FCVPSSHTestComp "var comments" UBYTE udf_CM_17424 0 0.0 0.0 255.0 ECU_ADDRESS 0x40002DEE /end MEASUREMENT
/begin MEASUREMENT FCVPSSHTestFail "var comments" UBYTE udf_CM_17431 0 0.0 0.0 255.0 ECU_ADDRESS 0x40002DF0 /end MEASUREMENT
/begin MEASUREMENT FCVPSSHFailCount "var comments" UWORD udf_CM_17389 0 0.0 0.0 65535.0 ECU_ADDRESS 0x40002DF6 /end MEASUREMENT
/begin MEASUREMENT FCVPSSHPassCount "var comments" UWORD udf_CM_17417 0 0.0 0.0 65535.0 ECU_ADDRESS 0x40002DF8 /end MEASUREMENT
/begin MEASUREMENT AFCCell1 "var comments" UWORD udf_CM_15275 0 0.0 0.0 1.999969005584717 DISPLAY_IDENTIFIER AFCCell[0] ECU_ADDRESS 0x4000014E /end MEASUREMENT
/begin MEASUREMENT AFCCell2 "var comments" UWORD udf_CM_15324 0 0.0 0.0 1.999969005584717 DISPLAY_IDENTIFIER AFCCell[1] ECU_ADDRESS 0x40000150 /end MEASUREMENT
/begin MEASUREMENT AFCCell11 "var comments" UWORD udf_CM_15282 0 0.0 0.0 1.999969005584717 DISPLAY_IDENTIFIER AFCCell[10] ECU_ADDRESS 0x40000162 /end MEASUREMENT
/begin MEASUREMENT AFCCell12 "var comments" UWORD udf_CM_15289 0 0.0 0.0 1.999969005584717 DISPLAY_IDENTIFIER AFCCell[11] ECU_ADDRESS 0x40000164 /end MEASUREMENT
/begin MEASUREMENT AFCCell13 "var comments" UWORD udf_CM_15296 0 0.0 0.0 1.999969005584717 DISPLAY_IDENTIFIER AFCCell[12] ECU_ADDRESS 0x40000166 /end MEASUREMENT
/begin MEASUREMENT AFCCell14 "var comments" UWORD udf_CM_15303 0 0.0 0.0 1.999969005584717 DISPLAY_IDENTIFIER AFCCell[13] ECU_ADDRESS 0x40000168 /end MEASUREMENT
/begin MEASUREMENT AFCCell15 "var comments" UWORD udf_CM_15310 0 0.0 0.0 1.999969005584717 DISPLAY_IDENTIFIER AFCCell[14] ECU_ADDRESS 0x4000016A /end MEASUREMENT
/begin MEASUREMENT AFCCell16 "var comments" UWORD udf_CM_15317 0 0.0 0.0 1.999969005584717 DISPLAY_IDENTIFIER AFCCell[15] ECU_ADDRESS 0x4000016C /end MEASUREMENT
/begin MEASUREMENT AFCCell3 "var comments" UWORD udf_CM_15331 0 0.0 0.0 1.999969005584717 DISPLAY_IDENTIFIER AFCCell[2] ECU_ADDRESS 0x40000152 /end MEASUREMENT
/begin MEASUREMENT AFCCell4 "var comments" UWORD udf_CM_15338 0 0.0 0.0 1.999969005584717 DISPLAY_IDENTIFIER AFCCell[3] ECU_ADDRESS 0x40000154 /end MEASUREMENT
/begin MEASUREMENT AFCCell5 "var comments" UWORD udf_CM_15345 0 0.0 0.0 1.999969005584717 DISPLAY_IDENTIFIER AFCCell[4] ECU_ADDRESS 0x40000156 /end MEASUREMENT
/begin MEASUREMENT AFCCell6 "var comments" UWORD udf_CM_15352 0 0.0 0.0 1.999969005584717 DISPLAY_IDENTIFIER AFCCell[5] ECU_ADDRESS 0x40000158 /end MEASUREMENT
/begin MEASUREMENT AFCCell7 "var comments" UWORD udf_CM_15359 0 0.0 0.0 1.999969005584717 DISPLAY_IDENTIFIER AFCCell[6] ECU_ADDRESS 0x4000015A /end MEASUREMENT
/begin MEASUREMENT AFCCell8 "var comments" UWORD udf_CM_15366 0 0.0 0.0 1.999969005584717 DISPLAY_IDENTIFIER AFCCell[7] ECU_ADDRESS 0x4000015C /end MEASUREMENT
/begin MEASUREMENT AFCCell9 "var comments" UWORD udf_CM_15373 0 0.0 0.0 1.999969005584717 DISPLAY_IDENTIFIER AFCCell[8] ECU_ADDRESS 0x4000015E /end MEASUREMENT
/begin MEASUREMENT AFCCell10 "var comments" UWORD udf_CM_15380 0 0.0 0.0 1.999969005584717 DISPLAY_IDENTIFIER AFCCell[9] ECU_ADDRESS 0x40000160 /end MEASUREMENT
/begin MEASUREMENT AFCCellNum "var comments" UBYTE udf_CM_15387 0 0.0 0.0 255.0 ECU_ADDRESS 0x40002904 /end MEASUREMENT
/begin MEASUREMENT FILE_NVM_Failure "var comments" UBYTE udf_CM_15667 0 0.0 0.0 255.0 ECU_ADDRESS 0x400025DB /end MEASUREMENT
/begin MEASUREMENT AFCFiltExpMAPMult "var comments" UWORD udf_CM_15394 0 0.0 0.0 1.999969005584717 ECU_ADDRESS 0x40002906 /end MEASUREMENT
/begin MEASUREMENT AFCFiltMAP "var comments" UWORD udf_CM_15401 0 0.0 0.0 255.99609375 ECU_ADDRESS 0x4000290C /end MEASUREMENT
/begin MEASUREMENT AFCLMet "var comments" UBYTE udf_CM_15408 0 0.0 0.0 255.0 ECU_ADDRESS 0x4000290A /end MEASUREMENT
/begin MEASUREMENT AFCMult "var comments" UWORD udf_CM_15415 0 0.0 0.0 1.999969005584717 ECU_ADDRESS 0x40002908 /end MEASUREMENT
/begin MEASUREMENT Baro "var comments" UWORD udf_CM_15562 0 0.0 0.0 255.99609375 ECU_ADDRESS 0x40000140 /end MEASUREMENT
/begin MEASUREMENT BaroReadCrtMet "var comments" UBYTE udf_CM_15576 0 0.0 0.0 255.0 ECU_ADDRESS 0x40002919 /end MEASUREMENT
/begin MEASUREMENT BaroOffset "var comments" UWORD udf_CM_15569 0 0.0 0.0 255.99609375 ECU_ADDRESS 0x40002916 /end MEASUREMENT
/begin MEASUREMENT BaroReadTthNum "var comments" UWORD udf_CM_15583 0 0.0 0.0 65535.0 ECU_ADDRESS 0x4000291C /end MEASUREMENT
/begin MEASUREMENT FinalPulseWidth1 "var comments" UWORD udf_CM_16304 0 0.0 0.0 1023.984375 DISPLAY_IDENTIFIER FinalPulseWidth[0] ECU_ADDRESS 0x400029FA /end MEASUREMENT
/begin MEASUREMENT FinalPulseWidth2 "var comments" UWORD udf_CM_16297 0 0.0 0.0 1023.984375 DISPLAY_IDENTIFIER FinalPulseWidth[1] ECU_ADDRESS 0x400029FC /end MEASUREMENT
/begin MEASUREMENT CoolTemp "var comments" SWORD udf_CM_15751 0 0.0 -256.0 255.9921875 ECU_ADDRESS 0x4000292E /end MEASUREMENT
/begin MEASUREMENT CoolTempFilt "var comments" SWORD udf_CM_15758 0 0.0 -256.0 255.9921875 ECU_ADDRESS 0x40002930 /end MEASUREMENT
/begin MEASUREMENT ClTStartup "var comments" SWORD udf_CM_15744 0 0.0 -256.0 255.9921875 ECU_ADDRESS 0x40002932 /end MEASUREMENT
/begin MEASUREMENT CoolTemp2 "var comments" SWORD udf_CM_15751 0 0.0 -256.0 255.9921875 ECU_ADDRESS 0x40002936 /end MEASUREMENT
/begin MEASUREMENT CoolTemp2Filt "var comments" SWORD udf_CM_15758 0 0.0 -256.0 255.9921875 ECU_ADDRESS 0x40002938 /end MEASUREMENT
/begin MEASUREMENT ClT2Startup "var comments" SWORD udf_CM_15744 0 0.0 -256.0 255.9921875 ECU_ADDRESS 0x4000293A /end MEASUREMENT
/begin MEASUREMENT CIDFailCount "var comments" UWORD udf_CM_15653 0 0.0 0.0 65535.0 ECU_ADDRESS 0x40002922 /end MEASUREMENT
/begin MEASUREMENT CIDSucceed "var comments" UBYTE udf_CM_15667 0 0.0 0.0 255.0 ECU_ADDRESS 0x4000291E /end MEASUREMENT
/begin MEASUREMENT SeqPhase_Cyl1 "var comments" UWORD udf_CM_15667 0 0.0 0.0 65535.0 DISPLAY_IDENTIFIER CylPhase[0] ECU_ADDRESS 0x40001D40 /end MEASUREMENT
/begin MEASUREMENT SeqPhase_Cyl2 "var comments" UWORD udf_CM_15667 0 0.0 0.0 65535.0 DISPLAY_IDENTIFIER CylPhase[1] ECU_ADDRESS 0x40001D42 /end MEASUREMENT
/begin MEASUREMENT SeqPhase_Cyl3 "var comments" UWORD udf_CM_15667 0 0.0 0.0 65535.0 DISPLAY_IDENTIFIER CylPhase[2] ECU_ADDRESS 0x40001D44 /end MEASUREMENT
/begin MEASUREMENT SeqPhase_Cyl4 "var comments" UWORD udf_CM_15667 0 0.0 0.0 65535.0 DISPLAY_IDENTIFIER CylPhase[3] ECU_ADDRESS 0x40001D46 /end MEASUREMENT
/begin MEASUREMENT MAP_EVENT_TOOTH "var comments" UBYTE udf_CM_15667 0 0.0 0.0 255.0 ECU_ADDRESS 0x40001E00 /end MEASUREMENT
/begin MEASUREMENT Map_Event_Tooth_Count "var comments" UBYTE udf_CM_15667 0 0.0 0.0 255.0 ECU_ADDRESS 0x40001E01 /end MEASUREMENT
/begin MEASUREMENT BdcTooth "var comments" UBYTE udf_CM_15667 0 0.0 0.0 255.0 DISPLAY_IDENTIFIER BDC_TOOTH[0] ECU_ADDRESS 0x400017B8 /end MEASUREMENT
/begin MEASUREMENT SyncTooth "var comments" UBYTE udf_CM_15667 0 0.0 0.0 255.0 DISPLAY_IDENTIFIER SYNCHRONIZATION_EVENT_TOOTH ECU_ADDRESS 0x40001D15 /end MEASUREMENT
/begin MEASUREMENT Ref1Tooth_Cyl1 "var comments" UBYTE udf_CM_15667 0 0.0 0.0 255.0 DISPLAY_IDENTIFIER REFERENCE_EVENT1_TOOTH[0] ECU_ADDRESS 0x40001D11 /end MEASUREMENT
/begin MEASUREMENT Ref1Tooth_Cyl2 "var comments" UBYTE udf_CM_15667 0 0.0 0.0 255.0 DISPLAY_IDENTIFIER REFERENCE_EVENT1_TOOTH[1] ECU_ADDRESS 0x40001D12 /end MEASUREMENT
/begin MEASUREMENT Ref1Tooth_Cyl3 "var comments" UBYTE udf_CM_15667 0 0.0 0.0 255.0 DISPLAY_IDENTIFIER REFERENCE_EVENT1_TOOTH[2] ECU_ADDRESS 0x40001D13 /end MEASUREMENT
/begin MEASUREMENT Ref1Tooth_Cyl4 "var comments" UBYTE udf_CM_15667 0 0.0 0.0 255.0 DISPLAY_IDENTIFIER REFERENCE_EVENT1_TOOTH[3] ECU_ADDRESS 0x40001D14 /end MEASUREMENT
/begin MEASUREMENT Ref2Tooth_Cyl1 "var comments" UBYTE udf_CM_15667 0 0.0 0.0 255.0 DISPLAY_IDENTIFIER REFERENCE_EVENT2_TOOTH[0] ECU_ADDRESS 0x40001D20 /end MEASUREMENT
/begin MEASUREMENT Ref2Tooth_Cyl2 "var comments" UBYTE udf_CM_15667 0 0.0 0.0 255.0 DISPLAY_IDENTIFIER REFERENCE_EVENT2_TOOTH[1] ECU_ADDRESS 0x40001D21 /end MEASUREMENT
/begin MEASUREMENT Ref2Tooth_Cyl3 "var comments" UBYTE udf_CM_15667 0 0.0 0.0 255.0 DISPLAY_IDENTIFIER REFERENCE_EVENT2_TOOTH[2] ECU_ADDRESS 0x40001D22 /end MEASUREMENT
/begin MEASUREMENT Ref2Tooth_Cyl4 "var comments" UBYTE udf_CM_15667 0 0.0 0.0 255.0 DISPLAY_IDENTIFIER REFERENCE_EVENT2_TOOTH[3] ECU_ADDRESS 0x40001D23 /end MEASUREMENT
/begin MEASUREMENT FuelTooth_Cyl1 "var comments" UBYTE udf_CM_15667 0 0.0 0.0 255.0 DISPLAY_IDENTIFIER FUEL_EVENT_TOOTH[0] ECU_ADDRESS 0x40001DCC /end MEASUREMENT
/begin MEASUREMENT FuelTooth_Cyl2 "var comments" UBYTE udf_CM_15667 0 0.0 0.0 255.0 DISPLAY_IDENTIFIER FUEL_EVENT_TOOTH[1] ECU_ADDRESS 0x40001DCD /end MEASUREMENT
/begin MEASUREMENT FuelTooth_Cyl3 "var comments" UBYTE udf_CM_15667 0 0.0 0.0 255.0 DISPLAY_IDENTIFIER FUEL_EVENT_TOOTH[2] ECU_ADDRESS 0x40001DCE /end MEASUREMENT
/begin MEASUREMENT FuelTooth_Cyl4 "var comments" UBYTE udf_CM_15667 0 0.0 0.0 255.0 DISPLAY_IDENTIFIER FUEL_EVENT_TOOTH[3] ECU_ADDRESS 0x40001DCF /end MEASUREMENT
/begin MEASUREMENT TrimTooth_Cyl1 "var comments" UBYTE udf_CM_15667 0 0.0 0.0 255.0 DISPLAY_IDENTIFIER TRIM_EVENT_TOOTH[0] ECU_ADDRESS 0x40001DD0 /end MEASUREMENT
/begin MEASUREMENT TrimTooth_Cyl2 "var comments" UBYTE udf_CM_15667 0 0.0 0.0 255.0 DISPLAY_IDENTIFIER TRIM_EVENT_TOOTH[1] ECU_ADDRESS 0x40001DD1 /end MEASUREMENT
/begin MEASUREMENT TrimTooth_Cyl3 "var comments" UBYTE udf_CM_15667 0 0.0 0.0 255.0 DISPLAY_IDENTIFIER TRIM_EVENT_TOOTH[2] ECU_ADDRESS 0x40001DD2 /end MEASUREMENT
/begin MEASUREMENT TrimTooth_Cyl4 "var comments" UBYTE udf_CM_15667 0 0.0 0.0 255.0 DISPLAY_IDENTIFIER TRIM_EVENT_TOOTH[3] ECU_ADDRESS 0x40001DD3 /end MEASUREMENT
/begin MEASUREMENT TrimCutOffTooth_Cyl1 "var comments" UBYTE udf_CM_15667 0 0.0 0.0 255.0 DISPLAY_IDENTIFIER TRIM_CUT_OFF_EVENT_TOOTH[0] ECU_ADDRESS 0x40001DD4 /end MEASUREMENT
/begin MEASUREMENT TrimCutOffTooth_Cyl2 "var comments" UBYTE udf_CM_15667 0 0.0 0.0 255.0 DISPLAY_IDENTIFIER TRIM_CUT_OFF_EVENT_TOOTH[1] ECU_ADDRESS 0x40001DD5 /end MEASUREMENT
/begin MEASUREMENT TrimCutOffTooth_Cyl3 "var comments" UBYTE udf_CM_15667 0 0.0 0.0 255.0 DISPLAY_IDENTIFIER TRIM_CUT_OFF_EVENT_TOOTH[2] ECU_ADDRESS 0x40001DD6 /end MEASUREMENT
/begin MEASUREMENT TrimCutOffTooth_Cyl4 "var comments" UBYTE udf_CM_15667 0 0.0 0.0 255.0 DISPLAY_IDENTIFIER TRIM_CUT_OFF_EVENT_TOOTH[3] ECU_ADDRESS 0x40001DD7 /end MEASUREMENT
/begin MEASUREMENT ToothPeriod "var comments" UWORD udf_CM_15660 0 0.0 0.0 65535.0 ECU_ADDRESS 0x40001D18 /end MEASUREMENT
/begin MEASUREMENT ToothDuration "var comments" UWORD udf_CM_15660 0 0.0 0.0 65535.0 ECU_ADDRESS 0x40001D1A /end MEASUREMENT
/begin MEASUREMENT SeqSparkEnb "var comments" UBYTE udf_CM_17921 0 0.0 0.0 255.0 ECU_ADDRESS 0x4000291F /end MEASUREMENT
/begin MEASUREMENT CIDSuccCount "var comments" UWORD udf_CM_15660 0 0.0 0.0 65535.0 ECU_ADDRESS 0x40002920 /end MEASUREMENT
/begin MEASUREMENT MAPExpAltCmpd "var comments" UWORD udf_CM_17123 0 0.0 0.0 255.99609375 ECU_ADDRESS 0x4000297A /end MEASUREMENT
/begin MEASUREMENT CLT_DefaultInUse "var comments" UBYTE udf_CM_16689 0 0.0 0.0 255.0 ECU_ADDRESS 0x40002934 /end MEASUREMENT
/begin MEASUREMENT IntakeAirTemp "var comments" SWORD udf_CM_17053 0 0.0 -256.0 255.9921875 ECU_ADDRESS 0x40002952 /end MEASUREMENT
/begin MEASUREMENT IATDfltUsed "var comments" UBYTE udf_CM_16689 0 0.0 0.0 255.0 ECU_ADDRESS 0x40002958 /end MEASUREMENT
/begin MEASUREMENT IntkAirTempFilt "var comments" SWORD udf_CM_17060 0 0.0 -256.0 255.9921875 ECU_ADDRESS 0x40002954 /end MEASUREMENT
/begin MEASUREMENT IATStartup "var comments" SWORD udf_CM_16766 0 0.0 -256.0 255.9921875 ECU_ADDRESS 0x40002956 /end MEASUREMENT
/begin MEASUREMENT IGNVolt "var comments" UWORD udf_CM_16913 0 0.0 0.0 31.99951171875 ECU_ADDRESS 0x4000295A /end MEASUREMENT
/begin MEASUREMENT IGNVoltFilt "var comments" UWORD udf_CM_16927 0 0.0 0.0 31.99951171875 ECU_ADDRESS 0x4000295C /end MEASUREMENT
/begin MEASUREMENT IGNOff "var comments" UBYTE udf_CM_16892 0 0.0 0.0 255.0 ECU_ADDRESS 0x40002961 /end MEASUREMENT
/begin MEASUREMENT BattVoltKeyOff "var comments" UWORD udf_CM_15611 0 0.0 0.0 31.99951171875 DISPLAY_IDENTIFIER BattVoltStepMotorDrive ECU_ADDRESS 0x40002968 /end MEASUREMENT
/begin MEASUREMENT IGNRawSignal "var comments" UWORD udf_CM_16899 0 0.0 0.0 65535.0 ECU_ADDRESS 0x4000295E /end MEASUREMENT
/begin MEASUREMENT IGNState "var comments" UBYTE udf_CM_16906 0 0.0 0.0 255.0 ECU_ADDRESS 0x40002960 /end MEASUREMENT
/begin MEASUREMENT SystVoltPassCount "var comments" UWORD udf_CM_18299 0 0.0 0.0 65535.0 ECU_ADDRESS 0x40002E02 /end MEASUREMENT
/begin MEASUREMENT SystVoltDiagEnb "var comments" UBYTE udf_CM_18250 0 0.0 0.0 255.0 ECU_ADDRESS 0x40002DFC /end MEASUREMENT
/begin MEASUREMENT SystVoltHFailMet "var comments" UBYTE udf_CM_18264 0 0.0 0.0 255.0 ECU_ADDRESS 0x40002E07 /end MEASUREMENT
/begin MEASUREMENT SystVoltHFailCount "var comments" UWORD udf_CM_18257 0 0.0 0.0 65535.0 ECU_ADDRESS 0x40002E00 /end MEASUREMENT
/begin MEASUREMENT SystVoltHTestFail "var comments" UBYTE udf_CM_18271 0 0.0 0.0 255.0 ECU_ADDRESS 0x40002DFF /end MEASUREMENT
/begin MEASUREMENT SystVoltLFailMet "var comments" UBYTE udf_CM_18285 0 0.0 0.0 255.0 ECU_ADDRESS 0x40002E06 /end MEASUREMENT
/begin MEASUREMENT SystVoltLFailCount "var comments" UWORD udf_CM_18278 0 0.0 0.0 65535.0 ECU_ADDRESS 0x40002E04 /end MEASUREMENT
/begin MEASUREMENT SystVoltLTestFail "var comments" UBYTE udf_CM_18292 0 0.0 0.0 255.0 ECU_ADDRESS 0x40002DFE /end MEASUREMENT
/begin MEASUREMENT GENVPassCount "var comments" UWORD udf_CM_18299 0 0.0 0.0 65535.0 ECU_ADDRESS 0x0 /end MEASUREMENT
/begin MEASUREMENT GENVDiagEnb "var comments" UBYTE udf_CM_18250 0 0.0 0.0 255.0 ECU_ADDRESS 0x0 /end MEASUREMENT
/begin MEASUREMENT GENVHFailMet "var comments" UBYTE udf_CM_18264 0 0.0 0.0 255.0 ECU_ADDRESS 0x0 /end MEASUREMENT
/begin MEASUREMENT GENVHFailCount "var comments" UWORD udf_CM_18257 0 0.0 0.0 65535.0 ECU_ADDRESS 0x0 /end MEASUREMENT
/begin MEASUREMENT GENVHTestFail "var comments" UBYTE udf_CM_18271 0 0.0 0.0 255.0 ECU_ADDRESS 0x0 /end MEASUREMENT
/begin MEASUREMENT GENVLFailMet "var comments" UBYTE udf_CM_18285 0 0.0 0.0 255.0 ECU_ADDRESS 0x0 /end MEASUREMENT
/begin MEASUREMENT GENVLFailCount "var comments" UWORD udf_CM_18278 0 0.0 0.0 65535.0 ECU_ADDRESS 0x0 /end MEASUREMENT
/begin MEASUREMENT GENVLTestFail "var comments" UBYTE udf_CM_18292 0 0.0 0.0 255.0 ECU_ADDRESS 0x0 /end MEASUREMENT
/begin MEASUREMENT MAPActual "var comments" UWORD udf_CM_17081 0 0.0 0.0 255.99609375 ECU_ADDRESS 0x40002980 /end MEASUREMENT
/begin MEASUREMENT MAPAltComp "var comments" UWORD udf_CM_17088 0 0.0 0.0 255.99609375 ECU_ADDRESS 0x4000296E /end MEASUREMENT
/begin MEASUREMENT MAPDfltUsed "var comments" UBYTE udf_CM_17102 0 0.0 0.0 255.0 ECU_ADDRESS 0x4000290E /end MEASUREMENT
/begin MEASUREMENT MAPEstCorr "var comments" UWORD udf_CM_17109 0 0.0 0.0 255.99609375 ECU_ADDRESS 0x4000299C /end MEASUREMENT
/begin MEASUREMENT MAPEstimated "var comments" UWORD udf_CM_17116 0 0.0 0.0 255.99609375 ECU_ADDRESS 0x4000298E /end MEASUREMENT
/begin MEASUREMENT MAPExpected "var comments" UWORD udf_CM_17137 0 0.0 0.0 255.99609375 ECU_ADDRESS 0x40002982 /end MEASUREMENT
/begin MEASUREMENT MAPExpDiff "var comments" UWORD udf_CM_17130 0 0.0 0.0 255.99609375 ECU_ADDRESS 0x4000299E /end MEASUREMENT
/begin MEASUREMENT MAPExpIncrs "var comments" UBYTE udf_CM_17144 0 0.0 0.0 255.0 ECU_ADDRESS 0x40002970 /end MEASUREMENT
/begin MEASUREMENT MAPExpPrev "var comments" UWORD udf_CM_17151 0 0.0 0.0 255.99609375 ECU_ADDRESS 0x4000298C /end MEASUREMENT
/begin MEASUREMENT VACExpected "var comments" UWORD udf_CM_19027 0 0.0 0.0 255.99609375 ECU_ADDRESS 0x40002972 /end MEASUREMENT
/begin MEASUREMENT MAPFiltLow "var comments" UWORD udf_CM_17165 0 0.0 0.0 255.99609375 ECU_ADDRESS 0x40002986 /end MEASUREMENT
/begin MEASUREMENT MAPFiltLowAvg "var comments" UWORD udf_CM_17172 0 0.0 0.0 255.99609375 ECU_ADDRESS 0x40002988 /end MEASUREMENT
/begin MEASUREMENT MAPFiltLowDlt "var comments" UWORD udf_CM_17179 0 0.0 0.0 255.99609375 ECU_ADDRESS 0x40002974 /end MEASUREMENT
/begin MEASUREMENT MAPFiltLowPrv "var comments" UWORD udf_CM_17186 0 0.0 0.0 255.99609375 ECU_ADDRESS 0x40002998 /end MEASUREMENT
/begin MEASUREMENT VACActual "var comments" UWORD udf_CM_19020 0 0.0 0.0 255.99609375 ECU_ADDRESS 0x40002996 /end MEASUREMENT
/begin MEASUREMENT BaroNorminal "var comments" UWORD udf_CM_19503 0 0.0 0.0 255.99609375 DISPLAY_IDENTIFIER VfVIOS_p_NominalBaro ECU_ADDRESS 0x40002992 /end MEASUREMENT
/begin MEASUREMENT MAPReadAngle "var comments" UWORD udf_CM_17193 0 0.0 0.0 1023.984375 ECU_ADDRESS 0x4000298A /end MEASUREMENT
/begin MEASUREMENT MAPReadCmplt "var comments" UBYTE udf_CM_17207 0 0.0 0.0 255.0 ECU_ADDRESS 0x40002978 /end MEASUREMENT
/begin MEASUREMENT MAPReadAngleDel "var comments" UWORD udf_CM_17200 0 0.0 0.0 1023.984375 ECU_ADDRESS 0x40002984 /end MEASUREMENT
/begin MEASUREMENT MAPReadErr "var comments" UBYTE udf_CM_19335 0 0.0 0.0 255.0 DISPLAY_IDENTIFIER VbVIOS_MAPReadError ECU_ADDRESS 0x40002977 /end MEASUREMENT
/begin MEASUREMENT MAPShorted "var comments" UBYTE udf_CM_17235 0 0.0 0.0 255.0 ECU_ADDRESS 0x4000296A /end MEASUREMENT
/begin MEASUREMENT MAPUnfilt "var comments" UWORD udf_CM_17291 0 0.0 0.0 255.99609375 ECU_ADDRESS 0x40002990 /end MEASUREMENT
/begin MEASUREMENT FuelPressureRelative "var comments" SWORD udf_CM_17293 0 0.0 -256 255.9921875 ECU_ADDRESS 0x40002B02 /end MEASUREMENT
/begin MEASUREMENT FuelPressureUnfilt "var comments" SWORD udf_CM_17293 0 0.0 -256 255.9921875 ECU_ADDRESS 0x40002B04 /end MEASUREMENT
/begin MEASUREMENT FPFiltCoef "var comments" UWORD CM_FiltCoef 0 0.0 0.0 0.9999847412109375 ECU_ADDRESS 0x40002B06 /end MEASUREMENT
/begin MEASUREMENT WPInFilt "var comments" UWORD udf_CM_17292 0 0.0 0.0 15.999755859375 ECU_ADDRESS 0x40002AFC /end MEASUREMENT
/begin MEASUREMENT WPOutFilt "var comments" UWORD udf_CM_17292 0 0.0 0.0 15.999755859375 ECU_ADDRESS 0x40002AFE /end MEASUREMENT
/begin MEASUREMENT WPPCurrFilt "var comments" UWORD udf_CM_17294 0 0.0 0.0 511.9921875 ECU_ADDRESS 0x40002B00 /end MEASUREMENT
/begin MEASUREMENT O2Volt "var comments" UWORD udf_CM_17536 0 0.0 0.0 1023.984375 ECU_ADDRESS 0x400029EC /end MEASUREMENT
/begin MEASUREMENT O2VoltPrev "var comments" UWORD udf_CM_17543 0 0.0 0.0 1023.984375 ECU_ADDRESS 0x400029EA /end MEASUREMENT
/begin MEASUREMENT RO2_1_Volt "var comments" UWORD udf_CM_17536 0 0.0 0.0 1023.984375 ECU_ADDRESS 0x400029EE /end MEASUREMENT
/begin MEASUREMENT FuelMode "var comments" UBYTE udf_CM_16528 0 0.0 0.0 255.0 ECU_ADDRESS 0x400029F5 /end MEASUREMENT
/begin MEASUREMENT RefPeriod "var comments" UWORD udf_CM_17655 0 0.0 0.0 1023.984375 ECU_ADDRESS 0x40002A5A /end MEASUREMENT
/begin MEASUREMENT RefPulseSeen "var comments" UBYTE udf_CM_17676 0 0.0 0.0 255.0 ECU_ADDRESS 0x40002A39 /end MEASUREMENT
/begin MEASUREMENT IACV_RefToothCount "var comments" UWORD udf_CM_19370 0 0.0 0.0 65535.0 ECU_ADDRESS 0x400029AC /end MEASUREMENT
/begin MEASUREMENT FCV_RefToothCount "var comments" UWORD udf_CM_19370 0 0.0 0.0 65535.0 ECU_ADDRESS 0x400029AA /end MEASUREMENT
/begin MEASUREMENT MAPExpRealUsed "var comments" UBYTE udf_CM_17158 0 0.0 0.0 255.0 ECU_ADDRESS 0x4000297E /end MEASUREMENT
/begin MEASUREMENT EngineSpeed "var comments" UWORD udf_CM_16185 0 0.0 0.0 16383.75 ECU_ADDRESS 0x40002A24 /end MEASUREMENT
/begin MEASUREMENT EngSpdDelta "var comments" UWORD udf_CM_16206 0 0.0 0.0 16383.75 ECU_ADDRESS 0x40002A0A /end MEASUREMENT
/begin MEASUREMENT EngSpdSAGovDelta "var comments" UWORD udf_CM_16206 0 0.0 0.0 16383.75 ECU_ADDRESS 0x40002A0C /end MEASUREMENT
/begin MEASUREMENT EngSpdErrF2UF "var comments" UWORD udf_CM_16213 0 0.0 0.0 16383.75 ECU_ADDRESS 0x40002A06 /end MEASUREMENT
/begin MEASUREMENT EngSpdFilt "var comments" UWORD udf_CM_16220 0 0.0 0.0 16383.75 ECU_ADDRESS 0x40002A04 /end MEASUREMENT
/begin MEASUREMENT EngSpdIncrs "var comments" UBYTE udf_CM_16227 0 0.0 0.0 255.0 ECU_ADDRESS 0x40002A08 /end MEASUREMENT
/begin MEASUREMENT EngSpdState "var comments" UBYTE udf_CM_16234 0 0.0 0.0 255.0 ECU_ADDRESS 0x40002A09 /end MEASUREMENT
/begin MEASUREMENT RunModeTran "var comments" UBYTE udf_CM_19412 0 0.0 0.0 255.0 DISPLAY_IDENTIFIER VeVIOS_RunModeTran ECU_ADDRESS 0x4000293F /end MEASUREMENT
/begin MEASUREMENT SprkDlvMode "var comments" UBYTE udf_CM_18131 0 0.0 0.0 255.0 ECU_ADDRESS 0x40002924 /end MEASUREMENT
/begin MEASUREMENT VSS_DUTY "var comments" UWORD udf_CM_18726 0 0.0 0.0 199.9969482421875 DISPLAY_IDENTIFIER FI_Current_Duty[0] ECU_ADDRESS 0x40000B54 /end MEASUREMENT
/begin MEASUREMENT DIAG_DUTY "var comments" UWORD udf_CM_18726 0 0.0 0.0 199.9969482421875 DISPLAY_IDENTIFIER FI_Current_Duty[1] ECU_ADDRESS 0x40000B56 /end MEASUREMENT
/begin MEASUREMENT DCEN_DUTY "var comments" UWORD udf_CM_18726 0 0.0 0.0 199.9969482421875 DISPLAY_IDENTIFIER FI_Current_Duty[2] ECU_ADDRESS 0x40000B58 /end MEASUREMENT
/begin MEASUREMENT TPS "var comments" UWORD udf_CM_18726 0 0.0 0.0 199.9969482421875 ECU_ADDRESS 0x40002A62 /end MEASUREMENT
/begin MEASUREMENT TPSChanged "var comments" UBYTE udf_CM_18796 0 0.0 0.0 255.0 DISPLAY_IDENTIFIER TPSIncreaseFlag ECU_ADDRESS 0x40002A60 /end MEASUREMENT
/begin MEASUREMENT TPSDelta "var comments" UWORD udf_CM_18733 0 0.0 0.0 199.9969482421875 ECU_ADDRESS 0x40002A74 /end MEASUREMENT
/begin MEASUREMENT TPSIACCompstd "var comments" UWORD udf_CM_18789 0 0.0 0.0 199.9969482421875 ECU_ADDRESS 0x40002994 /end MEASUREMENT
/begin MEASUREMENT TPSPrev "var comments" UWORD udf_CM_18831 0 0.0 0.0 199.9969482421875 ECU_ADDRESS 0x40002A6C /end MEASUREMENT
/begin MEASUREMENT TPSRawSignal "var comments" UWORD udf_CM_18838 0 0.0 0.0 65535.0 ECU_ADDRESS 0x40002A64 /end MEASUREMENT
/begin MEASUREMENT TPSDiffAE "var comments" SWORD udf_CM_18747 0 0.0 -200.0 199.993896484375 ECU_ADDRESS 0x40002A76 /end MEASUREMENT
/begin MEASUREMENT TPSFiltAE "var comments" UWORD udf_CM_18775 0 0.0 0.0 199.9969482421875 ECU_ADDRESS 0x40002A66 /end MEASUREMENT
/begin MEASUREMENT TPSDiffF2UF "var comments" SWORD udf_CM_18761 0 0.0 -200.0 199.993896484375 ECU_ADDRESS 0x40002A70 /end MEASUREMENT
/begin MEASUREMENT TPSDiffDE "var comments" SWORD udf_CM_18754 0 0.0 -200.0 199.993896484375 ECU_ADDRESS 0x40002A78 /end MEASUREMENT
/begin MEASUREMENT TPSDfltUsed "var comments" UBYTE udf_CM_18740 0 0.0 0.0 255.0 ECU_ADDRESS 0x40002A6A /end MEASUREMENT
/begin MEASUREMENT TPSFiltDE "var comments" UWORD udf_CM_18782 0 0.0 0.0 199.9969482421875 ECU_ADDRESS 0x40002A68 /end MEASUREMENT
/begin MEASUREMENT TPSFilt "var comments" UWORD udf_CM_18768 0 0.0 0.0 199.9969482421875 ECU_ADDRESS 0x40002A6E /end MEASUREMENT
/begin MEASUREMENT TPSIncrs "var comments" UBYTE udf_CM_18803 0 0.0 0.0 255.0 ECU_ADDRESS 0x40002A6B /end MEASUREMENT
/begin MEASUREMENT TPSZero "var comments" UWORD udf_CM_18901 0 0.0 0.0 199.9969482421875 ECU_ADDRESS 0x4000014C /end MEASUREMENT
/begin COMPU_METHOD udf_CM_15240 "Ax + B" RAT_FUNC "%4.4" "boolean" COEFFS 0 1 0 0 0 1 /end COMPU_METHOD
/begin COMPU_METHOD udf_CM_15247 "Ax + B" RAT_FUNC "%4.0" "counts" COEFFS 0 1 0 0 0 1 /end COMPU_METHOD
/begin COMPU_METHOD udf_CM_15254 "Ax + B" RAT_FUNC "%4.0" "boolean" COEFFS 0 1 0 0 0 1 /end COMPU_METHOD
/begin COMPU_METHOD udf_CM_15261 "Ax + B" RAT_FUNC "%4.4" "ratio" COEFFS 0.0 65536.00026843546 0.0 0.0 0.0 1.0 /end COMPU_METHOD
/begin COMPU_METHOD udf_CM_15262 "Ax + B" RAT_FUNC "%4.4" "ratio" COEFFS 0.0 32768.00013421773 0.0 0.0 0.0 1.0 /end COMPU_METHOD
/begin COMPU_METHOD udf_CM_15268 "Ax + B" RAT_FUNC "%4.4" "gm" COEFFS 0.0 8192.000033554432 0.0 0.0 0.0 1.0 /end COMPU_METHOD
/begin COMPU_METHOD udf_CM_15275 "Ax + B" RAT_FUNC "%4.4" "ratio" COEFFS 0.0 32768.00013421773 0.0 0.0 0.0 1.0 /end COMPU_METHOD
/begin COMPU_METHOD udf_CM_15282 "Ax + B" RAT_FUNC "%4.4" "ratio" COEFFS 0.0 32768.00013421773 0.0 0.0 0.0 1.0 /end COMPU_METHOD
/begin COMPU_METHOD udf_CM_15289 "Ax + B" RAT_FUNC "%4.4" "ratio" COEFFS 0.0 32768.00013421773 0.0 0.0 0.0 1.0 /end COMPU_METHOD
/begin COMPU_METHOD udf_CM_15296 "Ax + B" RAT_FUNC "%4.4" "ratio" COEFFS 0.0 32768.00013421773 0.0 0.0 0.0 1.0 /end COMPU_METHOD
/begin COMPU_METHOD udf_CM_15303 "Ax + B" RAT_FUNC "%4.4" "ratio" COEFFS 0.0 32768.00013421773 0.0 0.0 0.0 1.0 /end COMPU_METHOD
/begin COMPU_METHOD udf_CM_15310 "Ax + B" RAT_FUNC "%4.4" "ratio" COEFFS 0.0 32768.00013421773 0.0 0.0 0.0 1.0 /end COMPU_METHOD
/begin COMPU_METHOD udf_CM_15317 "Ax + B" RAT_FUNC "%4.4" "ratio" COEFFS 0.0 32768.00013421773 0.0 0.0 0.0 1.0 /end COMPU_METHOD
/begin COMPU_METHOD udf_CM_15324 "Ax + B" RAT_FUNC "%4.4" "ratio" COEFFS 0.0 32768.00013421773 0.0 0.0 0.0 1.0 /end COMPU_METHOD
/begin COMPU_METHOD udf_CM_15331 "Ax + B" RAT_FUNC "%4.4" "ratio" COEFFS 0.0 32768.00013421773 0.0 0.0 0.0 1.0 /end COMPU_METHOD
/begin COMPU_METHOD udf_CM_15338 "Ax + B" RAT_FUNC "%4.4" "ratio" COEFFS 0.0 32768.00013421773 0.0 0.0 0.0 1.0 /end COMPU_METHOD
/begin COMPU_METHOD udf_CM_15345 "Ax + B" RAT_FUNC "%4.4" "ratio" COEFFS 0.0 32768.00013421773 0.0 0.0 0.0 1.0 /end COMPU_METHOD
/begin COMPU_METHOD udf_CM_15352 "Ax + B" RAT_FUNC "%4.4" "ratio" COEFFS 0.0 32768.00013421773 0.0 0.0 0.0 1.0 /end COMPU_METHOD
/begin COMPU_METHOD udf_CM_15359 "Ax + B" RAT_FUNC "%4.4" "ratio" COEFFS 0.0 32768.00013421773 0.0 0.0 0.0 1.0 /end COMPU_METHOD
/begin COMPU_METHOD udf_CM_15366 "Ax + B" RAT_FUNC "%4.4" "ratio" COEFFS 0.0 32768.00013421773 0.0 0.0 0.0 1.0 /end COMPU_METHOD
/begin COMPU_METHOD udf_CM_15373 "Ax + B" RAT_FUNC "%4.4" "ratio" COEFFS 0.0 32768.00013421773 0.0 0.0 0.0 1.0 /end COMPU_METHOD
/begin COMPU_METHOD udf_CM_15380 "Ax + B" RAT_FUNC "%4.4" "ratio" COEFFS 0.0 32768.00013421773 0.0 0.0 0.0 1.0 /end COMPU_METHOD
/begin COMPU_METHOD udf_CM_15387 "Ax + B" RAT_FUNC "%4.0" "count" COEFFS 0 1 0 0 0 1 /end COMPU_METHOD
/begin COMPU_METHOD udf_CM_15394 "Ax + B" RAT_FUNC "%4.4" "ratio" COEFFS 0.0 32768.00013421773 0.0 0.0 0.0 1.0 /end COMPU_METHOD
/begin COMPU_METHOD udf_CM_15401 "Ax + B" RAT_FUNC "%4.4" "kpa" COEFFS 0.0 256.0 0.0 0.0 0.0 1.0 /end COMPU_METHOD
/begin COMPU_METHOD udf_CM_15408 "Ax + B" RAT_FUNC "%4.0" "boolean" COEFFS 0 1 0 0 0 1 /end COMPU_METHOD
/begin COMPU_METHOD udf_CM_15415 "Ax + B" RAT_FUNC "%4.4" "ratio" COEFFS 0.0 32768.00013421773 0.0 0.0 0.0 1.0 /end COMPU_METHOD
/begin COMPU_METHOD udf_CM_15422 "Ax + B" RAT_FUNC "%4.4" "ratio" COEFFS 0.0 2048.0 0.0 0.0 0.0 1.0 /end COMPU_METHOD
/begin COMPU_METHOD udf_CM_15429 "Ax + B" RAT_FUNC "%4.4" "ratio" COEFFS 0.0 2048.0 0.0 0.0 0.0 1.0 /end COMPU_METHOD
/begin COMPU_METHOD udf_CM_15436 "Ax + B" RAT_FUNC "%4.0" "boolean" COEFFS 0 1 0 0 0 1 /end COMPU_METHOD
/begin COMPU_METHOD udf_CM_15450 "Ax + B" RAT_FUNC "%4.4" "ratio" COEFFS 0.0 2048.0 0.0 0.0 0.0 1.0 /end COMPU_METHOD
/begin COMPU_METHOD udf_CM_15457 "Ax + B" RAT_FUNC "%4.4" "ratio" COEFFS 0.0 2048.0 0.0 0.0 0.0 1.0 /end COMPU_METHOD
/begin COMPU_METHOD udf_CM_15464 "Ax + B" RAT_FUNC "%4.4" "ratio" COEFFS 0.0 2048.0 0.0 0.0 0.0 1.0 /end COMPU_METHOD
/begin COMPU_METHOD udf_CM_15485 "Ax + B" RAT_FUNC "%4.4" "ratio" COEFFS 0.0 2048.0 0.0 0.0 0.0 1.0 /end COMPU_METHOD
/begin COMPU_METHOD udf_CM_15492 "Ax + B" RAT_FUNC "%4.4" "volt" COEFFS 0.0 2048.0 0.0 0.0 0.0 1.0 /end COMPU_METHOD
/begin COMPU_METHOD udf_CM_15499 "Ax + B" RAT_FUNC "%4.4" "volt" COEFFS 0.0 2048.0 0.0 0.0 0.0 1.0 /end COMPU_METHOD
/begin COMPU_METHOD udf_CM_15506 "Ax + B" RAT_FUNC "%4.4" "ratio" COEFFS 0.0 2048.0 0.0 0.0 0.0 1.0 /end COMPU_METHOD
/begin COMPU_METHOD udf_CM_15513 "Ax + B" RAT_FUNC "%4.0" "boolean" COEFFS 0 1 0 0 0 1 /end COMPU_METHOD
/begin COMPU_METHOD udf_CM_15520 "Ax + B" RAT_FUNC "%4.4" "ratio" COEFFS 0.0 2048.0 0.0 0.0 0.0 1.0 /end COMPU_METHOD
/begin COMPU_METHOD udf_CM_15527 "Ax + B" RAT_FUNC "%4.4" "ratio" COEFFS 0.0 2048.0 0.0 0.0 0.0 1.0 /end COMPU_METHOD
/begin COMPU_METHOD udf_CM_15534 "Ax + B" RAT_FUNC "%4.4" "gm/sec" COEFFS 0.0 128.0 0.0 0.0 0.0 1.0 /end COMPU_METHOD
/begin COMPU_METHOD udf_CM_15541 "Ax + B" RAT_FUNC "%4.4" "gm/sec" COEFFS 0.0 128.0 0.0 0.0 0.0 1.0 /end COMPU_METHOD
/begin COMPU_METHOD udf_CM_15548 "Ax + B" RAT_FUNC "%4.4" "grams" COEFFS 0.0 16384.00006710886 0.0 0.0 0.0 1.0 /end COMPU_METHOD
/begin COMPU_METHOD udf_CM_15555 "Ax + B" RAT_FUNC "%4.4" "grams" COEFFS 0.0 16384.00006710886 0.0 0.0 0.0 1.0 /end COMPU_METHOD
/begin COMPU_METHOD udf_CM_15562 "Ax + B" RAT_FUNC "%4.4" "kpa" COEFFS 0.0 256.0 0.0 0.0 0.0 1.0 /end COMPU_METHOD
/begin COMPU_METHOD udf_CM_15569 "Ax + B" RAT_FUNC "%4.4" "kpa" COEFFS 0.0 256.0 0.0 0.0 0.0 1.0 /end COMPU_METHOD
/begin COMPU_METHOD udf_CM_15576 "Ax + B" RAT_FUNC "%4.0" "boolean" COEFFS 0 1 0 0 0 1 /end COMPU_METHOD
/begin COMPU_METHOD udf_CM_15583 "Ax + B" RAT_FUNC "%4.0" "None" COEFFS 0 1 0 0 0 1 /end COMPU_METHOD
/begin COMPU_METHOD udf_CM_15590 "Ax + B" RAT_FUNC "%4.4" "gm" COEFFS 0.0 65536.00026843546 0.0 0.0 0.0 1.0 /end COMPU_METHOD
/begin COMPU_METHOD udf_CM_15597 "Ax + B" RAT_FUNC "%4.4" "msec" COEFFS 0.0 64.0 0.0 0.0 0.0 1.0 /end COMPU_METHOD
/begin COMPU_METHOD udf_CM_15604 "Ax + B" RAT_FUNC "%4.4" "gm" COEFFS 0.0 65536.00026843546 0.0 0.0 0.0 1.0 /end COMPU_METHOD
/begin COMPU_METHOD udf_CM_15611 "Ax + B" RAT_FUNC "%4.4" "volt" COEFFS 0.0 2048.0 0.0 0.0 0.0 1.0 /end COMPU_METHOD
/begin COMPU_METHOD CM_Boolean1 "" RAT_FUNC "%1.0" "bool" COEFFS 0 1 0 0 0 1 /end COMPU_METHOD
/begin COMPU_METHOD udf_CM_15639 "Ax + B" RAT_FUNC "%4.4" "ratio" COEFFS 0.0 16393.44262295082 0.0 0.0 0.0 1.0 /end COMPU_METHOD
/begin COMPU_METHOD udf_CM_15646 "Ax + B" RAT_FUNC "%4.4" "degC" COEFFS 0.0 128.0 0.0 0.0 0.0 1.0 /end COMPU_METHOD
/begin COMPU_METHOD udf_CM_15653 "Ax + B" RAT_FUNC "%4.0" "counts" COEFFS 0 1 0 0 0 1 /end COMPU_METHOD
/begin COMPU_METHOD udf_CM_15660 "Ax + B" RAT_FUNC "%4.0" "counts" COEFFS 0 1 0 0 0 1 /end COMPU_METHOD
/begin COMPU_METHOD udf_CM_15667 "Ax + B" RAT_FUNC "%4.0" "None" COEFFS 0 1 0 0 0 1 /end COMPU_METHOD
/begin COMPU_METHOD udf_CM_15674 "Ax + B" RAT_FUNC "%4.0" "None" COEFFS 0 1 0 0 0 1 /end COMPU_METHOD
/begin COMPU_METHOD udf_CM_15681 "Ax + B" RAT_FUNC "%4.0" "Counts" COEFFS 0 1 0 0 0 1 /end COMPU_METHOD
/begin COMPU_METHOD udf_CM_15688 "Ax + B" RAT_FUNC "%4.0" "None" COEFFS 0 1 0 0 0 1 /end COMPU_METHOD
/begin COMPU_METHOD udf_CM_15695 "Ax + B" RAT_FUNC "%4.0" "Counts" COEFFS 0 1 0 0 0 1 /end COMPU_METHOD
/begin COMPU_METHOD udf_CM_15702 "Ax + B" RAT_FUNC "%4.0" "None" COEFFS 0 1 0 0 0 1 /end COMPU_METHOD
/begin COMPU_METHOD udf_CM_15716 "Ax + B" RAT_FUNC "%4.0" "Counts" COEFFS 0 1 0 0 0 1 /end COMPU_METHOD
/begin COMPU_METHOD udf_CM_15723 "Ax + B" RAT_FUNC "%4.0" "None" COEFFS 0 1 0 0 0 1 /end COMPU_METHOD
/begin COMPU_METHOD udf_CM_15730 "Ax + B" RAT_FUNC "%4.0" "Counts" COEFFS 0 1 0 0 0 1 /end COMPU_METHOD
/begin COMPU_METHOD udf_CM_15737 "Ax + B" RAT_FUNC "%4.0" "None" COEFFS 0 1 0 0 0 1 /end COMPU_METHOD
/begin COMPU_METHOD udf_CM_15744 "Ax + B" RAT_FUNC "%4.4" "degC" COEFFS 0.0 128.0 0.0 0.0 0.0 1.0 /end COMPU_METHOD
/begin COMPU_METHOD udf_CM_15751 "Ax + B" RAT_FUNC "%4.4" "degC" COEFFS 0.0 128.0 0.0 0.0 0.0 1.0 /end COMPU_METHOD
/begin COMPU_METHOD udf_CM_15758 "Ax + B" RAT_FUNC "%4.4" "degC" COEFFS 0.0 128.0 0.0 0.0 0.0 1.0 /end COMPU_METHOD
/begin COMPU_METHOD CM_Count1 "" RAT_FUNC "%3.0" "count" COEFFS 0 1 0 0 0 1 /end COMPU_METHOD
/begin COMPU_METHOD CM_Count3 "" RAT_FUNC "%3.0" "None" COEFFS 0 1 0 0 0 1 /end COMPU_METHOD
/begin COMPU_METHOD udf_CM_15821 "Ax + B" RAT_FUNC "%4.0" "None" COEFFS 0 1 0 0 0 1 /end COMPU_METHOD
/begin COMPU_METHOD udf_CM_15828 "Ax + B" RAT_FUNC "%4.0" "None" COEFFS 0 1 0 0 0 1 /end COMPU_METHOD
/begin COMPU_METHOD udf_CM_15835 "Ax + B" RAT_FUNC "%4.2" "" COEFFS 0.0 128.0 0.0 0.0 0.0 1.0 /end COMPU_METHOD
/begin COMPU_METHOD udf_CM_15842 "Ax + B" RAT_FUNC "%4.2" "" COEFFS 0.0 128.0 0.0 0.0 0.0 1.0 /end COMPU_METHOD
/begin COMPU_METHOD udf_CM_15849 "Ax + B" RAT_FUNC "%4.0" "" COEFFS 0 1 0 0 0 1 /end COMPU_METHOD
/begin COMPU_METHOD udf_CM_15856 "Ax + B" RAT_FUNC "%4.0" "" COEFFS 0 1 0 0 0 1 /end COMPU_METHOD
/begin COMPU_METHOD udf_CM_15863 "Ax + B" RAT_FUNC "%4.0" "" COEFFS 0 1 0 0 0 1 /end COMPU_METHOD
/begin COMPU_METHOD udf_CM_15870 "Ax + B" RAT_FUNC "%4.0" "" COEFFS 0 1 0 0 0 1 /end COMPU_METHOD
/begin COMPU_METHOD udf_CM_15877 "Ax + B" RAT_FUNC "%4.0" "" COEFFS 0 1 0 0 0 1 /end COMPU_METHOD
/begin COMPU_METHOD udf_CM_15884 "Ax + B" RAT_FUNC "%4.0" "" COEFFS 0 1 0 0 0 1 /end COMPU_METHOD
/begin COMPU_METHOD udf_CM_15891 "Ax + B" RAT_FUNC "%4.0" "" COEFFS 0 1 0 0 0 1 /end COMPU_METHOD
/begin COMPU_METHOD udf_CM_15898 "Ax + B" RAT_FUNC "%4.0" "" COEFFS 0 1 0 0 0 1 /end COMPU_METHOD
/begin COMPU_METHOD udf_CM_15905 "Ax + B" RAT_FUNC "%4.0" "" COEFFS 0 1 0 0 0 1 /end COMPU_METHOD
/begin COMPU_METHOD udf_CM_15912 "Ax + B" RAT_FUNC "%4.0" "" COEFFS 0 1 0 0 0 1 /end COMPU_METHOD
/begin COMPU_METHOD udf_CM_15919 "Ax + B" RAT_FUNC "%4.0" "" COEFFS 0 1 0 0 0 1 /end COMPU_METHOD
/begin COMPU_METHOD udf_CM_15926 "Ax + B" RAT_FUNC "%4.0" "" COEFFS 0 1 0 0 0 1 /end COMPU_METHOD
/begin COMPU_METHOD udf_CM_15933 "Ax + B" RAT_FUNC "%4.0" "" COEFFS 0 1 0 0 0 1 /end COMPU_METHOD
/begin COMPU_METHOD CM_EOI "" TAB_VERB "%10.4" "" COMPU_TAB_REF CM_EOI_TAB /end COMPU_METHOD
/begin COMPU_METHOD CM_LIGHT_TYPE "" TAB_VERB "%4.0" "" COMPU_TAB_REF CM_LIGHT_TYPE_TAB /end COMPU_METHOD
/begin COMPU_METHOD udf_CM_15947 "Ax + B" RAT_FUNC "%4.0" "boolean" COEFFS 0 1 0 0 0 1 /end COMPU_METHOD
/begin COMPU_METHOD udf_CM_15954 "Ax + B" RAT_FUNC "%4.4" "boolean" COEFFS 0 1 0 0 0 1 /end COMPU_METHOD
/begin COMPU_METHOD udf_CM_15961 "Ax + B" RAT_FUNC "%4.4" "ratio" COEFFS 0.0 65536.00026843546 0.0 0.0 0.0 1.0 /end COMPU_METHOD
/begin COMPU_METHOD udf_CM_15968 "Ax + B" RAT_FUNC "%4.4" "gm" COEFFS 0.0 8192.000033554432 0.0 0.0 0.0 1.0 /end COMPU_METHOD
/begin COMPU_METHOD udf_CM_15975 "Ax + B" RAT_FUNC "%4.4" "gm" COEFFS 0.0 65536.00026843546 0.0 0.0 0.0 1.0 /end COMPU_METHOD
/begin COMPU_METHOD udf_CM_15982 "Ax + B" RAT_FUNC "%4.4" "Gram" COEFFS 0.0 128.0 0.0 0.0 0.0 1.0 /end COMPU_METHOD
/begin COMPU_METHOD udf_CM_15989 "Ax + B" RAT_FUNC "%4.4" "percent" COEFFS 0.0 327.6800000536871 0.0 0.0 0.0 1.0 /end COMPU_METHOD
/begin COMPU_METHOD udf_CM_15996 "Ax + B" RAT_FUNC "%4.0" "percent" COEFFS 0.0 327.6800000536871 0.0 0.0 0.0 1.0 /end COMPU_METHOD
/begin COMPU_METHOD udf_CM_16010 "" TAB_VERB "%10.4" "" COMPU_TAB_REF udf_CV_19704 /end COMPU_METHOD
/begin COMPU_METHOD udf_CM_16059 "Ax + B" RAT_FUNC "%4.4" "NM" COEFFS 0.0 256.0 0.0 0.0 0.0 1.0 /end COMPU_METHOD
/begin COMPU_METHOD udf_CM_16073 "Ax + B" RAT_FUNC "%4.4" "rpm" COEFFS 0.0 4.0 0.0 0.0 0.0 1.0 /end COMPU_METHOD
/begin COMPU_METHOD udf_CM_16080 "Ax + B" RAT_FUNC "%4.4" "rpm" COEFFS 0.0 4.0 0.0 0.0 0.0 1.0 /end COMPU_METHOD
/begin COMPU_METHOD udf_CM_16087 "Ax + B" RAT_FUNC "%4.4" "rpm" COEFFS 0.0 4.0 0.0 0.0 0.0 1.0 /end COMPU_METHOD
/begin COMPU_METHOD udf_CM_16094 "Ax + B" RAT_FUNC "%4.4" "rpm" COEFFS 0.0 4.0 0.0 0.0 0.0 1.0 /end COMPU_METHOD
/begin COMPU_METHOD udf_CM_16101 "Ax + B" RAT_FUNC "%4.4" "rpm" COEFFS 0.0 4.0 0.0 0.0 0.0 1.0 /end COMPU_METHOD
/begin COMPU_METHOD udf_CM_16108 "Ax + B" RAT_FUNC "%4.4" "rpm" COEFFS 0.0 4.0 0.0 0.0 0.0 1.0 /end COMPU_METHOD
/begin COMPU_METHOD udf_CM_16115 "Ax + B" RAT_FUNC "%4.4" "rpm" COEFFS 0.0 4.0 0.0 0.0 0.0 1.0 /end COMPU_METHOD
/begin COMPU_METHOD udf_CM_16122 "Ax + B" RAT_FUNC "%4.4" "rpm" COEFFS 0.0 4.0 0.0 0.0 0.0 1.0 /end COMPU_METHOD
/begin COMPU_METHOD udf_CM_16129 "Ax + B" RAT_FUNC "%4.4" "rpm" COEFFS 0.0 4.0 0.0 0.0 0.0 1.0 /end COMPU_METHOD
/begin COMPU_METHOD udf_CM_16136 "Ax + B" RAT_FUNC "%4.4" "rpm" COEFFS 0.0 4.0 0.0 0.0 0.0 1.0 /end COMPU_METHOD
/begin COMPU_METHOD udf_CM_16143 "Ax + B" RAT_FUNC "%4.4" "rpm" COEFFS 0.0 4.0 0.0 0.0 0.0 1.0 /end COMPU_METHOD
/begin COMPU_METHOD udf_CM_16150 "Ax + B" RAT_FUNC "%4.4" "rpm" COEFFS 0.0 4.0 0.0 0.0 0.0 1.0 /end COMPU_METHOD
/begin COMPU_METHOD udf_CM_16157 "Ax + B" RAT_FUNC "%4.4" "rpm" COEFFS 0.0 4.0 0.0 0.0 0.0 1.0 /end COMPU_METHOD
/begin COMPU_METHOD udf_CM_16164 "Ax + B" RAT_FUNC "%4.4" "rpm" COEFFS 0.0 4.0 0.0 0.0 0.0 1.0 /end COMPU_METHOD
/begin COMPU_METHOD udf_CM_16171 "Ax + B" RAT_FUNC "%4.4" "rpm" COEFFS 0.0 4.0 0.0 0.0 0.0 1.0 /end COMPU_METHOD
/begin COMPU_METHOD udf_CM_16178 "Ax + B" RAT_FUNC "%4.4" "rpm" COEFFS 0.0 4.0 0.0 0.0 0.0 1.0 /end COMPU_METHOD
/begin COMPU_METHOD udf_CM_16185 "Ax + B" RAT_FUNC "%4.4" "rpm" COEFFS 0.0 4.0 0.0 0.0 0.0 1.0 /end COMPU_METHOD
/begin COMPU_METHOD udf_CM_16192 "" TAB_VERB "%10.4" "" COMPU_TAB_REF udf_CV_19710 /end COMPU_METHOD
/begin COMPU_METHOD udf_CM_16193 "" TAB_VERB "%10.4" "" COMPU_TAB_REF udf_CV_19711 /end COMPU_METHOD
/begin COMPU_METHOD udf_CM_16199 "Ax + B" RAT_FUNC "%4.0" "None" COEFFS 0 1 0 0 0 1 /end COMPU_METHOD
/begin COMPU_METHOD udf_CM_16206 "Ax + B" RAT_FUNC "%4.4" "rpm" COEFFS 0.0 4.0 0.0 0.0 0.0 1.0 /end COMPU_METHOD
/begin COMPU_METHOD udf_CM_16213 "Ax + B" RAT_FUNC "%4.4" "rpm" COEFFS 0.0 4.0 0.0 0.0 0.0 1.0 /end COMPU_METHOD
/begin COMPU_METHOD udf_CM_16220 "Ax + B" RAT_FUNC "%4.4" "rpm" COEFFS 0.0 4.0 0.0 0.0 0.0 1.0 /end COMPU_METHOD
/begin COMPU_METHOD udf_CM_16227 "Ax + B" RAT_FUNC "%4.0" "none" COEFFS 0 1 0 0 0 1 /end COMPU_METHOD
/begin COMPU_METHOD udf_CM_16234 "Ax + B" RAT_FUNC "%4.0" "boolean" COEFFS 0 1 0 0 0 1 /end COMPU_METHOD
/begin COMPU_METHOD udf_CM_16269 "Ax + B" RAT_FUNC "%4.0" "boolean" COEFFS 0 1 0 0 0 1 /end COMPU_METHOD
/begin COMPU_METHOD udf_CM_16283 "Ax + B" RAT_FUNC "%4.4" "msec" COEFFS 0.0 64.0 0.0 0.0 0.0 1.0 /end COMPU_METHOD
/begin COMPU_METHOD udf_CM_16290 "Ax + B" RAT_FUNC "%4.4" "msec" COEFFS 0.0 64.0 0.0 0.0 0.0 1.0 /end COMPU_METHOD
/begin COMPU_METHOD udf_CM_16297 "Ax + B" RAT_FUNC "%4.4" "msec" COEFFS 0.0 64.0 0.0 0.0 0.0 1.0 /end COMPU_METHOD
/begin COMPU_METHOD udf_CM_16304 "Ax + B" RAT_FUNC "%4.4" "msec" COEFFS 0.0 64.0 0.0 0.0 0.0 1.0 /end COMPU_METHOD
/begin COMPU_METHOD udf_CM_16311 "" TAB_VERB "%10.4" "" COMPU_TAB_REF udf_CV_19716 /end COMPU_METHOD
/begin COMPU_METHOD udf_CM_16325 "Ax + B" RAT_FUNC "%4.4" "millivolt" COEFFS 0.0 64.0 0.0 0.0 0.0 1.0 /end COMPU_METHOD
/begin COMPU_METHOD udf_CM_16332 "" TAB_VERB "%10.4" "" COMPU_TAB_REF udf_CV_19722 /end COMPU_METHOD
/begin COMPU_METHOD udf_CM_16339 "Ax + B" RAT_FUNC "%4.0" "boolean" COEFFS 0 1 0 0 0 1 /end COMPU_METHOD
/begin COMPU_METHOD udf_CM_16346 "" TAB_VERB "%10.4" "" COMPU_TAB_REF udf_CV_19728 /end COMPU_METHOD
/begin COMPU_METHOD udf_CM_16353 "Ax + B" RAT_FUNC "%4.0" "boolean" COEFFS 0 1 0 0 0 1 /end COMPU_METHOD
/begin COMPU_METHOD udf_CM_16360 "Ax + B" RAT_FUNC "%4.4" "millivolt" COEFFS 0.0 64.0 0.0 0.0 0.0 1.0 /end COMPU_METHOD
/begin COMPU_METHOD udf_CM_16381 "Ax + B" RAT_FUNC "%4.0" "boolean" COEFFS 0 1 0 0 0 1 /end COMPU_METHOD
/begin COMPU_METHOD udf_CM_16395 "Ax + B" RAT_FUNC "%4.0" "boolean" COEFFS 0 1 0 0 0 1 /end COMPU_METHOD
/begin COMPU_METHOD udf_CM_16402 "Ax + B" RAT_FUNC "%4.0" "boolean" COEFFS 0 1 0 0 0 1 /end COMPU_METHOD
/begin COMPU_METHOD udf_CM_16409 "Ax + B" RAT_FUNC "%4.4" "msec" COEFFS 0.0 64.0 0.0 0.0 0.0 1.0 /end COMPU_METHOD
/begin COMPU_METHOD udf_CM_16416 "Ax + B" RAT_FUNC "%4.4" "msec" COEFFS 0.0 64.0 0.0 0.0 0.0 1.0 /end COMPU_METHOD
/begin COMPU_METHOD udf_CM_16423 "Ax + B" RAT_FUNC "%4.0" "boolean" COEFFS 0 1 0 0 0 1 /end COMPU_METHOD
/begin COMPU_METHOD udf_CM_16430 "Ax + B" RAT_FUNC "%4.0" "boolean" COEFFS 0 1 0 0 0 1 /end COMPU_METHOD
/begin COMPU_METHOD udf_CM_16437 "Ax + B" RAT_FUNC "%4.4" "msec" COEFFS 0.0 8192.000033554432 0.0 0.0 0.0 1.0 /end COMPU_METHOD
/begin COMPU_METHOD udf_CM_16444 "Ax + B" RAT_FUNC "%4.4" "grm" COEFFS 0.0 4096.0 0.0 0.0 0.0 1.0 /end COMPU_METHOD
/begin COMPU_METHOD udf_CM_16445 "Ax + B" RAT_FUNC "%4.4" "l/h" COEFFS 0.0 16.0 0.0 0.0 0.0 1.0 /end COMPU_METHOD
/begin COMPU_METHOD udf_CM_16446 "Ax + B" RAT_FUNC "%4.4" "L" COEFFS 0.0 2.0 0.0 0.0 0.0 1.0 /end COMPU_METHOD
/begin COMPU_METHOD udf_CM_16451 "Ax + B" RAT_FUNC "%4.0" "boolean" COEFFS 0 1 0 0 0 1 /end COMPU_METHOD
/begin COMPU_METHOD udf_CM_16458 "Ax + B" RAT_FUNC "%4.0" "None" COEFFS 0 1 0 0 0 1 /end COMPU_METHOD
/begin COMPU_METHOD udf_CM_16465 "Ax + B" RAT_FUNC "%4.4" "angle" COEFFS 0.0 64.0 0.0 0.0 0.0 1.0 /end COMPU_METHOD
/begin COMPU_METHOD udf_CM_16472 "Ax + B" RAT_FUNC "%4.4" "angle" COEFFS 0.0 64.0 0.0 0.0 0.0 1.0 /end COMPU_METHOD
/begin COMPU_METHOD udf_CM_16479 "Ax + B" RAT_FUNC "%4.4" "angle" COEFFS 0.0 64.0 0.0 0.0 0.0 1.0 /end COMPU_METHOD
/begin COMPU_METHOD udf_CM_16486 "Ax + B" RAT_FUNC "%4.0" "boolean" COEFFS 0 1 0 0 0 1 /end COMPU_METHOD
/begin COMPU_METHOD udf_CM_16493 "Ax + B" RAT_FUNC "%4.0" "boolean" COEFFS 0 1 0 0 0 1 /end COMPU_METHOD
/begin COMPU_METHOD udf_CM_16500 "Ax + B" RAT_FUNC "%4.4" "counts" COEFFS 0 1 0 0 0 1 /end COMPU_METHOD
/begin COMPU_METHOD udf_CM_16507 "Ax + B" RAT_FUNC "%4.4" "msec" COEFFS 0.0 64.0 0.0 0.0 0.0 1.0 /end COMPU_METHOD
/begin COMPU_METHOD udf_CM_16514 "Ax + B" RAT_FUNC "%4.0" "boolean" COEFFS 0 1 0 0 0 1 /end COMPU_METHOD
/begin COMPU_METHOD udf_CM_16521 "Ax + B" RAT_FUNC "%4.0" "boolean" COEFFS 0 1 0 0 0 1 /end COMPU_METHOD
/begin COMPU_METHOD udf_CM_16528 "Ax + B" RAT_FUNC "%4.0" "None" COEFFS 0 1 0 0 0 1 /end COMPU_METHOD
/begin COMPU_METHOD udf_CM_16535 "Ax + B" RAT_FUNC "%4.4" "percent" COEFFS 0.0 327.6800000536871 0.0 0.0 0.0 1.0 /end COMPU_METHOD
/begin COMPU_METHOD udf_CM_16598 "Ax + B" RAT_FUNC "%4.4" "percent" COEFFS 0.0 327.6800000536871 0.0 0.0 0.0 1.0 /end COMPU_METHOD
/begin COMPU_METHOD udf_CM_16605 "Ax + B" RAT_FUNC "%4.0" "None" COEFFS 0 1 0 0 0 1 /end COMPU_METHOD
/begin COMPU_METHOD udf_CM_16612 "Ax + B" RAT_FUNC "%4.0" "None" COEFFS 0 1 0 0 0 1 /end COMPU_METHOD
/begin COMPU_METHOD udf_CM_16619 "Ax + B" RAT_FUNC "%4.0" "None" COEFFS 0 1 0 0 0 1 /end COMPU_METHOD
/begin COMPU_METHOD udf_CM_16626 "Ax + B" RAT_FUNC "%4.4" "ratio" COEFFS 0.0 32768.00013421773 0.0 0.0 0.0 1.0 /end COMPU_METHOD
/begin COMPU_METHOD udf_CM_16627 "Ax + B" RAT_FUNC "%4.4" "ratio" COEFFS 0.0 16384 0.0 0.0 0.0 1.0 /end COMPU_METHOD
/begin COMPU_METHOD udf_CM_16640 "Ax + B" RAT_FUNC "%4.0" "IAC_Mode" COEFFS 0 1 0 0 0 1 /end COMPU_METHOD
/begin COMPU_METHOD udf_CM_16647 "Ax + B" RAT_FUNC "%4.0" "boolean" COEFFS 0 1 0 0 0 1 /end COMPU_METHOD
/begin COMPU_METHOD udf_CM_16654 "Ax + B" RAT_FUNC "%4.0" "boolean" COEFFS 0 1 0 0 0 1 /end COMPU_METHOD
/begin COMPU_METHOD udf_CM_16661 "" TAB_VERB "%10.4" "" COMPU_TAB_REF udf_CV_19734 /end COMPU_METHOD
/begin COMPU_METHOD udf_CM_16668 "" TAB_VERB "%10.4" "" COMPU_TAB_REF udf_CV_19740 /end COMPU_METHOD
/begin COMPU_METHOD udf_CM_16675 "Ax + B" RAT_FUNC "%4.0" "boolean" COEFFS 0 1 0 0 0 1 /end COMPU_METHOD
/begin COMPU_METHOD udf_CM_16682 "Ax + B" RAT_FUNC "%4.0" "boolean" COEFFS 0 1 0 0 0 1 /end COMPU_METHOD
/begin COMPU_METHOD udf_CM_16689 "Ax + B" RAT_FUNC "%4.0" "boolean" COEFFS 0 1 0 0 0 1 /end COMPU_METHOD
/begin COMPU_METHOD udf_CM_16703 "Ax + B" RAT_FUNC "%4.0" "Counts" COEFFS 0 1 0 0 0 1 /end COMPU_METHOD
/begin COMPU_METHOD udf_CM_16710 "Ax + B" RAT_FUNC "%4.0" "None" COEFFS 0 1 0 0 0 1 /end COMPU_METHOD
/begin COMPU_METHOD udf_CM_16717 "Ax + B" RAT_FUNC "%4.0" "Counts" COEFFS 0 1 0 0 0 1 /end COMPU_METHOD
/begin COMPU_METHOD udf_CM_16724 "Ax + B" RAT_FUNC "%4.0" "None" COEFFS 0 1 0 0 0 1 /end COMPU_METHOD
/begin COMPU_METHOD udf_CM_16731 "Ax + B" RAT_FUNC "%4.0" "None" COEFFS 0 1 0 0 0 1 /end COMPU_METHOD
/begin COMPU_METHOD udf_CM_16738 "Ax + B" RAT_FUNC "%4.0" "Counts" COEFFS 0 1 0 0 0 1 /end COMPU_METHOD
/begin COMPU_METHOD udf_CM_16745 "Ax + B" RAT_FUNC "%4.0" "None" COEFFS 0 1 0 0 0 1 /end COMPU_METHOD
/begin COMPU_METHOD udf_CM_16752 "Ax + B" RAT_FUNC "%4.0" "Counts" COEFFS 0 1 0 0 0 1 /end COMPU_METHOD
/begin COMPU_METHOD udf_CM_16759 "Ax + B" RAT_FUNC "%4.0" "None" COEFFS 0 1 0 0 0 1 /end COMPU_METHOD
/begin COMPU_METHOD udf_CM_16766 "Ax + B" RAT_FUNC "%4.4" "degC" COEFFS 0.0 128.0 0.0 0.0 0.0 1.0 /end COMPU_METHOD
/begin COMPU_METHOD udf_CM_16773 "Ax + B" RAT_FUNC "%4.4" "percent" COEFFS 0.0 163.84 0.0 0.0 0.0 1.0 /end COMPU_METHOD
/begin COMPU_METHOD udf_CM_16780 "Ax + B" RAT_FUNC "%4.4" "rpm" COEFFS 0.0 4.0 0.0 0.0 0.0 1.0 /end COMPU_METHOD
/begin COMPU_METHOD udf_CM_16787 "Ax + B" RAT_FUNC "%4.4" "rpm" COEFFS 0.0 4.0 0.0 0.0 0.0 1.0 /end COMPU_METHOD
/begin COMPU_METHOD udf_CM_16794 "Ax + B" RAT_FUNC "%4.4" "rpm" COEFFS 0.0 4.0 0.0 0.0 0.0 1.0 /end COMPU_METHOD
/begin COMPU_METHOD udf_CM_16801 "Ax + B" RAT_FUNC "%4.4" "rpm" COEFFS 0.0 4.0 0.0 0.0 0.0 1.0 /end COMPU_METHOD
/begin COMPU_METHOD udf_CM_16808 "Ax + B" RAT_FUNC "%4.4" "percent" COEFFS 0.0 327.6800000536871 0.0 0.0 0.0 1.0 /end COMPU_METHOD
/begin COMPU_METHOD udf_CM_16815 "Ax + B" RAT_FUNC "%4.0" "boolean" COEFFS 0 1 0 0 0 1 /end COMPU_METHOD
/begin COMPU_METHOD udf_CM_16822 "Ax + B" RAT_FUNC "%4.0" "boolean" COEFFS 0 1 0 0 0 1 /end COMPU_METHOD
/begin COMPU_METHOD udf_CM_16829 "Ax + B" RAT_FUNC "%4.0" "count" COEFFS 0 1 0 0 0 1 /end COMPU_METHOD
/begin COMPU_METHOD udf_CM_16836 "Ax + B" RAT_FUNC "%4.4" "percent" COEFFS 0.0 327.6800000536871 0.0 0.0 0.0 1.0 /end COMPU_METHOD
/begin COMPU_METHOD udf_CM_16843 "Ax + B" RAT_FUNC "%4.4" "rpm" COEFFS 0.0 4.0 0.0 0.0 0.0 1.0 /end COMPU_METHOD
/begin COMPU_METHOD udf_CM_16850 "Ax + B" RAT_FUNC "%4.0" "boolean" COEFFS 0 1 0 0 0 1 /end COMPU_METHOD
/begin COMPU_METHOD udf_CM_16857 "Ax + B" RAT_FUNC "%4.0" "boolean" COEFFS 0 1 0 0 0 1 /end COMPU_METHOD
/begin COMPU_METHOD udf_CM_16864 "Ax + B" RAT_FUNC "%4.4" "percent" COEFFS 0.0 327.6800000536871 0.0 0.0 0.0 1.0 /end COMPU_METHOD
/begin COMPU_METHOD udf_CM_16871 "Ax + B" RAT_FUNC "%4.4" "percent" COEFFS 0.0 327.6800000536871 0.0 0.0 0.0 1.0 /end COMPU_METHOD
/begin COMPU_METHOD udf_CM_16885 "Ax + B" RAT_FUNC "%4.4" "percent" COEFFS 0.0 163.84 0.0 0.0 0.0 1.0 /end COMPU_METHOD
/begin COMPU_METHOD udf_CM_16892 "Ax + B" RAT_FUNC "%4.0" "boolean" COEFFS 0 1 0 0 0 1 /end COMPU_METHOD
/begin COMPU_METHOD udf_CM_16899 "Ax + B" RAT_FUNC "%4.4" "counts" COEFFS 0 1 0 0 0 1 /end COMPU_METHOD
/begin COMPU_METHOD udf_CM_16906 "Ax + B" RAT_FUNC "%4.0" "boolean" COEFFS 0 1 0 0 0 1 /end COMPU_METHOD
/begin COMPU_METHOD udf_CM_16913 "Ax + B" RAT_FUNC "%4.4" "volt" COEFFS 0.0 2048.0 0.0 0.0 0.0 1.0 /end COMPU_METHOD
/begin COMPU_METHOD udf_CM_16920 "Ax + B" RAT_FUNC "%4.1" "" COEFFS 0.0 2048.0 0.0 0.0 0.0 1.0 /end COMPU_METHOD
/begin COMPU_METHOD udf_CM_16927 "Ax + B" RAT_FUNC "%4.4" "volt" COEFFS 0.0 2048.0 0.0 0.0 0.0 1.0 /end COMPU_METHOD
/begin COMPU_METHOD udf_CM_16928 "Ax + B" RAT_FUNC "%4.4" "volt" COEFFS 0.0 64.0 0.0 0.0 0.0 1.0 /end COMPU_METHOD
/begin COMPU_METHOD udf_CM_16941 "Ax + B" RAT_FUNC "%4.0" "Counts" COEFFS 0 1 0 0 0 1 /end COMPU_METHOD
/begin COMPU_METHOD udf_CM_16962 "Ax + B" RAT_FUNC "%4.0" "None" COEFFS 0 1 0 0 0 1 /end COMPU_METHOD
/begin COMPU_METHOD udf_CM_16969 "Ax + B" RAT_FUNC "%4.0" "Counts" COEFFS 0 1 0 0 0 1 /end COMPU_METHOD
/begin COMPU_METHOD udf_CM_16976 "Ax + B" RAT_FUNC "%4.0" "None" COEFFS 0 1 0 0 0 1 /end COMPU_METHOD
/begin COMPU_METHOD udf_CM_16983 "Ax + B" RAT_FUNC "%4.0" "None" COEFFS 0 1 0 0 0 1 /end COMPU_METHOD
/begin COMPU_METHOD udf_CM_17032 "Ax + B" RAT_FUNC "%4.0" "None" COEFFS 0 1 0 0 0 1 /end COMPU_METHOD
/begin COMPU_METHOD udf_CM_17039 "Ax + B" RAT_FUNC "%4.0" "None" COEFFS 0 1 0 0 0 1 /end COMPU_METHOD
/begin COMPU_METHOD udf_CM_17046 "Ax + B" RAT_FUNC "%4.4" "msec" COEFFS 0.0 64.0 0.0 0.0 0.0 1.0 /end COMPU_METHOD
/begin COMPU_METHOD udf_CM_17053 "Ax + B" RAT_FUNC "%4.4" "degC" COEFFS 0.0 128.0 0.0 0.0 0.0 1.0 /end COMPU_METHOD
/begin COMPU_METHOD udf_CM_17060 "Ax + B" RAT_FUNC "%4.4" "degC" COEFFS 0.0 128.0 0.0 0.0 0.0 1.0 /end COMPU_METHOD
/begin COMPU_METHOD udf_CM_17067 "Ax + B" RAT_FUNC "%4.4" "ratio" COEFFS 0.0 1024.0 0.0 0.0 0.0 1.0 /end COMPU_METHOD
/begin COMPU_METHOD udf_CM_17074 "Ax + B" RAT_FUNC "%4.0" "None" COEFFS 0 1 0 0 0 1 /end COMPU_METHOD
/begin COMPU_METHOD udf_CM_17081 "Ax + B" RAT_FUNC "%4.4" "kpa" COEFFS 0.0 256.0 0.0 0.0 0.0 1.0 /end COMPU_METHOD
/begin COMPU_METHOD udf_CM_17088 "Ax + B" RAT_FUNC "%4.4" "kpa" COEFFS 0.0 256.0 0.0 0.0 0.0 1.0 /end COMPU_METHOD
/begin COMPU_METHOD udf_CM_17095 "Ax + B" RAT_FUNC "%4.0" "None" COEFFS 0 1 0 0 0 1 /end COMPU_METHOD
/begin COMPU_METHOD udf_CM_17102 "Ax + B" RAT_FUNC "%4.0" "boolean" COEFFS 0 1 0 0 0 1 /end COMPU_METHOD
/begin COMPU_METHOD udf_CM_17109 "Ax + B" RAT_FUNC "%4.4" "kpa" COEFFS 0.0 256.0 0.0 0.0 0.0 1.0 /end COMPU_METHOD
/begin COMPU_METHOD udf_CM_17116 "Ax + B" RAT_FUNC "%4.4" "kpa" COEFFS 0.0 256.0 0.0 0.0 0.0 1.0 /end COMPU_METHOD
/begin COMPU_METHOD udf_CM_17123 "Ax + B" RAT_FUNC "%4.4" "kpa" COEFFS 0.0 256.0 0.0 0.0 0.0 1.0 /end COMPU_METHOD
/begin COMPU_METHOD udf_CM_17130 "Ax + B" RAT_FUNC "%4.4" "kpa" COEFFS 0.0 256.0 0.0 0.0 0.0 1.0 /end COMPU_METHOD
/begin COMPU_METHOD udf_CM_17137 "Ax + B" RAT_FUNC "%4.4" "kpa" COEFFS 0.0 256.0 0.0 0.0 0.0 1.0 /end COMPU_METHOD
/begin COMPU_METHOD udf_CM_17144 "Ax + B" RAT_FUNC "%4.0" "boolean" COEFFS 0 1 0 0 0 1 /end COMPU_METHOD
/begin COMPU_METHOD udf_CM_17151 "Ax + B" RAT_FUNC "%4.4" "kpa" COEFFS 0.0 256.0 0.0 0.0 0.0 1.0 /end COMPU_METHOD
/begin COMPU_METHOD udf_CM_17158 "Ax + B" RAT_FUNC "%4.0" "boolean" COEFFS 0 1 0 0 0 1 /end COMPU_METHOD
/begin COMPU_METHOD udf_CM_17165 "Ax + B" RAT_FUNC "%4.4" "kpa" COEFFS 0.0 256.0 0.0 0.0 0.0 1.0 /end COMPU_METHOD
/begin COMPU_METHOD udf_CM_17172 "Ax + B" RAT_FUNC "%4.4" "kpa" COEFFS 0.0 256.0 0.0 0.0 0.0 1.0 /end COMPU_METHOD
/begin COMPU_METHOD udf_CM_17179 "Ax + B" RAT_FUNC "%4.4" "kpa" COEFFS 0.0 256.0 0.0 0.0 0.0 1.0 /end COMPU_METHOD
/begin COMPU_METHOD udf_CM_17186 "Ax + B" RAT_FUNC "%4.4" "kpa" COEFFS 0.0 256.0 0.0 0.0 0.0 1.0 /end COMPU_METHOD
/begin COMPU_METHOD udf_CM_17193 "Ax + B" RAT_FUNC "%4.4" "angle" COEFFS 0.0 64.0 0.0 0.0 0.0 1.0 /end COMPU_METHOD
/begin COMPU_METHOD udf_CM_17200 "Ax + B" RAT_FUNC "%4.4" "angle" COEFFS 0.0 64.0 0.0 0.0 0.0 1.0 /end COMPU_METHOD
/begin COMPU_METHOD udf_CM_17207 "Ax + B" RAT_FUNC "%4.0" "boolean" COEFFS 0 1 0 0 0 1 /end COMPU_METHOD
/begin COMPU_METHOD udf_CM_17214 "Ax + B" RAT_FUNC "%4.0" "None" COEFFS 0 1 0 0 0 1 /end COMPU_METHOD
/begin COMPU_METHOD udf_CM_17221 "Ax + B" RAT_FUNC "%4.0" "Counts" COEFFS 0 1 0 0 0 1 /end COMPU_METHOD
/begin COMPU_METHOD udf_CM_17228 "Ax + B" RAT_FUNC "%4.0" "None" COEFFS 0 1 0 0 0 1 /end COMPU_METHOD
/begin COMPU_METHOD udf_CM_17235 "Ax + B" RAT_FUNC "%4.0" "boolean" COEFFS 0 1 0 0 0 1 /end COMPU_METHOD
/begin COMPU_METHOD udf_CM_17242 "Ax + B" RAT_FUNC "%4.0" "Counts" COEFFS 0 1 0 0 0 1 /end COMPU_METHOD
/begin COMPU_METHOD udf_CM_17249 "Ax + B" RAT_FUNC "%4.0" "None" COEFFS 0 1 0 0 0 1 /end COMPU_METHOD
/begin COMPU_METHOD udf_CM_17256 "Ax + B" RAT_FUNC "%4.0" "None" COEFFS 0 1 0 0 0 1 /end COMPU_METHOD
/begin COMPU_METHOD udf_CM_17263 "Ax + B" RAT_FUNC "%4.0" "Counts" COEFFS 0 1 0 0 0 1 /end COMPU_METHOD
/begin COMPU_METHOD udf_CM_17270 "Ax + B" RAT_FUNC "%4.0" "None" COEFFS 0 1 0 0 0 1 /end COMPU_METHOD
/begin COMPU_METHOD udf_CM_17277 "Ax + B" RAT_FUNC "%4.0" "Counts" COEFFS 0 1 0 0 0 1 /end COMPU_METHOD
/begin COMPU_METHOD udf_CM_17284 "Ax + B" RAT_FUNC "%4.0" "None" COEFFS 0 1 0 0 0 1 /end COMPU_METHOD
/begin COMPU_METHOD udf_CM_17291 "Ax + B" RAT_FUNC "%4.4" "kpa" COEFFS 0.0 256.0 0.0 0.0 0.0 1.0 /end COMPU_METHOD
/begin COMPU_METHOD udf_CM_17292 "Ax + B" RAT_FUNC "%4.4" "mpa" COEFFS 0.0 4096.0 0.0 0.0 0.0 1.0 /end COMPU_METHOD
/begin COMPU_METHOD udf_CM_17293 "Ax + B" RAT_FUNC "%4.4" "kpa" COEFFS 0.0 128.0 0.0 0.0 0.0 1.0 /end COMPU_METHOD
/begin COMPU_METHOD udf_CM_17294 "Ax + B" RAT_FUNC "%4.4" "amps" COEFFS 0.0 128.0 0.0 0.0 0.0 1.0 /end COMPU_METHOD
/begin COMPU_METHOD CM_Microsecond_1 "" RAT_FUNC "%6.0" "micro-seconds" COEFFS 0.0 0.125 0.0 0.0 0.0 1.0 /end COMPU_METHOD
/begin COMPU_METHOD CM_Mult_0to2 "" RAT_FUNC "%5.4" "Mul_0_to_2" COEFFS 0.0 128.0 0.0 0.0 0.0 1.0 /end COMPU_METHOD
/begin COMPU_METHOD CM_Boolean6 "Default N=E compu method" RAT_FUNC "%10.4" "Boolean" COEFFS 0 1 0 0 0 1 /end COMPU_METHOD
/begin COMPU_METHOD udf_CM_17368 "Ax + B" RAT_FUNC "%4.4" "msec" COEFFS 0.0 64.0 0.0 0.0 0.0 1.0 /end COMPU_METHOD
/begin COMPU_METHOD udf_CM_17382 "Ax + B" RAT_FUNC "%4.0" "None" COEFFS 0 1 0 0 0 1 /end COMPU_METHOD
/begin COMPU_METHOD udf_CM_17389 "Ax + B" RAT_FUNC "%4.0" "Counts" COEFFS 0 1 0 0 0 1 /end COMPU_METHOD
/begin COMPU_METHOD udf_CM_17396 "Ax + B" RAT_FUNC "%4.0" "None" COEFFS 0 1 0 0 0 1 /end COMPU_METHOD
/begin COMPU_METHOD udf_CM_17403 "Ax + B" RAT_FUNC "%4.0" "None" COEFFS 0 1 0 0 0 1 /end COMPU_METHOD
/begin COMPU_METHOD udf_CM_17410 "Ax + B" RAT_FUNC "%4.0" "None" COEFFS 0 1 0 0 0 1 /end COMPU_METHOD
/begin COMPU_METHOD udf_CM_17417 "Ax + B" RAT_FUNC "%4.0" "Counts" COEFFS 0 1 0 0 0 1 /end COMPU_METHOD
/begin COMPU_METHOD udf_CM_17424 "Ax + B" RAT_FUNC "%4.0" "None" COEFFS 0 1 0 0 0 1 /end COMPU_METHOD
/begin COMPU_METHOD udf_CM_17431 "Ax + B" RAT_FUNC "%4.0" "None" COEFFS 0 1 0 0 0 1 /end COMPU_METHOD
/begin COMPU_METHOD udf_CM_17438 "Ax + B" RAT_FUNC "%4.4" "percent" COEFFS 0.0 327.6800000536871 0.0 0.0 0.0 1.0 /end COMPU_METHOD
/begin COMPU_METHOD udf_CM_17445 "Ax + B" RAT_FUNC "%4.0" "boolean" COEFFS 0 1 0 0 0 1 /end COMPU_METHOD
/begin COMPU_METHOD udf_CM_17452 "Ax + B" RAT_FUNC "%4.0" "boolean" COEFFS 0 1 0 0 0 1 /end COMPU_METHOD
/begin COMPU_METHOD udf_CM_17459 "Ax + B" RAT_FUNC "%4.4" "grams" COEFFS 0.0 8192.000033554432 0.0 0.0 0.0 1.0 /end COMPU_METHOD
/begin COMPU_METHOD udf_CM_17466 "Ax + B" RAT_FUNC "%4.4" "grams" COEFFS 0.0 8192.000033554432 0.0 0.0 0.0 1.0 /end COMPU_METHOD
/begin COMPU_METHOD udf_CM_17473 "Ax + B" RAT_FUNC "%4.4" "grams" COEFFS 0.0 8192.000033554432 0.0 0.0 0.0 1.0 /end COMPU_METHOD
/begin COMPU_METHOD udf_CM_17480 "Ax + B" RAT_FUNC "%4.0" "counts" COEFFS 0 1 0 0 0 1 /end COMPU_METHOD
/begin COMPU_METHOD udf_CM_17487 "Ax + B" RAT_FUNC "%4.0" "None" COEFFS 0 1 0 0 0 1 /end COMPU_METHOD
/begin COMPU_METHOD udf_CM_17494 "Ax + B" RAT_FUNC "%4.0" "None" COEFFS 0 1 0 0 0 1 /end COMPU_METHOD
/begin COMPU_METHOD udf_CM_17501 "Ax + B" RAT_FUNC "%4.0" "counts" COEFFS 0 1 0 0 0 1 /end COMPU_METHOD
/begin COMPU_METHOD udf_CM_17508 "Ax + B" RAT_FUNC "%4.0" "None" COEFFS 0 1 0 0 0 1 /end COMPU_METHOD
/begin COMPU_METHOD udf_CM_17515 "Ax + B" RAT_FUNC "%4.0" "counts" COEFFS 0 1 0 0 0 1 /end COMPU_METHOD
/begin COMPU_METHOD udf_CM_17522 "Ax + B" RAT_FUNC "%4.0" "None" COEFFS 0 1 0 0 0 1 /end COMPU_METHOD
/begin COMPU_METHOD udf_CM_17529 "Ax + B" RAT_FUNC "%4.0" "None" COEFFS 0 1 0 0 0 1 /end COMPU_METHOD
/begin COMPU_METHOD udf_CM_17536 "Ax + B" RAT_FUNC "%4.4" "millivolt" COEFFS 0.0 64.0 0.0 0.0 0.0 1.0 /end COMPU_METHOD
/begin COMPU_METHOD udf_CM_17543 "Ax + B" RAT_FUNC "%4.4" "millivolt" COEFFS 0.0 64.0 0.0 0.0 0.0 1.0 /end COMPU_METHOD
/begin COMPU_METHOD udf_CM_17557 "Ax + B" RAT_FUNC "%4.0" "None" COEFFS 0 1 0 0 0 1 /end COMPU_METHOD
/begin COMPU_METHOD udf_CM_17564 "Ax + B" RAT_FUNC "%4.0" "None" COEFFS 0 1 0 0 0 1 /end COMPU_METHOD
/begin COMPU_METHOD udf_CM_17592 "Ax + B" RAT_FUNC "%4.0" "" COEFFS 0 1 0 0 0 1 /end COMPU_METHOD
/begin COMPU_METHOD udf_CM_17606 "Ax + B" RAT_FUNC "%4.0" "None" COEFFS 0 1 0 0 0 1 /end COMPU_METHOD
/begin COMPU_METHOD udf_CM_17613 "Ax + B" RAT_FUNC "%4.0" "boolean" COEFFS 0 1 0 0 0 1 /end COMPU_METHOD
/begin COMPU_METHOD udf_CM_17620 "Ax + B" RAT_FUNC "%4.0" "None" COEFFS 0 1 0 0 0 1 /end COMPU_METHOD
/begin COMPU_METHOD udf_CM_17627 "Ax + B" RAT_FUNC "%4.0" "None" COEFFS 0 1 0 0 0 1 /end COMPU_METHOD
/begin COMPU_METHOD udf_CM_17634 "Ax + B" RAT_FUNC "%4.0" "None" COEFFS 0 1 0 0 0 1 /end COMPU_METHOD
/begin COMPU_METHOD udf_CM_17641 "Ax + B" RAT_FUNC "%4.4" "msec" COEFFS 0.0 64.0 0.0 0.0 0.0 1.0 /end COMPU_METHOD
/begin COMPU_METHOD udf_CM_17648 "Ax + B" RAT_FUNC "%4.4" "millivolt" COEFFS 0.0 64.0 0.0 0.0 0.0 1.0 /end COMPU_METHOD
/begin COMPU_METHOD udf_CM_17655 "Ax + B" RAT_FUNC "%4.4" "msec" COEFFS 0.0 64.0 0.0 0.0 0.0 1.0 /end COMPU_METHOD
/begin COMPU_METHOD udf_CM_17662 "Ax + B" RAT_FUNC "%4.0" "usec" COEFFS 0.0 1.0 0.0 0.0 0.0 1.0 /end COMPU_METHOD
/begin COMPU_METHOD udf_CM_17663 "Ax + B" RAT_FUNC "%4.4" "sec" COEFFS 0.0 1.0 0.0 0.0 0.0 1.0 /end COMPU_METHOD
/begin COMPU_METHOD udf_CM_17676 "Ax + B" RAT_FUNC "%4.0" "boolean" COEFFS 0 1 0 0 0 1 /end COMPU_METHOD
/begin COMPU_METHOD udf_CM_17683 "Ax + B" RAT_FUNC "%4.0" "None" COEFFS 0 1 0 0 0 1 /end COMPU_METHOD
/begin COMPU_METHOD udf_CM_17690 "Ax + B" RAT_FUNC "%4.0" "None" COEFFS 0 1 0 0 0 1 /end COMPU_METHOD
/begin COMPU_METHOD udf_CM_17697 "Ax + B" RAT_FUNC "%4.0" "None" COEFFS 0 1 0 0 0 1 /end COMPU_METHOD
/begin COMPU_METHOD udf_CM_17704 "Ax + B" RAT_FUNC "%4.4" "percent" COEFFS 0.0 327.6800000536871 0.0 0.0 0.0 1.0 /end COMPU_METHOD
/begin COMPU_METHOD udf_CM_17711 "Ax + B" RAT_FUNC "%4.4" "angle" COEFFS 0.0 128.0 0.0 0.0 0.0 1.0 /end COMPU_METHOD
/begin COMPU_METHOD udf_CM_17718 "Ax + B" RAT_FUNC "%4.4" "angle" COEFFS 0.0 128.0 0.0 0.0 0.0 1.0 /end COMPU_METHOD
/begin COMPU_METHOD udf_CM_17725 "Ax + B" RAT_FUNC "%4.4" "angle" COEFFS 0.0 128.0 0.0 0.0 0.0 1.0 /end COMPU_METHOD
/begin COMPU_METHOD udf_CM_17732 "Ax + B" RAT_FUNC "%4.4" "angle" COEFFS 0.0 128.0 0.0 0.0 0.0 1.0 /end COMPU_METHOD
/begin COMPU_METHOD udf_CM_17739 "Ax + B" RAT_FUNC "%4.4" "angle" COEFFS 0.0 128.0 0.0 0.0 0.0 1.0 /end COMPU_METHOD
/begin COMPU_METHOD udf_CM_17746 "Ax + B" RAT_FUNC "%4.4" "angle" COEFFS 0.0 128.0 0.0 0.0 0.0 1.0 /end COMPU_METHOD
/begin COMPU_METHOD udf_CM_17767 "Ax + B" RAT_FUNC "%4.4" "angle" COEFFS 0.0 128.0 0.0 0.0 0.0 1.0 /end COMPU_METHOD
/begin COMPU_METHOD udf_CM_17781 "Ax + B" RAT_FUNC "%4.4" "angle" COEFFS 0.0 128.0 0.0 0.0 0.0 1.0 /end COMPU_METHOD
/begin COMPU_METHOD udf_CM_17788 "Hex No Scale" RAT_FUNC "%4.4" "none" COEFFS 0 1 0 0 0 1 /end COMPU_METHOD
/begin COMPU_METHOD udf_CM_17816 "Ax + B" RAT_FUNC "%4.0" "None" COEFFS 0 1 0 0 0 1 /end COMPU_METHOD
/begin COMPU_METHOD udf_CM_17837 "Ax + B" RAT_FUNC "%4.4" "none" COEFFS 0 1 0 0 0 1 /end COMPU_METHOD
/begin COMPU_METHOD udf_CM_17921 "Ax + B" RAT_FUNC "%4.0" "boolean" COEFFS 0 1 0 0 0 1 /end COMPU_METHOD
/begin COMPU_METHOD udf_CM_17963 "Ax + B" RAT_FUNC "%4.0" "None" COEFFS 0 1 0 0 0 1 /end COMPU_METHOD
/begin COMPU_METHOD udf_CM_17991 "Ax + B" RAT_FUNC "%4.4" "msec" COEFFS 0.0 64.0 0.0 0.0 0.0 1.0 /end COMPU_METHOD
/begin COMPU_METHOD udf_CM_17998 "Ax + B" RAT_FUNC "%4.0" "None" COEFFS 0 1 0 0 0 1 /end COMPU_METHOD
/begin COMPU_METHOD udf_CM_18005 "Ax + B" RAT_FUNC "%4.4" "percent" COEFFS 0.0 655.3600001073743 0.0 0.0 0.0 1.0 /end COMPU_METHOD
/begin COMPU_METHOD udf_CM_18012 "Ax + B" RAT_FUNC "%4.0" "count" COEFFS 0 1 0 0 0 1 /end COMPU_METHOD
/begin COMPU_METHOD udf_CM_18019 "Ax + B" RAT_FUNC "%4.0" "None" COEFFS 0 1 0 0 0 1 /end COMPU_METHOD
/begin COMPU_METHOD udf_CM_18026 "Ax + B" RAT_FUNC "%4.0" "Counts" COEFFS 0 1 0 0 0 1 /end COMPU_METHOD
/begin COMPU_METHOD udf_CM_18033 "Ax + B" RAT_FUNC "%4.0" "None" COEFFS 0 1 0 0 0 1 /end COMPU_METHOD
/begin COMPU_METHOD udf_CM_18040 "Ax + B" RAT_FUNC "%4.0" "None" COEFFS 0 1 0 0 0 1 /end COMPU_METHOD
/begin COMPU_METHOD udf_CM_18047 "Ax + B" RAT_FUNC "%4.0" "None" COEFFS 0 1 0 0 0 1 /end COMPU_METHOD
/begin COMPU_METHOD udf_CM_18054 "Ax + B" RAT_FUNC "%4.0" "Counts" COEFFS 0 1 0 0 0 1 /end COMPU_METHOD
/begin COMPU_METHOD udf_CM_18061 "Ax + B" RAT_FUNC "%4.0" "None" COEFFS 0 1 0 0 0 1 /end COMPU_METHOD
/begin COMPU_METHOD udf_CM_18068 "Ax + B" RAT_FUNC "%4.0" "None" COEFFS 0 1 0 0 0 1 /end COMPU_METHOD
/begin COMPU_METHOD udf_CM_18075 "Ax + B" RAT_FUNC "%4.0" "None" COEFFS 0 1 0 0 0 1 /end COMPU_METHOD
/begin COMPU_METHOD udf_CM_18082 "Ax + B" RAT_FUNC "%4.0" "Counts" COEFFS 0 1 0 0 0 1 /end COMPU_METHOD
/begin COMPU_METHOD udf_CM_18089 "Ax + B" RAT_FUNC "%4.0" "None" COEFFS 0 1 0 0 0 1 /end COMPU_METHOD
/begin COMPU_METHOD udf_CM_18096 "Ax + B" RAT_FUNC "%4.0" "None" COEFFS 0 1 0 0 0 1 /end COMPU_METHOD
/begin COMPU_METHOD udf_CM_18103 "Ax + B" RAT_FUNC "%4.0" "None" COEFFS 0 1 0 0 0 1 /end COMPU_METHOD
/begin COMPU_METHOD udf_CM_18110 "Ax + B" RAT_FUNC "%4.0" "Counts" COEFFS 0 1 0 0 0 1 /end COMPU_METHOD
/begin COMPU_METHOD udf_CM_18117 "Ax + B" RAT_FUNC "%4.0" "None" COEFFS 0 1 0 0 0 1 /end COMPU_METHOD
/begin COMPU_METHOD udf_CM_18124 "Ax + B" RAT_FUNC "%4.0" "None" COEFFS 0 1 0 0 0 1 /end COMPU_METHOD
/begin COMPU_METHOD udf_CM_18131 "Ax + B" RAT_FUNC "%4.0" "None" COEFFS 0 1 0 0 0 1 /end COMPU_METHOD
/begin COMPU_METHOD udf_CM_18138 "Ax + B" RAT_FUNC "%4.0" "None" COEFFS 0 1 0 0 0 1 /end COMPU_METHOD
/begin COMPU_METHOD udf_CM_18159 "Ax + B" RAT_FUNC "%4.0" "counts" COEFFS 0 1 0 0 0 1 /end COMPU_METHOD
/begin COMPU_METHOD udf_CM_18166 "Ax + B" RAT_FUNC "%4.0" "counts" COEFFS 0 1 0 0 0 1 /end COMPU_METHOD
/begin COMPU_METHOD udf_CM_18173 "Ax + B" RAT_FUNC "%4.0" "counts" COEFFS 0 1 0 0 0 1 /end COMPU_METHOD
/begin COMPU_METHOD udf_CM_18180 "Ax + B" RAT_FUNC "%4.4" "percent" COEFFS 0.0 327.6800000536871 0.0 0.0 0.0 1.0 /end COMPU_METHOD
/begin COMPU_METHOD udf_CM_18187 "Ax + B" RAT_FUNC "%4.0" "None" COEFFS 0 1 0 0 0 1 /end COMPU_METHOD
/begin COMPU_METHOD udf_CM_18194 "Ax + B" RAT_FUNC "%4.0" "Counts" COEFFS 0 1 0 0 0 1 /end COMPU_METHOD
/begin COMPU_METHOD udf_CM_18201 "Ax + B" RAT_FUNC "%4.0" "None" COEFFS 0 1 0 0 0 1 /end COMPU_METHOD
/begin COMPU_METHOD udf_CM_18208 "Ax + B" RAT_FUNC "%4.0" "Counts" COEFFS 0 1 0 0 0 1 /end COMPU_METHOD
/begin COMPU_METHOD udf_CM_18215 "Ax + B" RAT_FUNC "%4.0" "None" COEFFS 0 1 0 0 0 1 /end COMPU_METHOD
/begin COMPU_METHOD udf_CM_18222 "Ax + B" RAT_FUNC "%4.0" "None" COEFFS 0 1 0 0 0 1 /end COMPU_METHOD
/begin COMPU_METHOD udf_CM_18229 "Ax + B" RAT_FUNC "%4.4" "percent" COEFFS 0.0 327.6800000536871 0.0 0.0 0.0 1.0 /end COMPU_METHOD
/begin COMPU_METHOD udf_CM_18236 "Ax + B" RAT_FUNC "%4.4" "percent" COEFFS 0.0 327.6800000536871 0.0 0.0 0.0 1.0 /end COMPU_METHOD
/begin COMPU_METHOD udf_CM_18250 "Ax + B" RAT_FUNC "%4.0" "None" COEFFS 0 1 0 0 0 1 /end COMPU_METHOD
/begin COMPU_METHOD udf_CM_18257 "Ax + B" RAT_FUNC "%4.0" "Counts" COEFFS 0 1 0 0 0 1 /end COMPU_METHOD
/begin COMPU_METHOD udf_CM_18264 "Ax + B" RAT_FUNC "%4.0" "None" COEFFS 0 1 0 0 0 1 /end COMPU_METHOD
/begin COMPU_METHOD udf_CM_18271 "Ax + B" RAT_FUNC "%4.0" "None" COEFFS 0 1 0 0 0 1 /end COMPU_METHOD
/begin COMPU_METHOD udf_CM_18278 "Ax + B" RAT_FUNC "%4.0" "Counts" COEFFS 0 1 0 0 0 1 /end COMPU_METHOD
/begin COMPU_METHOD udf_CM_18285 "Ax + B" RAT_FUNC "%4.0" "None" COEFFS 0 1 0 0 0 1 /end COMPU_METHOD
/begin COMPU_METHOD udf_CM_18292 "Ax + B" RAT_FUNC "%4.0" "None" COEFFS 0 1 0 0 0 1 /end COMPU_METHOD
/begin COMPU_METHOD udf_CM_18299 "Ax + B" RAT_FUNC "%4.0" "Couints" COEFFS 0 1 0 0 0 1 /end COMPU_METHOD
/begin COMPU_METHOD CM_EnumFaultType "" RAT_FUNC "%1.0" "enum" COEFFS 0 1 0 0 0 1 /end COMPU_METHOD
/begin COMPU_METHOD CM_FiltCoef "" RAT_FUNC "%7.6" "coef" COEFFS 0.0 65536.00026843546 0.0 0.0 0.0 1.0 /end COMPU_METHOD
/begin COMPU_METHOD udf_CM_18376 "" RAT_FUNC "%7.5" "ratio" COEFFS 0.0 4096.0 0.0 0.0 0.0 1.0 /end COMPU_METHOD
/begin COMPU_METHOD CM_Seconds "" RAT_FUNC "%4.1" "seconds" COEFFS 0.0 2.0 0.0 0.0 0.0 1.0 /end COMPU_METHOD
/begin COMPU_METHOD CM_Percent_0to100_1 "" RAT_FUNC "%6.4" "percent" COEFFS 0.0 655.3603892316423 0.0 0.0 0.0 1.0 /end COMPU_METHOD
/begin COMPU_METHOD CM_Percent_0to200_2 "" RAT_FUNC "%7.4" "percent" COEFFS 0.0 327.6800872415464 0.0 0.0 0.0 1.0 /end COMPU_METHOD
/begin COMPU_METHOD CM_Ratio_0to4 "" RAT_FUNC "%6.5" "ratio" COEFFS 0.0 16384.00006710886 0.0 0.0 0.0 1.0 /end COMPU_METHOD
/begin COMPU_METHOD CM_Ratio_n512to512 "" RAT_FUNC "%7.4" "kpa" COEFFS 0.0 64.0 0.0 0.0 0.0 1.0 /end COMPU_METHOD
/begin COMPU_METHOD CM_CrankAngle_0to1024_1 "" RAT_FUNC "%7.3" "" COEFFS 0.0 64.0 0.0 0.0 0.0 1.0 /end COMPU_METHOD
/begin COMPU_METHOD udf_CM_18677 "Ax + B" RAT_FUNC "%4.4" "Gram" COEFFS 0.0 128.0 0.0 0.0 0.0 1.0 /end COMPU_METHOD
/begin COMPU_METHOD udf_CM_18684 "Ax + B" RAT_FUNC "%4.4" "Gram" COEFFS 0.0 128.0 0.0 0.0 0.0 1.0 /end COMPU_METHOD
/begin COMPU_METHOD CM_CrankAngle_0to512 "" RAT_FUNC "%7.4" "degrees" COEFFS 0.0 128.0 0.0 0.0 0.0 1.0 /end COMPU_METHOD
/begin COMPU_METHOD udf_CM_18726 "Ax + B" RAT_FUNC "%4.4" "percent" COEFFS 0.0 327.6800000536871 0.0 0.0 0.0 1.0 /end COMPU_METHOD
/begin COMPU_METHOD udf_CM_18733 "Ax + B" RAT_FUNC "%4.4" "percent" COEFFS 0.0 327.6800000536871 0.0 0.0 0.0 1.0 /end COMPU_METHOD
/begin COMPU_METHOD udf_CM_18740 "Ax + B" RAT_FUNC "%4.0" "boolean" COEFFS 0 1 0 0 0 1 /end COMPU_METHOD
/begin COMPU_METHOD udf_CM_18747 "Ax + B" RAT_FUNC "%4.4" "percent" COEFFS 0.0 163.84 0.0 0.0 0.0 1.0 /end COMPU_METHOD
/begin COMPU_METHOD udf_CM_18754 "Ax + B" RAT_FUNC "%4.4" "percent" COEFFS 0.0 163.84 0.0 0.0 0.0 1.0 /end COMPU_METHOD
/begin COMPU_METHOD udf_CM_18761 "Ax + B" RAT_FUNC "%4.4" "percent" COEFFS 0.0 163.84 0.0 0.0 0.0 1.0 /end COMPU_METHOD
/begin COMPU_METHOD udf_CM_18768 "Ax + B" RAT_FUNC "%4.4" "percent" COEFFS 0.0 327.6800000536871 0.0 0.0 0.0 1.0 /end COMPU_METHOD
/begin COMPU_METHOD udf_CM_18775 "Ax + B" RAT_FUNC "%4.4" "percent" COEFFS 0.0 327.6800000536871 0.0 0.0 0.0 1.0 /end COMPU_METHOD
/begin COMPU_METHOD udf_CM_18782 "Ax + B" RAT_FUNC "%4.4" "percent" COEFFS 0.0 327.6800000536871 0.0 0.0 0.0 1.0 /end COMPU_METHOD
/begin COMPU_METHOD udf_CM_18789 "Ax + B" RAT_FUNC "%4.4" "percent" COEFFS 0.0 327.6800000536871 0.0 0.0 0.0 1.0 /end COMPU_METHOD
/begin COMPU_METHOD udf_CM_18796 "Ax + B" RAT_FUNC "%4.0" "boolean" COEFFS 0 1 0 0 0 1 /end COMPU_METHOD
/begin COMPU_METHOD udf_CM_18803 "Ax + B" RAT_FUNC "%4.0" "none" COEFFS 0 1 0 0 0 1 /end COMPU_METHOD
/begin COMPU_METHOD udf_CM_18810 "Ax + B" RAT_FUNC "%4.4" "percent" COEFFS 0.0 327.6800000536871 0.0 0.0 0.0 1.0 /end COMPU_METHOD
/begin COMPU_METHOD udf_CM_18817 "Ax + B" RAT_FUNC "%4.0" "boolean" COEFFS 0 1 0 0 0 1 /end COMPU_METHOD
/begin COMPU_METHOD udf_CM_18824 "Ax + B" RAT_FUNC "%4.0" "counts" COEFFS 0 1 0 0 0 1 /end COMPU_METHOD
/begin COMPU_METHOD udf_CM_18831 "Ax + B" RAT_FUNC "%4.4" "percent" COEFFS 0.0 327.6800000536871 0.0 0.0 0.0 1.0 /end COMPU_METHOD
/begin COMPU_METHOD udf_CM_18838 "Ax + B" RAT_FUNC "%4.0" "None" COEFFS 0 1 0 0 0 1 /end COMPU_METHOD
/begin COMPU_METHOD udf_CM_18845 "Ax + B" RAT_FUNC "%4.0" "Counts" COEFFS 0 1 0 0 0 1 /end COMPU_METHOD
/begin COMPU_METHOD udf_CM_18852 "Ax + B" RAT_FUNC "%4.0" "None" COEFFS 0 1 0 0 0 1 /end COMPU_METHOD
/begin COMPU_METHOD udf_CM_18859 "Ax + B" RAT_FUNC "%4.0" "None" COEFFS 0 1 0 0 0 1 /end COMPU_METHOD
/begin COMPU_METHOD udf_CM_18866 "Ax + B" RAT_FUNC "%4.0" "Counts" COEFFS 0 1 0 0 0 1 /end COMPU_METHOD
/begin COMPU_METHOD udf_CM_18873 "Ax + B" RAT_FUNC "%4.0" "None" COEFFS 0 1 0 0 0 1 /end COMPU_METHOD
/begin COMPU_METHOD udf_CM_18880 "Ax + B" RAT_FUNC "%4.0" "Counts" COEFFS 0 1 0 0 0 1 /end COMPU_METHOD
/begin COMPU_METHOD udf_CM_18887 "Ax + B" RAT_FUNC "%4.0" "None" COEFFS 0 1 0 0 0 1 /end COMPU_METHOD
/begin COMPU_METHOD udf_CM_18894 "Ax + B" RAT_FUNC "%4.0" "None" COEFFS 0 1 0 0 0 1 /end COMPU_METHOD
/begin COMPU_METHOD udf_CM_18901 "Ax + B" RAT_FUNC "%4.4" "percent" COEFFS 0.0 327.6800000536871 0.0 0.0 0.0 1.0 /end COMPU_METHOD
/begin COMPU_METHOD udf_CM_18908 "Ax + B" RAT_FUNC "%4.4" "gm" COEFFS 0.0 4096.0 0.0 0.0 0.0 1.0 /end COMPU_METHOD
/begin COMPU_METHOD CM_Count_0to65535_1 "" RAT_FUNC "%5.0" "counts" COEFFS 0 1 0 0 0 1 /end COMPU_METHOD
/begin COMPU_METHOD CM_Count_0to65535_2 "" RAT_FUNC "%5.0" "None" COEFFS 0 1 0 0 0 1 /end COMPU_METHOD
/begin COMPU_METHOD udf_CM_19006 "" RAT_FUNC "%4.3" "second" COEFFS 0.0 32.0 0.0 0.0 0.0 1.0 /end COMPU_METHOD
/begin COMPU_METHOD udf_CM_19020 "Ax + B" RAT_FUNC "%4.4" "kpa" COEFFS 0.0 256.0 0.0 0.0 0.0 1.0 /end COMPU_METHOD
/begin COMPU_METHOD udf_CM_19027 "Ax + B" RAT_FUNC "%4.4" "kpa" COEFFS 0.0 256.0 0.0 0.0 0.0 1.0 /end COMPU_METHOD
/begin COMPU_METHOD udf_CM_19048 "Ax + B" RAT_FUNC "%4.4" "ratio" COEFFS 0.0 32768.00013421773 0.0 0.0 0.0 1.0 /end COMPU_METHOD
/begin COMPU_METHOD udf_CM_19174 "Ax + B" RAT_FUNC "%4.4" "msec" COEFFS 0.0 16.0 0.0 0.0 0.0 1.0 /end COMPU_METHOD
/begin COMPU_METHOD udf_CM_19230 "Ax + B" RAT_FUNC "%4.0" "boolean" COEFFS 0 1 0 0 0 1 /end COMPU_METHOD
/begin COMPU_METHOD udf_CM_19244 "Ax + B" RAT_FUNC "%4.0" "None" COEFFS 0 1 0 0 0 1 /end COMPU_METHOD
/begin COMPU_METHOD udf_CM_19335 "Ax + B" RAT_FUNC "%4.0" "boolean" COEFFS 0 1 0 0 0 1 /end COMPU_METHOD
/begin COMPU_METHOD udf_CM_19370 "Ax + B" RAT_FUNC "%4.0" "count" COEFFS 0 1 0 0 0 1 /end COMPU_METHOD
/begin COMPU_METHOD udf_CM_19377 "Ax + B" RAT_FUNC "%4.0" "Counts" COEFFS 0 1 0 0 0 1 /end COMPU_METHOD
/begin COMPU_METHOD udf_CM_19384 "Ax + B" RAT_FUNC "%4.0" "None" COEFFS 0 1 0 0 0 1 /end COMPU_METHOD
/begin COMPU_METHOD udf_CM_19398 "Ax + B" RAT_FUNC "%4.4" "percent" COEFFS 0.0 327.6800000536871 0.0 0.0 0.0 1.0 /end COMPU_METHOD
/begin COMPU_METHOD udf_CM_19412 "Ax + B" RAT_FUNC "%4.0" "None" COEFFS 0 1 0 0 0 1 /end COMPU_METHOD
/begin COMPU_METHOD udf_CM_19503 "Ax + B" RAT_FUNC "%4.4" "kpa" COEFFS 0.0 256.0 0.0 0.0 0.0 1.0 /end COMPU_METHOD
/begin COMPU_VTAB CM_EOI_TAB "" TAB_VERB 4 0 "Cyl1" 1 "Cyl2" 2 "Cyl3" 3 "Cyl4" /end COMPU_VTAB
/begin COMPU_VTAB CM_LIGHT_TYPE_TAB "" TAB_VERB 5 0 "NONE" 1 "MIL" 2 "STOP" 3 "WARNING" 4 "PROTECT" /end COMPU_VTAB
/begin COMPU_TAB DFLT_LIN_TAB "" TAB_INTP 1 1 1.0 /end COMPU_TAB
/begin COMPU_VTAB udf_CV_19704 "" TAB_VERB 2 0 "OFF" 1 "ON" /end COMPU_VTAB
/begin COMPU_VTAB udf_CV_19710 "" TAB_VERB 7 0 "0_EngineOff" 1 "1_KeyOn" 2 "2_Cranking" 3 "3_Run" 4 "4_Stall" 5 "5_ShutDownDelay" 6 "6_ShutDown" /end COMPU_VTAB
/begin COMPU_VTAB udf_CV_19711 "" TAB_VERB 3 0 "0_Petrol" 1 "1_NG" 2 "2_LPG" /end COMPU_VTAB
/begin COMPU_VTAB udf_CV_19716 "" TAB_VERB 2 0 "LEAN" 1 "RICH" /end COMPU_VTAB
/begin COMPU_VTAB udf_CV_19722 "" TAB_VERB 2 0 "LEAN" 1 "RICH" /end COMPU_VTAB
/begin COMPU_VTAB udf_CV_19728 "" TAB_VERB 2 0 "LEAN" 1 "RICH" /end COMPU_VTAB
/begin COMPU_VTAB udf_CV_19734 "" TAB_VERB 4 0 "NotMovingSt" 1 "ThrottleCloseSt" 2 "PauseSt" 3 "ThrottleOpenSt" /end COMPU_VTAB
/begin COMPU_VTAB udf_CV_19740 "" TAB_VERB 3 0 "ThrottleStable" 1 "ThrottleOpen" 2 "ThrottleClose" /end COMPU_VTAB
/begin RECORD_LAYOUT 2D_Array_UB FNC_VALUES 1 UBYTE COLUMN_DIR DIRECT ALIGNMENT_WORD 1 ALIGNMENT_LONG 2 /end RECORD_LAYOUT
/begin RECORD_LAYOUT Scalar_UB FNC_VALUES 1 UBYTE COLUMN_DIR DIRECT ALIGNMENT_WORD 1 ALIGNMENT_LONG 2 /end RECORD_LAYOUT
/begin RECORD_LAYOUT Scalar_UW FNC_VALUES 1 UWORD COLUMN_DIR DIRECT ALIGNMENT_WORD 1 ALIGNMENT_LONG 2 /end RECORD_LAYOUT
/begin RECORD_LAYOUT Scalar_UL FNC_VALUES 1 ULONG COLUMN_DIR DIRECT ALIGNMENT_WORD 1 ALIGNMENT_LONG 2 /end RECORD_LAYOUT
/end MODULE
/end PROJECT
