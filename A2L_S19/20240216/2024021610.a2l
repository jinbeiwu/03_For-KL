ASAP2_VERSION 1 40
/begin PROJECT RS19_Prod ""
/begin HEADER "" VERSION "" /end HEADER
/begin MODULE RS19_Prod ""
/begin MOD_COMMON "" BYTE_ORDER MSB_FIRST ALIGNMENT_BYTE 1 ALIGNMENT_WORD 1 ALIGNMENT_LONG 2 ALIGNMENT_FLOAT32_IEEE 4 ALIGNMENT_FLOAT64_IEEE 8 /end MOD_COMMON
/begin CHARACTERISTIC D_O21ShortDiagCoolTempThrsh "cal comments" VALUE 0xC208 Scalar_SW 0.0 CM_DegC_N256to256 -256.0 255.9921875 /end CHARACTERISTIC
/begin CHARACTERISTIC D_O21ShortDiagEnableDelay "cal comments" VALUE 0xC20A Scalar_UW 0.0 CM_Second_0to65535 0.0 65535.0 /end CHARACTERISTIC
/begin CHARACTERISTIC D_O21ShortDiagIGNVoltThrsh "cal comments" VALUE 0xC206 Scalar_UW 0.0 CM_Volt_0to32_1 0.0 31.99900627136231 /end CHARACTERISTIC
/begin CHARACTERISTIC D_O21ShortDiagPassTimeThrsh "cal comments" VALUE 0xC214 Scalar_UW 0.0 CM_Count_0to65535_1 0.0 65535.0 /end CHARACTERISTIC
/begin CHARACTERISTIC D_O21ShortDiagSingalFiltCoef "cal comments" VALUE 0xC204 Scalar_UW 0.0 CM_FiltCoef 0.0 0.9999847412109375 /end CHARACTERISTIC
/begin CHARACTERISTIC D_O21ShortEnb "cal comments" VALUE 0xC216 Scalar_UB 0.0 CM_Boolean6 0.0 255.0 /end CHARACTERISTIC
/begin CHARACTERISTIC D_O21ShortHighFailTimeThrsh "cal comments" VALUE 0xC212 Scalar_UW 0.0 CM_Count_0to65535_1 0.0 65535.0 /end CHARACTERISTIC
/begin CHARACTERISTIC D_O21ShortLowFailTimeThrsh "cal comments" VALUE 0xC210 Scalar_UW 0.0 CM_Count_0to65535_1 0.0 65535.0 /end CHARACTERISTIC
/begin CHARACTERISTIC D_O21ShortRangeThreshHi "cal comments" VALUE 0xC20E Scalar_UW 0.0 CM_mVolt_2 0.0 1023.96875 /end CHARACTERISTIC
/begin CHARACTERISTIC D_O21ShortRangeThreshLo "cal comments" VALUE 0xC20C Scalar_UW 0.0 CM_mVolt_2 0.0 1023.96875 /end CHARACTERISTIC
/begin CHARACTERISTIC D_O2HeaterShortEnb "cal comments" VALUE 0xC259 Scalar_UB 0.0 CM_Boolean6 0.0 255.0 /end CHARACTERISTIC
/begin CHARACTERISTIC D_O2HeaterShortFailThresh "cal comments" VALUE 0xC25A Scalar_UB 0.0 CM_Count1 0.0 255.0 /end CHARACTERISTIC
/begin CHARACTERISTIC D_O2HeaterShortPassThresh "cal comments" VALUE 0xC25B Scalar_UB 0.0 CM_Count1 0.0 255.0 /end CHARACTERISTIC
/begin CHARACTERISTIC D_O2Heater2ShortEnb "cal comments" VALUE 0xC25E Scalar_UB 0.0 CM_Boolean6 0.0 255.0 /end CHARACTERISTIC
/begin CHARACTERISTIC D_O2Heater2ShortFailThresh "cal comments" VALUE 0xC25F Scalar_UB 0.0 CM_Count1 0.0 255.0 /end CHARACTERISTIC
/begin CHARACTERISTIC D_O2Heater2ShortPassThresh "cal comments" VALUE 0xC260 Scalar_UB 0.0 CM_Count1 0.0 255.0 /end CHARACTERISTIC
/begin CHARACTERISTIC D_BSTCShortEnb "cal comments" VALUE 0xC27C Scalar_UB 0.0 CM_Boolean6 0.0 255.0 /end CHARACTERISTIC
/begin CHARACTERISTIC D_BSTCShortFailThresh "cal comments" VALUE 0xC27D Scalar_UB 0.0 CM_Count1 0.0 255.0 /end CHARACTERISTIC
/begin CHARACTERISTIC D_BSTCShortPassThresh "cal comments" VALUE 0xC27E Scalar_UB 0.0 CM_Count1 0.0 255.0 /end CHARACTERISTIC
/begin CHARACTERISTIC D_REF1ShortEnb "cal comments" VALUE 0xC272 Scalar_UB 0.0 CM_Boolean6 0.0 255.0 /end CHARACTERISTIC
/begin CHARACTERISTIC D_REF1ShortFailThresh "cal comments" VALUE 0xC273 Scalar_UB 0.0 CM_Count1 0.0 255.0 /end CHARACTERISTIC
/begin CHARACTERISTIC D_REF1ShortPassThresh "cal comments" VALUE 0xC274 Scalar_UB 0.0 CM_Count1 0.0 255.0 /end CHARACTERISTIC
/begin CHARACTERISTIC D_REF2ShortEnb "cal comments" VALUE 0xC277 Scalar_UB 0.0 CM_Boolean6 0.0 255.0 /end CHARACTERISTIC
/begin CHARACTERISTIC D_REF2ShortFailThresh "cal comments" VALUE 0xC278 Scalar_UB 0.0 CM_Count1 0.0 255.0 /end CHARACTERISTIC
/begin CHARACTERISTIC D_REF2ShortPassThresh "cal comments" VALUE 0xC279 Scalar_UB 0.0 CM_Count1 0.0 255.0 /end CHARACTERISTIC
/begin CHARACTERISTIC D_FCV1ShortEnb "cal comments" VALUE 0xC268 Scalar_UB 0.0 CM_Boolean6 0.0 255.0 /end CHARACTERISTIC
/begin CHARACTERISTIC D_IACVShortEnb "cal comments" VALUE 0xC263 Scalar_UB 0.0 CM_Boolean6 0.0 255.0 /end CHARACTERISTIC
/begin CHARACTERISTIC D_IACVShortFailThresh "cal comments" VALUE 0xC264 Scalar_UB 0.0 CM_Count1 0.0 255.0 /end CHARACTERISTIC
/begin CHARACTERISTIC D_IACVShortPassThresh "cal comments" VALUE 0xC265 Scalar_UB 0.0 CM_Count1 0.0 255.0 /end CHARACTERISTIC
/begin CHARACTERISTIC D_FCV1ShortFailThresh "cal comments" VALUE 0xC269 Scalar_UB 0.0 CM_Count1 0.0 255.0 /end CHARACTERISTIC
/begin CHARACTERISTIC D_FCV1ShortPassThresh "cal comments" VALUE 0xC26A Scalar_UB 0.0 CM_Count1 0.0 255.0 /end CHARACTERISTIC
/begin CHARACTERISTIC D_FCV2ShortEnb "cal comments" VALUE 0xC26D Scalar_UB 0.0 CM_Boolean6 0.0 255.0 /end CHARACTERISTIC
/begin CHARACTERISTIC D_FCV2ShortFailThresh "cal comments" VALUE 0xC26E Scalar_UB 0.0 CM_Count1 0.0 255.0 /end CHARACTERISTIC
/begin CHARACTERISTIC D_FCV2ShortPassThresh "cal comments" VALUE 0xC26F Scalar_UB 0.0 CM_Count1 0.0 255.0 /end CHARACTERISTIC
/begin CHARACTERISTIC D_OutputDiagEnableDelay "cal comments" VALUE 0xC356 Scalar_UB 0.0 CM_Second_0to64 0.0 63.75 /end CHARACTERISTIC
/begin CHARACTERISTIC D_SoftwareErrorEnb "cal comments" VALUE 0xC36C Scalar_UB 0.0 CM_Boolean6 0.0 255.0 /end CHARACTERISTIC
/begin CHARACTERISTIC D_SoftwareErrorFailTimeThrsh "cal comments" VALUE 0xC368 Scalar_UW 0.0 CM_Count_0to65535_2 0.0 65535.0 /end CHARACTERISTIC
/begin CHARACTERISTIC D_SoftwareErrorPassTimeThrsh "cal comments" VALUE 0xC36A Scalar_UW 0.0 CM_Count_0to65535_2 0.0 65535.0 /end CHARACTERISTIC
/begin CHARACTERISTIC D_FPFeedbackInputEnb "cal comments" VALUE 0xC23E Scalar_UB 0.0 CM_Boolean6 0.0 255.0 /end CHARACTERISTIC
/begin CHARACTERISTIC D_FPFeedbackShortFailThresh "cal comments" VALUE 0xC23C Scalar_UB 0.0 CM_Count3 0.0 255.0 /end CHARACTERISTIC
/begin CHARACTERISTIC D_FPFeedbackShortPassThresh "cal comments" VALUE 0xC23D Scalar_UB 0.0 CM_Count3 0.0 255.0 /end CHARACTERISTIC
/begin CHARACTERISTIC D_OilPressureInputEnb "cal comments" VALUE 0xC347 Scalar_UB 0.0 CM_Boolean6 0.0 255.0 /end CHARACTERISTIC
/begin CHARACTERISTIC D_OilPressureShortFailThresh "cal comments" VALUE 0xC345 Scalar_UB 0.0 CM_Count3 0.0 255.0 /end CHARACTERISTIC
/begin CHARACTERISTIC D_OilPressureShortPassThresh "cal comments" VALUE 0xC346 Scalar_UB 0.0 CM_Count3 0.0 255.0 /end CHARACTERISTIC
/begin CHARACTERISTIC D_OilPressureShortDetectDelay "cal comments" VALUE 0xC344 Scalar_UB 0.0 CM_Count3 0.0 255.0 /end CHARACTERISTIC
/begin CHARACTERISTIC D_OilSWLowActive "cal comments" VALUE 0xC348 Scalar_UB 0.0 CM_Boolean6 0.0 255.0 /end CHARACTERISTIC
/begin CHARACTERISTIC D_OilSWDiagKeyOn "cal comments" VALUE 0xC349 Scalar_UB 0.0 CM_Boolean6 0.0 255.0 /end CHARACTERISTIC
/begin CHARACTERISTIC D_OilSWAnalogused "cal comments" VALUE 0xC34A Scalar_UB 0.0 CM_Boolean6 0.0 255.0 /end CHARACTERISTIC
/begin CHARACTERISTIC D_OilSWShortRangeThreshLo "cal comments" VALUE 0xC34C Scalar_UW 0.0 CM_Percent_0to100_1 0.0 99.9984130859375 /end CHARACTERISTIC
/begin CHARACTERISTIC D_OilSWShortRangeThreshHi "cal comments" VALUE 0xC34E Scalar_UW 0.0 CM_Percent_0to100_1 0.0 99.9984130859375 /end CHARACTERISTIC
/begin CHARACTERISTIC D_SpkCoilShortFailThresh "cal comments" CURVE 0xC357 2D_Array_UB 0.0 CM_Count1 0.0 255.0
 /begin AXIS_DESCR FIX_AXIS NO_INPUT_QUANTITY CM_EOI 4 0.0 4.0 MAX_GRAD 0.0 /begin FIX_AXIS_PAR_LIST 0 1 2 3 /end FIX_AXIS_PAR_LIST /end AXIS_DESCR
/end CHARACTERISTIC
/begin CHARACTERISTIC D_SpkCoilShortPassThresh "cal comments" CURVE 0xC35B 2D_Array_UB 0.0 CM_Count1 0.0 255.0
 /begin AXIS_DESCR FIX_AXIS NO_INPUT_QUANTITY CM_EOI 4 0.0 4.0 MAX_GRAD 0.0 /begin FIX_AXIS_PAR_LIST 0 1 2 3 /end FIX_AXIS_PAR_LIST /end AXIS_DESCR
/end CHARACTERISTIC
/begin CHARACTERISTIC D_TPSMotorControlEnb "cal comments" VALUE 0xC282 Scalar_UB 0.0 CM_Boolean6 0.0 255.0 /end CHARACTERISTIC
/begin CHARACTERISTIC D_TPSMotorDiagFailTimeThresh "cal comments" VALUE 0xC284 Scalar_UW 0.0 CM_Count_0to65535_1 0.0 65535.0 /end CHARACTERISTIC
/begin CHARACTERISTIC D_TPSMotorDiagPassTimeThresh "cal comments" VALUE 0xC286 Scalar_UW 0.0 CM_Count_0to65535_1 0.0 65535.0 /end CHARACTERISTIC
/begin CHARACTERISTIC D_TPSMotorDiagTPSErrThresh "cal comments" VALUE 0xC28C Scalar_UW 0.0 CM_Percent_0to200_2 0.0 199.9969024658203 /end CHARACTERISTIC
/begin CHARACTERISTIC D_TPSMotorDynErrThrDecayStep "cal comments" VALUE 0xC28A Scalar_UW 0.0 CM_Percent_0to200_2 0.0 199.9969024658203 /end CHARACTERISTIC
/begin CHARACTERISTIC D_TPSMotorDynErrThrshGain "cal comments" VALUE 0xC288 Scalar_UW 0.0 udf_CM_18376 0.0 15.999755859375 /end CHARACTERISTIC
/begin CHARACTERISTIC D_FCVMotorControlEnb "cal comments" VALUE 0xC24C Scalar_UB 0.0 CM_Boolean6 0.0 255.0 /end CHARACTERISTIC
/begin CHARACTERISTIC D_FCVMotorDiagFailTimeThresh "cal comments" VALUE 0xC24E Scalar_UW 0.0 CM_Count_0to65535_1 0.0 65535.0 /end CHARACTERISTIC
/begin CHARACTERISTIC D_FCVMotorDiagPassTimeThresh "cal comments" VALUE 0xC250 Scalar_UW 0.0 CM_Count_0to65535_1 0.0 65535.0 /end CHARACTERISTIC
/begin CHARACTERISTIC D_FCVMotorDiagFCVPSErrThresh "cal comments" VALUE 0xC256 Scalar_UW 0.0 CM_Percent_0to200_2 0.0 199.9969024658203 /end CHARACTERISTIC
/begin CHARACTERISTIC D_FCVMotorDynErrThrDecayStep "cal comments" VALUE 0xC254 Scalar_UW 0.0 CM_Percent_0to200_2 0.0 199.9969024658203 /end CHARACTERISTIC
/begin CHARACTERISTIC D_FCVMotorDynErrThrshGain "cal comments" VALUE 0xC252 Scalar_UW 0.0 udf_CM_18376 0.0 15.999755859375 /end CHARACTERISTIC
/begin CHARACTERISTIC D_SWLOnMinDuration "cal comments" VALUE 0xC1DB Scalar_UB 0.0 CM_Seconds 0.0 127.5 /end CHARACTERISTIC
/begin CHARACTERISTIC D_IGNOffInitDDMS "cal comments" VALUE 0xC1DC Scalar_UB 0.0 CM_Boolean1 0.0 1.0 /end CHARACTERISTIC
/begin CHARACTERISTIC D_StopLightKillEn "cal comments" VALUE 0xC1DD Scalar_UB 0.0 CM_Boolean1 0.0 1.0 /end CHARACTERISTIC
/begin CHARACTERISTIC D_O21ShortLoLightType "cal comments" VALUE 0xC217 Scalar_UB 0.0 CM_LIGHT_TYPE 0.0 4.0 /end CHARACTERISTIC
/begin CHARACTERISTIC D_O21ShortHiLightType "cal comments" VALUE 0xC218 Scalar_UB 0.0 CM_LIGHT_TYPE 0.0 4.0 /end CHARACTERISTIC
/begin CHARACTERISTIC D_O2HeaterShortLoLightType "cal comments" VALUE 0xC25C Scalar_UB 0.0 CM_LIGHT_TYPE 0.0 4.0 /end CHARACTERISTIC
/begin CHARACTERISTIC D_O2HeaterShortHiLightType "cal comments" VALUE 0xC25D Scalar_UB 0.0 CM_LIGHT_TYPE 0.0 4.0 /end CHARACTERISTIC
/begin CHARACTERISTIC D_AFR1ShortLoLightType "cal comments" VALUE 0x0 Scalar_UB 0.0 CM_LIGHT_TYPE 0.0 4.0 /end CHARACTERISTIC
/begin CHARACTERISTIC D_AFR1ShortHiLightType "cal comments" VALUE 0x0 Scalar_UB 0.0 CM_LIGHT_TYPE 0.0 4.0 /end CHARACTERISTIC
/begin CHARACTERISTIC D_O2Heater2ShortLoLightType "cal comments" VALUE 0xC261 Scalar_UB 0.0 CM_LIGHT_TYPE 0.0 4.0 /end CHARACTERISTIC
/begin CHARACTERISTIC D_O2Heater2ShortHiLightType "cal comments" VALUE 0xC262 Scalar_UB 0.0 CM_LIGHT_TYPE 0.0 4.0 /end CHARACTERISTIC
/begin CHARACTERISTIC D_CoolTempShortLoLightType "cal comments" VALUE 0xC1F3 Scalar_UB 0.0 CM_LIGHT_TYPE 0.0 4.0 /end CHARACTERISTIC
/begin CHARACTERISTIC D_CoolTempShortHiLightType "cal comments" VALUE 0xC1F4 Scalar_UB 0.0 CM_LIGHT_TYPE 0.0 4.0 /end CHARACTERISTIC
/begin CHARACTERISTIC D_CoolTempOverHeatExp1LightType "cal comments" VALUE 0xC1F5 Scalar_UB 0.0 CM_LIGHT_TYPE 0.0 4.0 /end CHARACTERISTIC
/begin CHARACTERISTIC D_CoolTempOverHeatExp2LightType "cal comments" VALUE 0xC1F6 Scalar_UB 0.0 CM_LIGHT_TYPE 0.0 4.0 /end CHARACTERISTIC
/begin CHARACTERISTIC D_IntakeAirTempShortLoLightType "cal comments" VALUE 0xC29F Scalar_UB 0.0 CM_LIGHT_TYPE 0.0 4.0 /end CHARACTERISTIC
/begin CHARACTERISTIC D_IntakeAirTempShortHiLightType "cal comments" VALUE 0xC2A0 Scalar_UB 0.0 CM_LIGHT_TYPE 0.0 4.0 /end CHARACTERISTIC
/begin CHARACTERISTIC D_IntakeAirTempHiExp1LightType "cal comments" VALUE 0xC2A1 Scalar_UB 0.0 CM_LIGHT_TYPE 0.0 4.0 /end CHARACTERISTIC
/begin CHARACTERISTIC D_IntakeAirTempHiExp2LightType "cal comments" VALUE 0xC2A2 Scalar_UB 0.0 CM_LIGHT_TYPE 0.0 4.0 /end CHARACTERISTIC
/begin CHARACTERISTIC D_SCIShortLoLightType "cal comments" VALUE 0xC2AD Scalar_UB 0.0 CM_LIGHT_TYPE 0.0 4.0 /end CHARACTERISTIC
/begin CHARACTERISTIC D_SCIShortHiLightType "cal comments" VALUE 0xC2AE Scalar_UB 0.0 CM_LIGHT_TYPE 0.0 4.0 /end CHARACTERISTIC
/begin CHARACTERISTIC D_BSTPShortLoLightType "cal comments" VALUE 0xC301 Scalar_UB 0.0 CM_LIGHT_TYPE 0.0 4.0 /end CHARACTERISTIC
/begin CHARACTERISTIC D_BSTPShortHiLightType "cal comments" VALUE 0xC302 Scalar_UB 0.0 CM_LIGHT_TYPE 0.0 4.0 /end CHARACTERISTIC
/begin CHARACTERISTIC D_BSTCShortLoLightType "cal comments" VALUE 0xC27F Scalar_UB 0.0 CM_LIGHT_TYPE 0.0 4.0 /end CHARACTERISTIC
/begin CHARACTERISTIC D_BSTCShortHiLightType "cal comments" VALUE 0xC280 Scalar_UB 0.0 CM_LIGHT_TYPE 0.0 4.0 /end CHARACTERISTIC
/begin CHARACTERISTIC D_MAPShortLoLightType "cal comments" VALUE 0xC341 Scalar_UB 0.0 CM_LIGHT_TYPE 0.0 4.0 /end CHARACTERISTIC
/begin CHARACTERISTIC D_MAPShortHiLightType "cal comments" VALUE 0xC342 Scalar_UB 0.0 CM_LIGHT_TYPE 0.0 4.0 /end CHARACTERISTIC
/begin CHARACTERISTIC D_FPShortLoLightType "cal comments" VALUE 0xC249 Scalar_UB 0.0 CM_LIGHT_TYPE 0.0 4.0 /end CHARACTERISTIC
/begin CHARACTERISTIC D_FPShortHiLightType "cal comments" VALUE 0xC24A Scalar_UB 0.0 CM_LIGHT_TYPE 0.0 4.0 /end CHARACTERISTIC
/begin CHARACTERISTIC D_OilPressureLightType "cal comments" VALUE 0xC350 Scalar_UB 0.0 CM_LIGHT_TYPE 0.0 4.0 /end CHARACTERISTIC
/begin CHARACTERISTIC D_TPSShortLoLightType "cal comments" VALUE 0xC379 Scalar_UB 0.0 CM_LIGHT_TYPE 0.0 4.0 /end CHARACTERISTIC
/begin CHARACTERISTIC D_TPSShortHiLightType "cal comments" VALUE 0xC37A Scalar_UB 0.0 CM_LIGHT_TYPE 0.0 4.0 /end CHARACTERISTIC
/begin CHARACTERISTIC D_DCMShortLoLightType "cal comments" VALUE 0xC1D9 Scalar_UB 0.0 CM_LIGHT_TYPE 0.0 4.0 /end CHARACTERISTIC
/begin CHARACTERISTIC D_DCMShortHiLightType "cal comments" VALUE 0xC1DA Scalar_UB 0.0 CM_LIGHT_TYPE 0.0 4.0 /end CHARACTERISTIC
/begin CHARACTERISTIC D_TPSMotorControlLightType "cal comments" VALUE 0xC28E Scalar_UB 0.0 CM_LIGHT_TYPE 0.0 4.0 /end CHARACTERISTIC
/begin CHARACTERISTIC D_FCVPSShortLoLightType "cal comments" VALUE 0xC385 Scalar_UB 0.0 CM_LIGHT_TYPE 0.0 4.0 /end CHARACTERISTIC
/begin CHARACTERISTIC D_FCVPSShortHiLightType "cal comments" VALUE 0xC386 Scalar_UB 0.0 CM_LIGHT_TYPE 0.0 4.0 /end CHARACTERISTIC
/begin CHARACTERISTIC D_FCVMShortLoLightType "cal comments" VALUE 0xC1DE Scalar_UB 0.0 CM_LIGHT_TYPE 0.0 4.0 /end CHARACTERISTIC
/begin CHARACTERISTIC D_FCVMShortHiLightType "cal comments" VALUE 0xC1DF Scalar_UB 0.0 CM_LIGHT_TYPE 0.0 4.0 /end CHARACTERISTIC
/begin CHARACTERISTIC D_FCVMotorControlLightType "cal comments" VALUE 0xC258 Scalar_UB 0.0 CM_LIGHT_TYPE 0.0 4.0 /end CHARACTERISTIC
/begin CHARACTERISTIC D_FCV1ShortLoLightType "cal comments" VALUE 0xC26B Scalar_UB 0.0 CM_LIGHT_TYPE 0.0 4.0 /end CHARACTERISTIC
/begin CHARACTERISTIC D_FCV1ShortHiLightType "cal comments" VALUE 0xC26C Scalar_UB 0.0 CM_LIGHT_TYPE 0.0 4.0 /end CHARACTERISTIC
/begin CHARACTERISTIC D_FCV2ShortLoLightType "cal comments" VALUE 0xC270 Scalar_UB 0.0 CM_LIGHT_TYPE 0.0 4.0 /end CHARACTERISTIC
/begin CHARACTERISTIC D_FCV2ShortHiLightType "cal comments" VALUE 0xC271 Scalar_UB 0.0 CM_LIGHT_TYPE 0.0 4.0 /end CHARACTERISTIC
/begin CHARACTERISTIC D_REF1ShortLoLightType "cal comments" VALUE 0xC275 Scalar_UB 0.0 CM_LIGHT_TYPE 0.0 4.0 /end CHARACTERISTIC
/begin CHARACTERISTIC D_REF1ShortHiLightType "cal comments" VALUE 0xC276 Scalar_UB 0.0 CM_LIGHT_TYPE 0.0 4.0 /end CHARACTERISTIC
/begin CHARACTERISTIC D_REF2ShortLoLightType "cal comments" VALUE 0xC27A Scalar_UB 0.0 CM_LIGHT_TYPE 0.0 4.0 /end CHARACTERISTIC
/begin CHARACTERISTIC D_REF2ShortHiLightType "cal comments" VALUE 0xC27B Scalar_UB 0.0 CM_LIGHT_TYPE 0.0 4.0 /end CHARACTERISTIC
/begin CHARACTERISTIC D_IgnitionCoil1LoLightType "cal comments" VALUE 0xC22F Scalar_UB 0.0 CM_LIGHT_TYPE 0.0 4.0 /end CHARACTERISTIC
/begin CHARACTERISTIC D_IgnitionCoil1HiLightType "cal comments" VALUE 0xC230 Scalar_UB 0.0 CM_LIGHT_TYPE 0.0 4.0 /end CHARACTERISTIC
/begin CHARACTERISTIC D_IgnitionCoil2LoLightType "cal comments" VALUE 0xC231 Scalar_UB 0.0 CM_LIGHT_TYPE 0.0 4.0 /end CHARACTERISTIC
/begin CHARACTERISTIC D_IgnitionCoil2HiLightType "cal comments" VALUE 0xC232 Scalar_UB 0.0 CM_LIGHT_TYPE 0.0 4.0 /end CHARACTERISTIC
/begin CHARACTERISTIC D_IgnitionCoil3LoLightType "cal comments" VALUE 0xC233 Scalar_UB 0.0 CM_LIGHT_TYPE 0.0 4.0 /end CHARACTERISTIC
/begin CHARACTERISTIC D_IgnitionCoil3HiLightType "cal comments" VALUE 0xC234 Scalar_UB 0.0 CM_LIGHT_TYPE 0.0 4.0 /end CHARACTERISTIC
/begin CHARACTERISTIC D_IgnitionCoil4LoLightType "cal comments" VALUE 0xC235 Scalar_UB 0.0 CM_LIGHT_TYPE 0.0 4.0 /end CHARACTERISTIC
/begin CHARACTERISTIC D_IgnitionCoil4HiLightType "cal comments" VALUE 0xC236 Scalar_UB 0.0 CM_LIGHT_TYPE 0.0 4.0 /end CHARACTERISTIC
/begin CHARACTERISTIC D_InjectorCyl1LoLightType "cal comments" VALUE 0xC307 Scalar_UB 0.0 CM_LIGHT_TYPE 0.0 4.0 /end CHARACTERISTIC
/begin CHARACTERISTIC D_InjectorCyl1HiLoLightType "cal comments" VALUE 0xC308 Scalar_UB 0.0 CM_LIGHT_TYPE 0.0 4.0 /end CHARACTERISTIC
/begin CHARACTERISTIC D_InjectorCyl2LoLightType "cal comments" VALUE 0xC309 Scalar_UB 0.0 CM_LIGHT_TYPE 0.0 4.0 /end CHARACTERISTIC
/begin CHARACTERISTIC D_InjectorCyl2HiLoLightType "cal comments" VALUE 0xC30A Scalar_UB 0.0 CM_LIGHT_TYPE 0.0 4.0 /end CHARACTERISTIC
/begin CHARACTERISTIC D_InjectorCyl3LoLightType "cal comments" VALUE 0xC30B Scalar_UB 0.0 CM_LIGHT_TYPE 0.0 4.0 /end CHARACTERISTIC
/begin CHARACTERISTIC D_InjectorCyl3HiLoLightType "cal comments" VALUE 0xC30C Scalar_UB 0.0 CM_LIGHT_TYPE 0.0 4.0 /end CHARACTERISTIC
/begin CHARACTERISTIC D_InjectorCyl4LoLightType "cal comments" VALUE 0xC30D Scalar_UB 0.0 CM_LIGHT_TYPE 0.0 4.0 /end CHARACTERISTIC
/begin CHARACTERISTIC D_InjectorCyl4HiLoLightType "cal comments" VALUE 0xC30E Scalar_UB 0.0 CM_LIGHT_TYPE 0.0 4.0 /end CHARACTERISTIC
/begin CHARACTERISTIC D_CrankSignalLossLightType "cal comments" VALUE 0xC229 Scalar_UB 0.0 CM_LIGHT_TYPE 0.0 4.0 /end CHARACTERISTIC
/begin CHARACTERISTIC D_CrankSignalNoiseLightType "cal comments" VALUE 0xC22A Scalar_UB 0.0 CM_LIGHT_TYPE 0.0 4.0 /end CHARACTERISTIC
/begin CHARACTERISTIC D_BatVoltLoLightType "cal comments" VALUE 0xC393 Scalar_UB 0.0 CM_LIGHT_TYPE 0.0 4.0 /end CHARACTERISTIC
/begin CHARACTERISTIC D_BatVoltHiLightType "cal comments" VALUE 0xC394 Scalar_UB 0.0 CM_LIGHT_TYPE 0.0 4.0 /end CHARACTERISTIC
/begin CHARACTERISTIC D_Knock1SignalLightType "cal comments" VALUE 0xC1E0 Scalar_UB 0.0 CM_LIGHT_TYPE 0.0 4.0 /end CHARACTERISTIC
/begin CHARACTERISTIC D_Knock2SignalLightType "cal comments" VALUE 0xC1E1 Scalar_UB 0.0 CM_LIGHT_TYPE 0.0 4.0 /end CHARACTERISTIC
/begin CHARACTERISTIC D_LPGTrimHiLightType "cal comments" VALUE 0xC1E2 Scalar_UB 0.0 CM_LIGHT_TYPE 0.0 4.0 /end CHARACTERISTIC
/begin CHARACTERISTIC D_LPGTrimLoLightType "cal comments" VALUE 0xC1E3 Scalar_UB 0.0 CM_LIGHT_TYPE 0.0 4.0 /end CHARACTERISTIC
/begin CHARACTERISTIC D_NGTrimHiLightType "cal comments" VALUE 0xC1E4 Scalar_UB 0.0 CM_LIGHT_TYPE 0.0 4.0 /end CHARACTERISTIC
/begin CHARACTERISTIC D_NGTrimLoLightType "cal comments" VALUE 0xC1E5 Scalar_UB 0.0 CM_LIGHT_TYPE 0.0 4.0 /end CHARACTERISTIC
/begin CHARACTERISTIC D_IACVShortLoLightType "cal comments" VALUE 0xC266 Scalar_UB 0.0 CM_LIGHT_TYPE 0.0 4.0 /end CHARACTERISTIC
/begin CHARACTERISTIC D_IACVShortHiLightType "cal comments" VALUE 0xC267 Scalar_UB 0.0 CM_LIGHT_TYPE 0.0 4.0 /end CHARACTERISTIC
/begin CHARACTERISTIC D_FuelPumpShortLoLightType "cal comments" VALUE 0xC23A Scalar_UB 0.0 CM_LIGHT_TYPE 0.0 4.0 /end CHARACTERISTIC
/begin CHARACTERISTIC D_FuelPumpShortHiLightType "cal comments" VALUE 0xC23B Scalar_UB 0.0 CM_LIGHT_TYPE 0.0 4.0 /end CHARACTERISTIC
/begin CHARACTERISTIC D_FPFeedbackLightType "cal comments" VALUE 0xC23F Scalar_UB 0.0 CM_LIGHT_TYPE 0.0 4.0 /end CHARACTERISTIC
/begin CHARACTERISTIC D_CoolTemp2ShortLoLightType "cal comments" VALUE 0xC201 Scalar_UB 0.0 CM_LIGHT_TYPE 0.0 4.0 /end CHARACTERISTIC
/begin CHARACTERISTIC D_CoolTemp2ShortHiLightType "cal comments" VALUE 0xC202 Scalar_UB 0.0 CM_LIGHT_TYPE 0.0 4.0 /end CHARACTERISTIC
/begin CHARACTERISTIC D_CCPShortLoLightType "cal comments" VALUE 0x0 Scalar_UB 0.0 CM_LIGHT_TYPE 0.0 4.0 /end CHARACTERISTIC
/begin CHARACTERISTIC D_CCPShortHiLightType "cal comments" VALUE 0x0 Scalar_UB 0.0 CM_LIGHT_TYPE 0.0 4.0 /end CHARACTERISTIC
/begin CHARACTERISTIC D_SoftwareErrorLightType "cal comments" VALUE 0xC36D Scalar_UB 0.0 CM_LIGHT_TYPE 0.0 4.0 /end CHARACTERISTIC
/begin CHARACTERISTIC D_ACSShortLoLightType "cal comments" VALUE 0xC2BD Scalar_UB 0.0 CM_LIGHT_TYPE 0.0 4.0 /end CHARACTERISTIC
/begin CHARACTERISTIC D_ACSShortHiLightType "cal comments" VALUE 0xC2BE Scalar_UB 0.0 CM_LIGHT_TYPE 0.0 4.0 /end CHARACTERISTIC
/begin CHARACTERISTIC D_WPSShortLoLightType "cal comments" VALUE 0xC2CD Scalar_UB 0.0 CM_LIGHT_TYPE 0.0 4.0 /end CHARACTERISTIC
/begin CHARACTERISTIC D_WPSShortHiLightType "cal comments" VALUE 0xC2CE Scalar_UB 0.0 CM_LIGHT_TYPE 0.0 4.0 /end CHARACTERISTIC
/begin CHARACTERISTIC D_GENVLoLightType "cal comments" VALUE 0x0 Scalar_UB 0.0 CM_LIGHT_TYPE 0.0 4.0 /end CHARACTERISTIC
/begin CHARACTERISTIC D_GENVHiLightType "cal comments" VALUE 0x0 Scalar_UB 0.0 CM_LIGHT_TYPE 0.0 4.0 /end CHARACTERISTIC
/begin CHARACTERISTIC D_TPSShortDiagPassTimeThrsh "cal comments" VALUE 0xC372 Scalar_UW 0.0 CM_Count_0to65535_2 0.0 65535.0 /end CHARACTERISTIC
/begin CHARACTERISTIC D_TPSShortEnb "cal comments" VALUE 0xC378 Scalar_UB 0.0 CM_Boolean6 0.0 255.0 /end CHARACTERISTIC
/begin CHARACTERISTIC D_TPSShortHighFailTimeThrsh "cal comments" VALUE 0xC36E Scalar_UW 0.0 CM_Count_0to65535_2 0.0 65535.0 /end CHARACTERISTIC
/begin CHARACTERISTIC D_TPSShortLowFailTimeThrsh "cal comments" VALUE 0xC370 Scalar_UW 0.0 CM_Count_0to65535_2 0.0 65535.0 /end CHARACTERISTIC
/begin CHARACTERISTIC D_TPSShortRangeThreshHi "cal comments" VALUE 0xC376 Scalar_UW 0.0 CM_Percent_0to100_1 0.0 99.9984130859375 /end CHARACTERISTIC
/begin CHARACTERISTIC D_TPSShortRangeThreshLo "cal comments" VALUE 0xC374 Scalar_UW 0.0 CM_Percent_0to100_1 0.0 99.9984130859375 /end CHARACTERISTIC
/begin CHARACTERISTIC D_FCVPSShortEnb "cal comments" VALUE 0xC384 Scalar_UB 0.0 CM_Boolean6 0.0 255.0 /end CHARACTERISTIC
/begin CHARACTERISTIC D_FCVPSFailTimeThrsh "cal comments" VALUE 0xC37C Scalar_UW 0.0 CM_Count_0to65535_2 0.0 65535.0 /end CHARACTERISTIC
/begin CHARACTERISTIC D_FCVPSPassTimeThrsh "cal comments" VALUE 0xC37E Scalar_UW 0.0 CM_Count_0to65535_2 0.0 65535.0 /end CHARACTERISTIC
/begin CHARACTERISTIC D_FCVPSShortRangeThreshHi "cal comments" VALUE 0xC382 Scalar_UW 0.0 CM_Percent_0to100_1 0.0 99.9984130859375 /end CHARACTERISTIC
/begin CHARACTERISTIC D_FCVPSShortRangeThreshLo "cal comments" VALUE 0xC380 Scalar_UW 0.0 CM_Percent_0to100_1 0.0 99.9984130859375 /end CHARACTERISTIC
/begin CHARACTERISTIC DT_MAPShortHiRunTimeThrsh "cal comments" CURVE 0xC32A 2D_Array_UW 0.0 CM_Count_0to65535_2 0.0 65535.0
 /begin AXIS_DESCR FIX_AXIS NO_INPUT_QUANTITY CM_Equaloutput1 9 -40.0 40.0 MAX_GRAD 0.0 /begin FIX_AXIS_PAR_LIST -40 -30 -20 -10 0 10 20 30 40 /end FIX_AXIS_PAR_LIST /end AXIS_DESCR
/end CHARACTERISTIC
/begin MEASUREMENT AFRRamped "var comments" UWORD udf_CM_15464 0 0.0 0.0 31.99951171875 ECU_ADDRESS 0x400025FC /end MEASUREMENT
/begin MEASUREMENT AFRBase "var comments" UWORD udf_CM_15422 0 0.0 0.0 31.99951171875 ECU_ADDRESS 0x400026CA /end MEASUREMENT
/begin MEASUREMENT AFRCrankToRun "var comments" UBYTE udf_CM_15436 0 0.0 0.0 255.0 ECU_ADDRESS 0x400025F8 /end MEASUREMENT
/begin MEASUREMENT AFRWarmUpEnb "var comments" UBYTE udf_CM_15513 0 0.0 0.0 255.0 ECU_ADDRESS 0x40002606 /end MEASUREMENT
/begin MEASUREMENT AFRWarmUp "var comments" UWORD udf_CM_15506 0 0.0 0.0 31.99951171875 ECU_ADDRESS 0x40002604 /end MEASUREMENT
/begin MEASUREMENT AFRWarmUpIdle "var comments" UWORD udf_CM_15520 0 0.0 0.0 31.99951171875 ECU_ADDRESS 0x40002600 /end MEASUREMENT
/begin MEASUREMENT AFRWarmUpRun "var comments" UWORD udf_CM_15527 0 0.0 0.0 31.99951171875 ECU_ADDRESS 0x40002602 /end MEASUREMENT
/begin MEASUREMENT AFRCrank "var comments" UWORD udf_CM_15429 0 0.0 0.0 31.99951171875 ECU_ADDRESS 0x400026C4 /end MEASUREMENT
/begin MEASUREMENT AFRFinal "var comments" UWORD udf_CM_15450 0 0.0 0.0 31.99951171875 ECU_ADDRESS 0x4000260A /end MEASUREMENT
/begin MEASUREMENT AFRPE "var comments" UWORD udf_CM_15457 0 0.0 0.0 31.99951171875 ECU_ADDRESS 0x4000260C /end MEASUREMENT
/begin MEASUREMENT AFRTarget "var comments" UWORD udf_CM_15485 0 0.0 0.0 31.99951171875 ECU_ADDRESS 0x400025FA /end MEASUREMENT
/begin MEASUREMENT AirFlowCyl1 "var comments" UWORD udf_CM_15534 0 0.0 0.0 511.9921875 DISPLAY_IDENTIFIER AirFlowCyl[0] ECU_ADDRESS 0x4000256C /end MEASUREMENT
/begin MEASUREMENT AirFlowCyl2 "var comments" UWORD udf_CM_15541 0 0.0 0.0 511.9921875 DISPLAY_IDENTIFIER AirFlowCyl[1] ECU_ADDRESS 0x4000256E /end MEASUREMENT
/begin MEASUREMENT AFRVolt1Unfilt "var comments" UWORD udf_CM_15492 0 0.0 0.0 31.99951171875 ECU_ADDRESS 0x40002908 /end MEASUREMENT
/begin MEASUREMENT AFRVolt2Unfilt "var comments" UWORD udf_CM_15499 0 0.0 0.0 31.99951171875 ECU_ADDRESS 0x4000290E /end MEASUREMENT
/begin MEASUREMENT AFRVolt1 "var comments" UWORD udf_CM_15492 0 0.0 0.0 31.99951171875 ECU_ADDRESS 0x4000290A /end MEASUREMENT
/begin MEASUREMENT AFRVolt2 "var comments" UWORD udf_CM_15499 0 0.0 0.0 31.99951171875 ECU_ADDRESS 0x4000290C /end MEASUREMENT
/begin MEASUREMENT ClTDiagEnb "var comments" UBYTE udf_CM_15674 0 0.0 0.0 255.0 ECU_ADDRESS 0x40002BE4 /end MEASUREMENT
/begin MEASUREMENT ClTSHFailCount "var comments" UWORD udf_CM_15681 0 0.0 0.0 65535.0 ECU_ADDRESS 0x40002BF4 /end MEASUREMENT
/begin MEASUREMENT ClTSHFailMet "var comments" UBYTE udf_CM_15688 0 0.0 0.0 255.0 ECU_ADDRESS 0x40002BE6 /end MEASUREMENT
/begin MEASUREMENT ClTSHPassCount "var comments" UWORD udf_CM_15695 0 0.0 0.0 65535.0 ECU_ADDRESS 0x40002BF6 /end MEASUREMENT
/begin MEASUREMENT ClTSHTestFail "var comments" UBYTE udf_CM_15702 0 0.0 0.0 255.0 ECU_ADDRESS 0x40002BEC /end MEASUREMENT
/begin MEASUREMENT ClTSLFailCount "var comments" UWORD udf_CM_15716 0 0.0 0.0 65535.0 ECU_ADDRESS 0x40002BF0 /end MEASUREMENT
/begin MEASUREMENT ClTSLFailMet "var comments" UBYTE udf_CM_15723 0 0.0 0.0 255.0 ECU_ADDRESS 0x40002BE5 /end MEASUREMENT
/begin MEASUREMENT ClTSLPassCount "var comments" UWORD udf_CM_15730 0 0.0 0.0 65535.0 ECU_ADDRESS 0x40002BF2 /end MEASUREMENT
/begin MEASUREMENT ClTSLTestFail "var comments" UBYTE udf_CM_15737 0 0.0 0.0 255.0 ECU_ADDRESS 0x40002BEB /end MEASUREMENT
/begin MEASUREMENT ClTOH1FailCount "var comments" UWORD udf_CM_15716 0 0.0 0.0 65535.0 ECU_ADDRESS 0x40002BF8 /end MEASUREMENT
/begin MEASUREMENT ClTOH1FailMet "var comments" UBYTE udf_CM_15723 0 0.0 0.0 255.0 ECU_ADDRESS 0x40002BEF /end MEASUREMENT
/begin MEASUREMENT ClTOH1PassCount "var comments" UWORD udf_CM_15730 0 0.0 0.0 65535.0 ECU_ADDRESS 0x40002BFA /end MEASUREMENT
/begin MEASUREMENT ClTOH1TestFail "var comments" UBYTE udf_CM_15737 0 0.0 0.0 255.0 ECU_ADDRESS 0x40002BED /end MEASUREMENT
/begin MEASUREMENT ClTOH2FailCount "var comments" UWORD udf_CM_15716 0 0.0 0.0 65535.0 ECU_ADDRESS 0x40002BFC /end MEASUREMENT
/begin MEASUREMENT ClTOH2FailMet "var comments" UBYTE udf_CM_15723 0 0.0 0.0 255.0 ECU_ADDRESS 0x40002BE2 /end MEASUREMENT
/begin MEASUREMENT ClTOH2PassCount "var comments" UWORD udf_CM_15730 0 0.0 0.0 65535.0 ECU_ADDRESS 0x40002BFE /end MEASUREMENT
/begin MEASUREMENT ClTOH2TestFail "var comments" UBYTE udf_CM_15737 0 0.0 0.0 255.0 ECU_ADDRESS 0x40002BEE /end MEASUREMENT
/begin MEASUREMENT FPDiagEnb "var comments" UBYTE udf_CM_17382 0 0.0 0.0 255.0 ECU_ADDRESS 0x40002CAE /end MEASUREMENT
/begin MEASUREMENT FPSLFailMet "var comments" UBYTE udf_CM_17410 0 0.0 0.0 255.0 ECU_ADDRESS 0x40002CB3 /end MEASUREMENT
/begin MEASUREMENT FPSLTestComp "var comments" UBYTE udf_CM_17424 0 0.0 0.0 255.0 ECU_ADDRESS 0x40002CAF /end MEASUREMENT
/begin MEASUREMENT FPSLTestFail "var comments" UBYTE udf_CM_17431 0 0.0 0.0 255.0 ECU_ADDRESS 0x40002CB1 /end MEASUREMENT
/begin MEASUREMENT FPSLFailCount "var comments" UWORD udf_CM_17389 0 0.0 0.0 65535.0 ECU_ADDRESS 0x40002CB4 /end MEASUREMENT
/begin MEASUREMENT FPSLPassCount "var comments" UWORD udf_CM_17417 0 0.0 0.0 65535.0 ECU_ADDRESS 0x40002CB6 /end MEASUREMENT
/begin MEASUREMENT FPSHFailMet "var comments" UBYTE udf_CM_17410 0 0.0 0.0 255.0 ECU_ADDRESS 0x40002CBC /end MEASUREMENT
/begin MEASUREMENT FPSHTestComp "var comments" UBYTE udf_CM_17424 0 0.0 0.0 255.0 ECU_ADDRESS 0x40002CB0 /end MEASUREMENT
/begin MEASUREMENT FPSHTestFail "var comments" UBYTE udf_CM_17431 0 0.0 0.0 255.0 ECU_ADDRESS 0x40002CB2 /end MEASUREMENT
/begin MEASUREMENT FPSHFailCount "var comments" UWORD udf_CM_17389 0 0.0 0.0 65535.0 ECU_ADDRESS 0x40002CB8 /end MEASUREMENT
/begin MEASUREMENT FPSHPassCount "var comments" UWORD udf_CM_17417 0 0.0 0.0 65535.0 ECU_ADDRESS 0x40002CBA /end MEASUREMENT
/begin MEASUREMENT Coil1DiagEnb "var comments" UBYTE udf_CM_18019 0 0.0 0.0 255.0 DISPLAY_IDENTIFIER CoilDiagEnb[0] ECU_ADDRESS 0x40002CE2 /end MEASUREMENT
/begin MEASUREMENT Coil1SLFailMet "var comments" UBYTE udf_CM_18047 0 0.0 0.0 255.0 DISPLAY_IDENTIFIER CoilSLFailMet[0] ECU_ADDRESS 0x40002CE6 /end MEASUREMENT
/begin MEASUREMENT Coil1SLTestComp "var comments" UBYTE udf_CM_18061 0 0.0 0.0 255.0 DISPLAY_IDENTIFIER CoilSLTestComp[0] ECU_ADDRESS 0x40002CEE /end MEASUREMENT
/begin MEASUREMENT Coil1SLTestFail "var comments" UBYTE udf_CM_18068 0 0.0 0.0 255.0 DISPLAY_IDENTIFIER CoilSLTestFail[0] ECU_ADDRESS 0x40002D16 /end MEASUREMENT
/begin MEASUREMENT Coil1SLFailCount "var comments" UWORD udf_CM_18026 0 0.0 0.0 65535.0 DISPLAY_IDENTIFIER CoilSLFailCount[0] ECU_ADDRESS 0x40002CF6 /end MEASUREMENT
/begin MEASUREMENT Coil1SLPassCount "var comments" UWORD udf_CM_18054 0 0.0 0.0 65535.0 DISPLAY_IDENTIFIER CoilSLPassCount[0] ECU_ADDRESS 0x40002CFE /end MEASUREMENT
/begin MEASUREMENT Coil1SHFailMet "var comments" UBYTE udf_CM_18047 0 0.0 0.0 255.0 DISPLAY_IDENTIFIER CoilSHFailMet[0] ECU_ADDRESS 0x40002CEA /end MEASUREMENT
/begin MEASUREMENT Coil1SHTestComp "var comments" UBYTE udf_CM_18061 0 0.0 0.0 255.0 DISPLAY_IDENTIFIER CoilSHTestComp[0] ECU_ADDRESS 0x40002CF2 /end MEASUREMENT
/begin MEASUREMENT Coil1SHTestFail "var comments" UBYTE udf_CM_18068 0 0.0 0.0 255.0 DISPLAY_IDENTIFIER CoilSHTestFail[0] ECU_ADDRESS 0x40002D1A /end MEASUREMENT
/begin MEASUREMENT Coil1SHFailCount "var comments" UWORD udf_CM_18026 0 0.0 0.0 65535.0 DISPLAY_IDENTIFIER CoilSHFailCount[0] ECU_ADDRESS 0x40002D06 /end MEASUREMENT
/begin MEASUREMENT Coil1SHPassCount "var comments" UWORD udf_CM_18054 0 0.0 0.0 65535.0 DISPLAY_IDENTIFIER CoilSHPassCount[0] ECU_ADDRESS 0x40002D0E /end MEASUREMENT
/begin MEASUREMENT Coil2DiagEnb "var comments" UBYTE udf_CM_18019 0 0.0 0.0 255.0 DISPLAY_IDENTIFIER CoilDiagEnb[1] ECU_ADDRESS 0x40002CE3 /end MEASUREMENT
/begin MEASUREMENT Coil2SLFailMet "var comments" UBYTE udf_CM_18047 0 0.0 0.0 255.0 DISPLAY_IDENTIFIER CoilSLFailMet[1] ECU_ADDRESS 0x40002CE7 /end MEASUREMENT
/begin MEASUREMENT Coil2SLTestComp "var comments" UBYTE udf_CM_18061 0 0.0 0.0 255.0 DISPLAY_IDENTIFIER CoilSLTestComp[1] ECU_ADDRESS 0x40002CEF /end MEASUREMENT
/begin MEASUREMENT Coil2SLTestFail "var comments" UBYTE udf_CM_18068 0 0.0 0.0 255.0 DISPLAY_IDENTIFIER CoilSLTestFail[1] ECU_ADDRESS 0x40002D17 /end MEASUREMENT
/begin MEASUREMENT Coil2SLFailCount "var comments" UWORD udf_CM_18026 0 0.0 0.0 65535.0 DISPLAY_IDENTIFIER CoilSLFailCount[1] ECU_ADDRESS 0x40002CF8 /end MEASUREMENT
/begin MEASUREMENT Coil2SLPassCount "var comments" UWORD udf_CM_18054 0 0.0 0.0 65535.0 DISPLAY_IDENTIFIER CoilSLPassCount[1] ECU_ADDRESS 0x40002D00 /end MEASUREMENT
/begin MEASUREMENT Coil2SHFailMet "var comments" UBYTE udf_CM_18047 0 0.0 0.0 255.0 DISPLAY_IDENTIFIER CoilSHFailMet[1] ECU_ADDRESS 0x40002CEB /end MEASUREMENT
/begin MEASUREMENT Coil2SHTestComp "var comments" UBYTE udf_CM_18061 0 0.0 0.0 255.0 DISPLAY_IDENTIFIER CoilSHTestComp[1] ECU_ADDRESS 0x40002CF3 /end MEASUREMENT
/begin MEASUREMENT Coil2SHTestFail "var comments" UBYTE udf_CM_18068 0 0.0 0.0 255.0 DISPLAY_IDENTIFIER CoilSHTestFail[1] ECU_ADDRESS 0x40002D1B /end MEASUREMENT
/begin MEASUREMENT Coil2SHFailCount "var comments" UWORD udf_CM_18026 0 0.0 0.0 65535.0 DISPLAY_IDENTIFIER CoilSHFailCount[1] ECU_ADDRESS 0x40002D08 /end MEASUREMENT
/begin MEASUREMENT Coil2SHPassCount "var comments" UWORD udf_CM_18054 0 0.0 0.0 65535.0 DISPLAY_IDENTIFIER CoilSHPassCount[1] ECU_ADDRESS 0x40002D10 /end MEASUREMENT
/begin MEASUREMENT Coil3DiagEnb "var comments" UBYTE udf_CM_18019 0 0.0 0.0 255.0 DISPLAY_IDENTIFIER CoilDiagEnb[2] ECU_ADDRESS 0x40002CE4 /end MEASUREMENT
/begin MEASUREMENT Coil3SLFailMet "var comments" UBYTE udf_CM_18047 0 0.0 0.0 255.0 DISPLAY_IDENTIFIER CoilSLFailMet[2] ECU_ADDRESS 0x40002CE8 /end MEASUREMENT
/begin MEASUREMENT Coil3SLTestComp "var comments" UBYTE udf_CM_18061 0 0.0 0.0 255.0 DISPLAY_IDENTIFIER CoilSLTestComp[2] ECU_ADDRESS 0x40002CF0 /end MEASUREMENT
/begin MEASUREMENT Coil3SLTestFail "var comments" UBYTE udf_CM_18068 0 0.0 0.0 255.0 DISPLAY_IDENTIFIER CoilSLTestFail[2] ECU_ADDRESS 0x40002D18 /end MEASUREMENT
/begin MEASUREMENT Coil3SLFailCount "var comments" UWORD udf_CM_18026 0 0.0 0.0 65535.0 DISPLAY_IDENTIFIER CoilSLFailCount[2] ECU_ADDRESS 0x40002CFA /end MEASUREMENT
/begin MEASUREMENT Coil3SLPassCount "var comments" UWORD udf_CM_18054 0 0.0 0.0 65535.0 DISPLAY_IDENTIFIER CoilSLPassCount[2] ECU_ADDRESS 0x40002D02 /end MEASUREMENT
/begin MEASUREMENT Coil3SHFailMet "var comments" UBYTE udf_CM_18047 0 0.0 0.0 255.0 DISPLAY_IDENTIFIER CoilSHFailMet[2] ECU_ADDRESS 0x40002CEC /end MEASUREMENT
/begin MEASUREMENT Coil3SHTestComp "var comments" UBYTE udf_CM_18061 0 0.0 0.0 255.0 DISPLAY_IDENTIFIER CoilSHTestComp[2] ECU_ADDRESS 0x40002CF4 /end MEASUREMENT
/begin MEASUREMENT Coil3SHTestFail "var comments" UBYTE udf_CM_18068 0 0.0 0.0 255.0 DISPLAY_IDENTIFIER CoilSHTestFail[2] ECU_ADDRESS 0x40002D1C /end MEASUREMENT
/begin MEASUREMENT Coil3SHFailCount "var comments" UWORD udf_CM_18026 0 0.0 0.0 65535.0 DISPLAY_IDENTIFIER CoilSHFailCount[2] ECU_ADDRESS 0x40002D0A /end MEASUREMENT
/begin MEASUREMENT Coil3SHPassCount "var comments" UWORD udf_CM_18054 0 0.0 0.0 65535.0 DISPLAY_IDENTIFIER CoilSHPassCount[2] ECU_ADDRESS 0x40002D12 /end MEASUREMENT
/begin MEASUREMENT Coil4DiagEnb "var comments" UBYTE udf_CM_18019 0 0.0 0.0 255.0 DISPLAY_IDENTIFIER CoilDiagEnb[3] ECU_ADDRESS 0x40002CE5 /end MEASUREMENT
/begin MEASUREMENT Coil4SLFailMet "var comments" UBYTE udf_CM_18047 0 0.0 0.0 255.0 DISPLAY_IDENTIFIER CoilSLFailMet[3] ECU_ADDRESS 0x40002CE9 /end MEASUREMENT
/begin MEASUREMENT Coil4SLTestComp "var comments" UBYTE udf_CM_18061 0 0.0 0.0 255.0 DISPLAY_IDENTIFIER CoilSLTestComp[3] ECU_ADDRESS 0x40002CF1 /end MEASUREMENT
/begin MEASUREMENT Coil4SLTestFail "var comments" UBYTE udf_CM_18068 0 0.0 0.0 255.0 DISPLAY_IDENTIFIER CoilSLTestFail[3] ECU_ADDRESS 0x40002D19 /end MEASUREMENT
/begin MEASUREMENT Coil4SLFailCount "var comments" UWORD udf_CM_18026 0 0.0 0.0 65535.0 DISPLAY_IDENTIFIER CoilSLFailCount[3] ECU_ADDRESS 0x40002CFC /end MEASUREMENT
/begin MEASUREMENT Coil4SLPassCount "var comments" UWORD udf_CM_18054 0 0.0 0.0 65535.0 DISPLAY_IDENTIFIER CoilSLPassCount[3] ECU_ADDRESS 0x40002D04 /end MEASUREMENT
/begin MEASUREMENT Coil4SHFailMet "var comments" UBYTE udf_CM_18047 0 0.0 0.0 255.0 DISPLAY_IDENTIFIER CoilSHFailMet[3] ECU_ADDRESS 0x40002CED /end MEASUREMENT
/begin MEASUREMENT Coil4SHTestComp "var comments" UBYTE udf_CM_18061 0 0.0 0.0 255.0 DISPLAY_IDENTIFIER CoilSHTestComp[3] ECU_ADDRESS 0x40002CF5 /end MEASUREMENT
/begin MEASUREMENT Coil4SHTestFail "var comments" UBYTE udf_CM_18068 0 0.0 0.0 255.0 DISPLAY_IDENTIFIER CoilSHTestFail[3] ECU_ADDRESS 0x40002D1D /end MEASUREMENT
/begin MEASUREMENT Coil4SHFailCount "var comments" UWORD udf_CM_18026 0 0.0 0.0 65535.0 DISPLAY_IDENTIFIER CoilSHFailCount[3] ECU_ADDRESS 0x40002D0C /end MEASUREMENT
/begin MEASUREMENT Coil4SHPassCount "var comments" UWORD udf_CM_18054 0 0.0 0.0 65535.0 DISPLAY_IDENTIFIER CoilSHPassCount[3] ECU_ADDRESS 0x40002D14 /end MEASUREMENT
/begin MEASUREMENT CrkDiagTmrEnb "var comments" UBYTE udf_CM_15849 0 0.0 0.0 255.0 DISPLAY_IDENTIFIER CrkDiag_7p8TimerEnbl[0] ECU_ADDRESS 0x40002C26 /end MEASUREMENT
/begin MEASUREMENT CrkNoSigDiagEnb "var comments" UBYTE udf_CM_15905 0 0.0 0.0 255.0 ECU_ADDRESS 0x40002C32 /end MEASUREMENT
/begin MEASUREMENT CrkNoSigFailMet "var comments" UBYTE udf_CM_15912 0 0.0 0.0 255.0 ECU_ADDRESS 0x40002C22 /end MEASUREMENT
/begin MEASUREMENT CrkDiagTmr1 "var comments" UWORD udf_CM_15842 0 0.0 0.0 511.9921875 DISPLAY_IDENTIFIER CrkDiag_7p8TimerArray[1] ECU_ADDRESS 0x40002C2A /end MEASUREMENT
/begin MEASUREMENT CrkNoSigTestFail "var comments" UBYTE udf_CM_15926 0 0.0 0.0 255.0 ECU_ADDRESS 0x40002C30 /end MEASUREMENT
/begin MEASUREMENT CrkNoSigTestComp "var comments" UBYTE udf_CM_15919 0 0.0 0.0 255.0 ECU_ADDRESS 0x40002C2E /end MEASUREMENT
/begin MEASUREMENT CrkDiagTmr0 "var comments" UWORD udf_CM_15835 0 0.0 0.0 511.9921875 DISPLAY_IDENTIFIER CrkDiag_7p8TimerArray[0] ECU_ADDRESS 0x40002C28 /end MEASUREMENT
/begin MEASUREMENT CrkNoSigTestReported "var comments" UBYTE udf_CM_15933 0 0.0 0.0 255.0 ECU_ADDRESS 0x40002C23 /end MEASUREMENT
/begin MEASUREMENT CrkNoisyDiagEnb "var comments" UBYTE udf_CM_15856 0 0.0 0.0 255.0 ECU_ADDRESS 0x40002C2D /end MEASUREMENT
/begin MEASUREMENT CrkNoisyFailCnt "var comments" UWORD udf_CM_15863 0 0.0 0.0 65535.0 ECU_ADDRESS 0x40002C38 /end MEASUREMENT
/begin MEASUREMENT CrkNoisyFailMet "var comments" UBYTE udf_CM_15870 0 0.0 0.0 255.0 ECU_ADDRESS 0x40002C33 /end MEASUREMENT
/begin MEASUREMENT CrkNoisyPassCnt "var comments" UWORD udf_CM_15877 0 0.0 0.0 65535.0 ECU_ADDRESS 0x40002C36 /end MEASUREMENT
/begin MEASUREMENT CrkNoisyTestComp "var comments" UBYTE udf_CM_15884 0 0.0 0.0 255.0 ECU_ADDRESS 0x40002C2C /end MEASUREMENT
/begin MEASUREMENT CrkNoisyTestFail "var comments" UBYTE udf_CM_15891 0 0.0 0.0 255.0 ECU_ADDRESS 0x40002C31 /end MEASUREMENT
/begin MEASUREMENT CrkNoisyTestReported "var comments" UBYTE udf_CM_15898 0 0.0 0.0 255.0 ECU_ADDRESS 0x40002C24 /end MEASUREMENT
/begin MEASUREMENT IgnVoltAtKeyOn "var comments" UWORD udf_CM_16920 0 0.0 0.0 31.99951171875 ECU_ADDRESS 0x40002C3A /end MEASUREMENT
/begin MEASUREMENT CrankToRunMet "var comments" UBYTE udf_CM_15821 0 0.0 0.0 255.0 ECU_ADDRESS 0x40002943 /end MEASUREMENT
/begin MEASUREMENT CrankToStallMet "var comments" UBYTE udf_CM_15828 0 0.0 0.0 255.0 ECU_ADDRESS 0x40002944 /end MEASUREMENT
/begin MEASUREMENT MAPCIDEnb "var comments" UBYTE udf_CM_17095 0 0.0 0.0 255.0 ECU_ADDRESS 0x40002927 /end MEASUREMENT
/begin MEASUREMENT DesireTPS "var comments" UWORD udf_CM_15989 0 0.0 0.0 199.9969482421875 ECU_ADDRESS 0x40002AA0 /end MEASUREMENT
/begin MEASUREMENT DiagWarningLamp "var comments" UBYTE udf_CM_16010 0 0.0 0.0 1.0 ECU_ADDRESS 0x40002B1E /end MEASUREMENT
/begin MEASUREMENT IdlDsrdEngSpdStep "var comments" UWORD udf_CM_16787 0 0.0 0.0 16383.75 ECU_ADDRESS 0x4000279C /end MEASUREMENT
/begin MEASUREMENT IdlDsrdEngSpdTarget "var comments" UWORD udf_CM_16794 0 0.0 0.0 16383.75 ECU_ADDRESS 0x40002798 /end MEASUREMENT
/begin MEASUREMENT DsrdThrFlow "var comments" UWORD udf_CM_15982 0 0.0 0.0 511.9921875 ECU_ADDRESS 0x40002AB6 /end MEASUREMENT
/begin MEASUREMENT DesireTPSOld "var comments" UWORD udf_CM_15996 0 0.0 0.0 199.9969482421875 ECU_ADDRESS 0x40002AB8 /end MEASUREMENT
/begin MEASUREMENT EngSpdAvg "var comments" UWORD udf_CM_16066 0 0.0 0.0 16383.75 DISPLAY_IDENTIFIER EngineSpeed_Avg ECU_ADDRESS 0x40002A30 /end MEASUREMENT
/begin MEASUREMENT EngSpdOld0 "var comments" UWORD udf_CM_16073 0 0.0 0.0 16383.75 DISPLAY_IDENTIFIER EngineSpeed_AvgOld[0] ECU_ADDRESS 0x40002A0E /end MEASUREMENT
/begin MEASUREMENT EngSpdOld1 "var comments" UWORD udf_CM_16122 0 0.0 0.0 16383.75 DISPLAY_IDENTIFIER EngineSpeed_AvgOld[1] ECU_ADDRESS 0x40002A10 /end MEASUREMENT
/begin MEASUREMENT EngSpdOld10 "var comments" UWORD udf_CM_16080 0 0.0 0.0 16383.75 DISPLAY_IDENTIFIER EngineSpeed_AvgOld[10] ECU_ADDRESS 0x40002A22 /end MEASUREMENT
/begin MEASUREMENT EngSpdOld11 "var comments" UWORD udf_CM_16087 0 0.0 0.0 16383.75 DISPLAY_IDENTIFIER EngineSpeed_AvgOld[11] ECU_ADDRESS 0x40002A24 /end MEASUREMENT
/begin MEASUREMENT EngSpdOld12 "var comments" UWORD udf_CM_16094 0 0.0 0.0 16383.75 DISPLAY_IDENTIFIER EngineSpeed_AvgOld[12] ECU_ADDRESS 0x40002A26 /end MEASUREMENT
/begin MEASUREMENT EngSpdOld13 "var comments" UWORD udf_CM_16101 0 0.0 0.0 16383.75 DISPLAY_IDENTIFIER EngineSpeed_AvgOld[13] ECU_ADDRESS 0x40002A28 /end MEASUREMENT
/begin MEASUREMENT EngSpdOld14 "var comments" UWORD udf_CM_16108 0 0.0 0.0 16383.75 DISPLAY_IDENTIFIER EngineSpeed_AvgOld[14] ECU_ADDRESS 0x40002A2A /end MEASUREMENT
/begin MEASUREMENT EngSpdOld15 "var comments" UWORD udf_CM_16115 0 0.0 0.0 16383.75 DISPLAY_IDENTIFIER EngineSpeed_AvgOld[15] ECU_ADDRESS 0x40002A2C /end MEASUREMENT
/begin MEASUREMENT EngSpdOld2 "var comments" UWORD udf_CM_16129 0 0.0 0.0 16383.75 DISPLAY_IDENTIFIER EngineSpeed_AvgOld[2] ECU_ADDRESS 0x40002A12 /end MEASUREMENT
/begin MEASUREMENT EngSpdOld3 "var comments" UWORD udf_CM_16136 0 0.0 0.0 16383.75 DISPLAY_IDENTIFIER EngineSpeed_AvgOld[3] ECU_ADDRESS 0x40002A14 /end MEASUREMENT
/begin MEASUREMENT EngSpdOld4 "var comments" UWORD udf_CM_16143 0 0.0 0.0 16383.75 DISPLAY_IDENTIFIER EngineSpeed_AvgOld[4] ECU_ADDRESS 0x40002A16 /end MEASUREMENT
/begin MEASUREMENT EngSpdOld5 "var comments" UWORD udf_CM_16150 0 0.0 0.0 16383.75 DISPLAY_IDENTIFIER EngineSpeed_AvgOld[5] ECU_ADDRESS 0x40002A18 /end MEASUREMENT
/begin MEASUREMENT EngSpdOld6 "var comments" UWORD udf_CM_16157 0 0.0 0.0 16383.75 DISPLAY_IDENTIFIER EngineSpeed_AvgOld[6] ECU_ADDRESS 0x40002A1A /end MEASUREMENT
/begin MEASUREMENT EngSpdOld7 "var comments" UWORD udf_CM_16164 0 0.0 0.0 16383.75 DISPLAY_IDENTIFIER EngineSpeed_AvgOld[7] ECU_ADDRESS 0x40002A1C /end MEASUREMENT
/begin MEASUREMENT EngSpdOld8 "var comments" UWORD udf_CM_16171 0 0.0 0.0 16383.75 DISPLAY_IDENTIFIER EngineSpeed_AvgOld[8] ECU_ADDRESS 0x40002A1E /end MEASUREMENT
/begin MEASUREMENT EngSpdOld9 "var comments" UWORD udf_CM_16178 0 0.0 0.0 16383.75 DISPLAY_IDENTIFIER EngineSpeed_AvgOld[9] ECU_ADDRESS 0x40002A20 /end MEASUREMENT
/begin MEASUREMENT MultFuelType "var comments" UBYTE udf_CM_16193 0 0.0 0.0 255.0 ECU_ADDRESS 0x40002A8C /end MEASUREMENT
/begin MEASUREMENT MultFuelSeq "var comments" UBYTE udf_CM_18012 0 0.0 0.0 255.0 ECU_ADDRESS 0x40002A8D /end MEASUREMENT
/begin MEASUREMENT EngineState "var comments" UBYTE udf_CM_16192 0 0.0 0.0 255.0 ECU_ADDRESS 0x40002940 /end MEASUREMENT
/begin MEASUREMENT EngTorque "var comments" SWORD udf_CM_16059 0 0.0 -128.0 127.99609375 DISPLAY_IDENTIFIER EngineFlywheelTorq ECU_ADDRESS 0x400025E0 /end MEASUREMENT
/begin MEASUREMENT EngineTuning "var comments" UBYTE udf_CM_16199 0 0.0 0.0 255.0 ECU_ADDRESS 0x4000294E /end MEASUREMENT
/begin MEASUREMENT O2_1_SHTestFail "var comments" UBYTE udf_CM_17508 0 0.0 0.0 255.0 ECU_ADDRESS 0x40002C16 /end MEASUREMENT
/begin MEASUREMENT O2_1_ShrtDiagEnb "var comments" UBYTE udf_CM_17494 0 0.0 0.0 255.0 ECU_ADDRESS 0x40002C14 /end MEASUREMENT
/begin MEASUREMENT O2_1_SHFailMet "var comments" UBYTE udf_CM_17487 0 0.0 0.0 255.0 ECU_ADDRESS 0x40002C1A /end MEASUREMENT
/begin MEASUREMENT O2_1_SHFailCount "var comments" UWORD udf_CM_17480 0 0.0 0.0 65535.0 ECU_ADDRESS 0x40002C1C /end MEASUREMENT
/begin MEASUREMENT O2_1_SLFailMet "var comments" UBYTE udf_CM_17522 0 0.0 0.0 255.0 ECU_ADDRESS 0x40002C19 /end MEASUREMENT
/begin MEASUREMENT O2_1_SLFailCount "var comments" UWORD udf_CM_17515 0 0.0 0.0 65535.0 ECU_ADDRESS 0x40002C1E /end MEASUREMENT
/begin MEASUREMENT O2_1_SLTestFail "var comments" UBYTE udf_CM_17529 0 0.0 0.0 255.0 ECU_ADDRESS 0x40002C17 /end MEASUREMENT
/begin MEASUREMENT O2_1_ShrtPassCount "var comments" UWORD udf_CM_17501 0 0.0 0.0 65535.0 ECU_ADDRESS 0x40002C20 /end MEASUREMENT
/begin MEASUREMENT BaseFPWCyl1 "var comments" UWORD udf_CM_15597 0 0.0 0.0 1023.984375 DISPLAY_IDENTIFIER BaseFPWCyl ECU_ADDRESS 0x400025EE /end MEASUREMENT
/begin MEASUREMENT BaseFuelMassCyl1 "var comments" UWORD udf_CM_15604 0 0.0 0.0 0.9999849796295166 DISPLAY_IDENTIFIER BaseFuelMassCyl ECU_ADDRESS 0x400025EC /end MEASUREMENT
/begin MEASUREMENT BaseFMPrevCyl1 "var comments" UWORD udf_CM_15590 0 0.0 0.0 0.9999849796295166 DISPLAY_IDENTIFIER BaseFMPrevCyl ECU_ADDRESS 0x400025F6 /end MEASUREMENT
/begin MEASUREMENT FPWClCorrCyl1 "var comments" UWORD udf_CM_16409 0 0.0 0.0 1023.984375 DISPLAY_IDENTIFIER FPWClCorrCyl[0] ECU_ADDRESS 0x400025E2 /end MEASUREMENT
/begin MEASUREMENT FPWClCorrCyl2 "var comments" UWORD udf_CM_16416 0 0.0 0.0 1023.984375 DISPLAY_IDENTIFIER FPWClCorrCyl[1] ECU_ADDRESS 0x400025E4 /end MEASUREMENT
/begin MEASUREMENT ChrgAirTmpCyl1 "var comments" SWORD udf_CM_15646 0 0.0 -256.0 255.9921875 DISPLAY_IDENTIFIER ChrgAirTmpCyl ECU_ADDRESS 0x40002578 /end MEASUREMENT
/begin MEASUREMENT FuelCLTermCyl1 "var comments" SWORD udf_CM_16437 0 0.0 -4.0 3.9998779296875 DISPLAY_IDENTIFIER FuelCLTermCyl ECU_ADDRESS 0x40002702 /end MEASUREMENT
/begin MEASUREMENT FuelCLEnbCyl1 "var comments" UBYTE udf_CM_16423 0 0.0 0.0 255.0 DISPLAY_IDENTIFIER FuelCLEnbCyl ECU_ADDRESS 0x40002711 /end MEASUREMENT
/begin MEASUREMENT FuelINTCyl1 "var comments" SWORD udf_CM_16500 0 0.0 -32768.0 32767.0 DISPLAY_IDENTIFIER FuelINTCyl ECU_ADDRESS 0x4000270E /end MEASUREMENT
/begin MEASUREMENT FuelINTDlyCyl1 "var comments" UWORD udf_CM_16507 0 0.0 0.0 1023.984375 DISPLAY_IDENTIFIER FuelINTDlyCyl ECU_ADDRESS 0x40002722 /end MEASUREMENT
/begin MEASUREMENT FPropMinDurEnb "var comments" UBYTE udf_CM_16395 0 0.0 0.0 255.0 ECU_ADDRESS 0x4000271C /end MEASUREMENT
/begin MEASUREMENT FRichBiasHold1 "var comments" SWORD udf_CM_17067 0 0.0 -32.0 31.9990234375 DISPLAY_IDENTIFIER INTRatioCyl ECU_ADDRESS 0x400026FE /end MEASUREMENT
/begin MEASUREMENT RawO2RLThresh "var comments" UWORD udf_CM_17648 0 0.0 0.0 1023.984375 ECU_ADDRESS 0x40002728 /end MEASUREMENT
/begin MEASUREMENT FPropLoLoadCond "var comments" UBYTE udf_CM_19230 0 0.0 0.0 255.0 DISPLAY_IDENTIFIER VbFUEL_PropTerm_LowLoad ECU_ADDRESS 0x4000271B /end MEASUREMENT
/begin MEASUREMENT FPropAddFuelCyl1 "var comments" UBYTE udf_CM_16381 0 0.0 0.0 255.0 DISPLAY_IDENTIFIER FPropAddFuelCyl[0] ECU_ADDRESS 0x4000272A /end MEASUREMENT
/begin MEASUREMENT FuelINTRstCyl1 "var comments" UBYTE udf_CM_16521 0 0.0 0.0 255.0 DISPLAY_IDENTIFIER FuelINTRstCyl ECU_ADDRESS 0x40002708 /end MEASUREMENT
/begin MEASUREMENT FuelINTDlyPass1 "var comments" UBYTE udf_CM_16514 0 0.0 0.0 255.0 DISPLAY_IDENTIFIER FuelINTDlyPass ECU_ADDRESS 0x4000271D /end MEASUREMENT
/begin MEASUREMENT INTRatioCyl1 "var comments" UWORD udf_CM_19048 0 0.0 0.0 1.999969005584717 DISPLAY_IDENTIFIER VaFUEL_ClosedLoop_Mult ECU_ADDRESS 0x40002700 /end MEASUREMENT
/begin MEASUREMENT FPropRichHold1 "var comments" UBYTE udf_CM_16402 0 0.0 0.0 255.0 DISPLAY_IDENTIFIER FPropRichHold ECU_ADDRESS 0x4000270C /end MEASUREMENT
/begin MEASUREMENT FuelPropCyl1 "var comments" UWORD udf_CM_16535 0 0.0 0.0 199.9969482421875 DISPLAY_IDENTIFIER FuelPropCyl ECU_ADDRESS 0x40002714 /end MEASUREMENT
/begin MEASUREMENT FuelCLRstCyl1 "var comments" UBYTE udf_CM_16430 0 0.0 0.0 255.0 DISPLAY_IDENTIFIER FuelCLRstCyl ECU_ADDRESS 0x40002717 /end MEASUREMENT
/begin MEASUREMENT CATFactorCyl1 "var comments" SWORD udf_CM_15639 0 0.0 -1.998847961425781 1.998787045478821 DISPLAY_IDENTIFIER CATFactorCyl ECU_ADDRESS 0x40002576 /end MEASUREMENT
/begin MEASUREMENT FuelEOI "var comments" UWORD udf_CM_16465 0 0.0 0.0 1023.984375 ECU_ADDRESS 0x40002682 /end MEASUREMENT
/begin MEASUREMENT FuelEOITarget "var comments" UWORD udf_CM_16472 0 0.0 0.0 1023.984375 ECU_ADDRESS 0x4000268E /end MEASUREMENT
/begin MEASUREMENT FuelEOITrim "var comments" UWORD udf_CM_16479 0 0.0 0.0 1023.984375 ECU_ADDRESS 0x40002694 /end MEASUREMENT
/begin MEASUREMENT O2HeaterOutputEnable "var comments" UBYTE udf_CM_17452 0 0.0 0.0 255.0 ECU_ADDRESS 0x400025D3 /end MEASUREMENT
/begin MEASUREMENT FuelInj1Enb "var comments" UBYTE udf_CM_16486 0 0.0 0.0 255.0 DISPLAY_IDENTIFIER FuelInjEnb[0] ECU_ADDRESS 0x40002690 /end MEASUREMENT
/begin MEASUREMENT FuelInj2Enb "var comments" UBYTE udf_CM_16493 0 0.0 0.0 255.0 DISPLAY_IDENTIFIER FuelInjEnb[1] ECU_ADDRESS 0x40002691 /end MEASUREMENT
/begin MEASUREMENT InjectorOffset "var comments" UWORD udf_CM_17046 0 0.0 0.0 1023.984375 ECU_ADDRESS 0x4000269A /end MEASUREMENT
/begin MEASUREMENT FO21Filt "var comments" UWORD udf_CM_16325 0 0.0 0.0 1023.984375 DISPLAY_IDENTIFIER FO2Filt ECU_ADDRESS 0x40002720 /end MEASUREMENT
/begin MEASUREMENT FO21Ready "var comments" UBYTE udf_CM_16339 0 0.0 0.0 255.0 DISPLAY_IDENTIFIER FO2Ready ECU_ADDRESS 0x40002716 /end MEASUREMENT
/begin MEASUREMENT FO21RichOld "var comments" UBYTE udf_CM_16311 0 0.0 0.0 1.0 ECU_ADDRESS 0x4000270A /end MEASUREMENT
/begin MEASUREMENT FO21FiltRich "var comments" UBYTE udf_CM_16332 0 0.0 0.0 1.0 DISPLAY_IDENTIFIER FO2FiltRich ECU_ADDRESS 0x40002709 /end MEASUREMENT
/begin MEASUREMENT FO21Rich "var comments" UBYTE udf_CM_16346 0 0.0 0.0 1.0 DISPLAY_IDENTIFIER FO2Rich ECU_ADDRESS 0x40002710 /end MEASUREMENT
/begin MEASUREMENT FO2RLThresh "var comments" UWORD udf_CM_16360 0 0.0 0.0 1023.984375 ECU_ADDRESS 0x40002712 /end MEASUREMENT
/begin MEASUREMENT FO21RLChange "var comments" UBYTE udf_CM_16353 0 0.0 0.0 255.0 DISPLAY_IDENTIFIER FO2RLChange ECU_ADDRESS 0x4000271A /end MEASUREMENT
/begin MEASUREMENT O2HeaterEnb "var comments" UBYTE udf_CM_17445 0 0.0 0.0 255.0 DISPLAY_IDENTIFIER O2HeaterEnable ECU_ADDRESS 0x400025D2 /end MEASUREMENT
/begin MEASUREMENT ExtPEModeEnb "var comments" UBYTE udf_CM_16269 0 0.0 0.0 255.0 ECU_ADDRESS 0x40002607 /end MEASUREMENT
/begin MEASUREMENT FuelPumpEnb "var comments" UBYTE udf_CM_16605 0 0.0 0.0 255.0 ECU_ADDRESS 0x400026A1 /end MEASUREMENT
/begin MEASUREMENT PowerEnrich "var comments" UBYTE udf_CM_17613 0 0.0 0.0 255.0 ECU_ADDRESS 0x4000269C /end MEASUREMENT
/begin MEASUREMENT FuelCOADMult "var comments" SWORD udf_CM_15262 0 0.0 -1.0 0.999969482421875 ECU_ADDRESS 0x400000C0 /end MEASUREMENT
/begin MEASUREMENT FuelCOAdjFactor "var comments" SWORD udf_CM_15262 0 0.0 -1.0 0.999969482421875 ECU_ADDRESS 0x40002738 /end MEASUREMENT
/begin MEASUREMENT FuelCOAdjEn "var comments" UBYTE udf_CM_16710 0 0.0 0.0 255.0 ECU_ADDRESS 0x40002736 /end MEASUREMENT
/begin MEASUREMENT FuelPumpDiagEnb "var comments" UBYTE udf_CM_17382 0 0.0 0.0 255.0 ECU_ADDRESS 0x40002D24 /end MEASUREMENT
/begin MEASUREMENT FuelPumpSLFailMet "var comments" UBYTE udf_CM_17410 0 0.0 0.0 255.0 ECU_ADDRESS 0x40002D25 /end MEASUREMENT
/begin MEASUREMENT FuelPumpSLTestComp "var comments" UBYTE udf_CM_17424 0 0.0 0.0 255.0 ECU_ADDRESS 0x40002D27 /end MEASUREMENT
/begin MEASUREMENT FuelPumpSLTestFail "var comments" UBYTE udf_CM_17431 0 0.0 0.0 255.0 ECU_ADDRESS 0x40002D29 /end MEASUREMENT
/begin MEASUREMENT FuelPumpSLFailCount "var comments" UWORD udf_CM_17389 0 0.0 0.0 65535.0 ECU_ADDRESS 0x40002D2A /end MEASUREMENT
/begin MEASUREMENT FuelPumpSLPassCount "var comments" UWORD udf_CM_17417 0 0.0 0.0 65535.0 ECU_ADDRESS 0x40002D2E /end MEASUREMENT
/begin MEASUREMENT FuelPumpSHFailMet "var comments" UBYTE udf_CM_17410 0 0.0 0.0 255.0 ECU_ADDRESS 0x40002D26 /end MEASUREMENT
/begin MEASUREMENT FuelPumpSHTestComp "var comments" UBYTE udf_CM_17424 0 0.0 0.0 255.0 ECU_ADDRESS 0x40002D28 /end MEASUREMENT
/begin MEASUREMENT FuelPumpSHTestFail "var comments" UBYTE udf_CM_17431 0 0.0 0.0 255.0 ECU_ADDRESS 0x40002D32 /end MEASUREMENT
/begin MEASUREMENT FuelPumpSHFailCount "var comments" UWORD udf_CM_17389 0 0.0 0.0 65535.0 ECU_ADDRESS 0x40002D2C /end MEASUREMENT
/begin MEASUREMENT FuelPumpSHPassCount "var comments" UWORD udf_CM_17417 0 0.0 0.0 65535.0 ECU_ADDRESS 0x40002D30 /end MEASUREMENT
/begin MEASUREMENT FuelPumpRunEnb "var comments" UBYTE udf_CM_16619 0 0.0 0.0 255.0 ECU_ADDRESS 0x4000269F /end MEASUREMENT
/begin MEASUREMENT FuelPumpDC "var comments" UWORD udf_CM_16598 0 0.0 0.0 199.9969482421875 ECU_ADDRESS 0x400026A2 /end MEASUREMENT
/begin MEASUREMENT FuelPumpPPDsrd "var comments" UBYTE udf_CM_19244 0 0.0 0.0 255.0 DISPLAY_IDENTIFIER VbFUEL_PumpPrimeForPP_Dsrd ECU_ADDRESS 0x400026AB /end MEASUREMENT
/begin MEASUREMENT FuelPumpPrmEnb "var comments" UBYTE udf_CM_16612 0 0.0 0.0 255.0 ECU_ADDRESS 0x4000269E /end MEASUREMENT
/begin MEASUREMENT FuelVoltCorr "var comments" UWORD udf_CM_16626 0 0.0 0.0 1.999969005584717 ECU_ADDRESS 0x40002698 /end MEASUREMENT
/begin MEASUREMENT FuelPressureCorr "var comments" UWORD udf_CM_16627 0 0.0 0.0 3.99993896484375 ECU_ADDRESS 0x40002696 /end MEASUREMENT
/begin MEASUREMENT FinalFPWCyl1 "var comments" UWORD udf_CM_16283 0 0.0 0.0 1023.984375 DISPLAY_IDENTIFIER FinalFPWCyl[0] ECU_ADDRESS 0x40002686 /end MEASUREMENT
/begin MEASUREMENT FinalFPWCyl2 "var comments" UWORD udf_CM_16290 0 0.0 0.0 1023.984375 DISPLAY_IDENTIFIER FinalFPWCyl[1] ECU_ADDRESS 0x40002688 /end MEASUREMENT
/begin MEASUREMENT FinalFPWCyl3 "var comments" UWORD udf_CM_16290 0 0.0 0.0 1023.984375 DISPLAY_IDENTIFIER FinalFPWCyl[2] ECU_ADDRESS 0x4000268A /end MEASUREMENT
/begin MEASUREMENT FinalFPWCyl4 "var comments" UWORD udf_CM_16290 0 0.0 0.0 1023.984375 DISPLAY_IDENTIFIER FinalFPWCyl[3] ECU_ADDRESS 0x4000268C /end MEASUREMENT
/begin MEASUREMENT O2HtAccFuelMassPrevious "var comments" UWORD udf_CM_17466 0 0.0 0.0 7.9998779296875 ECU_ADDRESS 0x400025D6 /end MEASUREMENT
/begin MEASUREMENT O2HtAccFuelMass "var comments" UWORD udf_CM_17459 0 0.0 0.0 7.9998779296875 ECU_ADDRESS 0x400025D4 /end MEASUREMENT
/begin MEASUREMENT O2HeaterDC "var comments" UWORD udf_CM_17438 0 0.0 0.0 199.9969482421875 DISPLAY_IDENTIFIER O2HeaterDutyCycle ECU_ADDRESS 0x40002952 /end MEASUREMENT
/begin MEASUREMENT O2HtAccFuelMassThresh "var comments" UWORD udf_CM_17473 0 0.0 0.0 7.9998779296875 ECU_ADDRESS 0x400025D8 /end MEASUREMENT
/begin MEASUREMENT AEDecayFactor "var comments" UWORD udf_CM_15261 0 0.0 0.0 0.9999849796295166 ECU_ADDRESS 0x400026B4 /end MEASUREMENT
/begin MEASUREMENT AECancelled "var comments" UBYTE udf_CM_15254 0 0.0 0.0 255.0 ECU_ADDRESS 0x400026BA /end MEASUREMENT
/begin MEASUREMENT AEFuelCyl1 "var comments" UWORD udf_CM_15268 0 0.0 0.0 7.9998779296875 DISPLAY_IDENTIFIER AEFuelCyl ECU_ADDRESS 0x400026AC /end MEASUREMENT
/begin MEASUREMENT AccEnrich "var comments" UBYTE udf_CM_15240 0 0.0 0.0 255.0 ECU_ADDRESS 0x400026B8 /end MEASUREMENT
/begin MEASUREMENT DEDecayFactor "var comments" UWORD udf_CM_15961 0 0.0 0.0 0.9999849796295166 ECU_ADDRESS 0x400026B6 /end MEASUREMENT
/begin MEASUREMENT DEFuelCyl1 "var comments" UWORD udf_CM_15968 0 0.0 0.0 7.9998779296875 DISPLAY_IDENTIFIER DEFuelCyl ECU_ADDRESS 0x400026AE /end MEASUREMENT
/begin MEASUREMENT DECancelled "var comments" UBYTE udf_CM_15947 0 0.0 0.0 255.0 ECU_ADDRESS 0x400026BB /end MEASUREMENT
/begin MEASUREMENT DecEnlean "var comments" UBYTE udf_CM_15954 0 0.0 0.0 255.0 ECU_ADDRESS 0x400026B9 /end MEASUREMENT
/begin MEASUREMENT DeltaFuelCyl1 "var comments" UWORD udf_CM_15975 0 0.0 0.0 0.9999849796295166 DISPLAY_IDENTIFIER DeltaFuelCyl ECU_ADDRESS 0x400026B2 /end MEASUREMENT
/begin MEASUREMENT TranFuelDltCyl1 "var comments" SWORD udf_CM_18908 0 0.0 -8.0 7.999755859375 DISPLAY_IDENTIFIER TranFuelDltCyl ECU_ADDRESS 0x400026B0 /end MEASUREMENT
/begin MEASUREMENT FuelCutOff "var comments" UBYTE udf_CM_16451 0 0.0 0.0 255.0 ECU_ADDRESS 0x4000261A /end MEASUREMENT
/begin MEASUREMENT SparkCutOff "var comments" UBYTE udf_CM_16451 0 0.0 0.0 255.0 ECU_ADDRESS 0x4000261B /end MEASUREMENT
/begin MEASUREMENT VbFUEL_ClearFloodEnbl "var comments" UBYTE udf_CM_15723 0 0.0 0.0 255.0 ECU_ADDRESS 0x0 /end MEASUREMENT
/begin MEASUREMENT DFCO_TPS_Thrsh "var comments" UWORD udf_CM_16871 0 0.0 0.0 199.9969482421875 ECU_ADDRESS 0x0 /end MEASUREMENT
/begin MEASUREMENT DFCO_FuelCritMet "var comments" UBYTE udf_CM_15723 0 0.0 0.0 255.0 ECU_ADDRESS 0x4000261C /end MEASUREMENT
/begin MEASUREMENT DFCO_FuelEnabled "var comments" UBYTE udf_CM_15723 0 0.0 0.0 255.0 ECU_ADDRESS 0x4000261D /end MEASUREMENT
/begin MEASUREMENT DFCO_FuelExitEnbl "var comments" UBYTE udf_CM_15723 0 0.0 0.0 255.0 ECU_ADDRESS 0x4000261E /end MEASUREMENT
/begin MEASUREMENT DFCO_FuelRampOutEn "var comments" UBYTE udf_CM_15723 0 0.0 0.0 255.0 ECU_ADDRESS 0x4000261F /end MEASUREMENT
/begin MEASUREMENT DFCO_SparkCritMet "var comments" UBYTE udf_CM_15723 0 0.0 0.0 255.0 ECU_ADDRESS 0x40002620 /end MEASUREMENT
/begin MEASUREMENT DFCO_SparkEnabled "var comments" UBYTE udf_CM_15723 0 0.0 0.0 255.0 ECU_ADDRESS 0x40002621 /end MEASUREMENT
/begin MEASUREMENT DFCO_EM_Disable "var comments" UBYTE udf_CM_15723 0 0.0 0.0 255.0 ECU_ADDRESS 0x40002616 /end MEASUREMENT
/begin MEASUREMENT DFCO_MAPThrsh "var comments" UWORD udf_CM_15401 0 0.0 0.0 255.99609375 ECU_ADDRESS 0x40002612 /end MEASUREMENT
/begin MEASUREMENT DFCO_FuelRampoutFact "var comments" UWORD udf_CM_16626 0 0.0 0.0 1.999969005584717 ECU_ADDRESS 0x40002622 /end MEASUREMENT
/begin MEASUREMENT DFCO_ExitFuel "var comments" UWORD udf_CM_16283 0 0.0 0.0 1023.984375 ECU_ADDRESS 0x40002624 /end MEASUREMENT
/begin MEASUREMENT FuelConsump "var comments" UWORD udf_CM_16444 0 0.0 0.0 15.999755859375 ECU_ADDRESS 0x400025EA /end MEASUREMENT
/begin MEASUREMENT InjectorFlow "var comments" UWORD udf_CM_16444 0 0.0 0.0 15.999755859375 ECU_ADDRESS 0x40002A90 /end MEASUREMENT
/begin MEASUREMENT FuelDlvMode "var comments" UBYTE udf_CM_16458 0 0.0 0.0 255.0 ECU_ADDRESS 0x40002684 /end MEASUREMENT
/begin MEASUREMENT BLM_LrnActive "var comments" UBYTE udf_CM_17158 0 0.0 0.0 255.0 ECU_ADDRESS 0x400026EE /end MEASUREMENT
/begin MEASUREMENT BLM_Updated "var comments" UBYTE udf_CM_17158 0 0.0 0.0 255.0 ECU_ADDRESS 0x400026EF /end MEASUREMENT
/begin MEASUREMENT BLM_LrnAllowed "var comments" UBYTE udf_CM_17158 0 0.0 0.0 255.0 ECU_ADDRESS 0x400026F0 /end MEASUREMENT
/begin MEASUREMENT BLM_RPM_DeltaMet "var comments" UBYTE udf_CM_17158 0 0.0 0.0 255.0 ECU_ADDRESS 0x400026F1 /end MEASUREMENT
/begin MEASUREMENT BLM_AirFlowDeltaMet "var comments" UBYTE udf_CM_17158 0 0.0 0.0 255.0 ECU_ADDRESS 0x400026F2 /end MEASUREMENT
/begin MEASUREMENT BLM_EngSpeedFilt "var comments" UWORD udf_CM_16185 0 0.0 0.0 16383.75 ECU_ADDRESS 0x400026F6 /end MEASUREMENT
/begin MEASUREMENT BLM_EngSpeedDelta "var comments" UWORD udf_CM_16185 0 0.0 0.0 16383.75 ECU_ADDRESS 0x400026FA /end MEASUREMENT
/begin MEASUREMENT BLM_AirFlowFilt "var comments" UWORD udf_CM_15534 0 0.0 0.0 511.9921875 ECU_ADDRESS 0x400026F4 /end MEASUREMENT
/begin MEASUREMENT BLM_AirFlowDelta "var comments" UWORD udf_CM_15534 0 0.0 0.0 511.9921875 ECU_ADDRESS 0x400026F8 /end MEASUREMENT
/begin MEASUREMENT FUEL_BLM_Base "var comments" UWORD udf_CM_16626 0 0.0 0.0 1.999969005584717 ECU_ADDRESS 0x400026EA /end MEASUREMENT
/begin MEASUREMENT FUEL_BLM_FCV "var comments" UWORD udf_CM_16626 0 0.0 0.0 1.999969005584717 ECU_ADDRESS 0x400026EC /end MEASUREMENT
/begin MEASUREMENT BLM_CellChange "var comments" UBYTE udf_CM_17158 0 0.0 0.0 255.0 ECU_ADDRESS 0x400026E8 /end MEASUREMENT
/begin MEASUREMENT BLM_CellChangeLrnDly "var comments" UBYTE udf_CM_17158 0 0.0 0.0 255.0 ECU_ADDRESS 0x400026E9 /end MEASUREMENT
/begin MEASUREMENT BLM_CellRow "var comments" UBYTE udf_CM_15247 0 0.0 0.0 255.0 ECU_ADDRESS 0x400026E7 /end MEASUREMENT
/begin MEASUREMENT BLM_CellCol "var comments" UBYTE udf_CM_15247 0 0.0 0.0 255.0 ECU_ADDRESS 0x400026E5 /end MEASUREMENT
/begin MEASUREMENT BLM_Cell_Petrol "var comments" UWORD udf_CM_16626 0 0.0 0.0 1.999969005584717 LAYOUT COLUMN_DIR MATRIX_DIM 17 3 ECU_ADDRESS 0x400000C6 /end MEASUREMENT
/begin MEASUREMENT BLM_Cell_NG "var comments" UWORD udf_CM_16626 0 0.0 0.0 1.999969005584717 LAYOUT COLUMN_DIR MATRIX_DIM 17 3 ECU_ADDRESS 0x4000012C /end MEASUREMENT
/begin MEASUREMENT BLM_Cell_LPG "var comments" UWORD udf_CM_16626 0 0.0 0.0 1.999969005584717 LAYOUT COLUMN_DIR MATRIX_DIM 17 3 ECU_ADDRESS 0x40000192 /end MEASUREMENT
/begin MEASUREMENT VECyl1 "var comments" UWORD udf_CM_19398 0 0.0 0.0 199.9969482421875 DISPLAY_IDENTIFIER VECyl[0] ECU_ADDRESS 0x4000257A /end MEASUREMENT
/begin MEASUREMENT VECyl2 "var comments" UWORD udf_CM_19398 0 0.0 0.0 199.9969482421875 DISPLAY_IDENTIFIER VECyl[1] ECU_ADDRESS 0x4000257C /end MEASUREMENT
/begin MEASUREMENT VECyl3 "var comments" UWORD udf_CM_19398 0 0.0 0.0 199.9969482421875 DISPLAY_IDENTIFIER VECyl[2] ECU_ADDRESS 0x4000257E /end MEASUREMENT
/begin MEASUREMENT VECyl4 "var comments" UWORD udf_CM_19398 0 0.0 0.0 199.9969482421875 DISPLAY_IDENTIFIER VECyl[3] ECU_ADDRESS 0x40002580 /end MEASUREMENT
/begin MEASUREMENT AirPerCyl1 "var comments" UWORD udf_CM_15548 0 0.0 0.0 3.99993896484375 DISPLAY_IDENTIFIER AirPerCyl[0] ECU_ADDRESS 0x40002564 /end MEASUREMENT
/begin MEASUREMENT AirPerCyl2 "var comments" UWORD udf_CM_15555 0 0.0 0.0 3.99993896484375 DISPLAY_IDENTIFIER AirPerCyl[1] ECU_ADDRESS 0x40002566 /end MEASUREMENT
/begin MEASUREMENT IDLEMoveDirct "var comments" UBYTE udf_CM_16668 0 0.0 0.0 2.0 ECU_ADDRESS 0x40002A9E /end MEASUREMENT
/begin MEASUREMENT IDLEMode "var comments" UBYTE udf_CM_16640 0 0.0 0.0 255.0 ECU_ADDRESS 0x40002789 /end MEASUREMENT
/begin MEASUREMENT IDLEMotorState "var comments" UBYTE udf_CM_16661 0 0.0 0.0 3.0 ECU_ADDRESS 0x40002AA4 /end MEASUREMENT
/begin MEASUREMENT ActIDLEPosition "var comments" UBYTE udf_CM_15247 0 0.0 0.0 255.0 ECU_ADDRESS 0x40002AA2 /end MEASUREMENT
/begin MEASUREMENT IdlDerivTerm "var comments" SWORD udf_CM_16773 0 0.0 -200.0 199.993896484375 ECU_ADDRESS 0x40002768 /end MEASUREMENT
/begin MEASUREMENT IdlDsrdSpdStOfst "var comments" UWORD udf_CM_16801 0 0.0 0.0 16383.75 ECU_ADDRESS 0x400027A2 /end MEASUREMENT
/begin MEASUREMENT IdlEngSpdHigh "var comments" UBYTE udf_CM_16850 0 0.0 0.0 255.0 ECU_ADDRESS 0x400027A1 /end MEASUREMENT
/begin MEASUREMENT IdlINTDelta "var comments" UWORD udf_CM_16864 0 0.0 0.0 199.9969482421875 ECU_ADDRESS 0x40002762 /end MEASUREMENT
/begin MEASUREMENT IdlINTTerm "var comments" UWORD udf_CM_16871 0 0.0 0.0 199.9969482421875 ECU_ADDRESS 0x4000275E /end MEASUREMENT
/begin MEASUREMENT NrmIdlDlyTmr "var comments" UWORD udf_CM_17368 0 0.0 0.0 1023.984375 ECU_ADDRESS 0x4000279A /end MEASUREMENT
/begin MEASUREMENT IdlPropTerm "var comments" SWORD udf_CM_16885 0 0.0 -200.0 199.993896484375 ECU_ADDRESS 0x40002766 /end MEASUREMENT
/begin MEASUREMENT IdlDsrdEngSpd "var comments" UWORD udf_CM_16780 0 0.0 0.0 16383.75 ECU_ADDRESS 0x4000279E /end MEASUREMENT
/begin MEASUREMENT IdlEngSpdError "var comments" UWORD udf_CM_16843 0 0.0 0.0 16383.75 ECU_ADDRESS 0x400027A4 /end MEASUREMENT
/begin MEASUREMENT IACVResetInProg "var comments" UBYTE udf_CM_16682 0 0.0 0.0 255.0 ECU_ADDRESS 0x40002814 /end MEASUREMENT
/begin MEASUREMENT DsrdIACV_MtrPstn "var comments" UBYTE udf_CM_15247 0 0.0 0.0 255.0 ECU_ADDRESS 0x40002ACA /end MEASUREMENT
/begin MEASUREMENT IACVResetCmplt "var comments" UBYTE udf_CM_16675 0 0.0 0.0 255.0 ECU_ADDRESS 0x4000281A /end MEASUREMENT
/begin MEASUREMENT IACVMotorLost "var comments" UBYTE udf_CM_16647 0 0.0 0.0 255.0 ECU_ADDRESS 0x40002817 /end MEASUREMENT
/begin MEASUREMENT IACVMotorReset "var comments" UBYTE udf_CM_16654 0 0.0 0.0 255.0 ECU_ADDRESS 0x40002816 /end MEASUREMENT
/begin MEASUREMENT IACVOLFlow "var comments" UWORD udf_CM_16808 0 0.0 0.0 199.9969482421875 ECU_ADDRESS 0x40002802 /end MEASUREMENT
/begin MEASUREMENT IACVCLFlow "var comments" UWORD udf_CM_16808 0 0.0 0.0 199.9969482421875 ECU_ADDRESS 0x400027BC /end MEASUREMENT
/begin MEASUREMENT IACVFlow "var comments" UWORD udf_CM_16808 0 0.0 0.0 199.9969482421875 ECU_ADDRESS 0x400027C4 /end MEASUREMENT
/begin MEASUREMENT IACVFlowCoolOffset "var comments" UWORD udf_CM_16808 0 0.0 0.0 199.9969482421875 ECU_ADDRESS 0x400027F6 /end MEASUREMENT
/begin MEASUREMENT IACVFlowCoolOffsetMax "var comments" UWORD udf_CM_16808 0 0.0 0.0 199.9969482421875 ECU_ADDRESS 0x400027F8 /end MEASUREMENT
/begin MEASUREMENT IACVFlowCrankOffset "var comments" UWORD udf_CM_16808 0 0.0 0.0 199.9969482421875 ECU_ADDRESS 0x400027F4 /end MEASUREMENT
/begin MEASUREMENT IACVFlowTFOffset "var comments" UWORD udf_CM_16808 0 0.0 0.0 199.9969482421875 ECU_ADDRESS 0x40002804 /end MEASUREMENT
/begin MEASUREMENT IACVFlowBattOffset "var comments" UWORD udf_CM_16808 0 0.0 0.0 199.9969482421875 ECU_ADDRESS 0x400027FA /end MEASUREMENT
/begin MEASUREMENT IACVFlowDsrdTF "var comments" UWORD udf_CM_16808 0 0.0 0.0 199.9969482421875 ECU_ADDRESS 0x40002806 /end MEASUREMENT
/begin MEASUREMENT IACVFlowCoolFactor "var comments" UWORD udf_CM_15261 0 0.0 0.0 0.9999849796295166 ECU_ADDRESS 0x40002800 /end MEASUREMENT
/begin MEASUREMENT IACVFlowCoolantDecayTime "var comments" UWORD udf_CM_16507 0 0.0 0.0 1023.984375 ECU_ADDRESS 0x400027FC /end MEASUREMENT
/begin MEASUREMENT IACVAlternatorLoadStat "var comments" UBYTE udf_CM_16423 0 0.0 0.0 255.0 ECU_ADDRESS 0x400027FE /end MEASUREMENT
/begin MEASUREMENT IACVCLCondMet "var comments" UBYTE udf_CM_16857 0 0.0 0.0 255.0 ECU_ADDRESS 0x400027ED /end MEASUREMENT
/begin MEASUREMENT IACVMode "var comments" UBYTE udf_CM_16640 0 0.0 0.0 255.0 ECU_ADDRESS 0x400027EC /end MEASUREMENT
/begin MEASUREMENT ActIACVPosition "var comments" UBYTE udf_CM_15247 0 0.0 0.0 255.0 ECU_ADDRESS 0x40002ABD /end MEASUREMENT
/begin MEASUREMENT IACVMoveDirct "var comments" UBYTE udf_CM_16668 0 0.0 0.0 2.0 ECU_ADDRESS 0x40002ABC /end MEASUREMENT
/begin MEASUREMENT IACVMotorState "var comments" UBYTE udf_CM_16661 0 0.0 0.0 3.0 ECU_ADDRESS 0x40002AC1 /end MEASUREMENT
/begin MEASUREMENT IACVDerivTerm "var comments" SWORD udf_CM_16773 0 0.0 -200.0 199.993896484375 ECU_ADDRESS 0x400027B8 /end MEASUREMENT
/begin MEASUREMENT IACVDsrdSpdStOfst "var comments" UWORD udf_CM_16801 0 0.0 0.0 16383.75 ECU_ADDRESS 0x40002808 /end MEASUREMENT
/begin MEASUREMENT IACVEngSpdHigh "var comments" UBYTE udf_CM_16850 0 0.0 0.0 255.0 ECU_ADDRESS 0x4000280D /end MEASUREMENT
/begin MEASUREMENT IACVINTDelta "var comments" UWORD udf_CM_16864 0 0.0 0.0 199.9969482421875 ECU_ADDRESS 0x400027AE /end MEASUREMENT
/begin MEASUREMENT IACVINTTerm "var comments" UWORD udf_CM_16871 0 0.0 0.0 199.9969482421875 ECU_ADDRESS 0x400027AA /end MEASUREMENT
/begin MEASUREMENT NrmIACVDlyTmr "var comments" UWORD udf_CM_17368 0 0.0 0.0 1023.984375 ECU_ADDRESS 0x400027EE /end MEASUREMENT
/begin MEASUREMENT IACVPropTerm "var comments" SWORD udf_CM_16885 0 0.0 -200.0 199.993896484375 ECU_ADDRESS 0x400027BA /end MEASUREMENT
/begin MEASUREMENT IACVDsrdEngSpd "var comments" UWORD udf_CM_16780 0 0.0 0.0 16383.75 ECU_ADDRESS 0x4000280E /end MEASUREMENT
/begin MEASUREMENT IACVEngSpdError "var comments" UWORD udf_CM_16843 0 0.0 0.0 16383.75 ECU_ADDRESS 0x40002812 /end MEASUREMENT
/begin MEASUREMENT BSTPDsrd "var comments" UWORD udf_CM_15562 0 0.0 0.0 255.99609375 ECU_ADDRESS 0x400025B4 /end MEASUREMENT
/begin MEASUREMENT BSTPCommand "var comments" UWORD udf_CM_15562 0 0.0 0.0 255.99609375 ECU_ADDRESS 0x400025C0 /end MEASUREMENT
/begin MEASUREMENT BSTPError "var comments" UWORD udf_CM_15562 0 0.0 0.0 255.99609375 ECU_ADDRESS 0x400025B2 /end MEASUREMENT
/begin MEASUREMENT BSTPCntrCL "var comments" UWORD udf_CM_15562 0 0.0 0.0 255.99609375 ECU_ADDRESS 0x400025BE /end MEASUREMENT
/begin MEASUREMENT BSTPErrorHigh "var comments" UBYTE udf_CM_16850 0 0.0 0.0 255.0 ECU_ADDRESS 0x400025AE /end MEASUREMENT
/begin MEASUREMENT BSTPINTTerm "var comments" UWORD udf_CM_16871 0 0.0 0.0 199.9969482421875 ECU_ADDRESS 0x400025B0 /end MEASUREMENT
/begin MEASUREMENT BSTPPropTerm "var comments" SWORD udf_CM_16885 0 0.0 -200.0 199.993896484375 ECU_ADDRESS 0x400025B8 /end MEASUREMENT
/begin MEASUREMENT BSTPCntrCLTerm "var comments" UWORD udf_CM_16808 0 0.0 0.0 199.9969482421875 ECU_ADDRESS 0x400025B6 /end MEASUREMENT
/begin MEASUREMENT BSTPINTDelta "var comments" UWORD udf_CM_16864 0 0.0 0.0 199.9969482421875 ECU_ADDRESS 0x400025BA /end MEASUREMENT
/begin MEASUREMENT BSTPActual "var comments" UWORD udf_CM_17291 0 0.0 0.0 255.99609375 ECU_ADDRESS 0x40002B18 /end MEASUREMENT
/begin MEASUREMENT BSTPUnfilt "var comments" UWORD udf_CM_17291 0 0.0 0.0 255.99609375 ECU_ADDRESS 0x40002B1A /end MEASUREMENT
/begin MEASUREMENT BSTCDutyCycle "var comments" UWORD udf_CM_18726 0 0.0 0.0 199.9969482421875 ECU_ADDRESS 0x40002B16 /end MEASUREMENT
/begin MEASUREMENT BSTPMode "var comments" UBYTE udf_CM_16640 0 0.0 0.0 255.0 ECU_ADDRESS 0x400025C9 /end MEASUREMENT
/begin MEASUREMENT BSTPCondMet "var comments" UBYTE udf_CM_16815 0 0.0 0.0 255.0 ECU_ADDRESS 0x400025C8 /end MEASUREMENT
/begin MEASUREMENT ACLoadMet "var comments" UBYTE udf_CM_17214 0 0.0 0.0 255.0 ECU_ADDRESS 0x40002A8A /end MEASUREMENT
/begin MEASUREMENT GenDCCurrent "var comments" UWORD udf_CM_17294 0 0.0 0.0 255.99609375 ECU_ADDRESS 0x40002A88 /end MEASUREMENT
/begin MEASUREMENT IATSHTestFail "var comments" UBYTE udf_CM_16724 0 0.0 0.0 255.0 ECU_ADDRESS 0x40002C72 /end MEASUREMENT
/begin MEASUREMENT IATSHFailCount "var comments" UWORD udf_CM_16703 0 0.0 0.0 65535.0 ECU_ADDRESS 0x40002C7A /end MEASUREMENT
/begin MEASUREMENT IATSHFailMet "var comments" UBYTE udf_CM_16710 0 0.0 0.0 255.0 ECU_ADDRESS 0x40002C6C /end MEASUREMENT
/begin MEASUREMENT IATSHPassCount "var comments" UWORD udf_CM_16717 0 0.0 0.0 65535.0 ECU_ADDRESS 0x40002C7C /end MEASUREMENT
/begin MEASUREMENT IATDiagEnb "var comments" UBYTE udf_CM_16731 0 0.0 0.0 255.0 ECU_ADDRESS 0x40002C6A /end MEASUREMENT
/begin MEASUREMENT IATSLFailCount "var comments" UWORD udf_CM_16738 0 0.0 0.0 65535.0 ECU_ADDRESS 0x40002C76 /end MEASUREMENT
/begin MEASUREMENT IATSLFailMet "var comments" UBYTE udf_CM_16745 0 0.0 0.0 255.0 ECU_ADDRESS 0x40002C6B /end MEASUREMENT
/begin MEASUREMENT IATSLPassCount "var comments" UWORD udf_CM_16752 0 0.0 0.0 65535.0 ECU_ADDRESS 0x40002C78 /end MEASUREMENT
/begin MEASUREMENT IATSLTestFail "var comments" UBYTE udf_CM_16759 0 0.0 0.0 255.0 ECU_ADDRESS 0x40002C71 /end MEASUREMENT
/begin MEASUREMENT IATOH1FailCount "var comments" UWORD udf_CM_16738 0 0.0 0.0 65535.0 ECU_ADDRESS 0x40002C7E /end MEASUREMENT
/begin MEASUREMENT IATOH1FailMet "var comments" UBYTE udf_CM_16745 0 0.0 0.0 255.0 ECU_ADDRESS 0x40002C75 /end MEASUREMENT
/begin MEASUREMENT IATOH1PassCount "var comments" UWORD udf_CM_16752 0 0.0 0.0 65535.0 ECU_ADDRESS 0x40002C80 /end MEASUREMENT
/begin MEASUREMENT IATOH1TestFail "var comments" UBYTE udf_CM_16759 0 0.0 0.0 255.0 ECU_ADDRESS 0x40002C73 /end MEASUREMENT
/begin MEASUREMENT IATOH2FailCount "var comments" UWORD udf_CM_16738 0 0.0 0.0 65535.0 ECU_ADDRESS 0x40002C82 /end MEASUREMENT
/begin MEASUREMENT IATOH2FailMet "var comments" UBYTE udf_CM_16745 0 0.0 0.0 255.0 ECU_ADDRESS 0x40002C68 /end MEASUREMENT
/begin MEASUREMENT IATOH2PassCount "var comments" UWORD udf_CM_16752 0 0.0 0.0 65535.0 ECU_ADDRESS 0x40002C84 /end MEASUREMENT
/begin MEASUREMENT IATOH2TestFail "var comments" UBYTE udf_CM_16759 0 0.0 0.0 255.0 ECU_ADDRESS 0x40002C74 /end MEASUREMENT
/begin MEASUREMENT SCISHTestFail "var comments" UBYTE udf_CM_16724 0 0.0 0.0 255.0 ECU_ADDRESS 0x40002C8A /end MEASUREMENT
/begin MEASUREMENT SCISHFailCount "var comments" UWORD udf_CM_16703 0 0.0 0.0 65535.0 ECU_ADDRESS 0x40002C90 /end MEASUREMENT
/begin MEASUREMENT SCISHFailMet "var comments" UBYTE udf_CM_16710 0 0.0 0.0 255.0 ECU_ADDRESS 0x40002C94 /end MEASUREMENT
/begin MEASUREMENT SCISHPassCount "var comments" UWORD udf_CM_16717 0 0.0 0.0 65535.0 ECU_ADDRESS 0x40002C92 /end MEASUREMENT
/begin MEASUREMENT SCIDiagEnb "var comments" UBYTE udf_CM_16731 0 0.0 0.0 255.0 ECU_ADDRESS 0x40002C86 /end MEASUREMENT
/begin MEASUREMENT SCISLFailCount "var comments" UWORD udf_CM_16738 0 0.0 0.0 65535.0 ECU_ADDRESS 0x40002C8C /end MEASUREMENT
/begin MEASUREMENT SCISLFailMet "var comments" UBYTE udf_CM_16745 0 0.0 0.0 255.0 ECU_ADDRESS 0x40002C8B /end MEASUREMENT
/begin MEASUREMENT SCISLPassCount "var comments" UWORD udf_CM_16752 0 0.0 0.0 65535.0 ECU_ADDRESS 0x40002C8E /end MEASUREMENT
/begin MEASUREMENT SCISLTestFail "var comments" UBYTE udf_CM_16759 0 0.0 0.0 255.0 ECU_ADDRESS 0x40002C89 /end MEASUREMENT
/begin MEASUREMENT ACSSLFailMet "var comments" UBYTE udf_CM_16710 0 0.0 0.0 255.0 ECU_ADDRESS 0x40002E41 /end MEASUREMENT
/begin MEASUREMENT ACSSHFailMet "var comments" UBYTE udf_CM_16710 0 0.0 0.0 255.0 ECU_ADDRESS 0x40002E4A /end MEASUREMENT
/begin MEASUREMENT ACSSLTestFail "var comments" UBYTE udf_CM_16759 0 0.0 0.0 255.0 ECU_ADDRESS 0x40002E3F /end MEASUREMENT
/begin MEASUREMENT ACSSHTestFail "var comments" UBYTE udf_CM_16759 0 0.0 0.0 255.0 ECU_ADDRESS 0x40002E40 /end MEASUREMENT
/begin MEASUREMENT ACSSLFailCount "var comments" UWORD udf_CM_16717 0 0.0 0.0 65535.0 ECU_ADDRESS 0x40002E42 /end MEASUREMENT
/begin MEASUREMENT ACSSLPassCount "var comments" UWORD udf_CM_16717 0 0.0 0.0 65535.0 ECU_ADDRESS 0x40002E44 /end MEASUREMENT
/begin MEASUREMENT ACSSHFailCount "var comments" UWORD udf_CM_16717 0 0.0 0.0 65535.0 ECU_ADDRESS 0x40002E46 /end MEASUREMENT
/begin MEASUREMENT ACSSHPassCount "var comments" UWORD udf_CM_16717 0 0.0 0.0 65535.0 ECU_ADDRESS 0x40002E48 /end MEASUREMENT
/begin MEASUREMENT ACSShrtDiagEnb "var comments" UBYTE udf_CM_16731 0 0.0 0.0 255.0 ECU_ADDRESS 0x40002E3C /end MEASUREMENT
/begin MEASUREMENT WPSSLFailMet "var comments" UBYTE udf_CM_16710 0 0.0 0.0 255.0 ECU_ADDRESS 0x40002E5A /end MEASUREMENT
/begin MEASUREMENT WPSSHFailMet "var comments" UBYTE udf_CM_16710 0 0.0 0.0 255.0 ECU_ADDRESS 0x40002E5B /end MEASUREMENT
/begin MEASUREMENT WPSSLTestFail "var comments" UBYTE udf_CM_16759 0 0.0 0.0 255.0 ECU_ADDRESS 0x40002E4E /end MEASUREMENT
/begin MEASUREMENT WPSSHTestFail "var comments" UBYTE udf_CM_16759 0 0.0 0.0 255.0 ECU_ADDRESS 0x40002E4F /end MEASUREMENT
/begin MEASUREMENT WPSSLFailCount "var comments" UWORD udf_CM_16717 0 0.0 0.0 65535.0 ECU_ADDRESS 0x40002E50 /end MEASUREMENT
/begin MEASUREMENT WPSSLPassCount "var comments" UWORD udf_CM_16717 0 0.0 0.0 65535.0 ECU_ADDRESS 0x40002E52 /end MEASUREMENT
/begin MEASUREMENT WPSSHFailCount "var comments" UWORD udf_CM_16717 0 0.0 0.0 65535.0 ECU_ADDRESS 0x40002E54 /end MEASUREMENT
/begin MEASUREMENT WPSSHPassCount "var comments" UWORD udf_CM_16717 0 0.0 0.0 65535.0 ECU_ADDRESS 0x40002E56 /end MEASUREMENT
/begin MEASUREMENT WPSShrtHDiagEnb "var comments" UBYTE udf_CM_16731 0 0.0 0.0 255.0 ECU_ADDRESS 0x40002E58 /end MEASUREMENT
/begin MEASUREMENT WPSShrtLDiagEnb "var comments" UBYTE udf_CM_16731 0 0.0 0.0 255.0 ECU_ADDRESS 0x40002E59 /end MEASUREMENT
/begin MEASUREMENT VbCCPS_CCPEnable "var comments" UBYTE udf_CM_16857 0 0.0 0.0 255.0 ECU_ADDRESS 0x0 /end MEASUREMENT
/begin MEASUREMENT VfCCPS_Pct_CCPDutyCycle "var comments" UWORD udf_CM_16808 0 0.0 0.0 199.9969482421875 ECU_ADDRESS 0x0 /end MEASUREMENT
/begin MEASUREMENT IdleFlow "var comments" UWORD udf_CM_16836 0 0.0 0.0 199.9969482421875 ECU_ADDRESS 0x40002772 /end MEASUREMENT
/begin MEASUREMENT IdleCLFlow "var comments" UWORD udf_CM_16808 0 0.0 0.0 199.9969482421875 ECU_ADDRESS 0x4000276E /end MEASUREMENT
/begin MEASUREMENT IDLECondMet "var comments" UBYTE udf_CM_16815 0 0.0 0.0 255.0 ECU_ADDRESS 0x40002770 /end MEASUREMENT
/begin MEASUREMENT IdleSwitch "var comments" UBYTE udf_CM_16857 0 0.0 0.0 255.0 ECU_ADDRESS 0x40002795 /end MEASUREMENT
/begin MEASUREMENT FL_UpHillFlag "var comments" UBYTE udf_CM_16857 0 0.0 0.0 255.0 ECU_ADDRESS 0x0 /end MEASUREMENT
/begin MEASUREMENT Inj1SHFailMet "var comments" UBYTE udf_CM_16962 0 0.0 0.0 255.0 DISPLAY_IDENTIFIER InjSHFailMet[0] ECU_ADDRESS 0x40002D64 /end MEASUREMENT
/begin MEASUREMENT Inj1SHTestComp "var comments" UBYTE udf_CM_16976 0 0.0 0.0 255.0 DISPLAY_IDENTIFIER InjSHTestComp[0] ECU_ADDRESS 0x40002D6C /end MEASUREMENT
/begin MEASUREMENT Inj1SHTestFail "var comments" UBYTE udf_CM_16983 0 0.0 0.0 255.0 DISPLAY_IDENTIFIER InjSHTestFail[0] ECU_ADDRESS 0x40002D94 /end MEASUREMENT
/begin MEASUREMENT Inj1SHFailCount "var comments" UWORD udf_CM_16941 0 0.0 0.0 65535.0 DISPLAY_IDENTIFIER InjSHFailCount[0] ECU_ADDRESS 0x40002D80 /end MEASUREMENT
/begin MEASUREMENT Inj1SHPassCount "var comments" UWORD udf_CM_16969 0 0.0 0.0 65535.0 DISPLAY_IDENTIFIER InjSHPassCount[0] ECU_ADDRESS 0x40002D88 /end MEASUREMENT
/begin MEASUREMENT Inj1SLFailMet "var comments" UBYTE udf_CM_16962 0 0.0 0.0 255.0 DISPLAY_IDENTIFIER InjSLFailMet[0] ECU_ADDRESS 0x40002D60 /end MEASUREMENT
/begin MEASUREMENT Inj1SLTestComp "var comments" UBYTE udf_CM_16976 0 0.0 0.0 255.0 DISPLAY_IDENTIFIER InjSLTestComp[0] ECU_ADDRESS 0x40002D68 /end MEASUREMENT
/begin MEASUREMENT Inj1SLTestFail "var comments" UBYTE udf_CM_16983 0 0.0 0.0 255.0 DISPLAY_IDENTIFIER InjSLTestFail[0] ECU_ADDRESS 0x40002D90 /end MEASUREMENT
/begin MEASUREMENT Inj1SLFailCount "var comments" UWORD udf_CM_16941 0 0.0 0.0 65535.0 DISPLAY_IDENTIFIER InjSLFailCount[0] ECU_ADDRESS 0x40002D70 /end MEASUREMENT
/begin MEASUREMENT Inj1SLPassCount "var comments" UWORD udf_CM_16969 0 0.0 0.0 65535.0 DISPLAY_IDENTIFIER InjSLPassCount[0] ECU_ADDRESS 0x40002D78 /end MEASUREMENT
/begin MEASUREMENT Inj2SHFailMet "var comments" UBYTE udf_CM_16962 0 0.0 0.0 255.0 DISPLAY_IDENTIFIER InjSHFailMet[1] ECU_ADDRESS 0x40002D65 /end MEASUREMENT
/begin MEASUREMENT Inj2SHTestComp "var comments" UBYTE udf_CM_16976 0 0.0 0.0 255.0 DISPLAY_IDENTIFIER InjSHTestComp[1] ECU_ADDRESS 0x40002D6D /end MEASUREMENT
/begin MEASUREMENT Inj2SHTestFail "var comments" UBYTE udf_CM_16983 0 0.0 0.0 255.0 DISPLAY_IDENTIFIER InjSHTestFail[1] ECU_ADDRESS 0x40002D95 /end MEASUREMENT
/begin MEASUREMENT Inj2SHFailCount "var comments" UWORD udf_CM_16941 0 0.0 0.0 65535.0 DISPLAY_IDENTIFIER InjSHFailCount[1] ECU_ADDRESS 0x40002D82 /end MEASUREMENT
/begin MEASUREMENT Inj2SHPassCount "var comments" UWORD udf_CM_16969 0 0.0 0.0 65535.0 DISPLAY_IDENTIFIER InjSHPassCount[1] ECU_ADDRESS 0x40002D8A /end MEASUREMENT
/begin MEASUREMENT Inj2SLFailMet "var comments" UBYTE udf_CM_16962 0 0.0 0.0 255.0 DISPLAY_IDENTIFIER InjSLFailMet[1] ECU_ADDRESS 0x40002D61 /end MEASUREMENT
/begin MEASUREMENT Inj2SLTestComp "var comments" UBYTE udf_CM_16976 0 0.0 0.0 255.0 DISPLAY_IDENTIFIER InjSLTestComp[1] ECU_ADDRESS 0x40002D69 /end MEASUREMENT
/begin MEASUREMENT Inj2SLTestFail "var comments" UBYTE udf_CM_16983 0 0.0 0.0 255.0 DISPLAY_IDENTIFIER InjSLTestFail[1] ECU_ADDRESS 0x40002D91 /end MEASUREMENT
/begin MEASUREMENT Inj2SLFailCount "var comments" UWORD udf_CM_16941 0 0.0 0.0 65535.0 DISPLAY_IDENTIFIER InjSLFailCount[1] ECU_ADDRESS 0x40002D72 /end MEASUREMENT
/begin MEASUREMENT Inj2SLPassCount "var comments" UWORD udf_CM_16969 0 0.0 0.0 65535.0 DISPLAY_IDENTIFIER InjSLPassCount[1] ECU_ADDRESS 0x40002D7A /end MEASUREMENT
/begin MEASUREMENT Inj3SHFailMet "var comments" UBYTE udf_CM_16962 0 0.0 0.0 255.0 DISPLAY_IDENTIFIER InjSHFailMet[2] ECU_ADDRESS 0x40002D66 /end MEASUREMENT
/begin MEASUREMENT Inj3SHTestComp "var comments" UBYTE udf_CM_16976 0 0.0 0.0 255.0 DISPLAY_IDENTIFIER InjSHTestComp[2] ECU_ADDRESS 0x40002D6E /end MEASUREMENT
/begin MEASUREMENT Inj3SHTestFail "var comments" UBYTE udf_CM_16983 0 0.0 0.0 255.0 DISPLAY_IDENTIFIER InjSHTestFail[2] ECU_ADDRESS 0x40002D96 /end MEASUREMENT
/begin MEASUREMENT Inj3SHFailCount "var comments" UWORD udf_CM_16941 0 0.0 0.0 65535.0 DISPLAY_IDENTIFIER InjSHFailCount[2] ECU_ADDRESS 0x40002D84 /end MEASUREMENT
/begin MEASUREMENT Inj3SHPassCount "var comments" UWORD udf_CM_16969 0 0.0 0.0 65535.0 DISPLAY_IDENTIFIER InjSHPassCount[2] ECU_ADDRESS 0x40002D8C /end MEASUREMENT
/begin MEASUREMENT Inj3SLFailMet "var comments" UBYTE udf_CM_16962 0 0.0 0.0 255.0 DISPLAY_IDENTIFIER InjSLFailMet[2] ECU_ADDRESS 0x40002D62 /end MEASUREMENT
/begin MEASUREMENT Inj3SLTestComp "var comments" UBYTE udf_CM_16976 0 0.0 0.0 255.0 DISPLAY_IDENTIFIER InjSLTestComp[2] ECU_ADDRESS 0x40002D6A /end MEASUREMENT
/begin MEASUREMENT Inj3SLTestFail "var comments" UBYTE udf_CM_16983 0 0.0 0.0 255.0 DISPLAY_IDENTIFIER InjSLTestFail[2] ECU_ADDRESS 0x40002D92 /end MEASUREMENT
/begin MEASUREMENT Inj3SLFailCount "var comments" UWORD udf_CM_16941 0 0.0 0.0 65535.0 DISPLAY_IDENTIFIER InjSLFailCount[2] ECU_ADDRESS 0x40002D74 /end MEASUREMENT
/begin MEASUREMENT Inj3SLPassCount "var comments" UWORD udf_CM_16969 0 0.0 0.0 65535.0 DISPLAY_IDENTIFIER InjSLPassCount[2] ECU_ADDRESS 0x40002D7C /end MEASUREMENT
/begin MEASUREMENT Inj4SHFailMet "var comments" UBYTE udf_CM_16962 0 0.0 0.0 255.0 DISPLAY_IDENTIFIER InjSHFailMet[3] ECU_ADDRESS 0x40002D67 /end MEASUREMENT
/begin MEASUREMENT Inj4SHTestComp "var comments" UBYTE udf_CM_16976 0 0.0 0.0 255.0 DISPLAY_IDENTIFIER InjSHTestComp[3] ECU_ADDRESS 0x40002D6F /end MEASUREMENT
/begin MEASUREMENT Inj4SHTestFail "var comments" UBYTE udf_CM_16983 0 0.0 0.0 255.0 DISPLAY_IDENTIFIER InjSHTestFail[3] ECU_ADDRESS 0x40002D97 /end MEASUREMENT
/begin MEASUREMENT Inj4SHFailCount "var comments" UWORD udf_CM_16941 0 0.0 0.0 65535.0 DISPLAY_IDENTIFIER InjSHFailCount[3] ECU_ADDRESS 0x40002D86 /end MEASUREMENT
/begin MEASUREMENT Inj4SHPassCount "var comments" UWORD udf_CM_16969 0 0.0 0.0 65535.0 DISPLAY_IDENTIFIER InjSHPassCount[3] ECU_ADDRESS 0x40002D8E /end MEASUREMENT
/begin MEASUREMENT Inj4SLFailMet "var comments" UBYTE udf_CM_16962 0 0.0 0.0 255.0 DISPLAY_IDENTIFIER InjSLFailMet[3] ECU_ADDRESS 0x40002D63 /end MEASUREMENT
/begin MEASUREMENT Inj4SLTestComp "var comments" UBYTE udf_CM_16976 0 0.0 0.0 255.0 DISPLAY_IDENTIFIER InjSLTestComp[3] ECU_ADDRESS 0x40002D6B /end MEASUREMENT
/begin MEASUREMENT Inj4SLTestFail "var comments" UBYTE udf_CM_16983 0 0.0 0.0 255.0 DISPLAY_IDENTIFIER InjSLTestFail[3] ECU_ADDRESS 0x40002D93 /end MEASUREMENT
/begin MEASUREMENT Inj4SLFailCount "var comments" UWORD udf_CM_16941 0 0.0 0.0 65535.0 DISPLAY_IDENTIFIER InjSLFailCount[3] ECU_ADDRESS 0x40002D76 /end MEASUREMENT
/begin MEASUREMENT Inj4SLPassCount "var comments" UWORD udf_CM_16969 0 0.0 0.0 65535.0 DISPLAY_IDENTIFIER InjSLPassCount[3] ECU_ADDRESS 0x40002D7E /end MEASUREMENT
/begin MEASUREMENT OSWPFilt "var comments" UWORD udf_CM_18005 0 0.0 0.0 99.99847412109375 ECU_ADDRESS 0x40002A94 /end MEASUREMENT
/begin MEASUREMENT WPOutRawSignal "var comments" UWORD udf_CM_18005 0 0.0 0.0 99.99847412109375 ECU_ADDRESS 0x40002B02 /end MEASUREMENT
/begin MEASUREMENT PCodeActive "var comments" UWORD udf_CM_17592 0 0.0 0.0 65535.0 ECU_ADDRESS 0x40002B30 /end MEASUREMENT
/begin MEASUREMENT MAPSHDiagEnb "var comments" UBYTE udf_CM_17214 0 0.0 0.0 255.0 ECU_ADDRESS 0x40002C9C /end MEASUREMENT
/begin MEASUREMENT MAPSHFailCount "var comments" UWORD udf_CM_17221 0 0.0 0.0 65535.0 ECU_ADDRESS 0x40002CA6 /end MEASUREMENT
/begin MEASUREMENT MAPSHFailMet "var comments" UBYTE udf_CM_17228 0 0.0 0.0 255.0 ECU_ADDRESS 0x40002CAB /end MEASUREMENT
/begin MEASUREMENT MAPSHPassCount "var comments" UWORD udf_CM_17242 0 0.0 0.0 65535.0 ECU_ADDRESS 0x40002CA8 /end MEASUREMENT
/begin MEASUREMENT MAPSHTestFail "var comments" UBYTE udf_CM_17249 0 0.0 0.0 255.0 ECU_ADDRESS 0x40002CA1 /end MEASUREMENT
/begin MEASUREMENT MAPSLDiagEnb "var comments" UBYTE udf_CM_17256 0 0.0 0.0 255.0 ECU_ADDRESS 0x40002C9D /end MEASUREMENT
/begin MEASUREMENT MAPSLFailCount "var comments" UWORD udf_CM_17263 0 0.0 0.0 65535.0 ECU_ADDRESS 0x40002CA2 /end MEASUREMENT
/begin MEASUREMENT MAPSLFailMet "var comments" UBYTE udf_CM_17270 0 0.0 0.0 255.0 ECU_ADDRESS 0x40002CAA /end MEASUREMENT
/begin MEASUREMENT MAPSLPassCount "var comments" UWORD udf_CM_17277 0 0.0 0.0 65535.0 ECU_ADDRESS 0x40002CA4 /end MEASUREMENT
/begin MEASUREMENT MAPSLTestFail "var comments" UBYTE udf_CM_17284 0 0.0 0.0 255.0 ECU_ADDRESS 0x40002CA0 /end MEASUREMENT
/begin MEASUREMENT BSTPSHDiagEnb "var comments" UBYTE udf_CM_17214 0 0.0 0.0 255.0 ECU_ADDRESS 0x40002E62 /end MEASUREMENT
/begin MEASUREMENT BSTPSHFailCount "var comments" UWORD udf_CM_17221 0 0.0 0.0 65535.0 ECU_ADDRESS 0x40002E70 /end MEASUREMENT
/begin MEASUREMENT BSTPSHFailMet "var comments" UBYTE udf_CM_17228 0 0.0 0.0 255.0 ECU_ADDRESS 0x40002E65 /end MEASUREMENT
/begin MEASUREMENT BSTPSHPassCount "var comments" UWORD udf_CM_17242 0 0.0 0.0 65535.0 ECU_ADDRESS 0x40002E72 /end MEASUREMENT
/begin MEASUREMENT BSTPSHTestFail "var comments" UBYTE udf_CM_17249 0 0.0 0.0 255.0 ECU_ADDRESS 0x40002E6B /end MEASUREMENT
/begin MEASUREMENT BSTPSLDiagEnb "var comments" UBYTE udf_CM_17256 0 0.0 0.0 255.0 ECU_ADDRESS 0x40002E60 /end MEASUREMENT
/begin MEASUREMENT BSTPSLFailCount "var comments" UWORD udf_CM_17263 0 0.0 0.0 65535.0 ECU_ADDRESS 0x40002E6C /end MEASUREMENT
/begin MEASUREMENT BSTPSLFailMet "var comments" UBYTE udf_CM_17270 0 0.0 0.0 255.0 ECU_ADDRESS 0x40002E64 /end MEASUREMENT
/begin MEASUREMENT BSTPSLPassCount "var comments" UWORD udf_CM_17277 0 0.0 0.0 65535.0 ECU_ADDRESS 0x40002E6E /end MEASUREMENT
/begin MEASUREMENT BSTPSLTestFail "var comments" UBYTE udf_CM_17284 0 0.0 0.0 255.0 ECU_ADDRESS 0x40002E6A /end MEASUREMENT
/begin MEASUREMENT MtrMovDlyCnt "var comments" UBYTE udf_CM_18166 0 0.0 0.0 255.0 DISPLAY_IDENTIFIER IDLE_Motor_StartMoveDelayCount ECU_ADDRESS 0x40002A9F /end MEASUREMENT
/begin MEASUREMENT MtrPauseCnt "var comments" UBYTE udf_CM_18159 0 0.0 0.0 255.0 DISPLAY_IDENTIFIER IDLE_Motor_PauseDelayCount ECU_ADDRESS 0x40002AAA /end MEASUREMENT
/begin MEASUREMENT MtrStartSteps "var comments" UBYTE udf_CM_18173 0 0.0 0.0 255.0 DISPLAY_IDENTIFIER IDLE_Motor_StartMoveSteps ECU_ADDRESS 0x40002AA3 /end MEASUREMENT
/begin MEASUREMENT O2HtDiagEnb "var comments" UBYTE udf_CM_17382 0 0.0 0.0 255.0 ECU_ADDRESS 0x40002D36 /end MEASUREMENT
/begin MEASUREMENT O2HtSLFailMet "var comments" UBYTE udf_CM_17410 0 0.0 0.0 255.0 ECU_ADDRESS 0x40002D37 /end MEASUREMENT
/begin MEASUREMENT O2HtSLTestComp "var comments" UBYTE udf_CM_17424 0 0.0 0.0 255.0 ECU_ADDRESS 0x40002D39 /end MEASUREMENT
/begin MEASUREMENT O2HtSLTestFail "var comments" UBYTE udf_CM_17431 0 0.0 0.0 255.0 ECU_ADDRESS 0x40002D3B /end MEASUREMENT
/begin MEASUREMENT O2HtSLFailCount "var comments" UWORD udf_CM_17389 0 0.0 0.0 65535.0 ECU_ADDRESS 0x40002D3C /end MEASUREMENT
/begin MEASUREMENT O2HtSLPassCount "var comments" UWORD udf_CM_17417 0 0.0 0.0 65535.0 ECU_ADDRESS 0x40002D40 /end MEASUREMENT
/begin MEASUREMENT O2HtSHFailMet "var comments" UBYTE udf_CM_17410 0 0.0 0.0 255.0 ECU_ADDRESS 0x40002D38 /end MEASUREMENT
/begin MEASUREMENT O2HtSHTestComp "var comments" UBYTE udf_CM_17424 0 0.0 0.0 255.0 ECU_ADDRESS 0x40002D3A /end MEASUREMENT
/begin MEASUREMENT O2HtSHTestFail "var comments" UBYTE udf_CM_17431 0 0.0 0.0 255.0 ECU_ADDRESS 0x40002D44 /end MEASUREMENT
/begin MEASUREMENT O2HtSHFailCount "var comments" UWORD udf_CM_17389 0 0.0 0.0 65535.0 ECU_ADDRESS 0x40002D3E /end MEASUREMENT
/begin MEASUREMENT O2HtSHPassCount "var comments" UWORD udf_CM_17417 0 0.0 0.0 65535.0 ECU_ADDRESS 0x40002D42 /end MEASUREMENT
/begin MEASUREMENT O2Ht2DiagEnb "var comments" UBYTE udf_CM_17382 0 0.0 0.0 255.0 ECU_ADDRESS 0x40002D48 /end MEASUREMENT
/begin MEASUREMENT O2Ht2SLFailMet "var comments" UBYTE udf_CM_17410 0 0.0 0.0 255.0 ECU_ADDRESS 0x40002D49 /end MEASUREMENT
/begin MEASUREMENT O2Ht2SLTestComp "var comments" UBYTE udf_CM_17424 0 0.0 0.0 255.0 ECU_ADDRESS 0x40002D4B /end MEASUREMENT
/begin MEASUREMENT O2Ht2SLTestFail "var comments" UBYTE udf_CM_17431 0 0.0 0.0 255.0 ECU_ADDRESS 0x40002D4D /end MEASUREMENT
/begin MEASUREMENT O2Ht2SLFailCount "var comments" UWORD udf_CM_17389 0 0.0 0.0 65535.0 ECU_ADDRESS 0x40002D4E /end MEASUREMENT
/begin MEASUREMENT O2Ht2SLPassCount "var comments" UWORD udf_CM_17417 0 0.0 0.0 65535.0 ECU_ADDRESS 0x40002D52 /end MEASUREMENT
/begin MEASUREMENT O2Ht2SHFailMet "var comments" UBYTE udf_CM_17410 0 0.0 0.0 255.0 ECU_ADDRESS 0x40002D4A /end MEASUREMENT
/begin MEASUREMENT O2Ht2SHTestComp "var comments" UBYTE udf_CM_17424 0 0.0 0.0 255.0 ECU_ADDRESS 0x40002D4C /end MEASUREMENT
/begin MEASUREMENT O2Ht2SHTestFail "var comments" UBYTE udf_CM_17431 0 0.0 0.0 255.0 ECU_ADDRESS 0x40002D56 /end MEASUREMENT
/begin MEASUREMENT O2Ht2SHFailCount "var comments" UWORD udf_CM_17389 0 0.0 0.0 65535.0 ECU_ADDRESS 0x40002D50 /end MEASUREMENT
/begin MEASUREMENT O2Ht2SHPassCount "var comments" UWORD udf_CM_17417 0 0.0 0.0 65535.0 ECU_ADDRESS 0x40002D54 /end MEASUREMENT
/begin MEASUREMENT BSTCDiagEnb "var comments" UBYTE udf_CM_17382 0 0.0 0.0 255.0 ECU_ADDRESS 0x40002DD4 /end MEASUREMENT
/begin MEASUREMENT BSTCSLFailMet "var comments" UBYTE udf_CM_17410 0 0.0 0.0 255.0 ECU_ADDRESS 0x40002DD5 /end MEASUREMENT
/begin MEASUREMENT BSTCSLTestComp "var comments" UBYTE udf_CM_17424 0 0.0 0.0 255.0 ECU_ADDRESS 0x40002DD7 /end MEASUREMENT
/begin MEASUREMENT BSTCSLTestFail "var comments" UBYTE udf_CM_17431 0 0.0 0.0 255.0 ECU_ADDRESS 0x40002DD9 /end MEASUREMENT
/begin MEASUREMENT BSTCSLFailCount "var comments" UWORD udf_CM_17389 0 0.0 0.0 65535.0 ECU_ADDRESS 0x40002DDA /end MEASUREMENT
/begin MEASUREMENT BSTCSLPassCount "var comments" UWORD udf_CM_17417 0 0.0 0.0 65535.0 ECU_ADDRESS 0x40002DDE /end MEASUREMENT
/begin MEASUREMENT BSTCSHFailMet "var comments" UBYTE udf_CM_17410 0 0.0 0.0 255.0 ECU_ADDRESS 0x40002DD6 /end MEASUREMENT
/begin MEASUREMENT BSTCSHTestComp "var comments" UBYTE udf_CM_17424 0 0.0 0.0 255.0 ECU_ADDRESS 0x40002DD8 /end MEASUREMENT
/begin MEASUREMENT BSTCSHTestFail "var comments" UBYTE udf_CM_17431 0 0.0 0.0 255.0 ECU_ADDRESS 0x40002DE2 /end MEASUREMENT
/begin MEASUREMENT BSTCSHFailCount "var comments" UWORD udf_CM_17389 0 0.0 0.0 65535.0 ECU_ADDRESS 0x40002DDC /end MEASUREMENT
/begin MEASUREMENT BSTCSHPassCount "var comments" UWORD udf_CM_17417 0 0.0 0.0 65535.0 ECU_ADDRESS 0x40002DE0 /end MEASUREMENT
/begin MEASUREMENT REF1DiagEnb "var comments" UBYTE udf_CM_17382 0 0.0 0.0 255.0 ECU_ADDRESS 0x40002DE6 /end MEASUREMENT
/begin MEASUREMENT REF1SLFailMet "var comments" UBYTE udf_CM_17410 0 0.0 0.0 255.0 ECU_ADDRESS 0x40002DE7 /end MEASUREMENT
/begin MEASUREMENT REF1SLTestComp "var comments" UBYTE udf_CM_17424 0 0.0 0.0 255.0 ECU_ADDRESS 0x40002DE9 /end MEASUREMENT
/begin MEASUREMENT REF1SLTestFail "var comments" UBYTE udf_CM_17431 0 0.0 0.0 255.0 ECU_ADDRESS 0x40002DEB /end MEASUREMENT
/begin MEASUREMENT REF1SLFailCount "var comments" UWORD udf_CM_17389 0 0.0 0.0 65535.0 ECU_ADDRESS 0x40002DEC /end MEASUREMENT
/begin MEASUREMENT REF1SLPassCount "var comments" UWORD udf_CM_17417 0 0.0 0.0 65535.0 ECU_ADDRESS 0x40002DF0 /end MEASUREMENT
/begin MEASUREMENT REF1SHFailMet "var comments" UBYTE udf_CM_17410 0 0.0 0.0 255.0 ECU_ADDRESS 0x40002DE8 /end MEASUREMENT
/begin MEASUREMENT REF1SHTestComp "var comments" UBYTE udf_CM_17424 0 0.0 0.0 255.0 ECU_ADDRESS 0x40002DEA /end MEASUREMENT
/begin MEASUREMENT REF1SHTestFail "var comments" UBYTE udf_CM_17431 0 0.0 0.0 255.0 ECU_ADDRESS 0x40002DF4 /end MEASUREMENT
/begin MEASUREMENT REF1SHFailCount "var comments" UWORD udf_CM_17389 0 0.0 0.0 65535.0 ECU_ADDRESS 0x40002DEE /end MEASUREMENT
/begin MEASUREMENT REF1SHPassCount "var comments" UWORD udf_CM_17417 0 0.0 0.0 65535.0 ECU_ADDRESS 0x40002DF2 /end MEASUREMENT
/begin MEASUREMENT REF2DiagEnb "var comments" UBYTE udf_CM_17382 0 0.0 0.0 255.0 ECU_ADDRESS 0x40002DF8 /end MEASUREMENT
/begin MEASUREMENT REF2SLFailMet "var comments" UBYTE udf_CM_17410 0 0.0 0.0 255.0 ECU_ADDRESS 0x40002DF9 /end MEASUREMENT
/begin MEASUREMENT REF2SLTestComp "var comments" UBYTE udf_CM_17424 0 0.0 0.0 255.0 ECU_ADDRESS 0x40002DFB /end MEASUREMENT
/begin MEASUREMENT REF2SLTestFail "var comments" UBYTE udf_CM_17431 0 0.0 0.0 255.0 ECU_ADDRESS 0x40002DFD /end MEASUREMENT
/begin MEASUREMENT REF2SLFailCount "var comments" UWORD udf_CM_17389 0 0.0 0.0 65535.0 ECU_ADDRESS 0x40002DFE /end MEASUREMENT
/begin MEASUREMENT REF2SLPassCount "var comments" UWORD udf_CM_17417 0 0.0 0.0 65535.0 ECU_ADDRESS 0x40002E02 /end MEASUREMENT
/begin MEASUREMENT REF2SHFailMet "var comments" UBYTE udf_CM_17410 0 0.0 0.0 255.0 ECU_ADDRESS 0x40002DFA /end MEASUREMENT
/begin MEASUREMENT REF2SHTestComp "var comments" UBYTE udf_CM_17424 0 0.0 0.0 255.0 ECU_ADDRESS 0x40002DFC /end MEASUREMENT
/begin MEASUREMENT REF2SHTestFail "var comments" UBYTE udf_CM_17431 0 0.0 0.0 255.0 ECU_ADDRESS 0x40002E06 /end MEASUREMENT
/begin MEASUREMENT REF2SHFailCount "var comments" UWORD udf_CM_17389 0 0.0 0.0 65535.0 ECU_ADDRESS 0x40002E00 /end MEASUREMENT
/begin MEASUREMENT REF2SHPassCount "var comments" UWORD udf_CM_17417 0 0.0 0.0 65535.0 ECU_ADDRESS 0x40002E04 /end MEASUREMENT
/begin MEASUREMENT FCV1DiagEnb "var comments" UBYTE udf_CM_17382 0 0.0 0.0 255.0 ECU_ADDRESS 0x40002D9E /end MEASUREMENT
/begin MEASUREMENT FCV1SLFailMet "var comments" UBYTE udf_CM_17410 0 0.0 0.0 255.0 ECU_ADDRESS 0x40002D9F /end MEASUREMENT
/begin MEASUREMENT FCV1SLTestComp "var comments" UBYTE udf_CM_17424 0 0.0 0.0 255.0 ECU_ADDRESS 0x40002DA1 /end MEASUREMENT
/begin MEASUREMENT FCV1SLTestFail "var comments" UBYTE udf_CM_17431 0 0.0 0.0 255.0 ECU_ADDRESS 0x40002DA3 /end MEASUREMENT
/begin MEASUREMENT FCV1SLFailCount "var comments" UWORD udf_CM_17389 0 0.0 0.0 65535.0 ECU_ADDRESS 0x40002DA4 /end MEASUREMENT
/begin MEASUREMENT FCV1SLPassCount "var comments" UWORD udf_CM_17417 0 0.0 0.0 65535.0 ECU_ADDRESS 0x40002DA8 /end MEASUREMENT
/begin MEASUREMENT FCV1SHFailMet "var comments" UBYTE udf_CM_17410 0 0.0 0.0 255.0 ECU_ADDRESS 0x40002DA0 /end MEASUREMENT
/begin MEASUREMENT FCV1SHTestComp "var comments" UBYTE udf_CM_17424 0 0.0 0.0 255.0 ECU_ADDRESS 0x40002DA2 /end MEASUREMENT
/begin MEASUREMENT FCV1SHTestFail "var comments" UBYTE udf_CM_17431 0 0.0 0.0 255.0 ECU_ADDRESS 0x40002DAC /end MEASUREMENT
/begin MEASUREMENT FCV1SHFailCount "var comments" UWORD udf_CM_17389 0 0.0 0.0 65535.0 ECU_ADDRESS 0x40002DA6 /end MEASUREMENT
/begin MEASUREMENT FCV1SHPassCount "var comments" UWORD udf_CM_17417 0 0.0 0.0 65535.0 ECU_ADDRESS 0x40002DAA /end MEASUREMENT
/begin MEASUREMENT FCV2DiagEnb "var comments" UBYTE udf_CM_17382 0 0.0 0.0 255.0 ECU_ADDRESS 0x40002DB0 /end MEASUREMENT
/begin MEASUREMENT FCV2SLFailMet "var comments" UBYTE udf_CM_17410 0 0.0 0.0 255.0 ECU_ADDRESS 0x40002DB1 /end MEASUREMENT
/begin MEASUREMENT FCV2SLTestComp "var comments" UBYTE udf_CM_17424 0 0.0 0.0 255.0 ECU_ADDRESS 0x40002DB3 /end MEASUREMENT
/begin MEASUREMENT FCV2SLTestFail "var comments" UBYTE udf_CM_17431 0 0.0 0.0 255.0 ECU_ADDRESS 0x40002DB5 /end MEASUREMENT
/begin MEASUREMENT FCV2SLFailCount "var comments" UWORD udf_CM_17389 0 0.0 0.0 65535.0 ECU_ADDRESS 0x40002DB6 /end MEASUREMENT
/begin MEASUREMENT FCV2SLPassCount "var comments" UWORD udf_CM_17417 0 0.0 0.0 65535.0 ECU_ADDRESS 0x40002DBA /end MEASUREMENT
/begin MEASUREMENT FCV2SHFailMet "var comments" UBYTE udf_CM_17410 0 0.0 0.0 255.0 ECU_ADDRESS 0x40002DB2 /end MEASUREMENT
/begin MEASUREMENT FCV2SHTestComp "var comments" UBYTE udf_CM_17424 0 0.0 0.0 255.0 ECU_ADDRESS 0x40002DB4 /end MEASUREMENT
/begin MEASUREMENT FCV2SHTestFail "var comments" UBYTE udf_CM_17431 0 0.0 0.0 255.0 ECU_ADDRESS 0x40002DBE /end MEASUREMENT
/begin MEASUREMENT FCV2SHFailCount "var comments" UWORD udf_CM_17389 0 0.0 0.0 65535.0 ECU_ADDRESS 0x40002DB8 /end MEASUREMENT
/begin MEASUREMENT FCV2SHPassCount "var comments" UWORD udf_CM_17417 0 0.0 0.0 65535.0 ECU_ADDRESS 0x40002DBC /end MEASUREMENT
/begin MEASUREMENT IACVDiagEnb "var comments" UBYTE udf_CM_17382 0 0.0 0.0 255.0 ECU_ADDRESS 0x40002DC2 /end MEASUREMENT
/begin MEASUREMENT IACVSLFailMet "var comments" UBYTE udf_CM_17410 0 0.0 0.0 255.0 ECU_ADDRESS 0x40002DC3 /end MEASUREMENT
/begin MEASUREMENT IACVSLTestComp "var comments" UBYTE udf_CM_17424 0 0.0 0.0 255.0 ECU_ADDRESS 0x40002DC5 /end MEASUREMENT
/begin MEASUREMENT IACVSLTestFail "var comments" UBYTE udf_CM_17431 0 0.0 0.0 255.0 ECU_ADDRESS 0x40002DC7 /end MEASUREMENT
/begin MEASUREMENT IACVSLFailCount "var comments" UWORD udf_CM_17389 0 0.0 0.0 65535.0 ECU_ADDRESS 0x40002DC8 /end MEASUREMENT
/begin MEASUREMENT IACVSLPassCount "var comments" UWORD udf_CM_17417 0 0.0 0.0 65535.0 ECU_ADDRESS 0x40002DCC /end MEASUREMENT
/begin MEASUREMENT IACVSHFailMet "var comments" UBYTE udf_CM_17410 0 0.0 0.0 255.0 ECU_ADDRESS 0x40002DC4 /end MEASUREMENT
/begin MEASUREMENT IACVSHTestComp "var comments" UBYTE udf_CM_17424 0 0.0 0.0 255.0 ECU_ADDRESS 0x40002DC6 /end MEASUREMENT
/begin MEASUREMENT IACVSHTestFail "var comments" UBYTE udf_CM_17431 0 0.0 0.0 255.0 ECU_ADDRESS 0x40002DD0 /end MEASUREMENT
/begin MEASUREMENT IACVSHFailCount "var comments" UWORD udf_CM_17389 0 0.0 0.0 65535.0 ECU_ADDRESS 0x40002DCA /end MEASUREMENT
/begin MEASUREMENT IACVSHPassCount "var comments" UWORD udf_CM_17417 0 0.0 0.0 65535.0 ECU_ADDRESS 0x40002DCE /end MEASUREMENT
/begin MEASUREMENT DCMDiagEnb "var comments" UBYTE udf_CM_17382 0 0.0 0.0 255.0 ECU_ADDRESS 0x40002CCE /end MEASUREMENT
/begin MEASUREMENT DCMSLFailMet "var comments" UBYTE udf_CM_17410 0 0.0 0.0 255.0 ECU_ADDRESS 0x40002CCF /end MEASUREMENT
/begin MEASUREMENT DCMSLTestComp "var comments" UBYTE udf_CM_17424 0 0.0 0.0 255.0 ECU_ADDRESS 0x40002CD1 /end MEASUREMENT
/begin MEASUREMENT DCMSLTestFail "var comments" UBYTE udf_CM_17431 0 0.0 0.0 255.0 ECU_ADDRESS 0x40002CD3 /end MEASUREMENT
/begin MEASUREMENT DCMSLFailCount "var comments" UWORD udf_CM_17389 0 0.0 0.0 65535.0 ECU_ADDRESS 0x40002CD4 /end MEASUREMENT
/begin MEASUREMENT DCMSLPassCount "var comments" UWORD udf_CM_17417 0 0.0 0.0 65535.0 ECU_ADDRESS 0x40002CD8 /end MEASUREMENT
/begin MEASUREMENT DCMSHFailMet "var comments" UBYTE udf_CM_17410 0 0.0 0.0 255.0 ECU_ADDRESS 0x40002CD0 /end MEASUREMENT
/begin MEASUREMENT DCMSHTestComp "var comments" UBYTE udf_CM_17424 0 0.0 0.0 255.0 ECU_ADDRESS 0x40002CD2 /end MEASUREMENT
/begin MEASUREMENT DCMSHTestFail "var comments" UBYTE udf_CM_17431 0 0.0 0.0 255.0 ECU_ADDRESS 0x40002CDC /end MEASUREMENT
/begin MEASUREMENT DCMSHFailCount "var comments" UWORD udf_CM_17389 0 0.0 0.0 65535.0 ECU_ADDRESS 0x40002CD6 /end MEASUREMENT
/begin MEASUREMENT DCMSHPassCount "var comments" UWORD udf_CM_17417 0 0.0 0.0 65535.0 ECU_ADDRESS 0x40002CDA /end MEASUREMENT
/begin MEASUREMENT CCPDiagEnb "var comments" UBYTE udf_CM_17382 0 0.0 0.0 255.0 ECU_ADDRESS 0x0 /end MEASUREMENT
/begin MEASUREMENT CCPSLFailMet "var comments" UBYTE udf_CM_17410 0 0.0 0.0 255.0 ECU_ADDRESS 0x0 /end MEASUREMENT
/begin MEASUREMENT CCPSLTestComp "var comments" UBYTE udf_CM_17424 0 0.0 0.0 255.0 ECU_ADDRESS 0x0 /end MEASUREMENT
/begin MEASUREMENT CCPSLTestFail "var comments" UBYTE udf_CM_17431 0 0.0 0.0 255.0 ECU_ADDRESS 0x0 /end MEASUREMENT
/begin MEASUREMENT CCPSLFailCount "var comments" UWORD udf_CM_17389 0 0.0 0.0 65535.0 ECU_ADDRESS 0x0 /end MEASUREMENT
/begin MEASUREMENT CCPSLPassCount "var comments" UWORD udf_CM_17417 0 0.0 0.0 65535.0 ECU_ADDRESS 0x0 /end MEASUREMENT
/begin MEASUREMENT CCPSHFailMet "var comments" UBYTE udf_CM_17410 0 0.0 0.0 255.0 ECU_ADDRESS 0x0 /end MEASUREMENT
/begin MEASUREMENT CCPSHTestComp "var comments" UBYTE udf_CM_17424 0 0.0 0.0 255.0 ECU_ADDRESS 0x0 /end MEASUREMENT
/begin MEASUREMENT CCPSHTestFail "var comments" UBYTE udf_CM_17431 0 0.0 0.0 255.0 ECU_ADDRESS 0x0 /end MEASUREMENT
/begin MEASUREMENT CCPSHFailCount "var comments" UWORD udf_CM_17389 0 0.0 0.0 65535.0 ECU_ADDRESS 0x0 /end MEASUREMENT
/begin MEASUREMENT CCPSHPassCount "var comments" UWORD udf_CM_17417 0 0.0 0.0 65535.0 ECU_ADDRESS 0x0 /end MEASUREMENT
/begin MEASUREMENT OutDiagComEnbKO "var comments" UBYTE udf_CM_17557 0 0.0 0.0 255.0 DISPLAY_IDENTIFIER OutPutDiag_CommKeyOnEnbMet ECU_ADDRESS 0x40002CCA /end MEASUREMENT
/begin MEASUREMENT OutDiagComEnbRun "var comments" UBYTE udf_CM_17564 0 0.0 0.0 255.0 DISPLAY_IDENTIFIER OutPutDiag_CommRunEnbMet ECU_ADDRESS 0x40002CCB /end MEASUREMENT
/begin MEASUREMENT KeyonToCrankMet "var comments" UBYTE udf_CM_17074 0 0.0 0.0 255.0 ECU_ADDRESS 0x40002946 /end MEASUREMENT
/begin MEASUREMENT PowerDownDelay "var comments" UBYTE udf_CM_17606 0 0.0 0.0 255.0 ECU_ADDRESS 0x40002942 /end MEASUREMENT
/begin MEASUREMENT EOL_Init "var comments" UBYTE udf_CM_17634 0 0.0 0.0 255.0 ECU_ADDRESS 0x400000C4 /end MEASUREMENT
/begin MEASUREMENT PPCrtMet "var comments" UBYTE udf_CM_17627 0 0.0 0.0 255.0 ECU_ADDRESS 0x400026A6 /end MEASUREMENT
/begin MEASUREMENT PPComplete "var comments" UBYTE udf_CM_17620 0 0.0 0.0 255.0 ECU_ADDRESS 0x400026A7 /end MEASUREMENT
/begin MEASUREMENT PPDisable "var comments" UBYTE udf_CM_17634 0 0.0 0.0 255.0 ECU_ADDRESS 0x400001F8 /end MEASUREMENT
/begin MEASUREMENT PrimePulseWidth "var comments" UWORD udf_CM_17641 0 0.0 0.0 1023.984375 ECU_ADDRESS 0x400026A8 /end MEASUREMENT
/begin MEASUREMENT RefPeriodHiRes "var comments" ULONG udf_CM_17662 0 0.0 0.0 4294967.295 DISPLAY_IDENTIFIER RefPeriod_HiRes ECU_ADDRESS 0x40002A3C /end MEASUREMENT
/begin MEASUREMENT RefPeriodHiResAvg "var comments" ULONG udf_CM_17669 0 0.0 0.0 4294967.295 DISPLAY_IDENTIFIER RefPeriod_HiResAvg ECU_ADDRESS 0x40002A44 /end MEASUREMENT
/begin MEASUREMENT RunToCrankMet "var comments" UBYTE udf_CM_17697 0 0.0 0.0 255.0 ECU_ADDRESS 0x40002945 /end MEASUREMENT
/begin MEASUREMENT RunCylCount "var comments" UBYTE udf_CM_19377 0 0.0 0.0 255.0 DISPLAY_IDENTIFIER VcVIOS_RunCylCount ECU_ADDRESS 0x40002949 /end MEASUREMENT
/begin MEASUREMENT RunModeCount "var comments" UBYTE udf_CM_19384 0 0.0 0.0 255.0 DISPLAY_IDENTIFIER VcVIOS_RunModeCount ECU_ADDRESS 0x4000294A /end MEASUREMENT
/begin MEASUREMENT RunTime "var comments" UWORD udf_CM_17683 0 0.0 0.0 65535.0 ECU_ADDRESS 0x40000092 /end MEASUREMENT
/begin MEASUREMENT RunTimeTotal "var comments" ULONG udf_CM_17663 0 0.0 0.0 4294967.295 ECU_ADDRESS 0x40000094 /end MEASUREMENT
/begin MEASUREMENT ETCM_TPSHi2Dsr "var comments" UBYTE udf_CM_16353 0 0.0 0.0 255.0 ECU_ADDRESS 0x4000284C /end MEASUREMENT
/begin MEASUREMENT ETCM_TPSHi2Ref "var comments" UBYTE udf_CM_16353 0 0.0 0.0 255.0 ECU_ADDRESS 0x40002854 /end MEASUREMENT
/begin MEASUREMENT ETCM_TPSDltState "var comments" UBYTE udf_CM_16353 0 0.0 0.0 255.0 ECU_ADDRESS 0x40002847 /end MEASUREMENT
/begin MEASUREMENT ETCM_UnpwrdRefLearned "var comments" UBYTE udf_CM_16353 0 0.0 0.0 255.0 ECU_ADDRESS 0x4000284D /end MEASUREMENT
/begin MEASUREMENT ETCM_ThrotMtrDir "var comments" UBYTE udf_CM_16353 0 0.0 0.0 255.0 ECU_ADDRESS 0x40002848 /end MEASUREMENT
/begin MEASUREMENT ETCM_DutyLimited "var comments" UBYTE udf_CM_16353 0 0.0 0.0 255.0 ECU_ADDRESS 0x40002849 /end MEASUREMENT
/begin MEASUREMENT ETCM_UnpwrdRefThrotPstn "var comments" UWORD udf_CM_18726 0 0.0 0.0 199.9969482421875 ECU_ADDRESS 0x40002852 /end MEASUREMENT
/begin MEASUREMENT ETCM_UnlimitedDutyCycle "var comments" UWORD udf_CM_18726 0 0.0 0.0 199.9969482421875 ECU_ADDRESS 0x40002866 /end MEASUREMENT
/begin MEASUREMENT ETCM_LimitedDutyCycle "var comments" UWORD udf_CM_18726 0 0.0 0.0 199.9969482421875 ECU_ADDRESS 0x40002844 /end MEASUREMENT
/begin MEASUREMENT ETCM_INTDelta "var comments" UWORD udf_CM_18726 0 0.0 0.0 199.9969482421875 ECU_ADDRESS 0x40002868 /end MEASUREMENT
/begin MEASUREMENT ETCM_TPSErr2Dsr "var comments" UWORD udf_CM_18726 0 0.0 0.0 199.9969482421875 ECU_ADDRESS 0x4000284E /end MEASUREMENT
/begin MEASUREMENT ETCM_DesireTPSHi2Ref "var comments" UBYTE udf_CM_16353 0 0.0 0.0 255.0 ECU_ADDRESS 0x40002846 /end MEASUREMENT
/begin MEASUREMENT ETCM_DesireTPSErr2Ref "var comments" UWORD udf_CM_18726 0 0.0 0.0 199.9969482421875 ECU_ADDRESS 0x4000285E /end MEASUREMENT
/begin MEASUREMENT ETCM_TPSDltErr "var comments" UWORD udf_CM_18726 0 0.0 0.0 199.9969482421875 ECU_ADDRESS 0x40002864 /end MEASUREMENT
/begin MEASUREMENT ETCM_CompositeTerm "var comments" SWORD udf_CM_16773 0 0.0 -200.0 199.993896484375 ECU_ADDRESS 0x40002862 /end MEASUREMENT
/begin MEASUREMENT ETCM_SprTerm "var comments" SWORD udf_CM_16773 0 0.0 -200.0 199.993896484375 ECU_ADDRESS 0x40002858 /end MEASUREMENT
/begin MEASUREMENT ETCM_FriTerm "var comments" SWORD udf_CM_16773 0 0.0 -200.0 199.993896484375 ECU_ADDRESS 0x40002856 /end MEASUREMENT
/begin MEASUREMENT ETCM_INTTerm "var comments" SWORD udf_CM_16773 0 0.0 -200.0 199.993896484375 ECU_ADDRESS 0x4000284A /end MEASUREMENT
/begin MEASUREMENT ETCM_DerivTerm "var comments" SWORD udf_CM_16773 0 0.0 -200.0 199.993896484375 ECU_ADDRESS 0x4000285A /end MEASUREMENT
/begin MEASUREMENT ETCM_PropTerm "var comments" SWORD udf_CM_16773 0 0.0 -200.0 199.993896484375 ECU_ADDRESS 0x4000285C /end MEASUREMENT
/begin MEASUREMENT MotorCoilTempFilt "var comments" SWORD udf_CM_15758 0 0.0 -256.0 255.9921875 ECU_ADDRESS 0x40002B14 /end MEASUREMENT
/begin MEASUREMENT GENV1Filt "var comments" UWORD udf_CM_16928 0 0.0 0.0 1023.984375 ECU_ADDRESS 0x0 /end MEASUREMENT
/begin MEASUREMENT GENV2Filt "var comments" UWORD udf_CM_16928 0 0.0 0.0 1023.984375 ECU_ADDRESS 0x0 /end MEASUREMENT
/begin MEASUREMENT GENV3Filt "var comments" UWORD udf_CM_16928 0 0.0 0.0 1023.984375 ECU_ADDRESS 0x0 /end MEASUREMENT
/begin MEASUREMENT GENV_VOLTErr2Dsr "var comments" UWORD udf_CM_16928 0 0.0 0.0 1023.984375 ECU_ADDRESS 0x0 /end MEASUREMENT
/begin MEASUREMENT GENV_VOLTHi2Dsr "var comments" UBYTE udf_CM_16353 0 0.0 0.0 255.0 ECU_ADDRESS 0x0 /end MEASUREMENT
/begin MEASUREMENT GENV_CompositeTerm "var comments" SWORD udf_CM_16773 0 0.0 -200.0 199.993896484375 ECU_ADDRESS 0x0 /end MEASUREMENT
/begin MEASUREMENT GENV_INTTerm "var comments" SWORD udf_CM_16773 0 0.0 -200.0 199.993896484375 ECU_ADDRESS 0x0 /end MEASUREMENT
/begin MEASUREMENT GENV_PropTerm "var comments" SWORD udf_CM_16773 0 0.0 -200.0 199.993896484375 ECU_ADDRESS 0x0 /end MEASUREMENT
/begin MEASUREMENT GENV_INTDelta "var comments" UWORD udf_CM_18726 0 0.0 0.0 199.9969482421875 ECU_ADDRESS 0x0 /end MEASUREMENT
/begin MEASUREMENT WPGOV_Err2Dsr "var comments" UWORD udf_CM_17292 0 0.0 0.0 15.999755859375 ECU_ADDRESS 0x0 /end MEASUREMENT
/begin MEASUREMENT WPGOV_Hi2Dsr "var comments" UBYTE udf_CM_16353 0 0.0 0.0 255.0 ECU_ADDRESS 0x0 /end MEASUREMENT
/begin MEASUREMENT WPGOV_CompositeTerm "var comments" SWORD udf_CM_16773 0 0.0 -200.0 199.993896484375 ECU_ADDRESS 0x0 /end MEASUREMENT
/begin MEASUREMENT WPGOV_INTTerm "var comments" SWORD udf_CM_16773 0 0.0 -200.0 199.993896484375 ECU_ADDRESS 0x0 /end MEASUREMENT
/begin MEASUREMENT WPGOV_PropTerm "var comments" SWORD udf_CM_16773 0 0.0 -200.0 199.993896484375 ECU_ADDRESS 0x0 /end MEASUREMENT
/begin MEASUREMENT WPGOV_INTDelta "var comments" UWORD udf_CM_18726 0 0.0 0.0 199.9969482421875 ECU_ADDRESS 0x0 /end MEASUREMENT
/begin MEASUREMENT SABaseRun "var comments" SWORD udf_CM_17711 0 0.0 -256.0 255.9921875 ECU_ADDRESS 0x400028B0 /end MEASUREMENT
/begin MEASUREMENT SACrank "var comments" SWORD udf_CM_17718 0 0.0 -256.0 255.9921875 ECU_ADDRESS 0x400028E0 /end MEASUREMENT
/begin MEASUREMENT SAFinalCyl1 "var comments" SWORD udf_CM_17725 0 0.0 -256.0 255.9921875 DISPLAY_IDENTIFIER SAFinalCyl[0] ECU_ADDRESS 0x40002898 /end MEASUREMENT
/begin MEASUREMENT SAFinalDlvCyl1 "var comments" SWORD udf_CM_17739 0 0.0 -256.0 255.9921875 DISPLAY_IDENTIFIER SAFinalDlvCyl[0] ECU_ADDRESS 0x400028A4 /end MEASUREMENT
/begin MEASUREMENT SAFinalCyl2 "var comments" SWORD udf_CM_17732 0 0.0 -256.0 255.9921875 DISPLAY_IDENTIFIER SAFinalCyl[1] ECU_ADDRESS 0x4000289A /end MEASUREMENT
/begin MEASUREMENT SAFinalDlvCyl2 "var comments" SWORD udf_CM_17746 0 0.0 -256.0 255.9921875 DISPLAY_IDENTIFIER SAFinalDlvCyl[1] ECU_ADDRESS 0x400028A6 /end MEASUREMENT
/begin MEASUREMENT SAGlobal "var comments" SWORD udf_CM_17767 0 0.0 -256.0 255.9921875 ECU_ADDRESS 0x400028BC /end MEASUREMENT
/begin MEASUREMENT SAPE "var comments" SWORD udf_CM_17781 0 0.0 -256.0 255.9921875 ECU_ADDRESS 0x400028DA /end MEASUREMENT
/begin MEASUREMENT SAPECorr "var comments" SWORD udf_CM_17711 0 0.0 -256.0 255.9921875 ECU_ADDRESS 0x400028B8 /end MEASUREMENT
/begin MEASUREMENT SAIdleCorr "var comments" SWORD udf_CM_17711 0 0.0 -256.0 255.9921875 ECU_ADDRESS 0x400028B4 /end MEASUREMENT
/begin MEASUREMENT SAIdleDyna "var comments" SWORD udf_CM_17711 0 0.0 -256.0 255.9921875 ECU_ADDRESS 0x400028AE /end MEASUREMENT
/begin MEASUREMENT SAIdleBase "var comments" SWORD udf_CM_17718 0 0.0 -256.0 255.9921875 ECU_ADDRESS 0x400028DE /end MEASUREMENT
/begin MEASUREMENT SAGovCompositeTerm "var comments" SWORD udf_CM_16773 0 0.0 -200.0 199.993896484375 ECU_ADDRESS 0x400028EC /end MEASUREMENT
/begin MEASUREMENT SAGovINTTerm "var comments" SWORD udf_CM_16773 0 0.0 -200.0 199.993896484375 ECU_ADDRESS 0x400028E2 /end MEASUREMENT
/begin MEASUREMENT SAGovPropTerm "var comments" SWORD udf_CM_16773 0 0.0 -200.0 199.993896484375 ECU_ADDRESS 0x400028E8 /end MEASUREMENT
/begin MEASUREMENT SAGovINTDelta "var comments" UWORD udf_CM_18726 0 0.0 0.0 199.9969482421875 ECU_ADDRESS 0x400028E6 /end MEASUREMENT
/begin MEASUREMENT SAGovDerivTerm "var comments" SWORD udf_CM_16773 0 0.0 -200.0 199.993896484375 ECU_ADDRESS 0x400028E4 /end MEASUREMENT
/begin MEASUREMENT SAGovDerivEnb "var comments" UBYTE udf_CM_16822 0 0.0 0.0 255.0 ECU_ADDRESS 0x400028EB /end MEASUREMENT
/begin MEASUREMENT SAGovDerivLoopCnt "var comments" UBYTE udf_CM_16829 0 0.0 0.0 255.0 ECU_ADDRESS 0x400028EA /end MEASUREMENT
/begin MEASUREMENT SAGovernor "var comments" SWORD udf_CM_17711 0 0.0 -256.0 255.9921875 ECU_ADDRESS 0x400028EE /end MEASUREMENT
/begin MEASUREMENT SAGovMaxLimit "var comments" SWORD udf_CM_17711 0 0.0 -256.0 255.9921875 ECU_ADDRESS 0x400028F4 /end MEASUREMENT
/begin MEASUREMENT SAGovMinLimit "var comments" SWORD udf_CM_17711 0 0.0 -256.0 255.9921875 ECU_ADDRESS 0x400028F2 /end MEASUREMENT
/begin MEASUREMENT SAMaxLimit "var comments" SWORD udf_CM_17711 0 0.0 -256.0 255.9921875 ECU_ADDRESS 0x400028A0 /end MEASUREMENT
/begin MEASUREMENT SAMinLimit "var comments" SWORD udf_CM_17711 0 0.0 -256.0 255.9921875 ECU_ADDRESS 0x400028A2 /end MEASUREMENT
/begin MEASUREMENT SpdCntlDervEnb "var comments" UBYTE udf_CM_16822 0 0.0 0.0 255.0 ECU_ADDRESS 0x4000276B /end MEASUREMENT
/begin MEASUREMENT SpdCntlDervLoopCnt "var comments" UBYTE udf_CM_16829 0 0.0 0.0 255.0 ECU_ADDRESS 0x4000276A /end MEASUREMENT
/begin MEASUREMENT OPSWSTComp "var comments" UBYTE udf_CM_17816 0 0.0 0.0 255.0 ECU_ADDRESS 0x40002CBE /end MEASUREMENT
/begin MEASUREMENT OPSWSTEnb "var comments" UBYTE udf_CM_17494 0 0.0 0.0 255.0 DISPLAY_IDENTIFIER OPSWSTEnbMet ECU_ADDRESS 0x40002CC7 /end MEASUREMENT
/begin MEASUREMENT OPSWSTFail "var comments" UBYTE udf_CM_17508 0 0.0 0.0 255.0 ECU_ADDRESS 0x40002CBF /end MEASUREMENT
/begin MEASUREMENT OPSWSTFC "var comments" UWORD udf_CM_17515 0 0.0 0.0 65535.0 ECU_ADDRESS 0x40002CC0 /end MEASUREMENT
/begin MEASUREMENT OPSWSTFMet "var comments" UBYTE udf_CM_17522 0 0.0 0.0 255.0 ECU_ADDRESS 0x40002CC6 /end MEASUREMENT
/begin MEASUREMENT OPSWSTPC "var comments" UWORD udf_CM_17501 0 0.0 0.0 65535.0 ECU_ADDRESS 0x40002CC2 /end MEASUREMENT
/begin MEASUREMENT OPSWSTEnbMetDC "var comments" UWORD udf_CM_17501 0 0.0 0.0 65535.0 ECU_ADDRESS 0x40002CC4 /end MEASUREMENT
/begin MEASUREMENT FPFBNCTComp "var comments" UBYTE udf_CM_17816 0 0.0 0.0 255.0 ECU_ADDRESS 0x40002C4E /end MEASUREMENT
/begin MEASUREMENT FPFBNCTEnb "var comments" UBYTE udf_CM_17494 0 0.0 0.0 255.0 DISPLAY_IDENTIFIER FPFBNCTEnbMet ECU_ADDRESS 0x40002C4C /end MEASUREMENT
/begin MEASUREMENT FPFBNCTFail "var comments" UBYTE udf_CM_17508 0 0.0 0.0 255.0 ECU_ADDRESS 0x40002C4F /end MEASUREMENT
/begin MEASUREMENT FPFBNCTFC "var comments" UWORD udf_CM_17515 0 0.0 0.0 65535.0 ECU_ADDRESS 0x40002C50 /end MEASUREMENT
/begin MEASUREMENT FPFBNCTFMet "var comments" UBYTE udf_CM_17522 0 0.0 0.0 255.0 ECU_ADDRESS 0x40002C4D /end MEASUREMENT
/begin MEASUREMENT FPFBNCTPC "var comments" UWORD udf_CM_17501 0 0.0 0.0 65535.0 ECU_ADDRESS 0x40002C52 /end MEASUREMENT
/begin MEASUREMENT ShutDownCmplt "var comments" UBYTE udf_CM_17963 0 0.0 0.0 255.0 ECU_ADDRESS 0x40002948 /end MEASUREMENT
/begin MEASUREMENT IdleMetPrev "var comments" UBYTE udf_CM_17837 0 0.0 0.0 255.0 DISPLAY_IDENTIFIER SbIDLE_IdleCondsMet_Prev ECU_ADDRESS 0x400028BF /end MEASUREMENT
/begin MEASUREMENT TPSCntrDTestComp "var comments" UBYTE udf_CM_18215 0 0.0 0.0 255.0 ECU_ADDRESS 0x40002C5A /end MEASUREMENT
/begin MEASUREMENT TPSErrorDynThresh "var comments" UWORD udf_CM_18180 0 0.0 0.0 199.9969482421875 ECU_ADDRESS 0x40002C58 /end MEASUREMENT
/begin MEASUREMENT TPSCntrDDiagEnb "var comments" UBYTE udf_CM_18187 0 0.0 0.0 255.0 ECU_ADDRESS 0x40002C56 /end MEASUREMENT
/begin MEASUREMENT TPSCntrErrorThresh "var comments" UWORD udf_CM_18236 0 0.0 0.0 199.9969482421875 ECU_ADDRESS 0x40002C60 /end MEASUREMENT
/begin MEASUREMENT TPSCntrDTestFail "var comments" UBYTE udf_CM_18222 0 0.0 0.0 255.0 ECU_ADDRESS 0x40002C5B /end MEASUREMENT
/begin MEASUREMENT TPSCntrDFailCount "var comments" UWORD udf_CM_18194 0 0.0 0.0 65535.0 ECU_ADDRESS 0x40002C5E /end MEASUREMENT
/begin MEASUREMENT TPSCntrDFailMet "var comments" UBYTE udf_CM_18201 0 0.0 0.0 255.0 ECU_ADDRESS 0x40002C57 /end MEASUREMENT
/begin MEASUREMENT TPSCntrDPassCount "var comments" UWORD udf_CM_18208 0 0.0 0.0 65535.0 ECU_ADDRESS 0x40002C5C /end MEASUREMENT
/begin MEASUREMENT TPSCntrError "var comments" UWORD udf_CM_18229 0 0.0 0.0 199.9969482421875 ECU_ADDRESS 0x40002C64 /end MEASUREMENT
/begin MEASUREMENT FCVPSCntrDTestComp "var comments" UBYTE udf_CM_18215 0 0.0 0.0 255.0 ECU_ADDRESS 0x40002C40 /end MEASUREMENT
/begin MEASUREMENT FCVPSErrorDynThresh "var comments" UWORD udf_CM_18180 0 0.0 0.0 199.9969482421875 ECU_ADDRESS 0x40002C3E /end MEASUREMENT
/begin MEASUREMENT FCVPSCntrDDiagEnb "var comments" UBYTE udf_CM_18187 0 0.0 0.0 255.0 ECU_ADDRESS 0x40002C3C /end MEASUREMENT
/begin MEASUREMENT FCVPSCntrErrorThresh "var comments" UWORD udf_CM_18236 0 0.0 0.0 199.9969482421875 ECU_ADDRESS 0x40002C46 /end MEASUREMENT
/begin MEASUREMENT FCVPSCntrDTestFail "var comments" UBYTE udf_CM_18222 0 0.0 0.0 255.0 ECU_ADDRESS 0x40002C41 /end MEASUREMENT
/begin MEASUREMENT FCVPSCntrDFailCount "var comments" UWORD udf_CM_18194 0 0.0 0.0 65535.0 ECU_ADDRESS 0x40002C44 /end MEASUREMENT
/begin MEASUREMENT FCVPSCntrDFailMet "var comments" UBYTE udf_CM_18201 0 0.0 0.0 255.0 ECU_ADDRESS 0x40002C3D /end MEASUREMENT
/begin MEASUREMENT FCVPSCntrDPassCount "var comments" UWORD udf_CM_18208 0 0.0 0.0 65535.0 ECU_ADDRESS 0x40002C42 /end MEASUREMENT
/begin MEASUREMENT FCVPSCntrError "var comments" UWORD udf_CM_18229 0 0.0 0.0 199.9969482421875 ECU_ADDRESS 0x40002C4A /end MEASUREMENT
/begin MEASUREMENT SpdCntlLvl "var comments" UBYTE udf_CM_18012 0 0.0 0.0 255.0 DISPLAY_IDENTIFIER SpeedControlLvl ECU_ADDRESS 0x40002788 /end MEASUREMENT
/begin MEASUREMENT SpeedControlInput "var comments" UWORD udf_CM_18005 0 0.0 0.0 99.99847412109375 ECU_ADDRESS 0x4000278A /end MEASUREMENT
/begin MEASUREMENT SparkDwell "var comments" UWORD udf_CM_17991 0 0.0 0.0 1023.984375 ECU_ADDRESS 0x40002874 /end MEASUREMENT
/begin MEASUREMENT SparkMode "var comments" UBYTE udf_CM_17998 0 0.0 0.0 255.0 ECU_ADDRESS 0x400028AC /end MEASUREMENT
/begin MEASUREMENT StallToCrankMet "var comments" UBYTE udf_CM_18138 0 0.0 0.0 255.0 ECU_ADDRESS 0x40002947 /end MEASUREMENT
/begin MEASUREMENT ThrFlowAtTPSMax "var comments" UWORD udf_CM_18677 0 0.0 0.0 511.9921875 ECU_ADDRESS 0x40002AB2 /end MEASUREMENT
/begin MEASUREMENT ThrFlowAtTPSMin "var comments" UWORD udf_CM_18684 0 0.0 0.0 511.9921875 ECU_ADDRESS 0x40002AA6 /end MEASUREMENT
/begin MEASUREMENT TPSMinimum "var comments" UWORD udf_CM_18810 0 0.0 0.0 199.9969482421875 ECU_ADDRESS 0x40002AB4 /end MEASUREMENT
/begin MEASUREMENT TPSMinLnCNT "var comments" UBYTE udf_CM_18824 0 0.0 0.0 255.0 ECU_ADDRESS 0x40002AAB /end MEASUREMENT
/begin MEASUREMENT TPSMinLrned "var comments" UBYTE udf_CM_18817 0 0.0 0.0 255.0 ECU_ADDRESS 0x40002A9B /end MEASUREMENT
/begin MEASUREMENT DsrdFuelFlow "var comments" UWORD udf_CM_15982 0 0.0 0.0 511.9921875 ECU_ADDRESS 0x40002AD6 /end MEASUREMENT
/begin MEASUREMENT FCVPSMinimum "var comments" UWORD udf_CM_18810 0 0.0 0.0 199.9969482421875 ECU_ADDRESS 0x40002AEC /end MEASUREMENT
/begin MEASUREMENT FCVPSMinLnCNT "var comments" UBYTE udf_CM_18824 0 0.0 0.0 255.0 ECU_ADDRESS 0x40002ADF /end MEASUREMENT
/begin MEASUREMENT FCVPSMinLrned "var comments" UBYTE udf_CM_18817 0 0.0 0.0 255.0 ECU_ADDRESS 0x40002AE9 /end MEASUREMENT
/begin MEASUREMENT DesireFCVPS "var comments" UWORD udf_CM_15989 0 0.0 0.0 199.9969482421875 ECU_ADDRESS 0x40002ADC /end MEASUREMENT
/begin MEASUREMENT FCVMotorState "var comments" UBYTE udf_CM_16661 0 0.0 0.0 3.0 ECU_ADDRESS 0x40002AE2 /end MEASUREMENT
/begin MEASUREMENT ActFCVPosition "var comments" UBYTE udf_CM_15247 0 0.0 0.0 255.0 ECU_ADDRESS 0x40002ADB /end MEASUREMENT
/begin MEASUREMENT FCVMoveDirct "var comments" UBYTE udf_CM_16668 0 0.0 0.0 2.0 ECU_ADDRESS 0x40002ADA /end MEASUREMENT
/begin MEASUREMENT FCVPS "var comments" UWORD udf_CM_18726 0 0.0 0.0 199.9969482421875 ECU_ADDRESS 0x40002AF6 /end MEASUREMENT
/begin MEASUREMENT FCVPSRawSignal "var comments" UWORD udf_CM_18838 0 0.0 0.0 65535.0 ECU_ADDRESS 0x40002AF4 /end MEASUREMENT
/begin MEASUREMENT FCVPSDelta "var comments" UWORD udf_CM_18733 0 0.0 0.0 199.9969482421875 ECU_ADDRESS 0x40002AFC /end MEASUREMENT
/begin MEASUREMENT FCV_FP_CorrForFCVPS "var comments" UWORD udf_CM_15415 0 0.0 0.0 1.999969005584717 ECU_ADDRESS 0x40002AEE /end MEASUREMENT
/begin MEASUREMENT FCV_Baro_CorrForFCVPS "var comments" UWORD udf_CM_15415 0 0.0 0.0 1.999969005584717 ECU_ADDRESS 0x40002AF0 /end MEASUREMENT
/begin MEASUREMENT VbSMTR_Rotate_Active "var comments" UBYTE udf_CM_16710 0 0.0 0.0 255.0 ECU_ADDRESS 0x4000282D /end MEASUREMENT
/begin MEASUREMENT VbSMTR_Rotate_Command "var comments" UBYTE udf_CM_16710 0 0.0 0.0 255.0 ECU_ADDRESS 0x40002828 /end MEASUREMENT
/begin MEASUREMENT VbSMTR_Rotate_Enable "var comments" UBYTE udf_CM_16710 0 0.0 0.0 255.0 ECU_ADDRESS 0x4000282C /end MEASUREMENT
/begin MEASUREMENT VbSMTR_Rotate_Execute "var comments" UBYTE udf_CM_16710 0 0.0 0.0 255.0 ECU_ADDRESS 0x40002829 /end MEASUREMENT
/begin MEASUREMENT VbSMTR_IGN_StartEn "var comments" UBYTE udf_CM_16710 0 0.0 0.0 255.0 ECU_ADDRESS 0x4000282B /end MEASUREMENT
/begin MEASUREMENT VcSMTR_c_Attempt "var comments" UBYTE udf_CM_18824 0 0.0 0.0 255.0 ECU_ADDRESS 0x40002827 /end MEASUREMENT
/begin MEASUREMENT TPSShrtDiagEnb "var comments" UBYTE udf_CM_18859 0 0.0 0.0 255.0 ECU_ADDRESS 0x40002E11 /end MEASUREMENT
/begin MEASUREMENT TPSSHFailCount "var comments" UWORD udf_CM_18845 0 0.0 0.0 65535.0 ECU_ADDRESS 0x40002E1A /end MEASUREMENT
/begin MEASUREMENT TPSSHFailMet "var comments" UBYTE udf_CM_18852 0 0.0 0.0 255.0 ECU_ADDRESS 0x40002E12 /end MEASUREMENT
/begin MEASUREMENT TPSSHTestFail "var comments" UBYTE udf_CM_18873 0 0.0 0.0 255.0 ECU_ADDRESS 0x40002E15 /end MEASUREMENT
/begin MEASUREMENT TPSSLFailCount "var comments" UWORD udf_CM_18880 0 0.0 0.0 65535.0 ECU_ADDRESS 0x40002E18 /end MEASUREMENT
/begin MEASUREMENT TPSSLFailMet "var comments" UBYTE udf_CM_18887 0 0.0 0.0 255.0 ECU_ADDRESS 0x40002E10 /end MEASUREMENT
/begin MEASUREMENT TPSSLTestFail "var comments" UBYTE udf_CM_18894 0 0.0 0.0 255.0 ECU_ADDRESS 0x40002E14 /end MEASUREMENT
/begin MEASUREMENT TPSShrtPassCount "var comments" UWORD udf_CM_18866 0 0.0 0.0 65535.0 ECU_ADDRESS 0x40002E16 /end MEASUREMENT
/begin MEASUREMENT AFCCell1 "var comments" UWORD udf_CM_15275 0 0.0 0.0 1.999969005584717 DISPLAY_IDENTIFIER AFCCell[0] ECU_ADDRESS 0x4000009E /end MEASUREMENT
/begin MEASUREMENT AFCCell2 "var comments" UWORD udf_CM_15324 0 0.0 0.0 1.999969005584717 DISPLAY_IDENTIFIER AFCCell[1] ECU_ADDRESS 0x400000A0 /end MEASUREMENT
/begin MEASUREMENT AFCCell11 "var comments" UWORD udf_CM_15282 0 0.0 0.0 1.999969005584717 DISPLAY_IDENTIFIER AFCCell[10] ECU_ADDRESS 0x400000B2 /end MEASUREMENT
/begin MEASUREMENT AFCCell12 "var comments" UWORD udf_CM_15289 0 0.0 0.0 1.999969005584717 DISPLAY_IDENTIFIER AFCCell[11] ECU_ADDRESS 0x400000B4 /end MEASUREMENT
/begin MEASUREMENT AFCCell13 "var comments" UWORD udf_CM_15296 0 0.0 0.0 1.999969005584717 DISPLAY_IDENTIFIER AFCCell[12] ECU_ADDRESS 0x400000B6 /end MEASUREMENT
/begin MEASUREMENT AFCCell14 "var comments" UWORD udf_CM_15303 0 0.0 0.0 1.999969005584717 DISPLAY_IDENTIFIER AFCCell[13] ECU_ADDRESS 0x400000B8 /end MEASUREMENT
/begin MEASUREMENT AFCCell15 "var comments" UWORD udf_CM_15310 0 0.0 0.0 1.999969005584717 DISPLAY_IDENTIFIER AFCCell[14] ECU_ADDRESS 0x400000BA /end MEASUREMENT
/begin MEASUREMENT AFCCell16 "var comments" UWORD udf_CM_15317 0 0.0 0.0 1.999969005584717 DISPLAY_IDENTIFIER AFCCell[15] ECU_ADDRESS 0x400000BC /end MEASUREMENT
/begin MEASUREMENT AFCCell3 "var comments" UWORD udf_CM_15331 0 0.0 0.0 1.999969005584717 DISPLAY_IDENTIFIER AFCCell[2] ECU_ADDRESS 0x400000A2 /end MEASUREMENT
/begin MEASUREMENT AFCCell4 "var comments" UWORD udf_CM_15338 0 0.0 0.0 1.999969005584717 DISPLAY_IDENTIFIER AFCCell[3] ECU_ADDRESS 0x400000A4 /end MEASUREMENT
/begin MEASUREMENT AFCCell5 "var comments" UWORD udf_CM_15345 0 0.0 0.0 1.999969005584717 DISPLAY_IDENTIFIER AFCCell[4] ECU_ADDRESS 0x400000A6 /end MEASUREMENT
/begin MEASUREMENT AFCCell6 "var comments" UWORD udf_CM_15352 0 0.0 0.0 1.999969005584717 DISPLAY_IDENTIFIER AFCCell[5] ECU_ADDRESS 0x400000A8 /end MEASUREMENT
/begin MEASUREMENT AFCCell7 "var comments" UWORD udf_CM_15359 0 0.0 0.0 1.999969005584717 DISPLAY_IDENTIFIER AFCCell[6] ECU_ADDRESS 0x400000AA /end MEASUREMENT
/begin MEASUREMENT AFCCell8 "var comments" UWORD udf_CM_15366 0 0.0 0.0 1.999969005584717 DISPLAY_IDENTIFIER AFCCell[7] ECU_ADDRESS 0x400000AC /end MEASUREMENT
/begin MEASUREMENT AFCCell9 "var comments" UWORD udf_CM_15373 0 0.0 0.0 1.999969005584717 DISPLAY_IDENTIFIER AFCCell[8] ECU_ADDRESS 0x400000AE /end MEASUREMENT
/begin MEASUREMENT AFCCell10 "var comments" UWORD udf_CM_15380 0 0.0 0.0 1.999969005584717 DISPLAY_IDENTIFIER AFCCell[9] ECU_ADDRESS 0x400000B0 /end MEASUREMENT
/begin MEASUREMENT AFCCellNum "var comments" UBYTE udf_CM_15387 0 0.0 0.0 255.0 ECU_ADDRESS 0x400028FE /end MEASUREMENT
/begin MEASUREMENT FILE_NVM_Failure "var comments" UBYTE udf_CM_15667 0 0.0 0.0 255.0 ECU_ADDRESS 0x400025CF /end MEASUREMENT
/begin MEASUREMENT AFCFiltExpMAPMult "var comments" UWORD udf_CM_15394 0 0.0 0.0 1.999969005584717 ECU_ADDRESS 0x40002900 /end MEASUREMENT
/begin MEASUREMENT AFCFiltMAP "var comments" UWORD udf_CM_15401 0 0.0 0.0 255.99609375 ECU_ADDRESS 0x40002906 /end MEASUREMENT
/begin MEASUREMENT AFCLMet "var comments" UBYTE udf_CM_15408 0 0.0 0.0 255.0 ECU_ADDRESS 0x40002904 /end MEASUREMENT
/begin MEASUREMENT AFCMult "var comments" UWORD udf_CM_15415 0 0.0 0.0 1.999969005584717 ECU_ADDRESS 0x40002902 /end MEASUREMENT
/begin MEASUREMENT Baro "var comments" UWORD udf_CM_15562 0 0.0 0.0 255.99609375 ECU_ADDRESS 0x40000090 /end MEASUREMENT
/begin MEASUREMENT BaroReadCrtMet "var comments" UBYTE udf_CM_15576 0 0.0 0.0 255.0 ECU_ADDRESS 0x4000291B /end MEASUREMENT
/begin MEASUREMENT BaroOffset "var comments" UWORD udf_CM_15569 0 0.0 0.0 255.99609375 ECU_ADDRESS 0x40002918 /end MEASUREMENT
/begin MEASUREMENT BaroReadTthNum "var comments" UWORD udf_CM_15583 0 0.0 0.0 65535.0 ECU_ADDRESS 0x4000291E /end MEASUREMENT
/begin MEASUREMENT FinalPulseWidth1 "var comments" UWORD udf_CM_16304 0 0.0 0.0 1023.984375 DISPLAY_IDENTIFIER FinalPulseWidth[0] ECU_ADDRESS 0x400029FC /end MEASUREMENT
/begin MEASUREMENT FinalPulseWidth2 "var comments" UWORD udf_CM_16297 0 0.0 0.0 1023.984375 DISPLAY_IDENTIFIER FinalPulseWidth[1] ECU_ADDRESS 0x400029FE /end MEASUREMENT
/begin MEASUREMENT CoolTemp "var comments" SWORD udf_CM_15751 0 0.0 -256.0 255.9921875 ECU_ADDRESS 0x40002930 /end MEASUREMENT
/begin MEASUREMENT CoolTempFilt "var comments" SWORD udf_CM_15758 0 0.0 -256.0 255.9921875 ECU_ADDRESS 0x40002932 /end MEASUREMENT
/begin MEASUREMENT ClTStartup "var comments" SWORD udf_CM_15744 0 0.0 -256.0 255.9921875 ECU_ADDRESS 0x40002934 /end MEASUREMENT
/begin MEASUREMENT CoolTemp2 "var comments" SWORD udf_CM_15751 0 0.0 -256.0 255.9921875 ECU_ADDRESS 0x40002938 /end MEASUREMENT
/begin MEASUREMENT CoolTemp2Filt "var comments" SWORD udf_CM_15758 0 0.0 -256.0 255.9921875 ECU_ADDRESS 0x4000293A /end MEASUREMENT
/begin MEASUREMENT ClT2Startup "var comments" SWORD udf_CM_15744 0 0.0 -256.0 255.9921875 ECU_ADDRESS 0x4000293C /end MEASUREMENT
/begin MEASUREMENT CIDFailCount "var comments" UWORD udf_CM_15653 0 0.0 0.0 65535.0 ECU_ADDRESS 0x40002924 /end MEASUREMENT
/begin MEASUREMENT CIDSucceed "var comments" UBYTE udf_CM_15667 0 0.0 0.0 255.0 ECU_ADDRESS 0x40002920 /end MEASUREMENT
/begin MEASUREMENT SeqPhase_Cyl1 "var comments" UWORD udf_CM_15667 0 0.0 0.0 65535.0 DISPLAY_IDENTIFIER CylPhase[0] ECU_ADDRESS 0x40001D3C /end MEASUREMENT
/begin MEASUREMENT SeqPhase_Cyl2 "var comments" UWORD udf_CM_15667 0 0.0 0.0 65535.0 DISPLAY_IDENTIFIER CylPhase[1] ECU_ADDRESS 0x40001D3E /end MEASUREMENT
/begin MEASUREMENT SeqPhase_Cyl3 "var comments" UWORD udf_CM_15667 0 0.0 0.0 65535.0 DISPLAY_IDENTIFIER CylPhase[2] ECU_ADDRESS 0x40001D40 /end MEASUREMENT
/begin MEASUREMENT SeqPhase_Cyl4 "var comments" UWORD udf_CM_15667 0 0.0 0.0 65535.0 DISPLAY_IDENTIFIER CylPhase[3] ECU_ADDRESS 0x40001D42 /end MEASUREMENT
/begin MEASUREMENT MAP_EVENT_TOOTH "var comments" UBYTE udf_CM_15667 0 0.0 0.0 255.0 ECU_ADDRESS 0x40001DFC /end MEASUREMENT
/begin MEASUREMENT Map_Event_Tooth_Count "var comments" UBYTE udf_CM_15667 0 0.0 0.0 255.0 ECU_ADDRESS 0x40001DFD /end MEASUREMENT
/begin MEASUREMENT BdcTooth "var comments" UBYTE udf_CM_15667 0 0.0 0.0 255.0 DISPLAY_IDENTIFIER BDC_TOOTH[0] ECU_ADDRESS 0x400017B4 /end MEASUREMENT
/begin MEASUREMENT SyncTooth "var comments" UBYTE udf_CM_15667 0 0.0 0.0 255.0 DISPLAY_IDENTIFIER SYNCHRONIZATION_EVENT_TOOTH ECU_ADDRESS 0x40001D11 /end MEASUREMENT
/begin MEASUREMENT Ref1Tooth_Cyl1 "var comments" UBYTE udf_CM_15667 0 0.0 0.0 255.0 DISPLAY_IDENTIFIER REFERENCE_EVENT1_TOOTH[0] ECU_ADDRESS 0x40001D0D /end MEASUREMENT
/begin MEASUREMENT Ref1Tooth_Cyl2 "var comments" UBYTE udf_CM_15667 0 0.0 0.0 255.0 DISPLAY_IDENTIFIER REFERENCE_EVENT1_TOOTH[1] ECU_ADDRESS 0x40001D0E /end MEASUREMENT
/begin MEASUREMENT Ref1Tooth_Cyl3 "var comments" UBYTE udf_CM_15667 0 0.0 0.0 255.0 DISPLAY_IDENTIFIER REFERENCE_EVENT1_TOOTH[2] ECU_ADDRESS 0x40001D0F /end MEASUREMENT
/begin MEASUREMENT Ref1Tooth_Cyl4 "var comments" UBYTE udf_CM_15667 0 0.0 0.0 255.0 DISPLAY_IDENTIFIER REFERENCE_EVENT1_TOOTH[3] ECU_ADDRESS 0x40001D10 /end MEASUREMENT
/begin MEASUREMENT Ref2Tooth_Cyl1 "var comments" UBYTE udf_CM_15667 0 0.0 0.0 255.0 DISPLAY_IDENTIFIER REFERENCE_EVENT2_TOOTH[0] ECU_ADDRESS 0x40001D1C /end MEASUREMENT
/begin MEASUREMENT Ref2Tooth_Cyl2 "var comments" UBYTE udf_CM_15667 0 0.0 0.0 255.0 DISPLAY_IDENTIFIER REFERENCE_EVENT2_TOOTH[1] ECU_ADDRESS 0x40001D1D /end MEASUREMENT
/begin MEASUREMENT Ref2Tooth_Cyl3 "var comments" UBYTE udf_CM_15667 0 0.0 0.0 255.0 DISPLAY_IDENTIFIER REFERENCE_EVENT2_TOOTH[2] ECU_ADDRESS 0x40001D1E /end MEASUREMENT
/begin MEASUREMENT Ref2Tooth_Cyl4 "var comments" UBYTE udf_CM_15667 0 0.0 0.0 255.0 DISPLAY_IDENTIFIER REFERENCE_EVENT2_TOOTH[3] ECU_ADDRESS 0x40001D1F /end MEASUREMENT
/begin MEASUREMENT FuelTooth_Cyl1 "var comments" UBYTE udf_CM_15667 0 0.0 0.0 255.0 DISPLAY_IDENTIFIER FUEL_EVENT_TOOTH[0] ECU_ADDRESS 0x40001DC8 /end MEASUREMENT
/begin MEASUREMENT FuelTooth_Cyl2 "var comments" UBYTE udf_CM_15667 0 0.0 0.0 255.0 DISPLAY_IDENTIFIER FUEL_EVENT_TOOTH[1] ECU_ADDRESS 0x40001DC9 /end MEASUREMENT
/begin MEASUREMENT FuelTooth_Cyl3 "var comments" UBYTE udf_CM_15667 0 0.0 0.0 255.0 DISPLAY_IDENTIFIER FUEL_EVENT_TOOTH[2] ECU_ADDRESS 0x40001DCA /end MEASUREMENT
/begin MEASUREMENT FuelTooth_Cyl4 "var comments" UBYTE udf_CM_15667 0 0.0 0.0 255.0 DISPLAY_IDENTIFIER FUEL_EVENT_TOOTH[3] ECU_ADDRESS 0x40001DCB /end MEASUREMENT
/begin MEASUREMENT TrimTooth_Cyl1 "var comments" UBYTE udf_CM_15667 0 0.0 0.0 255.0 DISPLAY_IDENTIFIER TRIM_EVENT_TOOTH[0] ECU_ADDRESS 0x40001DCC /end MEASUREMENT
/begin MEASUREMENT TrimTooth_Cyl2 "var comments" UBYTE udf_CM_15667 0 0.0 0.0 255.0 DISPLAY_IDENTIFIER TRIM_EVENT_TOOTH[1] ECU_ADDRESS 0x40001DCD /end MEASUREMENT
/begin MEASUREMENT TrimTooth_Cyl3 "var comments" UBYTE udf_CM_15667 0 0.0 0.0 255.0 DISPLAY_IDENTIFIER TRIM_EVENT_TOOTH[2] ECU_ADDRESS 0x40001DCE /end MEASUREMENT
/begin MEASUREMENT TrimTooth_Cyl4 "var comments" UBYTE udf_CM_15667 0 0.0 0.0 255.0 DISPLAY_IDENTIFIER TRIM_EVENT_TOOTH[3] ECU_ADDRESS 0x40001DCF /end MEASUREMENT
/begin MEASUREMENT TrimCutOffTooth_Cyl1 "var comments" UBYTE udf_CM_15667 0 0.0 0.0 255.0 DISPLAY_IDENTIFIER TRIM_CUT_OFF_EVENT_TOOTH[0] ECU_ADDRESS 0x40001DD0 /end MEASUREMENT
/begin MEASUREMENT TrimCutOffTooth_Cyl2 "var comments" UBYTE udf_CM_15667 0 0.0 0.0 255.0 DISPLAY_IDENTIFIER TRIM_CUT_OFF_EVENT_TOOTH[1] ECU_ADDRESS 0x40001DD1 /end MEASUREMENT
/begin MEASUREMENT TrimCutOffTooth_Cyl3 "var comments" UBYTE udf_CM_15667 0 0.0 0.0 255.0 DISPLAY_IDENTIFIER TRIM_CUT_OFF_EVENT_TOOTH[2] ECU_ADDRESS 0x40001DD2 /end MEASUREMENT
/begin MEASUREMENT TrimCutOffTooth_Cyl4 "var comments" UBYTE udf_CM_15667 0 0.0 0.0 255.0 DISPLAY_IDENTIFIER TRIM_CUT_OFF_EVENT_TOOTH[3] ECU_ADDRESS 0x40001DD3 /end MEASUREMENT
/begin MEASUREMENT ToothPeriod "var comments" UWORD udf_CM_15660 0 0.0 0.0 65535.0 ECU_ADDRESS 0x40001D14 /end MEASUREMENT
/begin MEASUREMENT ToothDuration "var comments" UWORD udf_CM_15660 0 0.0 0.0 65535.0 ECU_ADDRESS 0x40001D16 /end MEASUREMENT
/begin MEASUREMENT SeqSparkEnb "var comments" UBYTE udf_CM_17921 0 0.0 0.0 255.0 ECU_ADDRESS 0x40002921 /end MEASUREMENT
/begin MEASUREMENT CIDSuccCount "var comments" UWORD udf_CM_15660 0 0.0 0.0 65535.0 ECU_ADDRESS 0x40002922 /end MEASUREMENT
/begin MEASUREMENT MAPExpAltCmpd "var comments" UWORD udf_CM_17123 0 0.0 0.0 255.99609375 ECU_ADDRESS 0x4000297C /end MEASUREMENT
/begin MEASUREMENT CLT_DefaultInUse "var comments" UBYTE udf_CM_16689 0 0.0 0.0 255.0 ECU_ADDRESS 0x40002936 /end MEASUREMENT
/begin MEASUREMENT IntakeAirTemp "var comments" SWORD udf_CM_17053 0 0.0 -256.0 255.9921875 ECU_ADDRESS 0x40002954 /end MEASUREMENT
/begin MEASUREMENT IATDfltUsed "var comments" UBYTE udf_CM_16689 0 0.0 0.0 255.0 ECU_ADDRESS 0x4000295A /end MEASUREMENT
/begin MEASUREMENT IntkAirTempFilt "var comments" SWORD udf_CM_17060 0 0.0 -256.0 255.9921875 ECU_ADDRESS 0x40002956 /end MEASUREMENT
/begin MEASUREMENT IATStartup "var comments" SWORD udf_CM_16766 0 0.0 -256.0 255.9921875 ECU_ADDRESS 0x40002958 /end MEASUREMENT
/begin MEASUREMENT IGNVolt "var comments" UWORD udf_CM_16913 0 0.0 0.0 31.99951171875 ECU_ADDRESS 0x4000295C /end MEASUREMENT
/begin MEASUREMENT IGNVoltFilt "var comments" UWORD udf_CM_16927 0 0.0 0.0 31.99951171875 ECU_ADDRESS 0x4000295E /end MEASUREMENT
/begin MEASUREMENT IGNOff "var comments" UBYTE udf_CM_16892 0 0.0 0.0 255.0 ECU_ADDRESS 0x40002963 /end MEASUREMENT
/begin MEASUREMENT BattVoltKeyOff "var comments" UWORD udf_CM_15611 0 0.0 0.0 31.99951171875 DISPLAY_IDENTIFIER BattVoltStepMotorDrive ECU_ADDRESS 0x4000296A /end MEASUREMENT
/begin MEASUREMENT IGNRawSignal "var comments" UWORD udf_CM_16899 0 0.0 0.0 65535.0 ECU_ADDRESS 0x40002960 /end MEASUREMENT
/begin MEASUREMENT IGNState "var comments" UBYTE udf_CM_16906 0 0.0 0.0 255.0 ECU_ADDRESS 0x40002962 /end MEASUREMENT
/begin MEASUREMENT SystVoltPassCount "var comments" UWORD udf_CM_18299 0 0.0 0.0 65535.0 ECU_ADDRESS 0x40002E36 /end MEASUREMENT
/begin MEASUREMENT SystVoltDiagEnb "var comments" UBYTE udf_CM_18250 0 0.0 0.0 255.0 ECU_ADDRESS 0x40002E30 /end MEASUREMENT
/begin MEASUREMENT SystVoltHFailMet "var comments" UBYTE udf_CM_18264 0 0.0 0.0 255.0 ECU_ADDRESS 0x40002E3B /end MEASUREMENT
/begin MEASUREMENT SystVoltHFailCount "var comments" UWORD udf_CM_18257 0 0.0 0.0 65535.0 ECU_ADDRESS 0x40002E34 /end MEASUREMENT
/begin MEASUREMENT SystVoltHTestFail "var comments" UBYTE udf_CM_18271 0 0.0 0.0 255.0 ECU_ADDRESS 0x40002E33 /end MEASUREMENT
/begin MEASUREMENT SystVoltLFailMet "var comments" UBYTE udf_CM_18285 0 0.0 0.0 255.0 ECU_ADDRESS 0x40002E3A /end MEASUREMENT
/begin MEASUREMENT SystVoltLFailCount "var comments" UWORD udf_CM_18278 0 0.0 0.0 65535.0 ECU_ADDRESS 0x40002E38 /end MEASUREMENT
/begin MEASUREMENT SystVoltLTestFail "var comments" UBYTE udf_CM_18292 0 0.0 0.0 255.0 ECU_ADDRESS 0x40002E32 /end MEASUREMENT
/begin MEASUREMENT GENVPassCount "var comments" UWORD udf_CM_18299 0 0.0 0.0 65535.0 ECU_ADDRESS 0x0 /end MEASUREMENT
/begin MEASUREMENT GENVDiagEnb "var comments" UBYTE udf_CM_18250 0 0.0 0.0 255.0 ECU_ADDRESS 0x0 /end MEASUREMENT
/begin MEASUREMENT GENVHFailMet "var comments" UBYTE udf_CM_18264 0 0.0 0.0 255.0 ECU_ADDRESS 0x0 /end MEASUREMENT
/begin MEASUREMENT GENVHFailCount "var comments" UWORD udf_CM_18257 0 0.0 0.0 65535.0 ECU_ADDRESS 0x0 /end MEASUREMENT
/begin MEASUREMENT GENVHTestFail "var comments" UBYTE udf_CM_18271 0 0.0 0.0 255.0 ECU_ADDRESS 0x0 /end MEASUREMENT
/begin MEASUREMENT GENVLFailMet "var comments" UBYTE udf_CM_18285 0 0.0 0.0 255.0 ECU_ADDRESS 0x0 /end MEASUREMENT
/begin MEASUREMENT GENVLFailCount "var comments" UWORD udf_CM_18278 0 0.0 0.0 65535.0 ECU_ADDRESS 0x0 /end MEASUREMENT
/begin MEASUREMENT GENVLTestFail "var comments" UBYTE udf_CM_18292 0 0.0 0.0 255.0 ECU_ADDRESS 0x0 /end MEASUREMENT
/begin MEASUREMENT MAPActual "var comments" UWORD udf_CM_17081 0 0.0 0.0 255.99609375 ECU_ADDRESS 0x40002982 /end MEASUREMENT
/begin MEASUREMENT MAPAltComp "var comments" UWORD udf_CM_17088 0 0.0 0.0 255.99609375 ECU_ADDRESS 0x40002970 /end MEASUREMENT
/begin MEASUREMENT MAPDfltUsed "var comments" UBYTE udf_CM_17102 0 0.0 0.0 255.0 ECU_ADDRESS 0x40002910 /end MEASUREMENT
/begin MEASUREMENT MAPEstCorr "var comments" UWORD udf_CM_17109 0 0.0 0.0 255.99609375 ECU_ADDRESS 0x4000299E /end MEASUREMENT
/begin MEASUREMENT MAPEstimated "var comments" UWORD udf_CM_17116 0 0.0 0.0 255.99609375 ECU_ADDRESS 0x40002990 /end MEASUREMENT
/begin MEASUREMENT MAPExpected "var comments" UWORD udf_CM_17137 0 0.0 0.0 255.99609375 ECU_ADDRESS 0x40002984 /end MEASUREMENT
/begin MEASUREMENT MAPExpDiff "var comments" UWORD udf_CM_17130 0 0.0 0.0 255.99609375 ECU_ADDRESS 0x400029A0 /end MEASUREMENT
/begin MEASUREMENT MAPExpIncrs "var comments" UBYTE udf_CM_17144 0 0.0 0.0 255.0 ECU_ADDRESS 0x40002972 /end MEASUREMENT
/begin MEASUREMENT MAPExpPrev "var comments" UWORD udf_CM_17151 0 0.0 0.0 255.99609375 ECU_ADDRESS 0x4000298E /end MEASUREMENT
/begin MEASUREMENT VACExpected "var comments" UWORD udf_CM_19027 0 0.0 0.0 255.99609375 ECU_ADDRESS 0x40002974 /end MEASUREMENT
/begin MEASUREMENT MAPFiltLow "var comments" UWORD udf_CM_17165 0 0.0 0.0 255.99609375 ECU_ADDRESS 0x40002988 /end MEASUREMENT
/begin MEASUREMENT MAPFiltLowAvg "var comments" UWORD udf_CM_17172 0 0.0 0.0 255.99609375 ECU_ADDRESS 0x4000298A /end MEASUREMENT
/begin MEASUREMENT MAPFiltLowDlt "var comments" UWORD udf_CM_17179 0 0.0 0.0 255.99609375 ECU_ADDRESS 0x40002976 /end MEASUREMENT
/begin MEASUREMENT MAPFiltLowPrv "var comments" UWORD udf_CM_17186 0 0.0 0.0 255.99609375 ECU_ADDRESS 0x4000299A /end MEASUREMENT
/begin MEASUREMENT VACActual "var comments" UWORD udf_CM_19020 0 0.0 0.0 255.99609375 ECU_ADDRESS 0x40002998 /end MEASUREMENT
/begin MEASUREMENT BaroNorminal "var comments" UWORD udf_CM_19503 0 0.0 0.0 255.99609375 DISPLAY_IDENTIFIER VfVIOS_p_NominalBaro ECU_ADDRESS 0x40002994 /end MEASUREMENT
/begin MEASUREMENT MAPReadAngle "var comments" UWORD udf_CM_17193 0 0.0 0.0 1023.984375 ECU_ADDRESS 0x4000298C /end MEASUREMENT
/begin MEASUREMENT MAPReadCmplt "var comments" UBYTE udf_CM_17207 0 0.0 0.0 255.0 ECU_ADDRESS 0x4000297A /end MEASUREMENT
/begin MEASUREMENT MAPReadAngleDel "var comments" UWORD udf_CM_17200 0 0.0 0.0 1023.984375 ECU_ADDRESS 0x40002986 /end MEASUREMENT
/begin MEASUREMENT MAPReadErr "var comments" UBYTE udf_CM_19335 0 0.0 0.0 255.0 DISPLAY_IDENTIFIER VbVIOS_MAPReadError ECU_ADDRESS 0x40002979 /end MEASUREMENT
/begin MEASUREMENT MAPShorted "var comments" UBYTE udf_CM_17235 0 0.0 0.0 255.0 ECU_ADDRESS 0x4000296C /end MEASUREMENT
/begin MEASUREMENT MAPUnfilt "var comments" UWORD udf_CM_17291 0 0.0 0.0 255.99609375 ECU_ADDRESS 0x40002992 /end MEASUREMENT
/begin MEASUREMENT FuelPressureAbsolute "var comments" SWORD udf_CM_17293 0 0.0 -256 255.9921875 ECU_ADDRESS 0x40002B0C /end MEASUREMENT
/begin MEASUREMENT FuelPressureRelative "var comments" SWORD udf_CM_17293 0 0.0 -256 255.9921875 ECU_ADDRESS 0x40002B0E /end MEASUREMENT
/begin MEASUREMENT FuelPressureRaw "var comments" SWORD udf_CM_17293 0 0.0 -256 255.9921875 ECU_ADDRESS 0x40002B10 /end MEASUREMENT
/begin MEASUREMENT FuelPressureFilt "var comments" SWORD udf_CM_17293 0 0.0 -256 255.9921875 ECU_ADDRESS 0x40002B0A /end MEASUREMENT
/begin MEASUREMENT FPFiltCoef "var comments" UWORD CM_FiltCoef 0 0.0 0.0 0.9999847412109375 ECU_ADDRESS 0x40002B12 /end MEASUREMENT
/begin MEASUREMENT WPInFilt "var comments" UWORD udf_CM_17292 0 0.0 0.0 15.999755859375 ECU_ADDRESS 0x40002B04 /end MEASUREMENT
/begin MEASUREMENT WPOutFilt "var comments" UWORD udf_CM_17292 0 0.0 0.0 15.999755859375 ECU_ADDRESS 0x40002B06 /end MEASUREMENT
/begin MEASUREMENT WPPCurrFilt "var comments" UWORD udf_CM_17294 0 0.0 0.0 511.9921875 ECU_ADDRESS 0x40002B08 /end MEASUREMENT
/begin MEASUREMENT O2Volt "var comments" UWORD udf_CM_17536 0 0.0 0.0 1023.984375 ECU_ADDRESS 0x400029EE /end MEASUREMENT
/begin MEASUREMENT O2VoltPrev "var comments" UWORD udf_CM_17543 0 0.0 0.0 1023.984375 ECU_ADDRESS 0x400029F0 /end MEASUREMENT
/begin MEASUREMENT FuelMode "var comments" UBYTE udf_CM_16528 0 0.0 0.0 255.0 ECU_ADDRESS 0x400029F7 /end MEASUREMENT
/begin MEASUREMENT RefPeriod "var comments" UWORD udf_CM_17655 0 0.0 0.0 1023.984375 ECU_ADDRESS 0x40002A4E /end MEASUREMENT
/begin MEASUREMENT RefPulseSeen "var comments" UBYTE udf_CM_17676 0 0.0 0.0 255.0 ECU_ADDRESS 0x40002A42 /end MEASUREMENT
/begin MEASUREMENT IACV_RefToothCount "var comments" UWORD udf_CM_19370 0 0.0 0.0 65535.0 ECU_ADDRESS 0x400029B2 /end MEASUREMENT
/begin MEASUREMENT FCV_RefToothCount "var comments" UWORD udf_CM_19370 0 0.0 0.0 65535.0 ECU_ADDRESS 0x400029B0 /end MEASUREMENT
/begin MEASUREMENT MAPExpRealUsed "var comments" UBYTE udf_CM_17158 0 0.0 0.0 255.0 ECU_ADDRESS 0x40002980 /end MEASUREMENT
/begin MEASUREMENT EngineSpeed "var comments" UWORD udf_CM_16185 0 0.0 0.0 16383.75 ECU_ADDRESS 0x40002A40 /end MEASUREMENT
/begin MEASUREMENT EngSpdDelta "var comments" UWORD udf_CM_16206 0 0.0 0.0 16383.75 ECU_ADDRESS 0x40002A0A /end MEASUREMENT
/begin MEASUREMENT EngSpdSAGovDelta "var comments" UWORD udf_CM_16206 0 0.0 0.0 16383.75 ECU_ADDRESS 0x40002A0C /end MEASUREMENT
/begin MEASUREMENT EngSpdErrF2UF "var comments" UWORD udf_CM_16213 0 0.0 0.0 16383.75 ECU_ADDRESS 0x40002A06 /end MEASUREMENT
/begin MEASUREMENT EngSpdFilt "var comments" UWORD udf_CM_16220 0 0.0 0.0 16383.75 ECU_ADDRESS 0x40002A04 /end MEASUREMENT
/begin MEASUREMENT EngSpdIncrs "var comments" UBYTE udf_CM_16227 0 0.0 0.0 255.0 ECU_ADDRESS 0x40002A08 /end MEASUREMENT
/begin MEASUREMENT EngSpdState "var comments" UBYTE udf_CM_16234 0 0.0 0.0 255.0 ECU_ADDRESS 0x40002A4D /end MEASUREMENT
/begin MEASUREMENT RunModeTran "var comments" UBYTE udf_CM_19412 0 0.0 0.0 255.0 DISPLAY_IDENTIFIER VeVIOS_RunModeTran ECU_ADDRESS 0x40002941 /end MEASUREMENT
/begin MEASUREMENT SprkDlvMode "var comments" UBYTE udf_CM_18131 0 0.0 0.0 255.0 ECU_ADDRESS 0x40002926 /end MEASUREMENT
/begin MEASUREMENT VSS_DUTY "var comments" UWORD udf_CM_18726 0 0.0 0.0 199.9969482421875 DISPLAY_IDENTIFIER FI_Current_Duty[0] ECU_ADDRESS 0x40000B54 /end MEASUREMENT
/begin MEASUREMENT DIAG_DUTY "var comments" UWORD udf_CM_18726 0 0.0 0.0 199.9969482421875 DISPLAY_IDENTIFIER FI_Current_Duty[1] ECU_ADDRESS 0x40000B56 /end MEASUREMENT
/begin MEASUREMENT DCEN_DUTY "var comments" UWORD udf_CM_18726 0 0.0 0.0 199.9969482421875 DISPLAY_IDENTIFIER FI_Current_Duty[2] ECU_ADDRESS 0x40000B58 /end MEASUREMENT
/begin MEASUREMENT TPS "var comments" UWORD udf_CM_18726 0 0.0 0.0 199.9969482421875 ECU_ADDRESS 0x40002A6A /end MEASUREMENT
/begin MEASUREMENT TPSChanged "var comments" UBYTE udf_CM_18796 0 0.0 0.0 255.0 DISPLAY_IDENTIFIER TPSIncreaseFlag ECU_ADDRESS 0x40002A68 /end MEASUREMENT
/begin MEASUREMENT TPSDelta "var comments" UWORD udf_CM_18733 0 0.0 0.0 199.9969482421875 ECU_ADDRESS 0x40002A7C /end MEASUREMENT
/begin MEASUREMENT TPSIACCompstd "var comments" UWORD udf_CM_18789 0 0.0 0.0 199.9969482421875 ECU_ADDRESS 0x40002996 /end MEASUREMENT
/begin MEASUREMENT TPSPrev "var comments" UWORD udf_CM_18831 0 0.0 0.0 199.9969482421875 ECU_ADDRESS 0x40002A74 /end MEASUREMENT
/begin MEASUREMENT TPSRawSignal "var comments" UWORD udf_CM_18838 0 0.0 0.0 65535.0 ECU_ADDRESS 0x40002A6C /end MEASUREMENT
/begin MEASUREMENT TPSDiffAE "var comments" SWORD udf_CM_18747 0 0.0 -200.0 199.993896484375 ECU_ADDRESS 0x40002A7E /end MEASUREMENT
/begin MEASUREMENT TPSFiltAE "var comments" UWORD udf_CM_18775 0 0.0 0.0 199.9969482421875 ECU_ADDRESS 0x40002A6E /end MEASUREMENT
/begin MEASUREMENT TPSDiffF2UF "var comments" SWORD udf_CM_18761 0 0.0 -200.0 199.993896484375 ECU_ADDRESS 0x40002A78 /end MEASUREMENT
/begin MEASUREMENT TPSDiffDE "var comments" SWORD udf_CM_18754 0 0.0 -200.0 199.993896484375 ECU_ADDRESS 0x40002A80 /end MEASUREMENT
/begin MEASUREMENT TPSDfltUsed "var comments" UBYTE udf_CM_18740 0 0.0 0.0 255.0 ECU_ADDRESS 0x40002A72 /end MEASUREMENT
/begin MEASUREMENT TPSFiltDE "var comments" UWORD udf_CM_18782 0 0.0 0.0 199.9969482421875 ECU_ADDRESS 0x40002A70 /end MEASUREMENT
/begin MEASUREMENT TPSFilt "var comments" UWORD udf_CM_18768 0 0.0 0.0 199.9969482421875 ECU_ADDRESS 0x40002A76 /end MEASUREMENT
/begin MEASUREMENT TPSIncrs "var comments" UBYTE udf_CM_18803 0 0.0 0.0 255.0 ECU_ADDRESS 0x40002A73 /end MEASUREMENT
/begin MEASUREMENT TPSZero "var comments" UWORD udf_CM_18901 0 0.0 0.0 199.9969482421875 ECU_ADDRESS 0x4000009C /end MEASUREMENT
/begin COMPU_METHOD udf_CM_15240 "Ax + B" RAT_FUNC "%4.4" "boolean" COEFFS 0 1 0 0 0 1 /end COMPU_METHOD
/begin COMPU_METHOD udf_CM_15247 "Ax + B" RAT_FUNC "%4.0" "counts" COEFFS 0 1 0 0 0 1 /end COMPU_METHOD
/begin COMPU_METHOD udf_CM_15254 "Ax + B" RAT_FUNC "%4.0" "boolean" COEFFS 0 1 0 0 0 1 /end COMPU_METHOD
/begin COMPU_METHOD udf_CM_15261 "Ax + B" RAT_FUNC "%4.4" "ratio" COEFFS 0.0 65536.00026843546 0.0 0.0 0.0 1.0 /end COMPU_METHOD
/begin COMPU_METHOD udf_CM_15262 "Ax + B" RAT_FUNC "%4.4" "ratio" COEFFS 0.0 32768.00013421773 0.0 0.0 0.0 1.0 /end COMPU_METHOD
/begin COMPU_METHOD udf_CM_15268 "Ax + B" RAT_FUNC "%4.4" "gm" COEFFS 0.0 8192.000033554432 0.0 0.0 0.0 1.0 /end COMPU_METHOD
/begin COMPU_METHOD udf_CM_15275 "Ax + B" RAT_FUNC "%4.4" "ratio" COEFFS 0.0 32768.00013421773 0.0 0.0 0.0 1.0 /end COMPU_METHOD
/begin COMPU_METHOD udf_CM_15282 "Ax + B" RAT_FUNC "%4.4" "ratio" COEFFS 0.0 32768.00013421773 0.0 0.0 0.0 1.0 /end COMPU_METHOD
/begin COMPU_METHOD udf_CM_15289 "Ax + B" RAT_FUNC "%4.4" "ratio" COEFFS 0.0 32768.00013421773 0.0 0.0 0.0 1.0 /end COMPU_METHOD
/begin COMPU_METHOD udf_CM_15296 "Ax + B" RAT_FUNC "%4.4" "ratio" COEFFS 0.0 32768.00013421773 0.0 0.0 0.0 1.0 /end COMPU_METHOD
/begin COMPU_METHOD udf_CM_15303 "Ax + B" RAT_FUNC "%4.4" "ratio" COEFFS 0.0 32768.00013421773 0.0 0.0 0.0 1.0 /end COMPU_METHOD
/begin COMPU_METHOD udf_CM_15310 "Ax + B" RAT_FUNC "%4.4" "ratio" COEFFS 0.0 32768.00013421773 0.0 0.0 0.0 1.0 /end COMPU_METHOD
/begin COMPU_METHOD udf_CM_15317 "Ax + B" RAT_FUNC "%4.4" "ratio" COEFFS 0.0 32768.00013421773 0.0 0.0 0.0 1.0 /end COMPU_METHOD
/begin COMPU_METHOD udf_CM_15324 "Ax + B" RAT_FUNC "%4.4" "ratio" COEFFS 0.0 32768.00013421773 0.0 0.0 0.0 1.0 /end COMPU_METHOD
/begin COMPU_METHOD udf_CM_15331 "Ax + B" RAT_FUNC "%4.4" "ratio" COEFFS 0.0 32768.00013421773 0.0 0.0 0.0 1.0 /end COMPU_METHOD
/begin COMPU_METHOD udf_CM_15338 "Ax + B" RAT_FUNC "%4.4" "ratio" COEFFS 0.0 32768.00013421773 0.0 0.0 0.0 1.0 /end COMPU_METHOD
/begin COMPU_METHOD udf_CM_15345 "Ax + B" RAT_FUNC "%4.4" "ratio" COEFFS 0.0 32768.00013421773 0.0 0.0 0.0 1.0 /end COMPU_METHOD
/begin COMPU_METHOD udf_CM_15352 "Ax + B" RAT_FUNC "%4.4" "ratio" COEFFS 0.0 32768.00013421773 0.0 0.0 0.0 1.0 /end COMPU_METHOD
/begin COMPU_METHOD udf_CM_15359 "Ax + B" RAT_FUNC "%4.4" "ratio" COEFFS 0.0 32768.00013421773 0.0 0.0 0.0 1.0 /end COMPU_METHOD
/begin COMPU_METHOD udf_CM_15366 "Ax + B" RAT_FUNC "%4.4" "ratio" COEFFS 0.0 32768.00013421773 0.0 0.0 0.0 1.0 /end COMPU_METHOD
/begin COMPU_METHOD udf_CM_15373 "Ax + B" RAT_FUNC "%4.4" "ratio" COEFFS 0.0 32768.00013421773 0.0 0.0 0.0 1.0 /end COMPU_METHOD
/begin COMPU_METHOD udf_CM_15380 "Ax + B" RAT_FUNC "%4.4" "ratio" COEFFS 0.0 32768.00013421773 0.0 0.0 0.0 1.0 /end COMPU_METHOD
/begin COMPU_METHOD udf_CM_15387 "Ax + B" RAT_FUNC "%4.0" "count" COEFFS 0 1 0 0 0 1 /end COMPU_METHOD
/begin COMPU_METHOD udf_CM_15394 "Ax + B" RAT_FUNC "%4.4" "ratio" COEFFS 0.0 32768.00013421773 0.0 0.0 0.0 1.0 /end COMPU_METHOD
/begin COMPU_METHOD udf_CM_15401 "Ax + B" RAT_FUNC "%4.4" "kpa" COEFFS 0.0 256.0 0.0 0.0 0.0 1.0 /end COMPU_METHOD
/begin COMPU_METHOD udf_CM_15408 "Ax + B" RAT_FUNC "%4.0" "boolean" COEFFS 0 1 0 0 0 1 /end COMPU_METHOD
/begin COMPU_METHOD udf_CM_15415 "Ax + B" RAT_FUNC "%4.4" "ratio" COEFFS 0.0 32768.00013421773 0.0 0.0 0.0 1.0 /end COMPU_METHOD
/begin COMPU_METHOD udf_CM_15422 "Ax + B" RAT_FUNC "%4.4" "ratio" COEFFS 0.0 2048.0 0.0 0.0 0.0 1.0 /end COMPU_METHOD
/begin COMPU_METHOD udf_CM_15429 "Ax + B" RAT_FUNC "%4.4" "ratio" COEFFS 0.0 2048.0 0.0 0.0 0.0 1.0 /end COMPU_METHOD
/begin COMPU_METHOD udf_CM_15436 "Ax + B" RAT_FUNC "%4.0" "boolean" COEFFS 0 1 0 0 0 1 /end COMPU_METHOD
/begin COMPU_METHOD udf_CM_15450 "Ax + B" RAT_FUNC "%4.4" "ratio" COEFFS 0.0 2048.0 0.0 0.0 0.0 1.0 /end COMPU_METHOD
/begin COMPU_METHOD udf_CM_15457 "Ax + B" RAT_FUNC "%4.4" "ratio" COEFFS 0.0 2048.0 0.0 0.0 0.0 1.0 /end COMPU_METHOD
/begin COMPU_METHOD udf_CM_15464 "Ax + B" RAT_FUNC "%4.4" "ratio" COEFFS 0.0 2048.0 0.0 0.0 0.0 1.0 /end COMPU_METHOD
/begin COMPU_METHOD udf_CM_15485 "Ax + B" RAT_FUNC "%4.4" "ratio" COEFFS 0.0 2048.0 0.0 0.0 0.0 1.0 /end COMPU_METHOD
/begin COMPU_METHOD udf_CM_15492 "Ax + B" RAT_FUNC "%4.4" "volt" COEFFS 0.0 2048.0 0.0 0.0 0.0 1.0 /end COMPU_METHOD
/begin COMPU_METHOD udf_CM_15499 "Ax + B" RAT_FUNC "%4.4" "volt" COEFFS 0.0 2048.0 0.0 0.0 0.0 1.0 /end COMPU_METHOD
/begin COMPU_METHOD udf_CM_15506 "Ax + B" RAT_FUNC "%4.4" "ratio" COEFFS 0.0 2048.0 0.0 0.0 0.0 1.0 /end COMPU_METHOD
/begin COMPU_METHOD udf_CM_15513 "Ax + B" RAT_FUNC "%4.0" "boolean" COEFFS 0 1 0 0 0 1 /end COMPU_METHOD
/begin COMPU_METHOD udf_CM_15520 "Ax + B" RAT_FUNC "%4.4" "ratio" COEFFS 0.0 2048.0 0.0 0.0 0.0 1.0 /end COMPU_METHOD
/begin COMPU_METHOD udf_CM_15527 "Ax + B" RAT_FUNC "%4.4" "ratio" COEFFS 0.0 2048.0 0.0 0.0 0.0 1.0 /end COMPU_METHOD
/begin COMPU_METHOD udf_CM_15534 "Ax + B" RAT_FUNC "%4.4" "gm/sec" COEFFS 0.0 128.0 0.0 0.0 0.0 1.0 /end COMPU_METHOD
/begin COMPU_METHOD udf_CM_15541 "Ax + B" RAT_FUNC "%4.4" "gm/sec" COEFFS 0.0 128.0 0.0 0.0 0.0 1.0 /end COMPU_METHOD
/begin COMPU_METHOD udf_CM_15548 "Ax + B" RAT_FUNC "%4.4" "grams" COEFFS 0.0 16384.00006710886 0.0 0.0 0.0 1.0 /end COMPU_METHOD
/begin COMPU_METHOD udf_CM_15555 "Ax + B" RAT_FUNC "%4.4" "grams" COEFFS 0.0 16384.00006710886 0.0 0.0 0.0 1.0 /end COMPU_METHOD
/begin COMPU_METHOD udf_CM_15562 "Ax + B" RAT_FUNC "%4.4" "kpa" COEFFS 0.0 256.0 0.0 0.0 0.0 1.0 /end COMPU_METHOD
/begin COMPU_METHOD udf_CM_15569 "Ax + B" RAT_FUNC "%4.4" "kpa" COEFFS 0.0 256.0 0.0 0.0 0.0 1.0 /end COMPU_METHOD
/begin COMPU_METHOD udf_CM_15576 "Ax + B" RAT_FUNC "%4.0" "boolean" COEFFS 0 1 0 0 0 1 /end COMPU_METHOD
/begin COMPU_METHOD udf_CM_15583 "Ax + B" RAT_FUNC "%4.0" "None" COEFFS 0 1 0 0 0 1 /end COMPU_METHOD
/begin COMPU_METHOD udf_CM_15590 "Ax + B" RAT_FUNC "%4.4" "gm" COEFFS 0.0 65536.00026843546 0.0 0.0 0.0 1.0 /end COMPU_METHOD
/begin COMPU_METHOD udf_CM_15597 "Ax + B" RAT_FUNC "%4.4" "msec" COEFFS 0.0 64.0 0.0 0.0 0.0 1.0 /end COMPU_METHOD
/begin COMPU_METHOD udf_CM_15604 "Ax + B" RAT_FUNC "%4.4" "gm" COEFFS 0.0 65536.00026843546 0.0 0.0 0.0 1.0 /end COMPU_METHOD
/begin COMPU_METHOD udf_CM_15611 "Ax + B" RAT_FUNC "%4.4" "volt" COEFFS 0.0 2048.0 0.0 0.0 0.0 1.0 /end COMPU_METHOD
/begin COMPU_METHOD CM_Boolean1 "" RAT_FUNC "%1.0" "bool" COEFFS 0 1 0 0 0 1 /end COMPU_METHOD
/begin COMPU_METHOD udf_CM_15639 "Ax + B" RAT_FUNC "%4.4" "ratio" COEFFS 0.0 16393.44262295082 0.0 0.0 0.0 1.0 /end COMPU_METHOD
/begin COMPU_METHOD udf_CM_15646 "Ax + B" RAT_FUNC "%4.4" "degC" COEFFS 0.0 128.0 0.0 0.0 0.0 1.0 /end COMPU_METHOD
/begin COMPU_METHOD udf_CM_15653 "Ax + B" RAT_FUNC "%4.0" "counts" COEFFS 0 1 0 0 0 1 /end COMPU_METHOD
/begin COMPU_METHOD udf_CM_15660 "Ax + B" RAT_FUNC "%4.0" "counts" COEFFS 0 1 0 0 0 1 /end COMPU_METHOD
/begin COMPU_METHOD udf_CM_15667 "Ax + B" RAT_FUNC "%4.0" "None" COEFFS 0 1 0 0 0 1 /end COMPU_METHOD
/begin COMPU_METHOD udf_CM_15674 "Ax + B" RAT_FUNC "%4.0" "None" COEFFS 0 1 0 0 0 1 /end COMPU_METHOD
/begin COMPU_METHOD udf_CM_15681 "Ax + B" RAT_FUNC "%4.0" "Counts" COEFFS 0 1 0 0 0 1 /end COMPU_METHOD
/begin COMPU_METHOD udf_CM_15688 "Ax + B" RAT_FUNC "%4.0" "None" COEFFS 0 1 0 0 0 1 /end COMPU_METHOD
/begin COMPU_METHOD udf_CM_15695 "Ax + B" RAT_FUNC "%4.0" "Counts" COEFFS 0 1 0 0 0 1 /end COMPU_METHOD
/begin COMPU_METHOD udf_CM_15702 "Ax + B" RAT_FUNC "%4.0" "None" COEFFS 0 1 0 0 0 1 /end COMPU_METHOD
/begin COMPU_METHOD udf_CM_15716 "Ax + B" RAT_FUNC "%4.0" "Counts" COEFFS 0 1 0 0 0 1 /end COMPU_METHOD
/begin COMPU_METHOD udf_CM_15723 "Ax + B" RAT_FUNC "%4.0" "None" COEFFS 0 1 0 0 0 1 /end COMPU_METHOD
/begin COMPU_METHOD udf_CM_15730 "Ax + B" RAT_FUNC "%4.0" "Counts" COEFFS 0 1 0 0 0 1 /end COMPU_METHOD
/begin COMPU_METHOD udf_CM_15737 "Ax + B" RAT_FUNC "%4.0" "None" COEFFS 0 1 0 0 0 1 /end COMPU_METHOD
/begin COMPU_METHOD udf_CM_15744 "Ax + B" RAT_FUNC "%4.4" "degC" COEFFS 0.0 128.0 0.0 0.0 0.0 1.0 /end COMPU_METHOD
/begin COMPU_METHOD udf_CM_15751 "Ax + B" RAT_FUNC "%4.4" "degC" COEFFS 0.0 128.0 0.0 0.0 0.0 1.0 /end COMPU_METHOD
/begin COMPU_METHOD udf_CM_15758 "Ax + B" RAT_FUNC "%4.4" "degC" COEFFS 0.0 128.0 0.0 0.0 0.0 1.0 /end COMPU_METHOD
/begin COMPU_METHOD CM_Count1 "" RAT_FUNC "%3.0" "count" COEFFS 0 1 0 0 0 1 /end COMPU_METHOD
/begin COMPU_METHOD CM_Count3 "" RAT_FUNC "%3.0" "None" COEFFS 0 1 0 0 0 1 /end COMPU_METHOD
/begin COMPU_METHOD udf_CM_15821 "Ax + B" RAT_FUNC "%4.0" "None" COEFFS 0 1 0 0 0 1 /end COMPU_METHOD
/begin COMPU_METHOD udf_CM_15828 "Ax + B" RAT_FUNC "%4.0" "None" COEFFS 0 1 0 0 0 1 /end COMPU_METHOD
/begin COMPU_METHOD udf_CM_15835 "Ax + B" RAT_FUNC "%4.2" "" COEFFS 0.0 128.0 0.0 0.0 0.0 1.0 /end COMPU_METHOD
/begin COMPU_METHOD udf_CM_15842 "Ax + B" RAT_FUNC "%4.2" "" COEFFS 0.0 128.0 0.0 0.0 0.0 1.0 /end COMPU_METHOD
/begin COMPU_METHOD udf_CM_15849 "Ax + B" RAT_FUNC "%4.0" "" COEFFS 0 1 0 0 0 1 /end COMPU_METHOD
/begin COMPU_METHOD udf_CM_15856 "Ax + B" RAT_FUNC "%4.0" "" COEFFS 0 1 0 0 0 1 /end COMPU_METHOD
/begin COMPU_METHOD udf_CM_15863 "Ax + B" RAT_FUNC "%4.0" "" COEFFS 0 1 0 0 0 1 /end COMPU_METHOD
/begin COMPU_METHOD udf_CM_15870 "Ax + B" RAT_FUNC "%4.0" "" COEFFS 0 1 0 0 0 1 /end COMPU_METHOD
/begin COMPU_METHOD udf_CM_15877 "Ax + B" RAT_FUNC "%4.0" "" COEFFS 0 1 0 0 0 1 /end COMPU_METHOD
/begin COMPU_METHOD udf_CM_15884 "Ax + B" RAT_FUNC "%4.0" "" COEFFS 0 1 0 0 0 1 /end COMPU_METHOD
/begin COMPU_METHOD udf_CM_15891 "Ax + B" RAT_FUNC "%4.0" "" COEFFS 0 1 0 0 0 1 /end COMPU_METHOD
/begin COMPU_METHOD udf_CM_15898 "Ax + B" RAT_FUNC "%4.0" "" COEFFS 0 1 0 0 0 1 /end COMPU_METHOD
/begin COMPU_METHOD udf_CM_15905 "Ax + B" RAT_FUNC "%4.0" "" COEFFS 0 1 0 0 0 1 /end COMPU_METHOD
/begin COMPU_METHOD udf_CM_15912 "Ax + B" RAT_FUNC "%4.0" "" COEFFS 0 1 0 0 0 1 /end COMPU_METHOD
/begin COMPU_METHOD udf_CM_15919 "Ax + B" RAT_FUNC "%4.0" "" COEFFS 0 1 0 0 0 1 /end COMPU_METHOD
/begin COMPU_METHOD udf_CM_15926 "Ax + B" RAT_FUNC "%4.0" "" COEFFS 0 1 0 0 0 1 /end COMPU_METHOD
/begin COMPU_METHOD udf_CM_15933 "Ax + B" RAT_FUNC "%4.0" "" COEFFS 0 1 0 0 0 1 /end COMPU_METHOD
/begin COMPU_METHOD CM_EOI "" TAB_VERB "%10.4" "" COMPU_TAB_REF CM_EOI_TAB /end COMPU_METHOD
/begin COMPU_METHOD CM_LIGHT_TYPE "" TAB_VERB "%4.0" "" COMPU_TAB_REF CM_LIGHT_TYPE_TAB /end COMPU_METHOD
/begin COMPU_METHOD udf_CM_15947 "Ax + B" RAT_FUNC "%4.0" "boolean" COEFFS 0 1 0 0 0 1 /end COMPU_METHOD
/begin COMPU_METHOD udf_CM_15954 "Ax + B" RAT_FUNC "%4.4" "boolean" COEFFS 0 1 0 0 0 1 /end COMPU_METHOD
/begin COMPU_METHOD udf_CM_15961 "Ax + B" RAT_FUNC "%4.4" "ratio" COEFFS 0.0 65536.00026843546 0.0 0.0 0.0 1.0 /end COMPU_METHOD
/begin COMPU_METHOD udf_CM_15968 "Ax + B" RAT_FUNC "%4.4" "gm" COEFFS 0.0 8192.000033554432 0.0 0.0 0.0 1.0 /end COMPU_METHOD
/begin COMPU_METHOD udf_CM_15975 "Ax + B" RAT_FUNC "%4.4" "gm" COEFFS 0.0 65536.00026843546 0.0 0.0 0.0 1.0 /end COMPU_METHOD
/begin COMPU_METHOD udf_CM_15982 "Ax + B" RAT_FUNC "%4.4" "Gram" COEFFS 0.0 128.0 0.0 0.0 0.0 1.0 /end COMPU_METHOD
/begin COMPU_METHOD udf_CM_15989 "Ax + B" RAT_FUNC "%4.4" "percent" COEFFS 0.0 327.6800000536871 0.0 0.0 0.0 1.0 /end COMPU_METHOD
/begin COMPU_METHOD udf_CM_15996 "Ax + B" RAT_FUNC "%4.0" "percent" COEFFS 0.0 327.6800000536871 0.0 0.0 0.0 1.0 /end COMPU_METHOD
/begin COMPU_METHOD udf_CM_16010 "" TAB_VERB "%10.4" "" COMPU_TAB_REF udf_CV_19704 /end COMPU_METHOD
/begin COMPU_METHOD udf_CM_16059 "Ax + B" RAT_FUNC "%4.4" "NM" COEFFS 0.0 256.0 0.0 0.0 0.0 1.0 /end COMPU_METHOD
/begin COMPU_METHOD udf_CM_16066 "Ax + B" RAT_FUNC "%4.4" "rpm" COEFFS 0.0 4.0 0.0 0.0 0.0 1.0 /end COMPU_METHOD
/begin COMPU_METHOD udf_CM_16073 "Ax + B" RAT_FUNC "%4.4" "rpm" COEFFS 0.0 4.0 0.0 0.0 0.0 1.0 /end COMPU_METHOD
/begin COMPU_METHOD udf_CM_16080 "Ax + B" RAT_FUNC "%4.4" "rpm" COEFFS 0.0 4.0 0.0 0.0 0.0 1.0 /end COMPU_METHOD
/begin COMPU_METHOD udf_CM_16087 "Ax + B" RAT_FUNC "%4.4" "rpm" COEFFS 0.0 4.0 0.0 0.0 0.0 1.0 /end COMPU_METHOD
/begin COMPU_METHOD udf_CM_16094 "Ax + B" RAT_FUNC "%4.4" "rpm" COEFFS 0.0 4.0 0.0 0.0 0.0 1.0 /end COMPU_METHOD
/begin COMPU_METHOD udf_CM_16101 "Ax + B" RAT_FUNC "%4.4" "rpm" COEFFS 0.0 4.0 0.0 0.0 0.0 1.0 /end COMPU_METHOD
/begin COMPU_METHOD udf_CM_16108 "Ax + B" RAT_FUNC "%4.4" "rpm" COEFFS 0.0 4.0 0.0 0.0 0.0 1.0 /end COMPU_METHOD
/begin COMPU_METHOD udf_CM_16115 "Ax + B" RAT_FUNC "%4.4" "rpm" COEFFS 0.0 4.0 0.0 0.0 0.0 1.0 /end COMPU_METHOD
/begin COMPU_METHOD udf_CM_16122 "Ax + B" RAT_FUNC "%4.4" "rpm" COEFFS 0.0 4.0 0.0 0.0 0.0 1.0 /end COMPU_METHOD
/begin COMPU_METHOD udf_CM_16129 "Ax + B" RAT_FUNC "%4.4" "rpm" COEFFS 0.0 4.0 0.0 0.0 0.0 1.0 /end COMPU_METHOD
/begin COMPU_METHOD udf_CM_16136 "Ax + B" RAT_FUNC "%4.4" "rpm" COEFFS 0.0 4.0 0.0 0.0 0.0 1.0 /end COMPU_METHOD
/begin COMPU_METHOD udf_CM_16143 "Ax + B" RAT_FUNC "%4.4" "rpm" COEFFS 0.0 4.0 0.0 0.0 0.0 1.0 /end COMPU_METHOD
/begin COMPU_METHOD udf_CM_16150 "Ax + B" RAT_FUNC "%4.4" "rpm" COEFFS 0.0 4.0 0.0 0.0 0.0 1.0 /end COMPU_METHOD
/begin COMPU_METHOD udf_CM_16157 "Ax + B" RAT_FUNC "%4.4" "rpm" COEFFS 0.0 4.0 0.0 0.0 0.0 1.0 /end COMPU_METHOD
/begin COMPU_METHOD udf_CM_16164 "Ax + B" RAT_FUNC "%4.4" "rpm" COEFFS 0.0 4.0 0.0 0.0 0.0 1.0 /end COMPU_METHOD
/begin COMPU_METHOD udf_CM_16171 "Ax + B" RAT_FUNC "%4.4" "rpm" COEFFS 0.0 4.0 0.0 0.0 0.0 1.0 /end COMPU_METHOD
/begin COMPU_METHOD udf_CM_16178 "Ax + B" RAT_FUNC "%4.4" "rpm" COEFFS 0.0 4.0 0.0 0.0 0.0 1.0 /end COMPU_METHOD
/begin COMPU_METHOD udf_CM_16185 "Ax + B" RAT_FUNC "%4.4" "rpm" COEFFS 0.0 4.0 0.0 0.0 0.0 1.0 /end COMPU_METHOD
/begin COMPU_METHOD udf_CM_16192 "" TAB_VERB "%10.4" "" COMPU_TAB_REF udf_CV_19710 /end COMPU_METHOD
/begin COMPU_METHOD udf_CM_16193 "" TAB_VERB "%10.4" "" COMPU_TAB_REF udf_CV_19711 /end COMPU_METHOD
/begin COMPU_METHOD udf_CM_16199 "Ax + B" RAT_FUNC "%4.0" "None" COEFFS 0 1 0 0 0 1 /end COMPU_METHOD
/begin COMPU_METHOD udf_CM_16206 "Ax + B" RAT_FUNC "%4.4" "rpm" COEFFS 0.0 4.0 0.0 0.0 0.0 1.0 /end COMPU_METHOD
/begin COMPU_METHOD udf_CM_16213 "Ax + B" RAT_FUNC "%4.4" "rpm" COEFFS 0.0 4.0 0.0 0.0 0.0 1.0 /end COMPU_METHOD
/begin COMPU_METHOD udf_CM_16220 "Ax + B" RAT_FUNC "%4.4" "rpm" COEFFS 0.0 4.0 0.0 0.0 0.0 1.0 /end COMPU_METHOD
/begin COMPU_METHOD udf_CM_16227 "Ax + B" RAT_FUNC "%4.0" "none" COEFFS 0 1 0 0 0 1 /end COMPU_METHOD
/begin COMPU_METHOD udf_CM_16234 "Ax + B" RAT_FUNC "%4.0" "boolean" COEFFS 0 1 0 0 0 1 /end COMPU_METHOD
/begin COMPU_METHOD udf_CM_16269 "Ax + B" RAT_FUNC "%4.0" "boolean" COEFFS 0 1 0 0 0 1 /end COMPU_METHOD
/begin COMPU_METHOD udf_CM_16283 "Ax + B" RAT_FUNC "%4.4" "msec" COEFFS 0.0 64.0 0.0 0.0 0.0 1.0 /end COMPU_METHOD
/begin COMPU_METHOD udf_CM_16290 "Ax + B" RAT_FUNC "%4.4" "msec" COEFFS 0.0 64.0 0.0 0.0 0.0 1.0 /end COMPU_METHOD
/begin COMPU_METHOD udf_CM_16297 "Ax + B" RAT_FUNC "%4.4" "msec" COEFFS 0.0 64.0 0.0 0.0 0.0 1.0 /end COMPU_METHOD
/begin COMPU_METHOD udf_CM_16304 "Ax + B" RAT_FUNC "%4.4" "msec" COEFFS 0.0 64.0 0.0 0.0 0.0 1.0 /end COMPU_METHOD
/begin COMPU_METHOD udf_CM_16311 "" TAB_VERB "%10.4" "" COMPU_TAB_REF udf_CV_19716 /end COMPU_METHOD
/begin COMPU_METHOD udf_CM_16325 "Ax + B" RAT_FUNC "%4.4" "millivolt" COEFFS 0.0 64.0 0.0 0.0 0.0 1.0 /end COMPU_METHOD
/begin COMPU_METHOD udf_CM_16332 "" TAB_VERB "%10.4" "" COMPU_TAB_REF udf_CV_19722 /end COMPU_METHOD
/begin COMPU_METHOD udf_CM_16339 "Ax + B" RAT_FUNC "%4.0" "boolean" COEFFS 0 1 0 0 0 1 /end COMPU_METHOD
/begin COMPU_METHOD udf_CM_16346 "" TAB_VERB "%10.4" "" COMPU_TAB_REF udf_CV_19728 /end COMPU_METHOD
/begin COMPU_METHOD udf_CM_16353 "Ax + B" RAT_FUNC "%4.0" "boolean" COEFFS 0 1 0 0 0 1 /end COMPU_METHOD
/begin COMPU_METHOD udf_CM_16360 "Ax + B" RAT_FUNC "%4.4" "millivolt" COEFFS 0.0 64.0 0.0 0.0 0.0 1.0 /end COMPU_METHOD
/begin COMPU_METHOD udf_CM_16381 "Ax + B" RAT_FUNC "%4.0" "boolean" COEFFS 0 1 0 0 0 1 /end COMPU_METHOD
/begin COMPU_METHOD udf_CM_16395 "Ax + B" RAT_FUNC "%4.0" "boolean" COEFFS 0 1 0 0 0 1 /end COMPU_METHOD
/begin COMPU_METHOD udf_CM_16402 "Ax + B" RAT_FUNC "%4.0" "boolean" COEFFS 0 1 0 0 0 1 /end COMPU_METHOD
/begin COMPU_METHOD udf_CM_16409 "Ax + B" RAT_FUNC "%4.4" "msec" COEFFS 0.0 64.0 0.0 0.0 0.0 1.0 /end COMPU_METHOD
/begin COMPU_METHOD udf_CM_16416 "Ax + B" RAT_FUNC "%4.4" "msec" COEFFS 0.0 64.0 0.0 0.0 0.0 1.0 /end COMPU_METHOD
/begin COMPU_METHOD udf_CM_16423 "Ax + B" RAT_FUNC "%4.0" "boolean" COEFFS 0 1 0 0 0 1 /end COMPU_METHOD
/begin COMPU_METHOD udf_CM_16430 "Ax + B" RAT_FUNC "%4.0" "boolean" COEFFS 0 1 0 0 0 1 /end COMPU_METHOD
/begin COMPU_METHOD udf_CM_16437 "Ax + B" RAT_FUNC "%4.4" "msec" COEFFS 0.0 8192.000033554432 0.0 0.0 0.0 1.0 /end COMPU_METHOD
/begin COMPU_METHOD udf_CM_16444 "Ax + B" RAT_FUNC "%4.4" "grm" COEFFS 0.0 4096.0 0.0 0.0 0.0 1.0 /end COMPU_METHOD
/begin COMPU_METHOD udf_CM_16451 "Ax + B" RAT_FUNC "%4.0" "boolean" COEFFS 0 1 0 0 0 1 /end COMPU_METHOD
/begin COMPU_METHOD udf_CM_16458 "Ax + B" RAT_FUNC "%4.0" "None" COEFFS 0 1 0 0 0 1 /end COMPU_METHOD
/begin COMPU_METHOD udf_CM_16465 "Ax + B" RAT_FUNC "%4.4" "angle" COEFFS 0.0 64.0 0.0 0.0 0.0 1.0 /end COMPU_METHOD
/begin COMPU_METHOD udf_CM_16472 "Ax + B" RAT_FUNC "%4.4" "angle" COEFFS 0.0 64.0 0.0 0.0 0.0 1.0 /end COMPU_METHOD
/begin COMPU_METHOD udf_CM_16479 "Ax + B" RAT_FUNC "%4.4" "angle" COEFFS 0.0 64.0 0.0 0.0 0.0 1.0 /end COMPU_METHOD
/begin COMPU_METHOD udf_CM_16486 "Ax + B" RAT_FUNC "%4.0" "boolean" COEFFS 0 1 0 0 0 1 /end COMPU_METHOD
/begin COMPU_METHOD udf_CM_16493 "Ax + B" RAT_FUNC "%4.0" "boolean" COEFFS 0 1 0 0 0 1 /end COMPU_METHOD
/begin COMPU_METHOD udf_CM_16500 "Ax + B" RAT_FUNC "%4.4" "counts" COEFFS 0 1 0 0 0 1 /end COMPU_METHOD
/begin COMPU_METHOD udf_CM_16507 "Ax + B" RAT_FUNC "%4.4" "msec" COEFFS 0.0 64.0 0.0 0.0 0.0 1.0 /end COMPU_METHOD
/begin COMPU_METHOD udf_CM_16514 "Ax + B" RAT_FUNC "%4.0" "boolean" COEFFS 0 1 0 0 0 1 /end COMPU_METHOD
/begin COMPU_METHOD udf_CM_16521 "Ax + B" RAT_FUNC "%4.0" "boolean" COEFFS 0 1 0 0 0 1 /end COMPU_METHOD
/begin COMPU_METHOD udf_CM_16528 "Ax + B" RAT_FUNC "%4.0" "None" COEFFS 0 1 0 0 0 1 /end COMPU_METHOD
/begin COMPU_METHOD udf_CM_16535 "Ax + B" RAT_FUNC "%4.4" "percent" COEFFS 0.0 327.6800000536871 0.0 0.0 0.0 1.0 /end COMPU_METHOD
/begin COMPU_METHOD udf_CM_16598 "Ax + B" RAT_FUNC "%4.4" "percent" COEFFS 0.0 327.6800000536871 0.0 0.0 0.0 1.0 /end COMPU_METHOD
/begin COMPU_METHOD udf_CM_16605 "Ax + B" RAT_FUNC "%4.0" "None" COEFFS 0 1 0 0 0 1 /end COMPU_METHOD
/begin COMPU_METHOD udf_CM_16612 "Ax + B" RAT_FUNC "%4.0" "None" COEFFS 0 1 0 0 0 1 /end COMPU_METHOD
/begin COMPU_METHOD udf_CM_16619 "Ax + B" RAT_FUNC "%4.0" "None" COEFFS 0 1 0 0 0 1 /end COMPU_METHOD
/begin COMPU_METHOD udf_CM_16626 "Ax + B" RAT_FUNC "%4.4" "ratio" COEFFS 0.0 32768.00013421773 0.0 0.0 0.0 1.0 /end COMPU_METHOD
/begin COMPU_METHOD udf_CM_16627 "Ax + B" RAT_FUNC "%4.4" "ratio" COEFFS 0.0 16384 0.0 0.0 0.0 1.0 /end COMPU_METHOD
/begin COMPU_METHOD udf_CM_16640 "Ax + B" RAT_FUNC "%4.0" "IAC_Mode" COEFFS 0 1 0 0 0 1 /end COMPU_METHOD
/begin COMPU_METHOD udf_CM_16647 "Ax + B" RAT_FUNC "%4.0" "boolean" COEFFS 0 1 0 0 0 1 /end COMPU_METHOD
/begin COMPU_METHOD udf_CM_16654 "Ax + B" RAT_FUNC "%4.0" "boolean" COEFFS 0 1 0 0 0 1 /end COMPU_METHOD
/begin COMPU_METHOD udf_CM_16661 "" TAB_VERB "%10.4" "" COMPU_TAB_REF udf_CV_19734 /end COMPU_METHOD
/begin COMPU_METHOD udf_CM_16668 "" TAB_VERB "%10.4" "" COMPU_TAB_REF udf_CV_19740 /end COMPU_METHOD
/begin COMPU_METHOD udf_CM_16675 "Ax + B" RAT_FUNC "%4.0" "boolean" COEFFS 0 1 0 0 0 1 /end COMPU_METHOD
/begin COMPU_METHOD udf_CM_16682 "Ax + B" RAT_FUNC "%4.0" "boolean" COEFFS 0 1 0 0 0 1 /end COMPU_METHOD
/begin COMPU_METHOD udf_CM_16689 "Ax + B" RAT_FUNC "%4.0" "boolean" COEFFS 0 1 0 0 0 1 /end COMPU_METHOD
/begin COMPU_METHOD udf_CM_16703 "Ax + B" RAT_FUNC "%4.0" "Counts" COEFFS 0 1 0 0 0 1 /end COMPU_METHOD
/begin COMPU_METHOD udf_CM_16710 "Ax + B" RAT_FUNC "%4.0" "None" COEFFS 0 1 0 0 0 1 /end COMPU_METHOD
/begin COMPU_METHOD udf_CM_16717 "Ax + B" RAT_FUNC "%4.0" "Counts" COEFFS 0 1 0 0 0 1 /end COMPU_METHOD
/begin COMPU_METHOD udf_CM_16724 "Ax + B" RAT_FUNC "%4.0" "None" COEFFS 0 1 0 0 0 1 /end COMPU_METHOD
/begin COMPU_METHOD udf_CM_16731 "Ax + B" RAT_FUNC "%4.0" "None" COEFFS 0 1 0 0 0 1 /end COMPU_METHOD
/begin COMPU_METHOD udf_CM_16738 "Ax + B" RAT_FUNC "%4.0" "Counts" COEFFS 0 1 0 0 0 1 /end COMPU_METHOD
/begin COMPU_METHOD udf_CM_16745 "Ax + B" RAT_FUNC "%4.0" "None" COEFFS 0 1 0 0 0 1 /end COMPU_METHOD
/begin COMPU_METHOD udf_CM_16752 "Ax + B" RAT_FUNC "%4.0" "Counts" COEFFS 0 1 0 0 0 1 /end COMPU_METHOD
/begin COMPU_METHOD udf_CM_16759 "Ax + B" RAT_FUNC "%4.0" "None" COEFFS 0 1 0 0 0 1 /end COMPU_METHOD
/begin COMPU_METHOD udf_CM_16766 "Ax + B" RAT_FUNC "%4.4" "degC" COEFFS 0.0 128.0 0.0 0.0 0.0 1.0 /end COMPU_METHOD
/begin COMPU_METHOD udf_CM_16773 "Ax + B" RAT_FUNC "%4.4" "percent" COEFFS 0.0 163.84 0.0 0.0 0.0 1.0 /end COMPU_METHOD
/begin COMPU_METHOD udf_CM_16780 "Ax + B" RAT_FUNC "%4.4" "rpm" COEFFS 0.0 4.0 0.0 0.0 0.0 1.0 /end COMPU_METHOD
/begin COMPU_METHOD udf_CM_16787 "Ax + B" RAT_FUNC "%4.4" "rpm" COEFFS 0.0 4.0 0.0 0.0 0.0 1.0 /end COMPU_METHOD
/begin COMPU_METHOD udf_CM_16794 "Ax + B" RAT_FUNC "%4.4" "rpm" COEFFS 0.0 4.0 0.0 0.0 0.0 1.0 /end COMPU_METHOD
/begin COMPU_METHOD udf_CM_16801 "Ax + B" RAT_FUNC "%4.4" "rpm" COEFFS 0.0 4.0 0.0 0.0 0.0 1.0 /end COMPU_METHOD
/begin COMPU_METHOD udf_CM_16808 "Ax + B" RAT_FUNC "%4.4" "percent" COEFFS 0.0 327.6800000536871 0.0 0.0 0.0 1.0 /end COMPU_METHOD
/begin COMPU_METHOD udf_CM_16815 "Ax + B" RAT_FUNC "%4.0" "boolean" COEFFS 0 1 0 0 0 1 /end COMPU_METHOD
/begin COMPU_METHOD udf_CM_16822 "Ax + B" RAT_FUNC "%4.0" "boolean" COEFFS 0 1 0 0 0 1 /end COMPU_METHOD
/begin COMPU_METHOD udf_CM_16829 "Ax + B" RAT_FUNC "%4.0" "count" COEFFS 0 1 0 0 0 1 /end COMPU_METHOD
/begin COMPU_METHOD udf_CM_16836 "Ax + B" RAT_FUNC "%4.4" "percent" COEFFS 0.0 327.6800000536871 0.0 0.0 0.0 1.0 /end COMPU_METHOD
/begin COMPU_METHOD udf_CM_16843 "Ax + B" RAT_FUNC "%4.4" "rpm" COEFFS 0.0 4.0 0.0 0.0 0.0 1.0 /end COMPU_METHOD
/begin COMPU_METHOD udf_CM_16850 "Ax + B" RAT_FUNC "%4.0" "boolean" COEFFS 0 1 0 0 0 1 /end COMPU_METHOD
/begin COMPU_METHOD udf_CM_16857 "Ax + B" RAT_FUNC "%4.0" "boolean" COEFFS 0 1 0 0 0 1 /end COMPU_METHOD
/begin COMPU_METHOD udf_CM_16864 "Ax + B" RAT_FUNC "%4.4" "percent" COEFFS 0.0 327.6800000536871 0.0 0.0 0.0 1.0 /end COMPU_METHOD
/begin COMPU_METHOD udf_CM_16871 "Ax + B" RAT_FUNC "%4.4" "percent" COEFFS 0.0 327.6800000536871 0.0 0.0 0.0 1.0 /end COMPU_METHOD
/begin COMPU_METHOD udf_CM_16885 "Ax + B" RAT_FUNC "%4.4" "percent" COEFFS 0.0 163.84 0.0 0.0 0.0 1.0 /end COMPU_METHOD
/begin COMPU_METHOD udf_CM_16892 "Ax + B" RAT_FUNC "%4.0" "boolean" COEFFS 0 1 0 0 0 1 /end COMPU_METHOD
/begin COMPU_METHOD udf_CM_16899 "Ax + B" RAT_FUNC "%4.4" "counts" COEFFS 0 1 0 0 0 1 /end COMPU_METHOD
/begin COMPU_METHOD udf_CM_16906 "Ax + B" RAT_FUNC "%4.0" "boolean" COEFFS 0 1 0 0 0 1 /end COMPU_METHOD
/begin COMPU_METHOD udf_CM_16913 "Ax + B" RAT_FUNC "%4.4" "volt" COEFFS 0.0 2048.0 0.0 0.0 0.0 1.0 /end COMPU_METHOD
/begin COMPU_METHOD udf_CM_16920 "Ax + B" RAT_FUNC "%4.1" "" COEFFS 0.0 2048.0 0.0 0.0 0.0 1.0 /end COMPU_METHOD
/begin COMPU_METHOD udf_CM_16927 "Ax + B" RAT_FUNC "%4.4" "volt" COEFFS 0.0 2048.0 0.0 0.0 0.0 1.0 /end COMPU_METHOD
/begin COMPU_METHOD udf_CM_16928 "Ax + B" RAT_FUNC "%4.4" "volt" COEFFS 0.0 64.0 0.0 0.0 0.0 1.0 /end COMPU_METHOD
/begin COMPU_METHOD udf_CM_16941 "Ax + B" RAT_FUNC "%4.0" "Counts" COEFFS 0 1 0 0 0 1 /end COMPU_METHOD
/begin COMPU_METHOD udf_CM_16962 "Ax + B" RAT_FUNC "%4.0" "None" COEFFS 0 1 0 0 0 1 /end COMPU_METHOD
/begin COMPU_METHOD udf_CM_16969 "Ax + B" RAT_FUNC "%4.0" "Counts" COEFFS 0 1 0 0 0 1 /end COMPU_METHOD
/begin COMPU_METHOD udf_CM_16976 "Ax + B" RAT_FUNC "%4.0" "None" COEFFS 0 1 0 0 0 1 /end COMPU_METHOD
/begin COMPU_METHOD udf_CM_16983 "Ax + B" RAT_FUNC "%4.0" "None" COEFFS 0 1 0 0 0 1 /end COMPU_METHOD
/begin COMPU_METHOD udf_CM_17039 "Ax + B" RAT_FUNC "%4.0" "None" COEFFS 0 1 0 0 0 1 /end COMPU_METHOD
/begin COMPU_METHOD udf_CM_17046 "Ax + B" RAT_FUNC "%4.4" "msec" COEFFS 0.0 64.0 0.0 0.0 0.0 1.0 /end COMPU_METHOD
/begin COMPU_METHOD udf_CM_17053 "Ax + B" RAT_FUNC "%4.4" "degC" COEFFS 0.0 128.0 0.0 0.0 0.0 1.0 /end COMPU_METHOD
/begin COMPU_METHOD udf_CM_17060 "Ax + B" RAT_FUNC "%4.4" "degC" COEFFS 0.0 128.0 0.0 0.0 0.0 1.0 /end COMPU_METHOD
/begin COMPU_METHOD udf_CM_17067 "Ax + B" RAT_FUNC "%4.4" "ratio" COEFFS 0.0 1024.0 0.0 0.0 0.0 1.0 /end COMPU_METHOD
/begin COMPU_METHOD udf_CM_17074 "Ax + B" RAT_FUNC "%4.0" "None" COEFFS 0 1 0 0 0 1 /end COMPU_METHOD
/begin COMPU_METHOD udf_CM_17081 "Ax + B" RAT_FUNC "%4.4" "kpa" COEFFS 0.0 256.0 0.0 0.0 0.0 1.0 /end COMPU_METHOD
/begin COMPU_METHOD udf_CM_17088 "Ax + B" RAT_FUNC "%4.4" "kpa" COEFFS 0.0 256.0 0.0 0.0 0.0 1.0 /end COMPU_METHOD
/begin COMPU_METHOD udf_CM_17095 "Ax + B" RAT_FUNC "%4.0" "None" COEFFS 0 1 0 0 0 1 /end COMPU_METHOD
/begin COMPU_METHOD udf_CM_17102 "Ax + B" RAT_FUNC "%4.0" "boolean" COEFFS 0 1 0 0 0 1 /end COMPU_METHOD
/begin COMPU_METHOD udf_CM_17109 "Ax + B" RAT_FUNC "%4.4" "kpa" COEFFS 0.0 256.0 0.0 0.0 0.0 1.0 /end COMPU_METHOD
/begin COMPU_METHOD udf_CM_17116 "Ax + B" RAT_FUNC "%4.4" "kpa" COEFFS 0.0 256.0 0.0 0.0 0.0 1.0 /end COMPU_METHOD
/begin COMPU_METHOD udf_CM_17123 "Ax + B" RAT_FUNC "%4.4" "kpa" COEFFS 0.0 256.0 0.0 0.0 0.0 1.0 /end COMPU_METHOD
/begin COMPU_METHOD udf_CM_17130 "Ax + B" RAT_FUNC "%4.4" "kpa" COEFFS 0.0 256.0 0.0 0.0 0.0 1.0 /end COMPU_METHOD
/begin COMPU_METHOD udf_CM_17137 "Ax + B" RAT_FUNC "%4.4" "kpa" COEFFS 0.0 256.0 0.0 0.0 0.0 1.0 /end COMPU_METHOD
/begin COMPU_METHOD udf_CM_17144 "Ax + B" RAT_FUNC "%4.0" "boolean" COEFFS 0 1 0 0 0 1 /end COMPU_METHOD
/begin COMPU_METHOD udf_CM_17151 "Ax + B" RAT_FUNC "%4.4" "kpa" COEFFS 0.0 256.0 0.0 0.0 0.0 1.0 /end COMPU_METHOD
/begin COMPU_METHOD udf_CM_17158 "Ax + B" RAT_FUNC "%4.0" "boolean" COEFFS 0 1 0 0 0 1 /end COMPU_METHOD
/begin COMPU_METHOD udf_CM_17165 "Ax + B" RAT_FUNC "%4.4" "kpa" COEFFS 0.0 256.0 0.0 0.0 0.0 1.0 /end COMPU_METHOD
/begin COMPU_METHOD udf_CM_17172 "Ax + B" RAT_FUNC "%4.4" "kpa" COEFFS 0.0 256.0 0.0 0.0 0.0 1.0 /end COMPU_METHOD
/begin COMPU_METHOD udf_CM_17179 "Ax + B" RAT_FUNC "%4.4" "kpa" COEFFS 0.0 256.0 0.0 0.0 0.0 1.0 /end COMPU_METHOD
/begin COMPU_METHOD udf_CM_17186 "Ax + B" RAT_FUNC "%4.4" "kpa" COEFFS 0.0 256.0 0.0 0.0 0.0 1.0 /end COMPU_METHOD
/begin COMPU_METHOD udf_CM_17193 "Ax + B" RAT_FUNC "%4.4" "angle" COEFFS 0.0 64.0 0.0 0.0 0.0 1.0 /end COMPU_METHOD
/begin COMPU_METHOD udf_CM_17200 "Ax + B" RAT_FUNC "%4.4" "angle" COEFFS 0.0 64.0 0.0 0.0 0.0 1.0 /end COMPU_METHOD
/begin COMPU_METHOD udf_CM_17207 "Ax + B" RAT_FUNC "%4.0" "boolean" COEFFS 0 1 0 0 0 1 /end COMPU_METHOD
/begin COMPU_METHOD udf_CM_17214 "Ax + B" RAT_FUNC "%4.0" "None" COEFFS 0 1 0 0 0 1 /end COMPU_METHOD
/begin COMPU_METHOD udf_CM_17221 "Ax + B" RAT_FUNC "%4.0" "Counts" COEFFS 0 1 0 0 0 1 /end COMPU_METHOD
/begin COMPU_METHOD udf_CM_17228 "Ax + B" RAT_FUNC "%4.0" "None" COEFFS 0 1 0 0 0 1 /end COMPU_METHOD
/begin COMPU_METHOD udf_CM_17235 "Ax + B" RAT_FUNC "%4.0" "boolean" COEFFS 0 1 0 0 0 1 /end COMPU_METHOD
/begin COMPU_METHOD udf_CM_17242 "Ax + B" RAT_FUNC "%4.0" "Counts" COEFFS 0 1 0 0 0 1 /end COMPU_METHOD
/begin COMPU_METHOD udf_CM_17249 "Ax + B" RAT_FUNC "%4.0" "None" COEFFS 0 1 0 0 0 1 /end COMPU_METHOD
/begin COMPU_METHOD udf_CM_17256 "Ax + B" RAT_FUNC "%4.0" "None" COEFFS 0 1 0 0 0 1 /end COMPU_METHOD
/begin COMPU_METHOD udf_CM_17263 "Ax + B" RAT_FUNC "%4.0" "Counts" COEFFS 0 1 0 0 0 1 /end COMPU_METHOD
/begin COMPU_METHOD udf_CM_17270 "Ax + B" RAT_FUNC "%4.0" "None" COEFFS 0 1 0 0 0 1 /end COMPU_METHOD
/begin COMPU_METHOD udf_CM_17277 "Ax + B" RAT_FUNC "%4.0" "Counts" COEFFS 0 1 0 0 0 1 /end COMPU_METHOD
/begin COMPU_METHOD udf_CM_17284 "Ax + B" RAT_FUNC "%4.0" "None" COEFFS 0 1 0 0 0 1 /end COMPU_METHOD
/begin COMPU_METHOD udf_CM_17291 "Ax + B" RAT_FUNC "%4.4" "kpa" COEFFS 0.0 256.0 0.0 0.0 0.0 1.0 /end COMPU_METHOD
/begin COMPU_METHOD udf_CM_17292 "Ax + B" RAT_FUNC "%4.4" "mpa" COEFFS 0.0 4096.0 0.0 0.0 0.0 1.0 /end COMPU_METHOD
/begin COMPU_METHOD udf_CM_17293 "Ax + B" RAT_FUNC "%4.4" "kpa" COEFFS 0.0 128.0 0.0 0.0 0.0 1.0 /end COMPU_METHOD
/begin COMPU_METHOD udf_CM_17294 "Ax + B" RAT_FUNC "%4.4" "amps" COEFFS 0.0 128.0 0.0 0.0 0.0 1.0 /end COMPU_METHOD
/begin COMPU_METHOD CM_Microsecond_1 "" RAT_FUNC "%6.0" "micro-seconds" COEFFS 0.0 0.125 0.0 0.0 0.0 1.0 /end COMPU_METHOD
/begin COMPU_METHOD CM_Mult_0to2 "" RAT_FUNC "%5.4" "Mul_0_to_2" COEFFS 0.0 128.0 0.0 0.0 0.0 1.0 /end COMPU_METHOD
/begin COMPU_METHOD CM_Equaloutput1 "Default N=E compu method" RAT_FUNC "%10.4" "" COEFFS 0 1 0 0 0 1 /end COMPU_METHOD
/begin COMPU_METHOD CM_Boolean6 "Default N=E compu method" RAT_FUNC "%10.4" "Boolean" COEFFS 0 1 0 0 0 1 /end COMPU_METHOD
/begin COMPU_METHOD udf_CM_17368 "Ax + B" RAT_FUNC "%4.4" "msec" COEFFS 0.0 64.0 0.0 0.0 0.0 1.0 /end COMPU_METHOD
/begin COMPU_METHOD udf_CM_17382 "Ax + B" RAT_FUNC "%4.0" "None" COEFFS 0 1 0 0 0 1 /end COMPU_METHOD
/begin COMPU_METHOD udf_CM_17389 "Ax + B" RAT_FUNC "%4.0" "Counts" COEFFS 0 1 0 0 0 1 /end COMPU_METHOD
/begin COMPU_METHOD udf_CM_17396 "Ax + B" RAT_FUNC "%4.0" "None" COEFFS 0 1 0 0 0 1 /end COMPU_METHOD
/begin COMPU_METHOD udf_CM_17403 "Ax + B" RAT_FUNC "%4.0" "None" COEFFS 0 1 0 0 0 1 /end COMPU_METHOD
/begin COMPU_METHOD udf_CM_17410 "Ax + B" RAT_FUNC "%4.0" "None" COEFFS 0 1 0 0 0 1 /end COMPU_METHOD
/begin COMPU_METHOD udf_CM_17417 "Ax + B" RAT_FUNC "%4.0" "Counts" COEFFS 0 1 0 0 0 1 /end COMPU_METHOD
/begin COMPU_METHOD udf_CM_17424 "Ax + B" RAT_FUNC "%4.0" "None" COEFFS 0 1 0 0 0 1 /end COMPU_METHOD
/begin COMPU_METHOD udf_CM_17431 "Ax + B" RAT_FUNC "%4.0" "None" COEFFS 0 1 0 0 0 1 /end COMPU_METHOD
/begin COMPU_METHOD udf_CM_17438 "Ax + B" RAT_FUNC "%4.4" "percent" COEFFS 0.0 327.6800000536871 0.0 0.0 0.0 1.0 /end COMPU_METHOD
/begin COMPU_METHOD udf_CM_17445 "Ax + B" RAT_FUNC "%4.0" "boolean" COEFFS 0 1 0 0 0 1 /end COMPU_METHOD
/begin COMPU_METHOD udf_CM_17452 "Ax + B" RAT_FUNC "%4.0" "boolean" COEFFS 0 1 0 0 0 1 /end COMPU_METHOD
/begin COMPU_METHOD udf_CM_17459 "Ax + B" RAT_FUNC "%4.4" "grams" COEFFS 0.0 8192.000033554432 0.0 0.0 0.0 1.0 /end COMPU_METHOD
/begin COMPU_METHOD udf_CM_17466 "Ax + B" RAT_FUNC "%4.4" "grams" COEFFS 0.0 8192.000033554432 0.0 0.0 0.0 1.0 /end COMPU_METHOD
/begin COMPU_METHOD udf_CM_17473 "Ax + B" RAT_FUNC "%4.4" "grams" COEFFS 0.0 8192.000033554432 0.0 0.0 0.0 1.0 /end COMPU_METHOD
/begin COMPU_METHOD udf_CM_17480 "Ax + B" RAT_FUNC "%4.0" "counts" COEFFS 0 1 0 0 0 1 /end COMPU_METHOD
/begin COMPU_METHOD udf_CM_17487 "Ax + B" RAT_FUNC "%4.0" "None" COEFFS 0 1 0 0 0 1 /end COMPU_METHOD
/begin COMPU_METHOD udf_CM_17494 "Ax + B" RAT_FUNC "%4.0" "None" COEFFS 0 1 0 0 0 1 /end COMPU_METHOD
/begin COMPU_METHOD udf_CM_17501 "Ax + B" RAT_FUNC "%4.0" "counts" COEFFS 0 1 0 0 0 1 /end COMPU_METHOD
/begin COMPU_METHOD udf_CM_17508 "Ax + B" RAT_FUNC "%4.0" "None" COEFFS 0 1 0 0 0 1 /end COMPU_METHOD
/begin COMPU_METHOD udf_CM_17515 "Ax + B" RAT_FUNC "%4.0" "counts" COEFFS 0 1 0 0 0 1 /end COMPU_METHOD
/begin COMPU_METHOD udf_CM_17522 "Ax + B" RAT_FUNC "%4.0" "None" COEFFS 0 1 0 0 0 1 /end COMPU_METHOD
/begin COMPU_METHOD udf_CM_17529 "Ax + B" RAT_FUNC "%4.0" "None" COEFFS 0 1 0 0 0 1 /end COMPU_METHOD
/begin COMPU_METHOD udf_CM_17536 "Ax + B" RAT_FUNC "%4.4" "millivolt" COEFFS 0.0 64.0 0.0 0.0 0.0 1.0 /end COMPU_METHOD
/begin COMPU_METHOD udf_CM_17543 "Ax + B" RAT_FUNC "%4.4" "millivolt" COEFFS 0.0 64.0 0.0 0.0 0.0 1.0 /end COMPU_METHOD
/begin COMPU_METHOD udf_CM_17557 "Ax + B" RAT_FUNC "%4.0" "None" COEFFS 0 1 0 0 0 1 /end COMPU_METHOD
/begin COMPU_METHOD udf_CM_17564 "Ax + B" RAT_FUNC "%4.0" "None" COEFFS 0 1 0 0 0 1 /end COMPU_METHOD
/begin COMPU_METHOD udf_CM_17592 "Ax + B" RAT_FUNC "%4.0" "" COEFFS 0 1 0 0 0 1 /end COMPU_METHOD
/begin COMPU_METHOD udf_CM_17606 "Ax + B" RAT_FUNC "%4.0" "None" COEFFS 0 1 0 0 0 1 /end COMPU_METHOD
/begin COMPU_METHOD udf_CM_17613 "Ax + B" RAT_FUNC "%4.0" "boolean" COEFFS 0 1 0 0 0 1 /end COMPU_METHOD
/begin COMPU_METHOD udf_CM_17620 "Ax + B" RAT_FUNC "%4.0" "None" COEFFS 0 1 0 0 0 1 /end COMPU_METHOD
/begin COMPU_METHOD udf_CM_17627 "Ax + B" RAT_FUNC "%4.0" "None" COEFFS 0 1 0 0 0 1 /end COMPU_METHOD
/begin COMPU_METHOD udf_CM_17634 "Ax + B" RAT_FUNC "%4.0" "None" COEFFS 0 1 0 0 0 1 /end COMPU_METHOD
/begin COMPU_METHOD udf_CM_17641 "Ax + B" RAT_FUNC "%4.4" "msec" COEFFS 0.0 64.0 0.0 0.0 0.0 1.0 /end COMPU_METHOD
/begin COMPU_METHOD udf_CM_17648 "Ax + B" RAT_FUNC "%4.4" "millivolt" COEFFS 0.0 64.0 0.0 0.0 0.0 1.0 /end COMPU_METHOD
/begin COMPU_METHOD udf_CM_17655 "Ax + B" RAT_FUNC "%4.4" "msec" COEFFS 0.0 64.0 0.0 0.0 0.0 1.0 /end COMPU_METHOD
/begin COMPU_METHOD udf_CM_17662 "Ax + B" RAT_FUNC "%4.4" "msec" COEFFS 0.0 1000.0 0.0 0.0 0.0 1.0 /end COMPU_METHOD
/begin COMPU_METHOD udf_CM_17663 "Ax + B" RAT_FUNC "%4.4" "sec" COEFFS 0.0 60.0 0.0 0.0 0.0 1.0 /end COMPU_METHOD
/begin COMPU_METHOD udf_CM_17669 "Ax + B" RAT_FUNC "%4.4" "msec" COEFFS 0.0 1000.0 0.0 0.0 0.0 1.0 /end COMPU_METHOD
/begin COMPU_METHOD udf_CM_17676 "Ax + B" RAT_FUNC "%4.0" "boolean" COEFFS 0 1 0 0 0 1 /end COMPU_METHOD
/begin COMPU_METHOD udf_CM_17683 "Ax + B" RAT_FUNC "%4.0" "None" COEFFS 0 1 0 0 0 1 /end COMPU_METHOD
/begin COMPU_METHOD udf_CM_17690 "Ax + B" RAT_FUNC "%4.0" "None" COEFFS 0 1 0 0 0 1 /end COMPU_METHOD
/begin COMPU_METHOD udf_CM_17697 "Ax + B" RAT_FUNC "%4.0" "None" COEFFS 0 1 0 0 0 1 /end COMPU_METHOD
/begin COMPU_METHOD udf_CM_17704 "Ax + B" RAT_FUNC "%4.4" "percent" COEFFS 0.0 327.6800000536871 0.0 0.0 0.0 1.0 /end COMPU_METHOD
/begin COMPU_METHOD udf_CM_17711 "Ax + B" RAT_FUNC "%4.4" "angle" COEFFS 0.0 128.0 0.0 0.0 0.0 1.0 /end COMPU_METHOD
/begin COMPU_METHOD udf_CM_17718 "Ax + B" RAT_FUNC "%4.4" "angle" COEFFS 0.0 128.0 0.0 0.0 0.0 1.0 /end COMPU_METHOD
/begin COMPU_METHOD udf_CM_17725 "Ax + B" RAT_FUNC "%4.4" "angle" COEFFS 0.0 128.0 0.0 0.0 0.0 1.0 /end COMPU_METHOD
/begin COMPU_METHOD udf_CM_17732 "Ax + B" RAT_FUNC "%4.4" "angle" COEFFS 0.0 128.0 0.0 0.0 0.0 1.0 /end COMPU_METHOD
/begin COMPU_METHOD udf_CM_17739 "Ax + B" RAT_FUNC "%4.4" "angle" COEFFS 0.0 128.0 0.0 0.0 0.0 1.0 /end COMPU_METHOD
/begin COMPU_METHOD udf_CM_17746 "Ax + B" RAT_FUNC "%4.4" "angle" COEFFS 0.0 128.0 0.0 0.0 0.0 1.0 /end COMPU_METHOD
/begin COMPU_METHOD udf_CM_17767 "Ax + B" RAT_FUNC "%4.4" "angle" COEFFS 0.0 128.0 0.0 0.0 0.0 1.0 /end COMPU_METHOD
/begin COMPU_METHOD udf_CM_17781 "Ax + B" RAT_FUNC "%4.4" "angle" COEFFS 0.0 128.0 0.0 0.0 0.0 1.0 /end COMPU_METHOD
/begin COMPU_METHOD udf_CM_17788 "Hex No Scale" RAT_FUNC "%4.4" "none" COEFFS 0 1 0 0 0 1 /end COMPU_METHOD
/begin COMPU_METHOD udf_CM_17816 "Ax + B" RAT_FUNC "%4.0" "None" COEFFS 0 1 0 0 0 1 /end COMPU_METHOD
/begin COMPU_METHOD udf_CM_17837 "Ax + B" RAT_FUNC "%4.4" "none" COEFFS 0 1 0 0 0 1 /end COMPU_METHOD
/begin COMPU_METHOD udf_CM_17921 "Ax + B" RAT_FUNC "%4.0" "boolean" COEFFS 0 1 0 0 0 1 /end COMPU_METHOD
/begin COMPU_METHOD udf_CM_17963 "Ax + B" RAT_FUNC "%4.0" "None" COEFFS 0 1 0 0 0 1 /end COMPU_METHOD
/begin COMPU_METHOD udf_CM_17991 "Ax + B" RAT_FUNC "%4.4" "msec" COEFFS 0.0 64.0 0.0 0.0 0.0 1.0 /end COMPU_METHOD
/begin COMPU_METHOD udf_CM_17998 "Ax + B" RAT_FUNC "%4.0" "None" COEFFS 0 1 0 0 0 1 /end COMPU_METHOD
/begin COMPU_METHOD udf_CM_18005 "Ax + B" RAT_FUNC "%4.4" "percent" COEFFS 0.0 655.3600001073743 0.0 0.0 0.0 1.0 /end COMPU_METHOD
/begin COMPU_METHOD udf_CM_18012 "Ax + B" RAT_FUNC "%4.0" "count" COEFFS 0 1 0 0 0 1 /end COMPU_METHOD
/begin COMPU_METHOD udf_CM_18019 "Ax + B" RAT_FUNC "%4.0" "None" COEFFS 0 1 0 0 0 1 /end COMPU_METHOD
/begin COMPU_METHOD udf_CM_18026 "Ax + B" RAT_FUNC "%4.0" "Counts" COEFFS 0 1 0 0 0 1 /end COMPU_METHOD
/begin COMPU_METHOD udf_CM_18033 "Ax + B" RAT_FUNC "%4.0" "None" COEFFS 0 1 0 0 0 1 /end COMPU_METHOD
/begin COMPU_METHOD udf_CM_18040 "Ax + B" RAT_FUNC "%4.0" "None" COEFFS 0 1 0 0 0 1 /end COMPU_METHOD
/begin COMPU_METHOD udf_CM_18047 "Ax + B" RAT_FUNC "%4.0" "None" COEFFS 0 1 0 0 0 1 /end COMPU_METHOD
/begin COMPU_METHOD udf_CM_18054 "Ax + B" RAT_FUNC "%4.0" "Counts" COEFFS 0 1 0 0 0 1 /end COMPU_METHOD
/begin COMPU_METHOD udf_CM_18061 "Ax + B" RAT_FUNC "%4.0" "None" COEFFS 0 1 0 0 0 1 /end COMPU_METHOD
/begin COMPU_METHOD udf_CM_18068 "Ax + B" RAT_FUNC "%4.0" "None" COEFFS 0 1 0 0 0 1 /end COMPU_METHOD
/begin COMPU_METHOD udf_CM_18075 "Ax + B" RAT_FUNC "%4.0" "None" COEFFS 0 1 0 0 0 1 /end COMPU_METHOD
/begin COMPU_METHOD udf_CM_18082 "Ax + B" RAT_FUNC "%4.0" "Counts" COEFFS 0 1 0 0 0 1 /end COMPU_METHOD
/begin COMPU_METHOD udf_CM_18089 "Ax + B" RAT_FUNC "%4.0" "None" COEFFS 0 1 0 0 0 1 /end COMPU_METHOD
/begin COMPU_METHOD udf_CM_18096 "Ax + B" RAT_FUNC "%4.0" "None" COEFFS 0 1 0 0 0 1 /end COMPU_METHOD
/begin COMPU_METHOD udf_CM_18103 "Ax + B" RAT_FUNC "%4.0" "None" COEFFS 0 1 0 0 0 1 /end COMPU_METHOD
/begin COMPU_METHOD udf_CM_18110 "Ax + B" RAT_FUNC "%4.0" "Counts" COEFFS 0 1 0 0 0 1 /end COMPU_METHOD
/begin COMPU_METHOD udf_CM_18117 "Ax + B" RAT_FUNC "%4.0" "None" COEFFS 0 1 0 0 0 1 /end COMPU_METHOD
/begin COMPU_METHOD udf_CM_18124 "Ax + B" RAT_FUNC "%4.0" "None" COEFFS 0 1 0 0 0 1 /end COMPU_METHOD
/begin COMPU_METHOD udf_CM_18131 "Ax + B" RAT_FUNC "%4.0" "None" COEFFS 0 1 0 0 0 1 /end COMPU_METHOD
/begin COMPU_METHOD udf_CM_18138 "Ax + B" RAT_FUNC "%4.0" "None" COEFFS 0 1 0 0 0 1 /end COMPU_METHOD
/begin COMPU_METHOD udf_CM_18159 "Ax + B" RAT_FUNC "%4.0" "counts" COEFFS 0 1 0 0 0 1 /end COMPU_METHOD
/begin COMPU_METHOD udf_CM_18166 "Ax + B" RAT_FUNC "%4.0" "counts" COEFFS 0 1 0 0 0 1 /end COMPU_METHOD
/begin COMPU_METHOD udf_CM_18173 "Ax + B" RAT_FUNC "%4.0" "counts" COEFFS 0 1 0 0 0 1 /end COMPU_METHOD
/begin COMPU_METHOD udf_CM_18180 "Ax + B" RAT_FUNC "%4.4" "percent" COEFFS 0.0 327.6800000536871 0.0 0.0 0.0 1.0 /end COMPU_METHOD
/begin COMPU_METHOD udf_CM_18187 "Ax + B" RAT_FUNC "%4.0" "None" COEFFS 0 1 0 0 0 1 /end COMPU_METHOD
/begin COMPU_METHOD udf_CM_18194 "Ax + B" RAT_FUNC "%4.0" "Counts" COEFFS 0 1 0 0 0 1 /end COMPU_METHOD
/begin COMPU_METHOD udf_CM_18201 "Ax + B" RAT_FUNC "%4.0" "None" COEFFS 0 1 0 0 0 1 /end COMPU_METHOD
/begin COMPU_METHOD udf_CM_18208 "Ax + B" RAT_FUNC "%4.0" "Counts" COEFFS 0 1 0 0 0 1 /end COMPU_METHOD
/begin COMPU_METHOD udf_CM_18215 "Ax + B" RAT_FUNC "%4.0" "None" COEFFS 0 1 0 0 0 1 /end COMPU_METHOD
/begin COMPU_METHOD udf_CM_18222 "Ax + B" RAT_FUNC "%4.0" "None" COEFFS 0 1 0 0 0 1 /end COMPU_METHOD
/begin COMPU_METHOD udf_CM_18229 "Ax + B" RAT_FUNC "%4.4" "percent" COEFFS 0.0 327.6800000536871 0.0 0.0 0.0 1.0 /end COMPU_METHOD
/begin COMPU_METHOD udf_CM_18236 "Ax + B" RAT_FUNC "%4.4" "percent" COEFFS 0.0 327.6800000536871 0.0 0.0 0.0 1.0 /end COMPU_METHOD
/begin COMPU_METHOD udf_CM_18250 "Ax + B" RAT_FUNC "%4.0" "None" COEFFS 0 1 0 0 0 1 /end COMPU_METHOD
/begin COMPU_METHOD udf_CM_18257 "Ax + B" RAT_FUNC "%4.0" "Counts" COEFFS 0 1 0 0 0 1 /end COMPU_METHOD
/begin COMPU_METHOD udf_CM_18264 "Ax + B" RAT_FUNC "%4.0" "None" COEFFS 0 1 0 0 0 1 /end COMPU_METHOD
/begin COMPU_METHOD udf_CM_18271 "Ax + B" RAT_FUNC "%4.0" "None" COEFFS 0 1 0 0 0 1 /end COMPU_METHOD
/begin COMPU_METHOD udf_CM_18278 "Ax + B" RAT_FUNC "%4.0" "Counts" COEFFS 0 1 0 0 0 1 /end COMPU_METHOD
/begin COMPU_METHOD udf_CM_18285 "Ax + B" RAT_FUNC "%4.0" "None" COEFFS 0 1 0 0 0 1 /end COMPU_METHOD
/begin COMPU_METHOD udf_CM_18292 "Ax + B" RAT_FUNC "%4.0" "None" COEFFS 0 1 0 0 0 1 /end COMPU_METHOD
/begin COMPU_METHOD udf_CM_18299 "Ax + B" RAT_FUNC "%4.0" "Couints" COEFFS 0 1 0 0 0 1 /end COMPU_METHOD
/begin COMPU_METHOD CM_EnumFaultType "" RAT_FUNC "%1.0" "enum" COEFFS 0 1 0 0 0 1 /end COMPU_METHOD
/begin COMPU_METHOD CM_FiltCoef "" RAT_FUNC "%7.6" "coef" COEFFS 0.0 65536.00026843546 0.0 0.0 0.0 1.0 /end COMPU_METHOD
/begin COMPU_METHOD udf_CM_18376 "" RAT_FUNC "%7.5" "ratio" COEFFS 0.0 4096.0 0.0 0.0 0.0 1.0 /end COMPU_METHOD
/begin COMPU_METHOD CM_Seconds "" RAT_FUNC "%4.1" "seconds" COEFFS 0.0 2.0 0.0 0.0 0.0 1.0 /end COMPU_METHOD
/begin COMPU_METHOD CM_mVolt_2 "" RAT_FUNC "%7.3" "mvolt" COEFFS 0.0 64.0 0.0 0.0 0.0 1.0 /end COMPU_METHOD
/begin COMPU_METHOD CM_DegC_N256to256 "" RAT_FUNC "%7.4" "degC" COEFFS 0.0 128.0 0.0 0.0 0.0 1.0 /end COMPU_METHOD
/begin COMPU_METHOD CM_Percent_0to100_1 "" RAT_FUNC "%6.4" "percent" COEFFS 0.0 655.3603892316423 0.0 0.0 0.0 1.0 /end COMPU_METHOD
/begin COMPU_METHOD CM_Percent_0to200_2 "" RAT_FUNC "%7.4" "percent" COEFFS 0.0 327.6800872415464 0.0 0.0 0.0 1.0 /end COMPU_METHOD
/begin COMPU_METHOD CM_Ratio_0to4 "" RAT_FUNC "%6.5" "ratio" COEFFS 0.0 16384.00006710886 0.0 0.0 0.0 1.0 /end COMPU_METHOD
/begin COMPU_METHOD CM_Ratio_n512to512 "" RAT_FUNC "%7.4" "kpa" COEFFS 0.0 64.0 0.0 0.0 0.0 1.0 /end COMPU_METHOD
/begin COMPU_METHOD CM_Second_0to64 "" RAT_FUNC "%4.2" "milliseconds" COEFFS 0.0 4.0 0.0 0.0 0.0 1.0 /end COMPU_METHOD
/begin COMPU_METHOD CM_CrankAngle_0to1024_1 "" RAT_FUNC "%7.3" "" COEFFS 0.0 64.0 0.0 0.0 0.0 1.0 /end COMPU_METHOD
/begin COMPU_METHOD CM_Volt_0to32_1 "" RAT_FUNC "%6.4" "volt" COEFFS 0.0 2048.001048576537 0.0 0.0 0.0 1.0 /end COMPU_METHOD
/begin COMPU_METHOD udf_CM_18677 "Ax + B" RAT_FUNC "%4.4" "Gram" COEFFS 0.0 128.0 0.0 0.0 0.0 1.0 /end COMPU_METHOD
/begin COMPU_METHOD udf_CM_18684 "Ax + B" RAT_FUNC "%4.4" "Gram" COEFFS 0.0 128.0 0.0 0.0 0.0 1.0 /end COMPU_METHOD
/begin COMPU_METHOD CM_CrankAngle_0to512 "" RAT_FUNC "%7.4" "degrees" COEFFS 0.0 128.0 0.0 0.0 0.0 1.0 /end COMPU_METHOD
/begin COMPU_METHOD udf_CM_18726 "Ax + B" RAT_FUNC "%4.4" "percent" COEFFS 0.0 327.6800000536871 0.0 0.0 0.0 1.0 /end COMPU_METHOD
/begin COMPU_METHOD udf_CM_18733 "Ax + B" RAT_FUNC "%4.4" "percent" COEFFS 0.0 327.6800000536871 0.0 0.0 0.0 1.0 /end COMPU_METHOD
/begin COMPU_METHOD udf_CM_18740 "Ax + B" RAT_FUNC "%4.0" "boolean" COEFFS 0 1 0 0 0 1 /end COMPU_METHOD
/begin COMPU_METHOD udf_CM_18747 "Ax + B" RAT_FUNC "%4.4" "percent" COEFFS 0.0 163.84 0.0 0.0 0.0 1.0 /end COMPU_METHOD
/begin COMPU_METHOD udf_CM_18754 "Ax + B" RAT_FUNC "%4.4" "percent" COEFFS 0.0 163.84 0.0 0.0 0.0 1.0 /end COMPU_METHOD
/begin COMPU_METHOD udf_CM_18761 "Ax + B" RAT_FUNC "%4.4" "percent" COEFFS 0.0 163.84 0.0 0.0 0.0 1.0 /end COMPU_METHOD
/begin COMPU_METHOD udf_CM_18768 "Ax + B" RAT_FUNC "%4.4" "percent" COEFFS 0.0 327.6800000536871 0.0 0.0 0.0 1.0 /end COMPU_METHOD
/begin COMPU_METHOD udf_CM_18775 "Ax + B" RAT_FUNC "%4.4" "percent" COEFFS 0.0 327.6800000536871 0.0 0.0 0.0 1.0 /end COMPU_METHOD
/begin COMPU_METHOD udf_CM_18782 "Ax + B" RAT_FUNC "%4.4" "percent" COEFFS 0.0 327.6800000536871 0.0 0.0 0.0 1.0 /end COMPU_METHOD
/begin COMPU_METHOD udf_CM_18789 "Ax + B" RAT_FUNC "%4.4" "percent" COEFFS 0.0 327.6800000536871 0.0 0.0 0.0 1.0 /end COMPU_METHOD
/begin COMPU_METHOD udf_CM_18796 "Ax + B" RAT_FUNC "%4.0" "boolean" COEFFS 0 1 0 0 0 1 /end COMPU_METHOD
/begin COMPU_METHOD udf_CM_18803 "Ax + B" RAT_FUNC "%4.0" "none" COEFFS 0 1 0 0 0 1 /end COMPU_METHOD
/begin COMPU_METHOD udf_CM_18810 "Ax + B" RAT_FUNC "%4.4" "percent" COEFFS 0.0 327.6800000536871 0.0 0.0 0.0 1.0 /end COMPU_METHOD
/begin COMPU_METHOD udf_CM_18817 "Ax + B" RAT_FUNC "%4.0" "boolean" COEFFS 0 1 0 0 0 1 /end COMPU_METHOD
/begin COMPU_METHOD udf_CM_18824 "Ax + B" RAT_FUNC "%4.0" "counts" COEFFS 0 1 0 0 0 1 /end COMPU_METHOD
/begin COMPU_METHOD udf_CM_18831 "Ax + B" RAT_FUNC "%4.4" "percent" COEFFS 0.0 327.6800000536871 0.0 0.0 0.0 1.0 /end COMPU_METHOD
/begin COMPU_METHOD udf_CM_18838 "Ax + B" RAT_FUNC "%4.0" "None" COEFFS 0 1 0 0 0 1 /end COMPU_METHOD
/begin COMPU_METHOD udf_CM_18845 "Ax + B" RAT_FUNC "%4.0" "Counts" COEFFS 0 1 0 0 0 1 /end COMPU_METHOD
/begin COMPU_METHOD udf_CM_18852 "Ax + B" RAT_FUNC "%4.0" "None" COEFFS 0 1 0 0 0 1 /end COMPU_METHOD
/begin COMPU_METHOD udf_CM_18859 "Ax + B" RAT_FUNC "%4.0" "None" COEFFS 0 1 0 0 0 1 /end COMPU_METHOD
/begin COMPU_METHOD udf_CM_18866 "Ax + B" RAT_FUNC "%4.0" "Counts" COEFFS 0 1 0 0 0 1 /end COMPU_METHOD
/begin COMPU_METHOD udf_CM_18873 "Ax + B" RAT_FUNC "%4.0" "None" COEFFS 0 1 0 0 0 1 /end COMPU_METHOD
/begin COMPU_METHOD udf_CM_18880 "Ax + B" RAT_FUNC "%4.0" "Counts" COEFFS 0 1 0 0 0 1 /end COMPU_METHOD
/begin COMPU_METHOD udf_CM_18887 "Ax + B" RAT_FUNC "%4.0" "None" COEFFS 0 1 0 0 0 1 /end COMPU_METHOD
/begin COMPU_METHOD udf_CM_18894 "Ax + B" RAT_FUNC "%4.0" "None" COEFFS 0 1 0 0 0 1 /end COMPU_METHOD
/begin COMPU_METHOD udf_CM_18901 "Ax + B" RAT_FUNC "%4.4" "percent" COEFFS 0.0 327.6800000536871 0.0 0.0 0.0 1.0 /end COMPU_METHOD
/begin COMPU_METHOD udf_CM_18908 "Ax + B" RAT_FUNC "%4.4" "gm" COEFFS 0.0 4096.0 0.0 0.0 0.0 1.0 /end COMPU_METHOD
/begin COMPU_METHOD CM_Count_0to65535_1 "" RAT_FUNC "%5.0" "counts" COEFFS 0 1 0 0 0 1 /end COMPU_METHOD
/begin COMPU_METHOD CM_Count_0to65535_2 "" RAT_FUNC "%5.0" "None" COEFFS 0 1 0 0 0 1 /end COMPU_METHOD
/begin COMPU_METHOD CM_Second_0to65535 "" RAT_FUNC "%5.0" "sec" COEFFS 0 1 0 0 0 1 /end COMPU_METHOD
/begin COMPU_METHOD udf_CM_19006 "" RAT_FUNC "%4.3" "second" COEFFS 0.0 32.0 0.0 0.0 0.0 1.0 /end COMPU_METHOD
/begin COMPU_METHOD udf_CM_19020 "Ax + B" RAT_FUNC "%4.4" "kpa" COEFFS 0.0 256.0 0.0 0.0 0.0 1.0 /end COMPU_METHOD
/begin COMPU_METHOD udf_CM_19027 "Ax + B" RAT_FUNC "%4.4" "kpa" COEFFS 0.0 256.0 0.0 0.0 0.0 1.0 /end COMPU_METHOD
/begin COMPU_METHOD udf_CM_19048 "Ax + B" RAT_FUNC "%4.4" "ratio" COEFFS 0.0 32768.00013421773 0.0 0.0 0.0 1.0 /end COMPU_METHOD
/begin COMPU_METHOD udf_CM_19174 "Ax + B" RAT_FUNC "%4.4" "msec" COEFFS 0.0 16.0 0.0 0.0 0.0 1.0 /end COMPU_METHOD
/begin COMPU_METHOD udf_CM_19230 "Ax + B" RAT_FUNC "%4.0" "boolean" COEFFS 0 1 0 0 0 1 /end COMPU_METHOD
/begin COMPU_METHOD udf_CM_19244 "Ax + B" RAT_FUNC "%4.0" "None" COEFFS 0 1 0 0 0 1 /end COMPU_METHOD
/begin COMPU_METHOD udf_CM_19335 "Ax + B" RAT_FUNC "%4.0" "boolean" COEFFS 0 1 0 0 0 1 /end COMPU_METHOD
/begin COMPU_METHOD udf_CM_19370 "Ax + B" RAT_FUNC "%4.0" "count" COEFFS 0 1 0 0 0 1 /end COMPU_METHOD
/begin COMPU_METHOD udf_CM_19377 "Ax + B" RAT_FUNC "%4.0" "Counts" COEFFS 0 1 0 0 0 1 /end COMPU_METHOD
/begin COMPU_METHOD udf_CM_19384 "Ax + B" RAT_FUNC "%4.0" "None" COEFFS 0 1 0 0 0 1 /end COMPU_METHOD
/begin COMPU_METHOD udf_CM_19398 "Ax + B" RAT_FUNC "%4.4" "percent" COEFFS 0.0 327.6800000536871 0.0 0.0 0.0 1.0 /end COMPU_METHOD
/begin COMPU_METHOD udf_CM_19412 "Ax + B" RAT_FUNC "%4.0" "None" COEFFS 0 1 0 0 0 1 /end COMPU_METHOD
/begin COMPU_METHOD udf_CM_19503 "Ax + B" RAT_FUNC "%4.4" "kpa" COEFFS 0.0 256.0 0.0 0.0 0.0 1.0 /end COMPU_METHOD
/begin COMPU_VTAB CM_EOI_TAB "" TAB_VERB 4 0 "Cyl1" 1 "Cyl2" 2 "Cyl3" 3 "Cyl4" /end COMPU_VTAB
/begin COMPU_VTAB CM_LIGHT_TYPE_TAB "" TAB_VERB 5 0 "NONE" 1 "MIL" 2 "STOP" 3 "WARNING" 4 "PROTECT" /end COMPU_VTAB
/begin COMPU_TAB DFLT_LIN_TAB "" TAB_INTP 1 1 1.0 /end COMPU_TAB
/begin COMPU_VTAB udf_CV_19704 "" TAB_VERB 2 0 "OFF" 1 "ON" /end COMPU_VTAB
/begin COMPU_VTAB udf_CV_19710 "" TAB_VERB 7 0 "0_EngineOff" 1 "1_KeyOn" 2 "2_Cranking" 3 "3_Run" 4 "4_Stall" 5 "5_ShutDownDelay" 6 "6_ShutDown" /end COMPU_VTAB
/begin COMPU_VTAB udf_CV_19711 "" TAB_VERB 3 0 "0_Petrol" 1 "1_NG" 2 "2_LPG" /end COMPU_VTAB
/begin COMPU_VTAB udf_CV_19716 "" TAB_VERB 2 0 "LEAN" 1 "RICH" /end COMPU_VTAB
/begin COMPU_VTAB udf_CV_19722 "" TAB_VERB 2 0 "LEAN" 1 "RICH" /end COMPU_VTAB
/begin COMPU_VTAB udf_CV_19728 "" TAB_VERB 2 0 "LEAN" 1 "RICH" /end COMPU_VTAB
/begin COMPU_VTAB udf_CV_19734 "" TAB_VERB 4 0 "NotMovingSt" 1 "ThrottleCloseSt" 2 "PauseSt" 3 "ThrottleOpenSt" /end COMPU_VTAB
/begin COMPU_VTAB udf_CV_19740 "" TAB_VERB 3 0 "ThrottleStable" 1 "ThrottleOpen" 2 "ThrottleClose" /end COMPU_VTAB
/begin RECORD_LAYOUT 2D_Array_UB FNC_VALUES 1 UBYTE COLUMN_DIR DIRECT ALIGNMENT_WORD 1 ALIGNMENT_LONG 2 /end RECORD_LAYOUT
/begin RECORD_LAYOUT 2D_Array_UW FNC_VALUES 1 UWORD COLUMN_DIR DIRECT ALIGNMENT_WORD 1 ALIGNMENT_LONG 2 /end RECORD_LAYOUT
/begin RECORD_LAYOUT Scalar_SW FNC_VALUES 1 SWORD COLUMN_DIR DIRECT ALIGNMENT_WORD 1 ALIGNMENT_LONG 2 /end RECORD_LAYOUT
/begin RECORD_LAYOUT Scalar_UB FNC_VALUES 1 UBYTE COLUMN_DIR DIRECT ALIGNMENT_WORD 1 ALIGNMENT_LONG 2 /end RECORD_LAYOUT
/begin RECORD_LAYOUT Scalar_UW FNC_VALUES 1 UWORD COLUMN_DIR DIRECT ALIGNMENT_WORD 1 ALIGNMENT_LONG 2 /end RECORD_LAYOUT
/end MODULE
/end PROJECT
