ASAP2_VERSION 1 40
/begin PROJECT RS19_Prod ""
/begin HEADER "" VERSION "" /end HEADER
/begin MODULE RS19_Prod ""
/begin MOD_COMMON "" BYTE_ORDER MSB_FIRST ALIGNMENT_BYTE 1 ALIGNMENT_WORD 1 ALIGNMENT_LONG 2 ALIGNMENT_FLOAT32_IEEE 4 ALIGNMENT_FLOAT64_IEEE 8 /end MOD_COMMON
/begin CHARACTERISTIC CT_PrimePulseBaroMult "cal comments" CURVE 0x92E2 2D_Array_UB 0.0 CM_Mult0_to_2_ratio 0.0 1.9921875
 /begin AXIS_DESCR FIX_AXIS NO_INPUT_QUANTITY CM_Equaloutput1 6 55.0 105.0 MAX_GRAD 0.0 /begin FIX_AXIS_PAR_LIST 55 65 75 85 95 105 /end FIX_AXIS_PAR_LIST /end AXIS_DESCR
/end CHARACTERISTIC
/begin CHARACTERISTIC CT_PrimePulseFPMultGas "cal comments" CURVE 0x92EA 2D_Array_UB 0.0 CM_Mult0_to_2_ratio 0.0 1.9921875
 /begin AXIS_DESCR COM_AXIS NO_INPUT_QUANTITY CM_kpa_n256to256_1 8 -256 255.9921875 AXIS_PTS_REF CA_MAP8Step1 MAX_GRAD 0.0 /end AXIS_DESCR
/end CHARACTERISTIC
/begin CHARACTERISTIC CT_PrimePulseDelay "cal comments" CURVE 0x92AA 2D_Array_UB 0.0 CM_Mult0_to_2_second 0.0 1.9921875
 /begin AXIS_DESCR FIX_AXIS NO_INPUT_QUANTITY CM_Equaloutput1 17 -28.0 164.0 MAX_GRAD 0.0 /begin FIX_AXIS_PAR_LIST -28 -16 -4 8 20 32 44 56 68 80 92 104 116 128 140 152 164 /end FIX_AXIS_PAR_LIST /end AXIS_DESCR
/end CHARACTERISTIC
/begin CHARACTERISTIC CT_PrimePulseWidth "cal comments" CURVE 0x9632 2D_Array_UW 0.0 CM_msec_0to1024 0.0 1023.984375
 /begin AXIS_DESCR FIX_AXIS NO_INPUT_QUANTITY CM_Equaloutput1 17 -28.0 164.0 MAX_GRAD 0.0 /begin FIX_AXIS_PAR_LIST -28 -16 -4 8 20 32 44 56 68 80 92 104 116 128 140 152 164 /end FIX_AXIS_PAR_LIST /end AXIS_DESCR
/end CHARACTERISTIC
/begin CHARACTERISTIC CT_PrimePulseWidth_NG "cal comments" CURVE 0x9656 2D_Array_UW 0.0 CM_msec_0to1024 0.0 1023.984375
 /begin AXIS_DESCR FIX_AXIS NO_INPUT_QUANTITY CM_Equaloutput1 17 -28.0 164.0 MAX_GRAD 0.0 /begin FIX_AXIS_PAR_LIST -28 -16 -4 8 20 32 44 56 68 80 92 104 116 128 140 152 164 /end FIX_AXIS_PAR_LIST /end AXIS_DESCR
/end CHARACTERISTIC
/begin CHARACTERISTIC CT_PrimePulseWidth_LPG "cal comments" CURVE 0x967A 2D_Array_UW 0.0 CM_msec_0to1024 0.0 1023.984375
 /begin AXIS_DESCR FIX_AXIS NO_INPUT_QUANTITY CM_Equaloutput1 17 -28.0 164.0 MAX_GRAD 0.0 /begin FIX_AXIS_PAR_LIST -28 -16 -4 8 20 32 44 56 68 80 92 104 116 128 140 152 164 /end FIX_AXIS_PAR_LIST /end AXIS_DESCR
/end CHARACTERISTIC
/begin CHARACTERISTIC CT_RunTimeThreshToEnbNextPrimePulse "cal comments" CURVE 0x92BE 2D_Array_UW 0.0 CM_Second_0to512 0.0 511.9921875
 /begin AXIS_DESCR FIX_AXIS NO_INPUT_QUANTITY CM_Equaloutput1 17 -28.0 164.0 MAX_GRAD 0.0 /begin FIX_AXIS_PAR_LIST -28 -16 -4 8 20 32 44 56 68 80 92 104 116 128 140 152 164 /end FIX_AXIS_PAR_LIST /end AXIS_DESCR
/end CHARACTERISTIC
/begin CHARACTERISTIC CT_SACoolTempOfst "cal comments" MAP 0xA238 D_Array_SB 0.0 CM_Angle_8bit -64.0 63.5
 /begin AXIS_DESCR FIX_AXIS NO_INPUT_QUANTITY CM_Equaloutput1 17 -28.0 164.0 MAX_GRAD 0.0 /begin FIX_AXIS_PAR_LIST -28 -16 -4 8 20 32 44 56 68 80 92 104 116 128 140 152 164 /end FIX_AXIS_PAR_LIST /end AXIS_DESCR
 /begin AXIS_DESCR FIX_AXIS NO_INPUT_QUANTITY CM_Equaloutput1 9 15.0 115.0 MAX_GRAD 0.0 /begin FIX_AXIS_PAR_LIST 15 27.5 40 52.5 65 77.5 90 102.5 115 /end FIX_AXIS_PAR_LIST /end AXIS_DESCR
/end CHARACTERISTIC
/begin CHARACTERISTIC CT_SACrankBaroOffset "cal comments" CURVE 0xAAD3 2D_Array_SB 0.0 CM_Angle_8bit -64.0 63.5
 /begin AXIS_DESCR FIX_AXIS NO_INPUT_QUANTITY CM_Equaloutput1 11 55.0 105.0 MAX_GRAD 0.0 /begin FIX_AXIS_PAR_LIST 55 60 65 70 75 80 85 90 95 100 105 /end FIX_AXIS_PAR_LIST /end AXIS_DESCR
/end CHARACTERISTIC
/begin CHARACTERISTIC CT_SACrankMain "cal comments" CURVE 0xAAAD 2D_Array_SB 0.0 CM_Angle_8bit -64.0 63.5
 /begin AXIS_DESCR FIX_AXIS NO_INPUT_QUANTITY CM_Equaloutput1 17 -28.0 164.0 MAX_GRAD 0.0 /begin FIX_AXIS_PAR_LIST -28 -16 -4 8 20 32 44 56 68 80 92 104 116 128 140 152 164 /end FIX_AXIS_PAR_LIST /end AXIS_DESCR
/end CHARACTERISTIC
/begin CHARACTERISTIC CT_SAIntakeAirTempOfst "cal comments" MAP 0xA19C D_Array_SB 0.0 CM_Angle_8bit -64.0 63.5
 /begin AXIS_DESCR FIX_AXIS NO_INPUT_QUANTITY CM_Equaloutput1 17 -28.0 164.0 MAX_GRAD 0.0 /begin FIX_AXIS_PAR_LIST -28 -16 -4 8 20 32 44 56 68 80 92 104 116 128 140 152 164 /end FIX_AXIS_PAR_LIST /end AXIS_DESCR
 /begin AXIS_DESCR FIX_AXIS NO_INPUT_QUANTITY CM_Equaloutput1 9 15.0 115.0 MAX_GRAD 0.0 /begin FIX_AXIS_PAR_LIST 15 27.5 40 52.5 65 77.5 90 102.5 115 /end FIX_AXIS_PAR_LIST /end AXIS_DESCR
/end CHARACTERISTIC
/begin CHARACTERISTIC CT_SparkAdvance "cal comments" MAP 0x3 D_Array_SB 0.0 CM_Angle_8bit -64.0 63.5
 /begin AXIS_DESCR COM_AXIS NO_INPUT_QUANTITY CM_kpa_0to512_1 18 0.0 511.9921875 AXIS_PTS_REF CA_MAP18Step1 MAX_GRAD 0.0 /end AXIS_DESCR
 /begin AXIS_DESCR COM_AXIS NO_INPUT_QUANTITY CM_RPM_0to16384 10 0.0 16383.75 AXIS_PTS_REF CA_EngSpd10Step1 MAX_GRAD 0.0 /end AXIS_DESCR
/end CHARACTERISTIC
/begin CHARACTERISTIC CT_SparkAdvance_NG "cal comments" MAP 0x3 D_Array_SB 0.0 CM_Angle_8bit -64.0 63.5
 /begin AXIS_DESCR COM_AXIS NO_INPUT_QUANTITY CM_kpa_0to512_1 18 0.0 511.9921875 AXIS_PTS_REF CA_MAP18Step1 MAX_GRAD 0.0 /end AXIS_DESCR
 /begin AXIS_DESCR COM_AXIS NO_INPUT_QUANTITY CM_RPM_0to16384 10 0.0 16383.75 AXIS_PTS_REF CA_EngSpd10Step1 MAX_GRAD 0.0 /end AXIS_DESCR
/end CHARACTERISTIC
/begin CHARACTERISTIC CT_SparkAdvance_LPG "cal comments" MAP 0x3 D_Array_SB 0.0 CM_Angle_8bit -64.0 63.5
 /begin AXIS_DESCR COM_AXIS NO_INPUT_QUANTITY CM_kpa_0to512_1 18 0.0 511.9921875 AXIS_PTS_REF CA_MAP18Step1 MAX_GRAD 0.0 /end AXIS_DESCR
 /begin AXIS_DESCR COM_AXIS NO_INPUT_QUANTITY CM_RPM_0to16384 10 0.0 16383.75 AXIS_PTS_REF CA_EngSpd10Step1 MAX_GRAD 0.0 /end AXIS_DESCR
/end CHARACTERISTIC
/begin CHARACTERISTIC CT_SparkAdvanceCyl2Offset "cal comments" MAP 0x3 D_Array_SB 0.0 CM_Angle_8bit -64.0 63.5
 /begin AXIS_DESCR COM_AXIS NO_INPUT_QUANTITY CM_kpa_0to512_1 18 0.0 511.9921875 AXIS_PTS_REF CA_MAP18Step1 MAX_GRAD 0.0 /end AXIS_DESCR
 /begin AXIS_DESCR COM_AXIS NO_INPUT_QUANTITY CM_RPM_0to16384 10 0.0 16383.75 AXIS_PTS_REF CA_EngSpd10Step1 MAX_GRAD 0.0 /end AXIS_DESCR
/end CHARACTERISTIC
/begin CHARACTERISTIC CT_SparkAdvanceCyl3Offset "cal comments" MAP 0x3 D_Array_SB 0.0 CM_Angle_8bit -64.0 63.5
 /begin AXIS_DESCR COM_AXIS NO_INPUT_QUANTITY CM_kpa_0to512_1 18 0.0 511.9921875 AXIS_PTS_REF CA_MAP18Step1 MAX_GRAD 0.0 /end AXIS_DESCR
 /begin AXIS_DESCR COM_AXIS NO_INPUT_QUANTITY CM_RPM_0to16384 10 0.0 16383.75 AXIS_PTS_REF CA_EngSpd10Step1 MAX_GRAD 0.0 /end AXIS_DESCR
/end CHARACTERISTIC
/begin CHARACTERISTIC CT_SparkAdvanceCyl4Offset "cal comments" MAP 0x3 D_Array_SB 0.0 CM_Angle_8bit -64.0 63.5
 /begin AXIS_DESCR COM_AXIS NO_INPUT_QUANTITY CM_kpa_0to512_1 18 0.0 511.9921875 AXIS_PTS_REF CA_MAP18Step1 MAX_GRAD 0.0 /end AXIS_DESCR
 /begin AXIS_DESCR COM_AXIS NO_INPUT_QUANTITY CM_RPM_0to16384 10 0.0 16383.75 AXIS_PTS_REF CA_EngSpd10Step1 MAX_GRAD 0.0 /end AXIS_DESCR
/end CHARACTERISTIC
/begin CHARACTERISTIC CT_SparkBaroOffset1 "cal comments" MAP 0x3 D_Array_SB 0.0 CM_Angle_8bit -64.0 63.5
 /begin AXIS_DESCR COM_AXIS NO_INPUT_QUANTITY CM_kpa_0to512_1 18 0.0 511.9921875 AXIS_PTS_REF CA_MAP18Step1 MAX_GRAD 0.0 /end AXIS_DESCR
 /begin AXIS_DESCR COM_AXIS NO_INPUT_QUANTITY CM_RPM_0to16384 10 0.0 16383.75 AXIS_PTS_REF CA_EngSpd10Step1 MAX_GRAD 0.0 /end AXIS_DESCR
/end CHARACTERISTIC
/begin CHARACTERISTIC CT_SparkBaroOffset2 "cal comments" MAP 0x3 D_Array_SB 0.0 CM_Angle_8bit -64.0 63.5
 /begin AXIS_DESCR COM_AXIS NO_INPUT_QUANTITY CM_kpa_0to512_1 18 0.0 511.9921875 AXIS_PTS_REF CA_MAP18Step1 MAX_GRAD 0.0 /end AXIS_DESCR
 /begin AXIS_DESCR COM_AXIS NO_INPUT_QUANTITY CM_RPM_0to16384 10 0.0 16383.75 AXIS_PTS_REF CA_EngSpd10Step1 MAX_GRAD 0.0 /end AXIS_DESCR
/end CHARACTERISTIC
/begin CHARACTERISTIC CT_SparkBaroOffset3 "cal comments" MAP 0x3 D_Array_SB 0.0 CM_Angle_8bit -64.0 63.5
 /begin AXIS_DESCR COM_AXIS NO_INPUT_QUANTITY CM_kpa_0to512_1 18 0.0 511.9921875 AXIS_PTS_REF CA_MAP18Step1 MAX_GRAD 0.0 /end AXIS_DESCR
 /begin AXIS_DESCR COM_AXIS NO_INPUT_QUANTITY CM_RPM_0to16384 10 0.0 16383.75 AXIS_PTS_REF CA_EngSpd10Step1 MAX_GRAD 0.0 /end AXIS_DESCR
/end CHARACTERISTIC
/begin CHARACTERISTIC CT_SparkBaroOffset4 "cal comments" MAP 0x3 D_Array_SB 0.0 CM_Angle_8bit -64.0 63.5
 /begin AXIS_DESCR COM_AXIS NO_INPUT_QUANTITY CM_kpa_0to512_1 18 0.0 511.9921875 AXIS_PTS_REF CA_MAP18Step1 MAX_GRAD 0.0 /end AXIS_DESCR
 /begin AXIS_DESCR COM_AXIS NO_INPUT_QUANTITY CM_RPM_0to16384 10 0.0 16383.75 AXIS_PTS_REF CA_EngSpd10Step1 MAX_GRAD 0.0 /end AXIS_DESCR
/end CHARACTERISTIC
/begin CHARACTERISTIC CT_SparkBaroOffset5 "cal comments" MAP 0x3 D_Array_SB 0.0 CM_Angle_8bit -64.0 63.5
 /begin AXIS_DESCR COM_AXIS NO_INPUT_QUANTITY CM_kpa_0to512_1 18 0.0 511.9921875 AXIS_PTS_REF CA_MAP18Step1 MAX_GRAD 0.0 /end AXIS_DESCR
 /begin AXIS_DESCR COM_AXIS NO_INPUT_QUANTITY CM_RPM_0to16384 10 0.0 16383.75 AXIS_PTS_REF CA_EngSpd10Step1 MAX_GRAD 0.0 /end AXIS_DESCR
/end CHARACTERISTIC
/begin CHARACTERISTIC CT_SparkBaroOffset6 "cal comments" MAP 0x3 D_Array_SB 0.0 CM_Angle_8bit -64.0 63.5
 /begin AXIS_DESCR COM_AXIS NO_INPUT_QUANTITY CM_kpa_0to512_1 18 0.0 511.9921875 AXIS_PTS_REF CA_MAP18Step1 MAX_GRAD 0.0 /end AXIS_DESCR
 /begin AXIS_DESCR COM_AXIS NO_INPUT_QUANTITY CM_RPM_0to16384 10 0.0 16383.75 AXIS_PTS_REF CA_EngSpd10Step1 MAX_GRAD 0.0 /end AXIS_DESCR
/end CHARACTERISTIC
/begin CHARACTERISTIC CT_SparkAdvanceMain "cal comments" MAP 0xA2D4 D_Array_SB 0.0 CM_Angle_8bit -64.0 63.5
 /begin AXIS_DESCR COM_AXIS NO_INPUT_QUANTITY CM_kpa_0to512_1 18 0.0 511.9921875 AXIS_PTS_REF CA_MAP18Step1 MAX_GRAD 0.0 /end AXIS_DESCR
 /begin AXIS_DESCR COM_AXIS NO_INPUT_QUANTITY CM_RPM_0to16384 17 0.0 16383.75 AXIS_PTS_REF CA_EngSpd17Step1 MAX_GRAD 0.0 /end AXIS_DESCR
/end CHARACTERISTIC
/begin CHARACTERISTIC CT_SparkAdvanceMain_NG "cal comments" MAP 0xA409 D_Array_SB 0.0 CM_Angle_8bit -64.0 63.5
 /begin AXIS_DESCR COM_AXIS NO_INPUT_QUANTITY CM_kpa_0to512_1 18 0.0 511.9921875 AXIS_PTS_REF CA_MAP18Step1 MAX_GRAD 0.0 /end AXIS_DESCR
 /begin AXIS_DESCR COM_AXIS NO_INPUT_QUANTITY CM_RPM_0to16384 17 0.0 16383.75 AXIS_PTS_REF CA_EngSpd17Step1 MAX_GRAD 0.0 /end AXIS_DESCR
/end CHARACTERISTIC
/begin CHARACTERISTIC CT_SparkAdvanceMain_LPG "cal comments" MAP 0xA53E D_Array_SB 0.0 CM_Angle_8bit -64.0 63.5
 /begin AXIS_DESCR COM_AXIS NO_INPUT_QUANTITY CM_kpa_0to512_1 18 0.0 511.9921875 AXIS_PTS_REF CA_MAP18Step1 MAX_GRAD 0.0 /end AXIS_DESCR
 /begin AXIS_DESCR COM_AXIS NO_INPUT_QUANTITY CM_RPM_0to16384 17 0.0 16383.75 AXIS_PTS_REF CA_EngSpd17Step1 MAX_GRAD 0.0 /end AXIS_DESCR
/end CHARACTERISTIC
/begin CHARACTERISTIC CT_SparkAdvanceCyl2Offset2Main "cal comments" MAP 0xA673 D_Array_SB 0.0 CM_Angle_8bit -64.0 63.5
 /begin AXIS_DESCR COM_AXIS NO_INPUT_QUANTITY CM_kpa_0to512_1 18 0.0 511.9921875 AXIS_PTS_REF CA_MAP18Step1 MAX_GRAD 0.0 /end AXIS_DESCR
 /begin AXIS_DESCR COM_AXIS NO_INPUT_QUANTITY CM_RPM_0to16384 17 0.0 16383.75 AXIS_PTS_REF CA_EngSpd17Step1 MAX_GRAD 0.0 /end AXIS_DESCR
/end CHARACTERISTIC
/begin CHARACTERISTIC CT_SparkAdvanceCyl3Offset2Main "cal comments" MAP 0xA7A8 D_Array_SB 0.0 CM_Angle_8bit -64.0 63.5
 /begin AXIS_DESCR COM_AXIS NO_INPUT_QUANTITY CM_kpa_0to512_1 18 0.0 511.9921875 AXIS_PTS_REF CA_MAP18Step1 MAX_GRAD 0.0 /end AXIS_DESCR
 /begin AXIS_DESCR COM_AXIS NO_INPUT_QUANTITY CM_RPM_0to16384 17 0.0 16383.75 AXIS_PTS_REF CA_EngSpd17Step1 MAX_GRAD 0.0 /end AXIS_DESCR
/end CHARACTERISTIC
/begin CHARACTERISTIC CT_SparkAdvanceCyl4Offset2Main "cal comments" MAP 0xA8DD D_Array_SB 0.0 CM_Angle_8bit -64.0 63.5
 /begin AXIS_DESCR COM_AXIS NO_INPUT_QUANTITY CM_kpa_0to512_1 18 0.0 511.9921875 AXIS_PTS_REF CA_MAP18Step1 MAX_GRAD 0.0 /end AXIS_DESCR
 /begin AXIS_DESCR COM_AXIS NO_INPUT_QUANTITY CM_RPM_0to16384 17 0.0 16383.75 AXIS_PTS_REF CA_EngSpd17Step1 MAX_GRAD 0.0 /end AXIS_DESCR
/end CHARACTERISTIC
/begin CHARACTERISTIC C_PickupTooth2TDCAngle "cal comments" VALUE 0x80B4 Scalar_SW 0.0 CM_SparkAngle_N256to256 -256.0 255.9921875 /end CHARACTERISTIC
/begin CHARACTERISTIC CT_SAIdleMain "cal comments" CURVE 0xAAC0 2D_Array_SB 0.0 CM_Angle_8bit -64.0 63.5
 /begin AXIS_DESCR FIX_AXIS NO_INPUT_QUANTITY CM_Equaloutput1 17 -28.0 164.0 MAX_GRAD 0.0 /begin FIX_AXIS_PAR_LIST -28 -16 -4 8 20 32 44 56 68 80 92 104 116 128 140 152 164 /end FIX_AXIS_PAR_LIST /end AXIS_DESCR
/end CHARACTERISTIC
/begin CHARACTERISTIC CT_SAIdleLimit "cal comments" CURVE 0xAA11 2D_Array_SB 0.0 CM_Angle_8bit -64.0 63.5
 /begin AXIS_DESCR COM_AXIS NO_INPUT_QUANTITY CM_RPM_0to16384 6 0.0 16383.75 AXIS_PTS_REF CA_EngSpd6Step1 MAX_GRAD 0.0 /end AXIS_DESCR
/end CHARACTERISTIC
/begin CHARACTERISTIC C_SPRK_IdleAdj "cal comments" VALUE 0xAA6C Scalar_UB 0.0 CM_Boolean1 0.0 1.0 /end CHARACTERISTIC
/begin CHARACTERISTIC C_SA_MAP_ALT_Enb "cal comments" VALUE 0xAA6D Scalar_UB 0.0 CM_Boolean1 0.0 1.0 /end CHARACTERISTIC
/begin CHARACTERISTIC CT_SAIdleRPMoffset "cal comments" CURVE 0xAA70 2D_Array_SB 0.0 CM_Angle_8bit -64.0 63.5
 /begin AXIS_DESCR COM_AXIS NO_INPUT_QUANTITY CM_RPM_0to16384 6 0.0 16383.75 AXIS_PTS_REF CA_EngSpd6Step1 MAX_GRAD 0.0 /end AXIS_DESCR
/end CHARACTERISTIC
/begin CHARACTERISTIC CT_SAIdleBaroComp "cal comments" CURVE 0xAA19 2D_Array_SB 0.0 CM_Angle_8bit -64.0 63.5
 /begin AXIS_DESCR FIX_AXIS NO_INPUT_QUANTITY CM_Equaloutput1 11 55.0 105.0 MAX_GRAD 0.0 /begin FIX_AXIS_PAR_LIST 55 60 65 70 75 80 85 90 95 100 105 /end FIX_AXIS_PAR_LIST /end AXIS_DESCR
/end CHARACTERISTIC
/begin CHARACTERISTIC CT_SAIdleBattComp "cal comments" CURVE 0xAA26 2D_Array_SB 0.0 CM_Angle_8bit -64.0 63.5
 /begin AXIS_DESCR FIX_AXIS NO_INPUT_QUANTITY CM_Equaloutput1 17 6.0 18.79999923706055 MAX_GRAD 0.0
  /begin FIX_AXIS_PAR_LIST 6 6.8 7.6 8.4 9.199999999999999 10 10.8 11.6 12.4 13.2 14 14.8 15.6 16.4 17.2 18 18.8 /end FIX_AXIS_PAR_LIST
 /end AXIS_DESCR
/end CHARACTERISTIC
/begin CHARACTERISTIC CT_SAIdleDyn "cal comments" CURVE 0xAA39 2D_Array_SB 0.0 CM_Angle_8bit -64.0 63.5
 /begin AXIS_DESCR FIX_AXIS NO_INPUT_QUANTITY CM_Equaloutput1 33 -512.0 512.0 MAX_GRAD 0.0
  /begin FIX_AXIS_PAR_LIST -512 -480 -448 -416 -384 -352 -320 -288 -256 -224 -192 -160 -128 -96 -64 -32 0 32 64 96 128 160 192 224 256 288 320 352 384 416 448 480 512 /end FIX_AXIS_PAR_LIST
 /end AXIS_DESCR
/end CHARACTERISTIC
/begin CHARACTERISTIC C_SPRK_t_CtoIDLE_DelayTime "cal comments" VALUE 0xAA5A Scalar_UW 0.0 CM_Seconds_1 0.0 2047.96875 /end CHARACTERISTIC
/begin CHARACTERISTIC C_SPRK_t_RtoIDLE_DelayTime "cal comments" VALUE 0xAA5C Scalar_UW 0.0 CM_Seconds_1 0.0 2047.96875 /end CHARACTERISTIC
/begin CHARACTERISTIC CT_SparkDwellIntakeAirTempMult "cal comments" CURVE 0xAA78 2D_Array_UB 0.0 CM_Mult0_to_2_ratio 0.0 1.9921875
 /begin AXIS_DESCR FIX_AXIS NO_INPUT_QUANTITY CM_Equaloutput1 9 -28.0 36.0 MAX_GRAD 0.0 /begin FIX_AXIS_PAR_LIST -28 -20 -12 -4 4 12 20 28 36 /end FIX_AXIS_PAR_LIST /end AXIS_DESCR
/end CHARACTERISTIC
/begin CHARACTERISTIC CT_SparkDwellMain "cal comments" MAP 0xA155 3D_Array_UB 0.0 CM_msec 0.0 15.9375
 /begin AXIS_DESCR FIX_AXIS NO_INPUT_QUANTITY CM_Equaloutput1 17 6.0 18.79999923706055 MAX_GRAD 0.0
  /begin FIX_AXIS_PAR_LIST 6 6.8 7.6 8.4 9.199999999999999 10 10.8 11.6 12.4 13.2 14 14.8 15.6 16.4 17.2 18 18.8 /end FIX_AXIS_PAR_LIST
 /end AXIS_DESCR
 /begin AXIS_DESCR COM_AXIS NO_INPUT_QUANTITY CM_RPM_0to16384 4 0.0 16383.75 AXIS_PTS_REF CA_EngSpd4Step1 MAX_GRAD 0.0 /end AXIS_DESCR
/end CHARACTERISTIC
/begin CHARACTERISTIC CT_SparkDwellMaxLimit "cal comments" CURVE 0xAA60 2D_Array_UB 0.0 CM_msec 0.0 15.9375
 /begin AXIS_DESCR FIX_AXIS NO_INPUT_QUANTITY CM_Equaloutput1 9 0.0 12800.0 MAX_GRAD 0.0 /begin FIX_AXIS_PAR_LIST 0 1600 3200 4800 6400 8000 9600 11200 12800 /end FIX_AXIS_PAR_LIST /end AXIS_DESCR
/end CHARACTERISTIC
/begin CHARACTERISTIC CT_KNK_WB_NG "cal comments" MAP 0xAEA3 D_Array_SB 0.0 CM_Angle_8bit -30.0 30.0
 /begin AXIS_DESCR COM_AXIS NO_INPUT_QUANTITY CM_kpa_0to512_1 7 0.0 511.9921875 AXIS_PTS_REF CA_MAP7Step1 MAX_GRAD 0.0 /end AXIS_DESCR
 /begin AXIS_DESCR COM_AXIS NO_INPUT_QUANTITY CM_RPM_0to16384 4 0.0 16383.75 AXIS_PTS_REF CA_EngSpd4Step1 MAX_GRAD 0.0 /end AXIS_DESCR
/end CHARACTERISTIC
/begin CHARACTERISTIC CT_KNK_WB_LPG "cal comments" MAP 0xAEC2 D_Array_SB 0.0 CM_Angle_8bit -30.0 30.0
 /begin AXIS_DESCR COM_AXIS NO_INPUT_QUANTITY CM_kpa_0to512_1 7 0.0 511.9921875 AXIS_PTS_REF CA_MAP7Step1 MAX_GRAD 0.0 /end AXIS_DESCR
 /begin AXIS_DESCR COM_AXIS NO_INPUT_QUANTITY CM_RPM_0to16384 4 0.0 16383.75 AXIS_PTS_REF CA_EngSpd4Step1 MAX_GRAD 0.0 /end AXIS_DESCR
/end CHARACTERISTIC
/begin CHARACTERISTIC CT_KNK_WD_NG "cal comments" MAP 0xAEE1 D_Array_SB 0.0 CM_Angle_8bit 0.0 60.0
 /begin AXIS_DESCR COM_AXIS NO_INPUT_QUANTITY CM_kpa_0to512_1 7 0.0 511.9921875 AXIS_PTS_REF CA_MAP7Step1 MAX_GRAD 0.0 /end AXIS_DESCR
 /begin AXIS_DESCR COM_AXIS NO_INPUT_QUANTITY CM_RPM_0to16384 4 0.0 16383.75 AXIS_PTS_REF CA_EngSpd4Step1 MAX_GRAD 0.0 /end AXIS_DESCR
/end CHARACTERISTIC
/begin CHARACTERISTIC CT_KNK_WD_LPG "cal comments" MAP 0xAF00 D_Array_SB 0.0 CM_Angle_8bit 0.0 60.0
 /begin AXIS_DESCR COM_AXIS NO_INPUT_QUANTITY CM_kpa_0to512_1 7 0.0 511.9921875 AXIS_PTS_REF CA_MAP7Step1 MAX_GRAD 0.0 /end AXIS_DESCR
 /begin AXIS_DESCR COM_AXIS NO_INPUT_QUANTITY CM_RPM_0to16384 4 0.0 16383.75 AXIS_PTS_REF CA_EngSpd4Step1 MAX_GRAD 0.0 /end AXIS_DESCR
/end CHARACTERISTIC
/begin CHARACTERISTIC CT_KNK_GAIN "cal comments" MAP 0xAF1F 2D_Array_UB 0.0 CM_KNK_GAIN 0.0 63.0
 /begin AXIS_DESCR COM_AXIS NO_INPUT_QUANTITY CM_kpa_0to512_1 7 0.0 511.9921875 AXIS_PTS_REF CA_MAP7Step1 MAX_GRAD 0.0 /end AXIS_DESCR
 /begin AXIS_DESCR COM_AXIS NO_INPUT_QUANTITY CM_RPM_0to16384 4 0.0 16383.75 AXIS_PTS_REF CA_EngSpd4Step1 MAX_GRAD 0.0 /end AXIS_DESCR
/end CHARACTERISTIC
/begin CHARACTERISTIC CT_KNK_FIL "cal comments" MAP 0xAF3E 2D_Array_UB 0.0 CM_KNK_HZ 0.0 63.0
 /begin AXIS_DESCR COM_AXIS NO_INPUT_QUANTITY CM_kpa_0to512_1 7 0.0 511.9921875 AXIS_PTS_REF CA_MAP7Step1 MAX_GRAD 0.0 /end AXIS_DESCR
 /begin AXIS_DESCR COM_AXIS NO_INPUT_QUANTITY CM_RPM_0to16384 4 0.0 16383.75 AXIS_PTS_REF CA_EngSpd4Step1 MAX_GRAD 0.0 /end AXIS_DESCR
/end CHARACTERISTIC
/begin CHARACTERISTIC CT_KNK_INT "cal comments" MAP 0xAF5D 2D_Array_UB 0.0 CM_KNK_INT 0.0 31.0
 /begin AXIS_DESCR COM_AXIS NO_INPUT_QUANTITY CM_kpa_0to512_1 7 0.0 511.9921875 AXIS_PTS_REF CA_MAP7Step1 MAX_GRAD 0.0 /end AXIS_DESCR
 /begin AXIS_DESCR COM_AXIS NO_INPUT_QUANTITY CM_RPM_0to16384 4 0.0 16383.75 AXIS_PTS_REF CA_EngSpd4Step1 MAX_GRAD 0.0 /end AXIS_DESCR
/end CHARACTERISTIC
/begin CHARACTERISTIC C_KNK_N_CYL "cal comments" VALUE 0xAE86 Scalar_UB 0.0 CM_Count1 0.0 8.0 /end CHARACTERISTIC
/begin CHARACTERISTIC CT_KNK_CYL2CH "cal comments" CURVE 0xAE87 2D_Array_UB 0.0 CM_Count1 0.0 1.0
 /begin AXIS_DESCR FIX_AXIS NO_INPUT_QUANTITY CM_CYL 8 0.0 8.0 MAX_GRAD 0.0 /begin FIX_AXIS_PAR_LIST 0 1 2 3 4 5 6 7 /end FIX_AXIS_PAR_LIST /end AXIS_DESCR
/end CHARACTERISTIC
/begin CHARACTERISTIC CT_KNK_SL_RTD_MAX "cal comments" MAP 0xAF89 3D_Array_UB 0.0 CM_Angle_8bit_2 0.0 31.875
 /begin AXIS_DESCR COM_AXIS NO_INPUT_QUANTITY CM_kpa_0to512_1 7 0.0 511.9921875 AXIS_PTS_REF CA_MAP7Step1 MAX_GRAD 0.0 /end AXIS_DESCR
 /begin AXIS_DESCR COM_AXIS NO_INPUT_QUANTITY CM_RPM_0to16384 4 0.0 16383.75 AXIS_PTS_REF CA_EngSpd4Step1 MAX_GRAD 0.0 /end AXIS_DESCR
/end CHARACTERISTIC
/begin CHARACTERISTIC CT_KNK_SL_COL_DIFF "cal comments" CURVE 0xAFB1 2D_Array_UB 0.0 CM_Angle_8bit_2 0.0 31.875
 /begin AXIS_DESCR FIX_AXIS NO_INPUT_QUANTITY CM_Equaloutput1 6 0.0 6.0 MAX_GRAD 0.0 /begin FIX_AXIS_PAR_LIST 0 1 2 3 4 5 /end FIX_AXIS_PAR_LIST /end AXIS_DESCR
/end CHARACTERISTIC
/begin CHARACTERISTIC CT_KNK_MUL_CYL1 "cal comments" MAP 0xAFE5 3D_Array_UB 0.0 CM_Mult_0to16 0.0 15.9375
 /begin AXIS_DESCR COM_AXIS NO_INPUT_QUANTITY CM_kpa_0to512_1 7 0.0 511.9921875 AXIS_PTS_REF CA_MAP7Step1 MAX_GRAD 0.0 /end AXIS_DESCR
 /begin AXIS_DESCR COM_AXIS NO_INPUT_QUANTITY CM_RPM_0to16384 4 0.0 16383.75 AXIS_PTS_REF CA_EngSpd4Step1 MAX_GRAD 0.0 /end AXIS_DESCR
/end CHARACTERISTIC
/begin CHARACTERISTIC CT_KNK_MUL_CYL2 "cal comments" MAP 0xB004 3D_Array_UB 0.0 CM_Mult_0to16 0.0 15.9375
 /begin AXIS_DESCR COM_AXIS NO_INPUT_QUANTITY CM_kpa_0to512_1 7 0.0 511.9921875 AXIS_PTS_REF CA_MAP7Step1 MAX_GRAD 0.0 /end AXIS_DESCR
 /begin AXIS_DESCR COM_AXIS NO_INPUT_QUANTITY CM_RPM_0to16384 4 0.0 16383.75 AXIS_PTS_REF CA_EngSpd4Step1 MAX_GRAD 0.0 /end AXIS_DESCR
/end CHARACTERISTIC
/begin CHARACTERISTIC CT_KNK_MUL_CYL3 "cal comments" MAP 0xB023 3D_Array_UB 0.0 CM_Mult_0to16 0.0 15.9375
 /begin AXIS_DESCR COM_AXIS NO_INPUT_QUANTITY CM_kpa_0to512_1 7 0.0 511.9921875 AXIS_PTS_REF CA_MAP7Step1 MAX_GRAD 0.0 /end AXIS_DESCR
 /begin AXIS_DESCR COM_AXIS NO_INPUT_QUANTITY CM_RPM_0to16384 4 0.0 16383.75 AXIS_PTS_REF CA_EngSpd4Step1 MAX_GRAD 0.0 /end AXIS_DESCR
/end CHARACTERISTIC
/begin CHARACTERISTIC CT_KNK_MUL_CYL4 "cal comments" MAP 0xB042 3D_Array_UB 0.0 CM_Mult_0to16 0.0 15.9375
 /begin AXIS_DESCR COM_AXIS NO_INPUT_QUANTITY CM_kpa_0to512_1 7 0.0 511.9921875 AXIS_PTS_REF CA_MAP7Step1 MAX_GRAD 0.0 /end AXIS_DESCR
 /begin AXIS_DESCR COM_AXIS NO_INPUT_QUANTITY CM_RPM_0to16384 4 0.0 16383.75 AXIS_PTS_REF CA_EngSpd4Step1 MAX_GRAD 0.0 /end AXIS_DESCR
/end CHARACTERISTIC
/begin CHARACTERISTIC CT_KNK_MAD_MIN "cal comments" MAP 0xB071 3D_Array_UB 0.0 CM_Percent_0to100 0.0 99.609375
 /begin AXIS_DESCR COM_AXIS NO_INPUT_QUANTITY CM_kpa_0to512_1 7 0.0 511.9921875 AXIS_PTS_REF CA_MAP7Step1 MAX_GRAD 0.0 /end AXIS_DESCR
 /begin AXIS_DESCR COM_AXIS NO_INPUT_QUANTITY CM_RPM_0to16384 4 0.0 16383.75 AXIS_PTS_REF CA_EngSpd4Step1 MAX_GRAD 0.0 /end AXIS_DESCR
/end CHARACTERISTIC
/begin CHARACTERISTIC CT_KNK_MAD_MAX "cal comments" MAP 0xB090 3D_Array_UB 0.0 CM_Percent_0to100 0.0 99.609375
 /begin AXIS_DESCR COM_AXIS NO_INPUT_QUANTITY CM_kpa_0to512_1 7 0.0 511.9921875 AXIS_PTS_REF CA_MAP7Step1 MAX_GRAD 0.0 /end AXIS_DESCR
 /begin AXIS_DESCR COM_AXIS NO_INPUT_QUANTITY CM_RPM_0to16384 4 0.0 16383.75 AXIS_PTS_REF CA_EngSpd4Step1 MAX_GRAD 0.0 /end AXIS_DESCR
/end CHARACTERISTIC
/begin CHARACTERISTIC C_KNK_ENA "cal comments" VALUE 0xAF79 Scalar_UB 0.0 CM_Count3 0.0 255.0 /end CHARACTERISTIC
/begin CHARACTERISTIC C_KNK_GOV_OFS_MAX "cal comments" VALUE 0xAF7A Scalar_SW 0.0 CM_SparkAngle_N256to256 -256.0 255.9921875 /end CHARACTERISTIC
/begin CHARACTERISTIC C_KNK_ERR_REC_PRD "cal comments" VALUE 0xAF7C Scalar_UW 0.0 CM_Seconds_1 0.0 2047.96875 /end CHARACTERISTIC
/begin CHARACTERISTIC C_KNK_RUN_THD "cal comments" VALUE 0xAF7E Scalar_UB 0.0 CM_Count1 0.0 255.0 /end CHARACTERISTIC
/begin CHARACTERISTIC C_KNK_TCO_MIN "cal comments" VALUE 0xAF80 Scalar_SW 0.0 CM_DegC_N256to256 -256.0 255.9921875 /end CHARACTERISTIC
/begin CHARACTERISTIC C_KNK_MAP_MIN "cal comments" VALUE 0xAF82 Scalar_UW 0.0 CM_kpa_0to512_1 0.0 511.9921875 /end CHARACTERISTIC
/begin CHARACTERISTIC C_KNK_RPM_MIN "cal comments" VALUE 0xAF84 Scalar_UW 0.0 CM_RPM_0to16384 0.0 16383.75 /end CHARACTERISTIC
/begin CHARACTERISTIC C_KNK_RTD_MAX "cal comments" VALUE 0xAF86 Scalar_UB 0.0 CM_Angle_8bit_2 0.0 31.875 /end CHARACTERISTIC
/begin CHARACTERISTIC C_KNK_SL_CEL_RST "cal comments" VALUE 0xAF87 Scalar_UB 0.0 CM_Count3 0.0 255.0 /end CHARACTERISTIC
/begin CHARACTERISTIC C_KNK_SL_ALL_RST "cal comments" VALUE 0xAF88 Scalar_UB 0.0 CM_Count3 0.0 255.0 /end CHARACTERISTIC
/begin CHARACTERISTIC C_KNK_SL_RTD_STEP "cal comments" VALUE 0xAFA5 Scalar_UB 0.0 CM_Angle_8bit_2 0.0 31.875 /end CHARACTERISTIC
/begin CHARACTERISTIC C_KNK_SL_RTD_RST "cal comments" VALUE 0xAFA6 Scalar_UB 0.0 CM_Angle_8bit_2 0.0 31.875 /end CHARACTERISTIC
/begin CHARACTERISTIC C_KNK_SL_REC_STEP "cal comments" VALUE 0xAFAA Scalar_UB 0.0 CM_Angle_8bit_2 0.0 31.875 /end CHARACTERISTIC
/begin CHARACTERISTIC C_KNK_SL_ROW_DIFF "cal comments" VALUE 0xAFB0 Scalar_UB 0.0 CM_Angle_8bit_2 0.0 31.875 /end CHARACTERISTIC
/begin CHARACTERISTIC C_KNK_SL_REC_PRD "cal comments" VALUE 0xAFA8 Scalar_UW 0.0 CM_Second_0to512 0.0 511.9921875 /end CHARACTERISTIC
/begin CHARACTERISTIC C_KNK_SL_COL_MAP_HYST "cal comments" VALUE 0xAFAC Scalar_UW 0.0 CM_kpa_0to512_1 0.0 511.9921875 /end CHARACTERISTIC
/begin CHARACTERISTIC C_KNK_SL_ROW_RPM_HYST "cal comments" VALUE 0xAFAE Scalar_UW 0.0 CM_RPM_0to16384 0.0 16383.75 /end CHARACTERISTIC
/begin CHARACTERISTIC C_KNK_FS_REC_PRD "cal comments" VALUE 0xAFBA Scalar_UW 0.0 CM_Second_0to512 0.0 511.9921875 /end CHARACTERISTIC
/begin CHARACTERISTIC C_KNK_FS_RTD_MAX "cal comments" VALUE 0xAFB7 Scalar_UB 0.0 CM_Angle_8bit_2 0.0 31.875 /end CHARACTERISTIC
/begin CHARACTERISTIC C_KNK_FS_RTD_STEP "cal comments" VALUE 0xAFB8 Scalar_UB 0.0 CM_Angle_8bit_2 0.0 31.875 /end CHARACTERISTIC
/begin CHARACTERISTIC C_KNK_FS_REC_STEP "cal comments" VALUE 0xAFBC Scalar_UB 0.0 CM_Angle_8bit_2 0.0 31.875 /end CHARACTERISTIC
/begin CHARACTERISTIC C_KNK_FS_ACC_REC_THD "cal comments" VALUE 0xAFBD Scalar_UB 0.0 CM_Angle_8bit_2 0.0 31.875 /end CHARACTERISTIC
/begin CHARACTERISTIC C_KNK_FS_ACC_REC_STEP "cal comments" VALUE 0xAFBE Scalar_UB 0.0 CM_Angle_8bit_2 0.0 31.875 /end CHARACTERISTIC
/begin CHARACTERISTIC C_KNK_TRA_MAP_INC_THD "cal comments" VALUE 0xAFCE Scalar_UW 0.0 CM_kpa_0to512_1 0.0 511.9921875 /end CHARACTERISTIC
/begin CHARACTERISTIC C_KNK_TRA_MAP_DEC_THD "cal comments" VALUE 0xAFD0 Scalar_UW 0.0 CM_kpa_0to512_1 0.0 511.9921875 /end CHARACTERISTIC
/begin CHARACTERISTIC C_KNK_TRA_RPM_INC_THD "cal comments" VALUE 0xAFC6 Scalar_UW 0.0 CM_RPM_0to16384 0.0 16383.75 /end CHARACTERISTIC
/begin CHARACTERISTIC C_KNK_TRA_RPM_DEC_THD "cal comments" VALUE 0xAFC8 Scalar_UW 0.0 CM_RPM_0to16384 0.0 16383.75 /end CHARACTERISTIC
/begin CHARACTERISTIC C_KNK_TRA_TPS_INC_THD "cal comments" VALUE 0xAFCA Scalar_UW 0.0 CM_Percent_0to200_2 0.0 199.9969024658203 /end CHARACTERISTIC
/begin CHARACTERISTIC C_KNK_TRA_TPS_DEC_THD "cal comments" VALUE 0xAFCC Scalar_UW 0.0 CM_Percent_0to200_2 0.0 199.9969024658203 /end CHARACTERISTIC
/begin CHARACTERISTIC C_KNK_TRA_LOD_MUL_OFS "cal comments" VALUE 0xAFD2 Scalar_UW 0.0 CM_Ratio_0to16 0.0 15.999755859375 /end CHARACTERISTIC
/begin CHARACTERISTIC C_KNK_TRA_RPM_MUL_OFS "cal comments" VALUE 0xAFD4 Scalar_UW 0.0 CM_Ratio_0to16 0.0 15.999755859375 /end CHARACTERISTIC
/begin CHARACTERISTIC C_KNK_TRA_MAP_COEF "cal comments" VALUE 0xAFC0 Scalar_UW 0.0 CM_FiltCoef 0.0 0.9999847412109375 /end CHARACTERISTIC
/begin CHARACTERISTIC C_KNK_TRA_RPM_COEF "cal comments" VALUE 0xAFC2 Scalar_UW 0.0 CM_FiltCoef 0.0 0.9999847412109375 /end CHARACTERISTIC
/begin CHARACTERISTIC C_KNK_TRA_TPS_COEF "cal comments" VALUE 0xAFC4 Scalar_UW 0.0 CM_FiltCoef 0.0 0.9999847412109375 /end CHARACTERISTIC
/begin CHARACTERISTIC C_KNK_AVG_SS_COEF "cal comments" VALUE 0xAFD6 Scalar_UW 0.0 CM_FiltCoef 0.0 0.9999847412109375 /end CHARACTERISTIC
/begin CHARACTERISTIC C_KNK_AVG_TRA_INC_COEF "cal comments" VALUE 0xAFDA Scalar_UW 0.0 CM_FiltCoef 0.0 0.9999847412109375 /end CHARACTERISTIC
/begin CHARACTERISTIC C_KNK_AVG_TRA_DEC_COEF "cal comments" VALUE 0xAFDC Scalar_UW 0.0 CM_FiltCoef 0.0 0.9999847412109375 /end CHARACTERISTIC
/begin CHARACTERISTIC C_KNK_AVG_INIT "cal comments" VALUE 0xAFDE Scalar_UW 0.0 CM_Percent_0to200_2 0.0 199.9969024658203 /end CHARACTERISTIC
/begin CHARACTERISTIC C_KNK_AVG_MIN "cal comments" VALUE 0xAFE0 Scalar_UW 0.0 CM_Percent_0to200_2 0.0 199.9969024658203 /end CHARACTERISTIC
/begin CHARACTERISTIC C_KNK_AVG_KNK_COEF_MUL "cal comments" VALUE 0xAFD8 Scalar_UW 0.0 CM_FactorRatio 0.0 0.9999847412109375 /end CHARACTERISTIC
/begin CHARACTERISTIC C_KNK_MAD_INIT "cal comments" VALUE 0xB0B0 Scalar_UW 0.0 CM_Percent_0to200_2 0.0 199.9969024658203 /end CHARACTERISTIC
/begin CHARACTERISTIC C_KNK_MAD_COEF "cal comments" VALUE 0xB06C Scalar_UW 0.0 CM_FiltCoef 0.0 0.9999847412109375 /end CHARACTERISTIC
/begin CHARACTERISTIC C_KNK_SKP_CTR_DEC "cal comments" VALUE 0xB05E Scalar_UW 0.0 CM_Count1 0.0 65535.0 /end CHARACTERISTIC
/begin CHARACTERISTIC C_KNK_SKP_CTR_INC "cal comments" VALUE 0xB060 Scalar_UW 0.0 CM_Count1 0.0 65535.0 /end CHARACTERISTIC
/begin CHARACTERISTIC C_KNK_SKP_CTR_THD "cal comments" VALUE 0xB062 Scalar_UW 0.0 CM_Count1 0.0 65535.0 /end CHARACTERISTIC
/begin CHARACTERISTIC C_KNK_SKP_CTR_MAX "cal comments" VALUE 0xB064 Scalar_UW 0.0 CM_Count1 0.0 65535.0 /end CHARACTERISTIC
/begin CHARACTERISTIC CT_SpeedControlFlowBaroMult "cal comments" CURVE 0x9D3B 2D_Array_UB 0.0 CM_Mult_0to8 0.0 7.96875
 /begin AXIS_DESCR FIX_AXIS NO_INPUT_QUANTITY CM_Equaloutput1 6 55.0 105.0 MAX_GRAD 0.0 /begin FIX_AXIS_PAR_LIST 55 65 75 85 95 105 /end FIX_AXIS_PAR_LIST /end AXIS_DESCR
/end CHARACTERISTIC
/begin CHARACTERISTIC CT_ThrottleFlow "cal comments" CURVE 0x9CAE 2D_Array_UW 0.0 udf_CM_18698 0.0 511.9921875
 /begin AXIS_DESCR COM_AXIS NO_INPUT_QUANTITY CM_Percent_0to200_2 21 0.0 199.9969024658203 AXIS_PTS_REF CA_PercentStep21 MAX_GRAD 0.0 /end AXIS_DESCR
/end CHARACTERISTIC
/begin CHARACTERISTIC CT_ThrottleFlow_Reverse "cal comments" CURVE 0x9CDA 2D_Array_UW 0.0 CM_Percent_0to200_2 0.0 199.9969024658203
 /begin AXIS_DESCR COM_AXIS NO_INPUT_QUANTITY udf_CM_18705 21 0.0 511.9921875 AXIS_PTS_REF CA_GramStep21 MAX_GRAD 0.0 /end AXIS_DESCR
/end CHARACTERISTIC
/begin CHARACTERISTIC CT_TimpPulseWidthMult "cal comments" MAP 0x99D5 3D_Array_UB 0.0 CM_Mult_0to8 0.0 7.96875
 /begin AXIS_DESCR FIX_AXIS NO_INPUT_QUANTITY CM_Equaloutput1 9 -28.0 164.0 MAX_GRAD 0.0 /begin FIX_AXIS_PAR_LIST -28 -4 20 44 68 92 116 140 164 /end FIX_AXIS_PAR_LIST /end AXIS_DESCR
 /begin AXIS_DESCR FIX_AXIS NO_INPUT_QUANTITY CM_Equaloutput1 6 800.0 2800.0 MAX_GRAD 0.0 /begin FIX_AXIS_PAR_LIST 800 1200 1600 2000 2400 2800 /end FIX_AXIS_PAR_LIST /end AXIS_DESCR
/end CHARACTERISTIC
/begin CHARACTERISTIC CT_VEAltCorrFactor "cal comments" MAP 0x8F56 3D_Array_UB 0.0 CM_Mult0_to_2_ratio 0.0 1.9921875
 /begin AXIS_DESCR COM_AXIS NO_INPUT_QUANTITY CM_kpa_0to512_1 6 0.0 511.9921875 AXIS_PTS_REF CA_VELoad6Step MAX_GRAD 0.0 /end AXIS_DESCR
 /begin AXIS_DESCR COM_AXIS NO_INPUT_QUANTITY CM_kpa_0to512_1 10 0.0 511.9921875 AXIS_PTS_REF CA_MAP10Step1 MAX_GRAD 0.0 /end AXIS_DESCR
/end CHARACTERISTIC
/begin CHARACTERISTIC CT_VEMainCyl1 "cal comments" MAP 0x4 3D_Array_UW 0.0 CM_Percent_0to200_2 0.0 199.9969024658203
 /begin AXIS_DESCR COM_AXIS NO_INPUT_QUANTITY CM_kpa_0to512_1 22 0.0 511.9921875 AXIS_PTS_REF CA_MAP22Step1 MAX_GRAD 0.0 /end AXIS_DESCR
 /begin AXIS_DESCR COM_AXIS NO_INPUT_QUANTITY CM_RPM_0to16384 10 0.0 16383.75 AXIS_PTS_REF CA_EngSpd10Step1 MAX_GRAD 0.0 /end AXIS_DESCR
/end CHARACTERISTIC
/begin CHARACTERISTIC CT_VEMainCyl2 "cal comments" MAP 0x4 3D_Array_UW 0.0 CM_Percent_0to200_2 0.0 199.9969024658203
 /begin AXIS_DESCR COM_AXIS NO_INPUT_QUANTITY CM_kpa_0to512_1 22 0.0 511.9921875 AXIS_PTS_REF CA_MAP22Step1 MAX_GRAD 0.0 /end AXIS_DESCR
 /begin AXIS_DESCR COM_AXIS NO_INPUT_QUANTITY CM_RPM_0to16384 10 0.0 16383.75 AXIS_PTS_REF CA_EngSpd10Step1 MAX_GRAD 0.0 /end AXIS_DESCR
/end CHARACTERISTIC
/begin CHARACTERISTIC CT_VEMainCyl1_NG "cal comments" MAP 0x4 3D_Array_UW 0.0 CM_Percent_0to200_2 0.0 199.9969024658203
 /begin AXIS_DESCR COM_AXIS NO_INPUT_QUANTITY CM_kpa_0to512_1 22 0.0 511.9921875 AXIS_PTS_REF CA_MAP22Step1 MAX_GRAD 0.0 /end AXIS_DESCR
 /begin AXIS_DESCR COM_AXIS NO_INPUT_QUANTITY CM_RPM_0to16384 10 0.0 16383.75 AXIS_PTS_REF CA_EngSpd10Step1 MAX_GRAD 0.0 /end AXIS_DESCR
/end CHARACTERISTIC
/begin CHARACTERISTIC CT_VEMainCyl2_NG "cal comments" MAP 0x4 3D_Array_UW 0.0 CM_Percent_0to200_2 0.0 199.9969024658203
 /begin AXIS_DESCR COM_AXIS NO_INPUT_QUANTITY CM_kpa_0to512_1 22 0.0 511.9921875 AXIS_PTS_REF CA_MAP22Step1 MAX_GRAD 0.0 /end AXIS_DESCR
 /begin AXIS_DESCR COM_AXIS NO_INPUT_QUANTITY CM_RPM_0to16384 10 0.0 16383.75 AXIS_PTS_REF CA_EngSpd10Step1 MAX_GRAD 0.0 /end AXIS_DESCR
/end CHARACTERISTIC
/begin CHARACTERISTIC CT_VEMainCyl1_LPG "cal comments" MAP 0x4 3D_Array_UW 0.0 CM_Percent_0to200_2 0.0 199.9969024658203
 /begin AXIS_DESCR COM_AXIS NO_INPUT_QUANTITY CM_kpa_0to512_1 22 0.0 511.9921875 AXIS_PTS_REF CA_MAP22Step1 MAX_GRAD 0.0 /end AXIS_DESCR
 /begin AXIS_DESCR COM_AXIS NO_INPUT_QUANTITY CM_RPM_0to16384 10 0.0 16383.75 AXIS_PTS_REF CA_EngSpd10Step1 MAX_GRAD 0.0 /end AXIS_DESCR
/end CHARACTERISTIC
/begin CHARACTERISTIC CT_VEMainCyl2_LPG "cal comments" MAP 0x4 3D_Array_UW 0.0 CM_Percent_0to200_2 0.0 199.9969024658203
 /begin AXIS_DESCR COM_AXIS NO_INPUT_QUANTITY CM_kpa_0to512_1 22 0.0 511.9921875 AXIS_PTS_REF CA_MAP22Step1 MAX_GRAD 0.0 /end AXIS_DESCR
 /begin AXIS_DESCR COM_AXIS NO_INPUT_QUANTITY CM_RPM_0to16384 10 0.0 16383.75 AXIS_PTS_REF CA_EngSpd10Step1 MAX_GRAD 0.0 /end AXIS_DESCR
/end CHARACTERISTIC
/begin CHARACTERISTIC CT_VEMainHighLoadCyl1 "cal comments" MAP 0x8396 3D_Array_UW 0.0 CM_Percent_0to200_2 0.0 199.9969024658203
 /begin AXIS_DESCR COM_AXIS NO_INPUT_QUANTITY CM_kpa_0to512_1 22 0.0 511.9921875 AXIS_PTS_REF CA_MAP22Step1 MAX_GRAD 0.0 /end AXIS_DESCR
 /begin AXIS_DESCR COM_AXIS NO_INPUT_QUANTITY CM_RPM_0to16384 17 0.0 16383.75 AXIS_PTS_REF CA_EngSpd17Step1 MAX_GRAD 0.0 /end AXIS_DESCR
/end CHARACTERISTIC
/begin CHARACTERISTIC CT_VEMainHighLoadCyl2 "cal comments" MAP 0x8686 3D_Array_UW 0.0 CM_Percent_0to200_2 0.0 199.9969024658203
 /begin AXIS_DESCR COM_AXIS NO_INPUT_QUANTITY CM_kpa_0to512_1 22 0.0 511.9921875 AXIS_PTS_REF CA_MAP22Step1 MAX_GRAD 0.0 /end AXIS_DESCR
 /begin AXIS_DESCR COM_AXIS NO_INPUT_QUANTITY CM_RPM_0to16384 17 0.0 16383.75 AXIS_PTS_REF CA_EngSpd17Step1 MAX_GRAD 0.0 /end AXIS_DESCR
/end CHARACTERISTIC
/begin CHARACTERISTIC CT_VEMainHighLoadCyl3 "cal comments" MAP 0x8976 3D_Array_UW 0.0 CM_Percent_0to200_2 0.0 199.9969024658203
 /begin AXIS_DESCR COM_AXIS NO_INPUT_QUANTITY CM_kpa_0to512_1 22 0.0 511.9921875 AXIS_PTS_REF CA_MAP22Step1 MAX_GRAD 0.0 /end AXIS_DESCR
 /begin AXIS_DESCR COM_AXIS NO_INPUT_QUANTITY CM_RPM_0to16384 17 0.0 16383.75 AXIS_PTS_REF CA_EngSpd17Step1 MAX_GRAD 0.0 /end AXIS_DESCR
/end CHARACTERISTIC
/begin CHARACTERISTIC CT_VEMainHighLoadCyl4 "cal comments" MAP 0x8C66 3D_Array_UW 0.0 CM_Percent_0to200_2 0.0 199.9969024658203
 /begin AXIS_DESCR COM_AXIS NO_INPUT_QUANTITY CM_kpa_0to512_1 22 0.0 511.9921875 AXIS_PTS_REF CA_MAP22Step1 MAX_GRAD 0.0 /end AXIS_DESCR
 /begin AXIS_DESCR COM_AXIS NO_INPUT_QUANTITY CM_RPM_0to16384 17 0.0 16383.75 AXIS_PTS_REF CA_EngSpd17Step1 MAX_GRAD 0.0 /end AXIS_DESCR
/end CHARACTERISTIC
/begin CHARACTERISTIC CT_VEMulCyl1 "cal comments" MAP 0x4 3D_Array_UW 0.0 CM_Percent_0to200_2 0.0 199.9969024658203
 /begin AXIS_DESCR COM_AXIS NO_INPUT_QUANTITY CM_kpa_0to512_1 22 0.0 511.9921875 AXIS_PTS_REF CA_MAP22Step1 MAX_GRAD 0.0 /end AXIS_DESCR
 /begin AXIS_DESCR COM_AXIS NO_INPUT_QUANTITY CM_RPM_0to16384 17 0.0 16383.75 AXIS_PTS_REF CA_EngSpd17Step1 MAX_GRAD 0.0 /end AXIS_DESCR
/end CHARACTERISTIC
/begin CHARACTERISTIC CT_VEMulCyl2 "cal comments" MAP 0x4 3D_Array_UW 0.0 CM_Percent_0to200_2 0.0 199.9969024658203
 /begin AXIS_DESCR COM_AXIS NO_INPUT_QUANTITY CM_kpa_0to512_1 22 0.0 511.9921875 AXIS_PTS_REF CA_MAP22Step1 MAX_GRAD 0.0 /end AXIS_DESCR
 /begin AXIS_DESCR COM_AXIS NO_INPUT_QUANTITY CM_RPM_0to16384 17 0.0 16383.75 AXIS_PTS_REF CA_EngSpd17Step1 MAX_GRAD 0.0 /end AXIS_DESCR
/end CHARACTERISTIC
/begin CHARACTERISTIC CT_VEBaroMul1 "cal comments" MAP 0x4 3D_Array_UW 0.0 CM_Percent_0to200_2 0.0 199.9969024658203
 /begin AXIS_DESCR COM_AXIS NO_INPUT_QUANTITY CM_kpa_0to512_1 22 0.0 511.9921875 AXIS_PTS_REF CA_MAP22Step1 MAX_GRAD 0.0 /end AXIS_DESCR
 /begin AXIS_DESCR COM_AXIS NO_INPUT_QUANTITY CM_RPM_0to16384 17 0.0 16383.75 AXIS_PTS_REF CA_EngSpd17Step1 MAX_GRAD 0.0 /end AXIS_DESCR
/end CHARACTERISTIC
/begin CHARACTERISTIC CT_VEBaroMul2 "cal comments" MAP 0x4 3D_Array_UW 0.0 CM_Percent_0to200_2 0.0 199.9969024658203
 /begin AXIS_DESCR COM_AXIS NO_INPUT_QUANTITY CM_kpa_0to512_1 22 0.0 511.9921875 AXIS_PTS_REF CA_MAP22Step1 MAX_GRAD 0.0 /end AXIS_DESCR
 /begin AXIS_DESCR COM_AXIS NO_INPUT_QUANTITY CM_RPM_0to16384 17 0.0 16383.75 AXIS_PTS_REF CA_EngSpd17Step1 MAX_GRAD 0.0 /end AXIS_DESCR
/end CHARACTERISTIC
/begin CHARACTERISTIC CT_VEBaroMul3 "cal comments" MAP 0x4 3D_Array_UW 0.0 CM_Percent_0to200_2 0.0 199.9969024658203
 /begin AXIS_DESCR COM_AXIS NO_INPUT_QUANTITY CM_kpa_0to512_1 22 0.0 511.9921875 AXIS_PTS_REF CA_MAP22Step1 MAX_GRAD 0.0 /end AXIS_DESCR
 /begin AXIS_DESCR COM_AXIS NO_INPUT_QUANTITY CM_RPM_0to16384 17 0.0 16383.75 AXIS_PTS_REF CA_EngSpd17Step1 MAX_GRAD 0.0 /end AXIS_DESCR
/end CHARACTERISTIC
/begin CHARACTERISTIC CT_VEBaroMul4 "cal comments" MAP 0x4 3D_Array_UW 0.0 CM_Percent_0to200_2 0.0 199.9969024658203
 /begin AXIS_DESCR COM_AXIS NO_INPUT_QUANTITY CM_kpa_0to512_1 22 0.0 511.9921875 AXIS_PTS_REF CA_MAP22Step1 MAX_GRAD 0.0 /end AXIS_DESCR
 /begin AXIS_DESCR COM_AXIS NO_INPUT_QUANTITY CM_RPM_0to16384 17 0.0 16383.75 AXIS_PTS_REF CA_EngSpd17Step1 MAX_GRAD 0.0 /end AXIS_DESCR
/end CHARACTERISTIC
/begin CHARACTERISTIC CT_VEBaroMul5 "cal comments" MAP 0x4 3D_Array_UW 0.0 CM_Percent_0to200_2 0.0 199.9969024658203
 /begin AXIS_DESCR COM_AXIS NO_INPUT_QUANTITY CM_kpa_0to512_1 22 0.0 511.9921875 AXIS_PTS_REF CA_MAP22Step1 MAX_GRAD 0.0 /end AXIS_DESCR
 /begin AXIS_DESCR COM_AXIS NO_INPUT_QUANTITY CM_RPM_0to16384 17 0.0 16383.75 AXIS_PTS_REF CA_EngSpd17Step1 MAX_GRAD 0.0 /end AXIS_DESCR
/end CHARACTERISTIC
/begin CHARACTERISTIC CT_VEBaroMul6 "cal comments" MAP 0x4 3D_Array_UW 0.0 CM_Percent_0to200_2 0.0 199.9969024658203
 /begin AXIS_DESCR COM_AXIS NO_INPUT_QUANTITY CM_kpa_0to512_1 22 0.0 511.9921875 AXIS_PTS_REF CA_MAP22Step1 MAX_GRAD 0.0 /end AXIS_DESCR
 /begin AXIS_DESCR COM_AXIS NO_INPUT_QUANTITY CM_RPM_0to16384 17 0.0 16383.75 AXIS_PTS_REF CA_EngSpd17Step1 MAX_GRAD 0.0 /end AXIS_DESCR
/end CHARACTERISTIC
/begin CHARACTERISTIC C_VESynForCalEn "cal comments" VALUE 0x8F52 Scalar_UB 0.0 CM_Boolean6 0.0 255.0 /end CHARACTERISTIC
/begin CHARACTERISTIC CT_VirtualTPS "cal comments" CURVE 0xB0F0 2D_Array_UB 0.0 CM_Percent_0to200_3 0.0 199.21875
 /begin AXIS_DESCR COM_AXIS NO_INPUT_QUANTITY CM_kpa_0to512_1 10 0.0 511.9921875 AXIS_PTS_REF CA_MAP10Step1 MAX_GRAD 0.0 /end AXIS_DESCR
/end CHARACTERISTIC
/begin CHARACTERISTIC D_BatVoltDiagPassTimeThrsh "cal comments" VALUE 0xC06A Scalar_UW 0.0 CM_Count_0to65535_2 0.0 65535.0 /end CHARACTERISTIC
/begin CHARACTERISTIC D_BatVoltEnb "cal comments" VALUE 0xC070 Scalar_UB 0.0 CM_Boolean6 0.0 255.0 /end CHARACTERISTIC
/begin CHARACTERISTIC D_BatVoltHighFailTimeThrsh "cal comments" VALUE 0xC068 Scalar_UW 0.0 CM_Count_0to65535_2 0.0 65535.0 /end CHARACTERISTIC
/begin CHARACTERISTIC D_BatVoltLowFailTimeThrsh "cal comments" VALUE 0xC066 Scalar_UW 0.0 CM_Count_0to65535_2 0.0 65535.0 /end CHARACTERISTIC
/begin CHARACTERISTIC D_BatVoltRangeThreshHi "cal comments" VALUE 0xC06E Scalar_UW 0.0 CM_Volt_0to32_1 0.0 31.99900627136231 /end CHARACTERISTIC
/begin CHARACTERISTIC D_BatVoltRangeThreshLo "cal comments" VALUE 0xC06C Scalar_UW 0.0 CM_Volt_0to32_1 0.0 31.99900627136231 /end CHARACTERISTIC
/begin CHARACTERISTIC D_GENVDiagPassTimeThrsh "cal comments" VALUE 0x0 Scalar_UW 0.0 CM_Count_0to65535_2 0.0 65535.0 /end CHARACTERISTIC
/begin CHARACTERISTIC D_GENVEnb "cal comments" VALUE 0x0 Scalar_UB 0.0 CM_Boolean6 0.0 255.0 /end CHARACTERISTIC
/begin CHARACTERISTIC D_GENVHighFailTimeThrsh "cal comments" VALUE 0x0 Scalar_UW 0.0 CM_Count_0to65535_2 0.0 65535.0 /end CHARACTERISTIC
/begin CHARACTERISTIC D_GENVLowFailTimeThrsh "cal comments" VALUE 0x0 Scalar_UW 0.0 CM_Count_0to65535_2 0.0 65535.0 /end CHARACTERISTIC
/begin CHARACTERISTIC D_GENVRangeThreshHi "cal comments" VALUE 0x0 Scalar_UW 0.0 CM_Volt_0to1024_1 0.0 1023.984375 /end CHARACTERISTIC
/begin CHARACTERISTIC D_GENVRangeThreshLo "cal comments" VALUE 0x0 Scalar_UW 0.0 CM_Volt_0to1024_1 0.0 1023.984375 /end CHARACTERISTIC
/begin CHARACTERISTIC D_COSEnb "cal comments" VALUE 0xC05E Scalar_UB 0.0 CM_Boolean6 0.0 255.0 /end CHARACTERISTIC
/begin CHARACTERISTIC D_COSFailTimeThrsh "cal comments" VALUE 0xC058 Scalar_UW 0.0 CM_Count_0to65535_2 0.0 65535.0 /end CHARACTERISTIC
/begin CHARACTERISTIC D_COSPassTimeThrsh "cal comments" VALUE 0xC05A Scalar_UW 0.0 CM_Count_0to65535_2 0.0 65535.0 /end CHARACTERISTIC
/begin CHARACTERISTIC D_COSThreshHi "cal comments" VALUE 0xC05C Scalar_UW 0.0 CM_RPM_0to16384 0.0 16383.75 /end CHARACTERISTIC
/begin CHARACTERISTIC D_COAFailTimeThrsh "cal comments" VALUE 0xC061 Scalar_UB 0.0 CM_Count3 0.0 255.0 /end CHARACTERISTIC
/begin CHARACTERISTIC D_COAPassTimeThrsh "cal comments" VALUE 0xC062 Scalar_UB 0.0 CM_Count3 0.0 255.0 /end CHARACTERISTIC
/begin CHARACTERISTIC D_COAEnb "cal comments" VALUE 0xC063 Scalar_UB 0.0 CM_Boolean6 0.0 255.0 /end CHARACTERISTIC
/begin CHARACTERISTIC D_CoolTempShortEnb "cal comments" VALUE 0xBEA0 Scalar_UB 0.0 CM_Boolean6 0.0 255.0 /end CHARACTERISTIC
/begin CHARACTERISTIC D_CoolTempFailTimeThrsh "cal comments" VALUE 0xBE8E Scalar_UW 0.0 CM_Count_0to65535_1 0.0 65535.0 /end CHARACTERISTIC
/begin CHARACTERISTIC D_CoolTempPassTimeThrsh "cal comments" VALUE 0xBE90 Scalar_UW 0.0 CM_Count_0to65535_1 0.0 65535.0 /end CHARACTERISTIC
/begin CHARACTERISTIC D_CoolTempOH1FailTimeThrsh "cal comments" VALUE 0xBE92 Scalar_UB 0.0 CM_Count3 0.0 255.0 /end CHARACTERISTIC
/begin CHARACTERISTIC D_CoolTempOH1PassTimeThrsh "cal comments" VALUE 0xBE93 Scalar_UB 0.0 CM_Count3 0.0 255.0 /end CHARACTERISTIC
/begin CHARACTERISTIC D_CoolTempOH2FailTimeThrsh "cal comments" VALUE 0xBE94 Scalar_UB 0.0 CM_Count3 0.0 255.0 /end CHARACTERISTIC
/begin CHARACTERISTIC D_CoolTempOH2PassTimeThrsh "cal comments" VALUE 0xBE95 Scalar_UB 0.0 CM_Count3 0.0 255.0 /end CHARACTERISTIC
/begin CHARACTERISTIC D_CoolTempShortRangeThreshHi "cal comments" VALUE 0xBE96 Scalar_UW 0.0 CM_Percent_0to100_1 0.0 99.9984130859375 /end CHARACTERISTIC
/begin CHARACTERISTIC D_CoolTempShortRangeThreshLo "cal comments" VALUE 0xBE98 Scalar_UW 0.0 CM_Percent_0to100_1 0.0 99.9984130859375 /end CHARACTERISTIC
/begin CHARACTERISTIC D_CoolTempOHDiagRunTimeThrsh "cal comments" VALUE 0xBE9A Scalar_UB 0.0 CM_Count3 0.0 255.0 /end CHARACTERISTIC
/begin CHARACTERISTIC D_CoolTempOH1Thresh "cal comments" VALUE 0xBE9C Scalar_SW 0.0 CM_DegC_N256to256 -256.0 255.9921875 /end CHARACTERISTIC
/begin CHARACTERISTIC D_CoolTempOH2Thresh "cal comments" VALUE 0xBE9E Scalar_SW 0.0 CM_DegC_N256to256 -256.0 255.9921875 /end CHARACTERISTIC
/begin CHARACTERISTIC D_FPShortEnb "cal comments" VALUE 0xBF2E Scalar_UB 0.0 CM_Boolean6 0.0 255.0 /end CHARACTERISTIC
/begin CHARACTERISTIC D_FPShrtFailTimeThrsh "cal comments" VALUE 0xBF20 Scalar_UB 0.0 CM_Count3 0.0 255.0 /end CHARACTERISTIC
/begin CHARACTERISTIC D_FPHLFailTimeThrsh "cal comments" VALUE 0xBF21 Scalar_UB 0.0 CM_Count3 0.0 255.0 /end CHARACTERISTIC
/begin CHARACTERISTIC D_FPPassTimeThrsh "cal comments" VALUE 0xBF22 Scalar_UB 0.0 CM_Count3 0.0 255.0 /end CHARACTERISTIC
/begin CHARACTERISTIC D_FPShortRangeThreshHi "cal comments" VALUE 0xBF24 Scalar_UW 0.0 CM_Percent_0to100_1 0.0 99.9984130859375 /end CHARACTERISTIC
/begin CHARACTERISTIC D_FPShortRangeThreshLo "cal comments" VALUE 0xBF26 Scalar_UW 0.0 CM_Percent_0to100_1 0.0 99.9984130859375 /end CHARACTERISTIC
/begin CHARACTERISTIC D_FPRangeThreshHi "cal comments" VALUE 0xBF28 Scalar_SW 0.0 CM_kpa_n256to256_1 -256 255.9921875 /end CHARACTERISTIC
/begin CHARACTERISTIC D_FPRangeThreshLo "cal comments" VALUE 0xBF2A Scalar_SW 0.0 CM_kpa_n256to256_1 -256 255.9921875 /end CHARACTERISTIC
/begin CHARACTERISTIC D_FP_MAP_MAX "cal comments" VALUE 0xBF2C Scalar_UW 0.0 CM_kpa_0to512_1 0.0 511.9921875 /end CHARACTERISTIC
/begin CHARACTERISTIC D_CrankNoisySignalFailTimeThrsh "cal comments" VALUE 0xBEE6 Scalar_UW 0.0 CM_Count_0to65535 0.0 65535.0 /end CHARACTERISTIC
/begin CHARACTERISTIC D_CrankNoisySignalPassTimeThrsh "cal comments" VALUE 0xBEE8 Scalar_UW 0.0 CM_Count_0to65535 0.0 65535.0 /end CHARACTERISTIC
/begin CHARACTERISTIC D_CrankNoSignalDeltaMAPThrsh "cal comments" VALUE 0xBEEA Scalar_UW 0.0 CM_kpa_0to512_1 0.0 511.9921875 /end CHARACTERISTIC
/begin CHARACTERISTIC D_CrankNoSignalFailTimeThrsh "cal comments" VALUE 0xBEEC Scalar_UW 0.0 CM_Second_0to512_1 0.0 511.9921875 /end CHARACTERISTIC
/begin CHARACTERISTIC D_CrankNoSignalPassTimeThrsh "cal comments" VALUE 0xBEEE Scalar_UW 0.0 CM_Second_0to512_1 0.0 511.9921875 /end CHARACTERISTIC
/begin CHARACTERISTIC D_CrankNoSignalCountThresh "cal comments" VALUE 0xBEF0 Scalar_UB 0.0 CM_Count1 0.0 255.0 /end CHARACTERISTIC
/begin CHARACTERISTIC D_CrankNosignalMAPCoef "cal comments" VALUE 0xBEF2 Scalar_UW 0.0 CM_FiltCoef 0.0 0.9999847412109375 /end CHARACTERISTIC
/begin CHARACTERISTIC D_CrankSignalEnb "cal comments" VALUE 0xBEF4 Scalar_UB 0.0 CM_Boolean6 0.0 255.0 /end CHARACTERISTIC
/begin CHARACTERISTIC D_FuelPumpShortEnb "cal comments" VALUE 0xBF10 Scalar_UB 0.0 CM_Boolean6 0.0 255.0 /end CHARACTERISTIC
/begin CHARACTERISTIC D_FuelPumpShortLoThresh "cal comments" VALUE 0xBF12 Scalar_UW 0.0 CM_Count_0to65535_1 0.0 65535.0 /end CHARACTERISTIC
/begin CHARACTERISTIC D_FuelPumpShortFailThresh "cal comments" VALUE 0xBF14 Scalar_UB 0.0 CM_Count1 0.0 255.0 /end CHARACTERISTIC
/begin CHARACTERISTIC D_FuelPumpShortPassThresh "cal comments" VALUE 0xBF15 Scalar_UB 0.0 CM_Count1 0.0 255.0 /end CHARACTERISTIC
/begin CHARACTERISTIC D_DCMShortEnb "cal comments" VALUE 0xBE7A Scalar_UB 0.0 CM_Boolean6 0.0 255.0 /end CHARACTERISTIC
/begin CHARACTERISTIC D_DCMShortFailTimeThrsh "cal comments" VALUE 0xBE7B Scalar_UB 0.0 CM_Count1 0.0 255.0 /end CHARACTERISTIC
/begin CHARACTERISTIC D_DCMShortPassTimeThrsh "cal comments" VALUE 0xBE7C Scalar_UB 0.0 CM_Count1 0.0 255.0 /end CHARACTERISTIC
/begin CHARACTERISTIC D_CCPShortEnb "cal comments" VALUE 0x0 Scalar_UB 0.0 CM_Boolean6 0.0 255.0 /end CHARACTERISTIC
/begin CHARACTERISTIC D_CCPShortFailThresh "cal comments" VALUE 0x0 Scalar_UB 0.0 CM_Count1 0.0 255.0 /end CHARACTERISTIC
/begin CHARACTERISTIC D_CCPShortPassThresh "cal comments" VALUE 0x0 Scalar_UB 0.0 CM_Count1 0.0 255.0 /end CHARACTERISTIC
/begin CHARACTERISTIC D_IgnitionCoilEnb "cal comments" CURVE 0xBEFC 2D_Array_UB 0.0 CM_Count1 0.0 1.0
 /begin AXIS_DESCR FIX_AXIS NO_INPUT_QUANTITY CM_EOI 4 0.0 4.0 MAX_GRAD 0.0 /begin FIX_AXIS_PAR_LIST 0 1 2 3 /end FIX_AXIS_PAR_LIST /end AXIS_DESCR
/end CHARACTERISTIC
/begin CHARACTERISTIC D_InjCyShortFailThresh "cal comments" CURVE 0xC029 2D_Array_UB 0.0 CM_Count1 0.0 255.0
 /begin AXIS_DESCR FIX_AXIS NO_INPUT_QUANTITY CM_EOI 4 0.0 4.0 MAX_GRAD 0.0 /begin FIX_AXIS_PAR_LIST 0 1 2 3 /end FIX_AXIS_PAR_LIST /end AXIS_DESCR
/end CHARACTERISTIC
/begin CHARACTERISTIC D_InjCyShortPassThresh "cal comments" CURVE 0xC02D 2D_Array_UB 0.0 CM_Count1 0.0 255.0
 /begin AXIS_DESCR FIX_AXIS NO_INPUT_QUANTITY CM_EOI 4 0.0 4.0 MAX_GRAD 0.0 /begin FIX_AXIS_PAR_LIST 0 1 2 3 /end FIX_AXIS_PAR_LIST /end AXIS_DESCR
/end CHARACTERISTIC
/begin CHARACTERISTIC D_InjectorCylEnb "cal comments" CURVE 0xBFDF 2D_Array_UB 0.0 CM_Count1 0.0 1.0
 /begin AXIS_DESCR FIX_AXIS NO_INPUT_QUANTITY CM_EOI 4 0.0 4.0 MAX_GRAD 0.0 /begin FIX_AXIS_PAR_LIST 0 1 2 3 /end FIX_AXIS_PAR_LIST /end AXIS_DESCR
/end CHARACTERISTIC
/begin CHARACTERISTIC D_IntakeAirTempShortEnb "cal comments" VALUE 0xBFA4 Scalar_UB 0.0 CM_Boolean6 0.0 255.0 /end CHARACTERISTIC
/begin CHARACTERISTIC D_IntakeAirTempFailTimeThrsh "cal comments" VALUE 0xBF95 Scalar_UB 0.0 CM_Count3 0.0 255.0 /end CHARACTERISTIC
/begin CHARACTERISTIC D_IntakeAirTempOH1FailTimeThrsh "cal comments" VALUE 0xBF97 Scalar_UB 0.0 CM_Count3 0.0 255.0 /end CHARACTERISTIC
/begin CHARACTERISTIC D_IntakeAirTempOH2FailTimeThrsh "cal comments" VALUE 0xBF98 Scalar_UB 0.0 CM_Count3 0.0 255.0 /end CHARACTERISTIC
/begin CHARACTERISTIC D_IntakeAirTempOH1PassTimeThrsh "cal comments" VALUE 0xBF99 Scalar_UB 0.0 CM_Count3 0.0 255.0 /end CHARACTERISTIC
/begin CHARACTERISTIC D_IntakeAirTempOH2PassTimeThrsh "cal comments" VALUE 0xBF9A Scalar_UB 0.0 CM_Count3 0.0 255.0 /end CHARACTERISTIC
/begin CHARACTERISTIC D_IntakeAirTempPassTimeThrsh "cal comments" VALUE 0xBF96 Scalar_UB 0.0 CM_Count3 0.0 255.0 /end CHARACTERISTIC
/begin CHARACTERISTIC D_IntakeAirTempOHDiagRunTimeThrsh "cal comments" VALUE 0xBF94 Scalar_UB 0.0 CM_Count3 0.0 255.0 /end CHARACTERISTIC
/begin CHARACTERISTIC D_IntakeAirTempShortRangeThreshHi "cal comments" VALUE 0xBF9C Scalar_UW 0.0 CM_Percent_0to100_1 0.0 99.9984130859375 /end CHARACTERISTIC
/begin CHARACTERISTIC D_IntakeAirTempShortRangeThreshLo "cal comments" VALUE 0xBF9E Scalar_UW 0.0 CM_Percent_0to100_1 0.0 99.9984130859375 /end CHARACTERISTIC
/begin CHARACTERISTIC D_IntakeAirTempOH1Thresh "cal comments" VALUE 0xBFA0 Scalar_SW 0.0 CM_DegC_N256to256 -256.0 255.9921875 /end CHARACTERISTIC
/begin CHARACTERISTIC D_IntakeAirTempOH2Thresh "cal comments" VALUE 0xBFA2 Scalar_SW 0.0 CM_DegC_N256to256 -256.0 255.9921875 /end CHARACTERISTIC
/begin CHARACTERISTIC D_SCIShortEnb "cal comments" VALUE 0xBFB6 Scalar_UB 0.0 CM_Boolean6 0.0 255.0 /end CHARACTERISTIC
/begin CHARACTERISTIC D_SCIFailTimeThrsh "cal comments" VALUE 0xBFAE Scalar_UW 0.0 CM_Count_0to65535_1 0.0 65535.0 /end CHARACTERISTIC
/begin CHARACTERISTIC D_SCIPassTimeThrsh "cal comments" VALUE 0xBFB0 Scalar_UW 0.0 CM_Count_0to65535_3 0.0 65535.0 /end CHARACTERISTIC
/begin CHARACTERISTIC D_SCIShortRangeThreshHi "cal comments" VALUE 0xBFB2 Scalar_UW 0.0 CM_Percent_0to100_1 0.0 99.9984130859375 /end CHARACTERISTIC
/begin CHARACTERISTIC D_SCIShortRangeThreshLo "cal comments" VALUE 0xBFB4 Scalar_UW 0.0 CM_Percent_0to100_1 0.0 99.9984130859375 /end CHARACTERISTIC
/begin CHARACTERISTIC D_ACSShortHighFailTimeThrsh "cal comments" VALUE 0xBFBC Scalar_UW 0.0 CM_Count_0to65535_1 0.0 65535.0 /end CHARACTERISTIC
/begin CHARACTERISTIC D_ACSShortHighPassTimeThrsh "cal comments" VALUE 0xBFBE Scalar_UW 0.0 CM_Count_0to65535_1 0.0 65535.0 /end CHARACTERISTIC
/begin CHARACTERISTIC D_ACSShortLowFailTimeThrsh "cal comments" VALUE 0xBFC0 Scalar_UW 0.0 CM_Count_0to65535_1 0.0 65535.0 /end CHARACTERISTIC
/begin CHARACTERISTIC D_ACSShortLowPassTimeThrsh "cal comments" VALUE 0xBFC2 Scalar_UW 0.0 CM_Count_0to65535_1 0.0 65535.0 /end CHARACTERISTIC
/begin CHARACTERISTIC D_ACSShortRangeThreshHi "cal comments" VALUE 0xBFC4 Scalar_UW 0.0 CM_Percent_0to100_1 0.0 99.9984130859375 /end CHARACTERISTIC
/begin CHARACTERISTIC D_ACSShortRangeThreshLo "cal comments" VALUE 0xBFC6 Scalar_UW 0.0 CM_Percent_0to100_1 0.0 99.9984130859375 /end CHARACTERISTIC
/begin CHARACTERISTIC D_ACSShortEnb "cal comments" VALUE 0xBFC8 Scalar_UB 0.0 CM_Boolean6 0.0 255.0 /end CHARACTERISTIC
/begin CHARACTERISTIC D_WPSShortHighFailTimeThrsh "cal comments" VALUE 0x0 Scalar_UW 0.0 CM_Count_0to65535_1 0.0 65535.0 /end CHARACTERISTIC
/begin CHARACTERISTIC D_WPSShortHighPassTimeThrsh "cal comments" VALUE 0x0 Scalar_UW 0.0 CM_Count_0to65535_1 0.0 65535.0 /end CHARACTERISTIC
/begin CHARACTERISTIC D_WPSShortLowFailTimeThrsh "cal comments" VALUE 0x0 Scalar_UW 0.0 CM_Count_0to65535_1 0.0 65535.0 /end CHARACTERISTIC
/begin CHARACTERISTIC D_WPSShortLowPassTimeThrsh "cal comments" VALUE 0x0 Scalar_UW 0.0 CM_Count_0to65535_1 0.0 65535.0 /end CHARACTERISTIC
/begin CHARACTERISTIC D_WPSShortRangeThreshHi "cal comments" VALUE 0x0 Scalar_UW 0.0 CM_Percent_0to100_1 0.0 99.9984130859375 /end CHARACTERISTIC
/begin CHARACTERISTIC D_WPSShortRangeThreshLo "cal comments" VALUE 0x0 Scalar_UW 0.0 CM_Percent_0to100_1 0.0 99.9984130859375 /end CHARACTERISTIC
/begin CHARACTERISTIC D_WPSShortEnb "cal comments" VALUE 0x0 Scalar_UB 0.0 CM_Boolean6 0.0 255.0 /end CHARACTERISTIC
/begin CHARACTERISTIC D_MAPShortEnb "cal comments" VALUE 0xC008 Scalar_UB 0.0 CM_Boolean6 0.0 255.0 /end CHARACTERISTIC
/begin CHARACTERISTIC D_MAPShortHiDiagFailThrsh "cal comments" VALUE 0xC006 Scalar_UW 0.0 CM_Percent_0to100_1 0.0 99.9984130859375 /end CHARACTERISTIC
/begin CHARACTERISTIC D_MAPShortHighFailTimeThrsh "cal comments" VALUE 0xBFFC Scalar_UW 0.0 CM_Count_0to65535_2 0.0 65535.0 /end CHARACTERISTIC
/begin CHARACTERISTIC D_MAPShortHighPassTimeThrsh "cal comments" VALUE 0xBFFE Scalar_UW 0.0 CM_Count_0to65535_2 0.0 65535.0 /end CHARACTERISTIC
/begin CHARACTERISTIC D_MAPShortLoDiagFailThrsh "cal comments" VALUE 0xC004 Scalar_UW 0.0 CM_Percent_0to100_1 0.0 99.9984130859375 /end CHARACTERISTIC
/begin CHARACTERISTIC D_MAPShortLowFailTimeThrsh "cal comments" VALUE 0xC000 Scalar_UW 0.0 CM_Count_0to65535_2 0.0 65535.0 /end CHARACTERISTIC
/begin CHARACTERISTIC D_MAPShortLowPassTimeThrsh "cal comments" VALUE 0xC002 Scalar_UW 0.0 CM_Count_0to65535_2 0.0 65535.0 /end CHARACTERISTIC
/begin CHARACTERISTIC D_BSTPShortEnb "cal comments" VALUE 0xBFDA Scalar_UB 0.0 CM_Boolean6 0.0 255.0 /end CHARACTERISTIC
/begin CHARACTERISTIC D_BSTPShortHiDiagFailThrsh "cal comments" VALUE 0xBFD8 Scalar_UW 0.0 CM_Percent_0to100_1 0.0 99.9984130859375 /end CHARACTERISTIC
/begin CHARACTERISTIC D_BSTPShortHighFailTimeThrsh "cal comments" VALUE 0xBFCE Scalar_UW 0.0 CM_Count_0to65535_2 0.0 65535.0 /end CHARACTERISTIC
/begin CHARACTERISTIC D_BSTPShortHighPassTimeThrsh "cal comments" VALUE 0xBFD0 Scalar_UW 0.0 CM_Count_0to65535_2 0.0 65535.0 /end CHARACTERISTIC
/begin CHARACTERISTIC D_BSTPShortLoDiagFailThrsh "cal comments" VALUE 0xBFD6 Scalar_UW 0.0 CM_Percent_0to100_1 0.0 99.9984130859375 /end CHARACTERISTIC
/begin CHARACTERISTIC D_BSTPShortLowFailTimeThrsh "cal comments" VALUE 0xBFD2 Scalar_UW 0.0 CM_Count_0to65535_2 0.0 65535.0 /end CHARACTERISTIC
/begin CHARACTERISTIC D_BSTPShortLowPassTimeThrsh "cal comments" VALUE 0xBFD4 Scalar_UW 0.0 CM_Count_0to65535_2 0.0 65535.0 /end CHARACTERISTIC
/begin CHARACTERISTIC D_O21ShortDiagCoolTempThrsh "cal comments" VALUE 0xBEAE Scalar_SW 0.0 CM_DegC_N256to256 -256.0 255.9921875 /end CHARACTERISTIC
/begin CHARACTERISTIC D_O21ShortDiagEnableDelay "cal comments" VALUE 0xBEB0 Scalar_UW 0.0 CM_Second_0to65535 0.0 65535.0 /end CHARACTERISTIC
/begin CHARACTERISTIC D_O21ShortDiagIGNVoltThrsh "cal comments" VALUE 0xBEAC Scalar_UW 0.0 CM_Volt_0to32_1 0.0 31.99900627136231 /end CHARACTERISTIC
/begin CHARACTERISTIC D_O21ShortDiagPassTimeThrsh "cal comments" VALUE 0xBEBA Scalar_UW 0.0 CM_Count_0to65535_1 0.0 65535.0 /end CHARACTERISTIC
/begin CHARACTERISTIC D_O21ShortDiagSingalFiltCoef "cal comments" VALUE 0xBEAA Scalar_UW 0.0 CM_FiltCoef 0.0 0.9999847412109375 /end CHARACTERISTIC
/begin CHARACTERISTIC D_O21ShortEnb "cal comments" VALUE 0xBEBC Scalar_UB 0.0 CM_Boolean6 0.0 255.0 /end CHARACTERISTIC
/begin CHARACTERISTIC D_O21ShortHighFailTimeThrsh "cal comments" VALUE 0xBEB8 Scalar_UW 0.0 CM_Count_0to65535_1 0.0 65535.0 /end CHARACTERISTIC
/begin CHARACTERISTIC D_O21ShortLowFailTimeThrsh "cal comments" VALUE 0xBEB6 Scalar_UW 0.0 CM_Count_0to65535_1 0.0 65535.0 /end CHARACTERISTIC
/begin CHARACTERISTIC D_O21ShortRangeThreshHi "cal comments" VALUE 0xBEB4 Scalar_UW 0.0 CM_mVolt_2 0.0 1023.96875 /end CHARACTERISTIC
/begin CHARACTERISTIC D_O21ShortRangeThreshLo "cal comments" VALUE 0xBEB2 Scalar_UW 0.0 CM_mVolt_2 0.0 1023.96875 /end CHARACTERISTIC
/begin CHARACTERISTIC D_O22ShortDiagCoolTempThrsh "cal comments" VALUE 0x0 Scalar_SW 0.0 CM_DegC_N256to256 -256.0 255.9921875 /end CHARACTERISTIC
/begin CHARACTERISTIC D_O22ShortDiagEnableDelay "cal comments" VALUE 0x0 Scalar_UW 0.0 CM_Second_0to65535 0.0 65535.0 /end CHARACTERISTIC
/begin CHARACTERISTIC D_O22ShortDiagIGNVoltThrsh "cal comments" VALUE 0x0 Scalar_UW 0.0 CM_Volt_0to32_1 0.0 31.99900627136231 /end CHARACTERISTIC
/begin CHARACTERISTIC D_O22ShortDiagPassTimeThrsh "cal comments" VALUE 0x0 Scalar_UW 0.0 CM_Count_0to65535_1 0.0 65535.0 /end CHARACTERISTIC
/begin CHARACTERISTIC D_O22ShortDiagSingalFiltCoef "cal comments" VALUE 0x0 Scalar_UW 0.0 CM_FiltCoef 0.0 0.9999847412109375 /end CHARACTERISTIC
/begin CHARACTERISTIC D_O22ShortEnb "cal comments" VALUE 0x0 Scalar_UB 0.0 CM_Boolean6 0.0 255.0 /end CHARACTERISTIC
/begin CHARACTERISTIC D_O22ShortHighFailTimeThrsh "cal comments" VALUE 0x0 Scalar_UW 0.0 CM_Count_0to65535_1 0.0 65535.0 /end CHARACTERISTIC
/begin CHARACTERISTIC D_O22ShortLowFailTimeThrsh "cal comments" VALUE 0x0 Scalar_UW 0.0 CM_Count_0to65535_1 0.0 65535.0 /end CHARACTERISTIC
/begin CHARACTERISTIC D_O22ShortRangeThreshHi "cal comments" VALUE 0x0 Scalar_UW 0.0 CM_mVolt_2 0.0 1023.96875 /end CHARACTERISTIC
/begin CHARACTERISTIC D_O22ShortRangeThreshLo "cal comments" VALUE 0x0 Scalar_UW 0.0 CM_mVolt_2 0.0 1023.96875 /end CHARACTERISTIC
/begin CHARACTERISTIC D_RO21ShortDiagCoolTempThrsh "cal comments" VALUE 0xBEC6 Scalar_SW 0.0 CM_DegC_N256to256 -256.0 255.9921875 /end CHARACTERISTIC
/begin CHARACTERISTIC D_RO21ShortDiagEnableDelay "cal comments" VALUE 0xBEC8 Scalar_UW 0.0 CM_Second_0to65535 0.0 65535.0 /end CHARACTERISTIC
/begin CHARACTERISTIC D_RO21ShortDiagIGNVoltThrsh "cal comments" VALUE 0xBEC4 Scalar_UW 0.0 CM_Volt_0to32_1 0.0 31.99900627136231 /end CHARACTERISTIC
/begin CHARACTERISTIC D_RO21ShortDiagPassTimeThrsh "cal comments" VALUE 0xBED2 Scalar_UW 0.0 CM_Count_0to65535_1 0.0 65535.0 /end CHARACTERISTIC
/begin CHARACTERISTIC D_RO21ShortDiagSingalFiltCoef "cal comments" VALUE 0xBEC2 Scalar_UW 0.0 CM_FiltCoef 0.0 0.9999847412109375 /end CHARACTERISTIC
/begin CHARACTERISTIC D_RO21ShortEnb "cal comments" VALUE 0xBED4 Scalar_UB 0.0 CM_Boolean6 0.0 255.0 /end CHARACTERISTIC
/begin CHARACTERISTIC D_RO21ShortHighFailTimeThrsh "cal comments" VALUE 0xBED0 Scalar_UW 0.0 CM_Count_0to65535_1 0.0 65535.0 /end CHARACTERISTIC
/begin CHARACTERISTIC D_RO21ShortLowFailTimeThrsh "cal comments" VALUE 0xBECE Scalar_UW 0.0 CM_Count_0to65535_1 0.0 65535.0 /end CHARACTERISTIC
/begin CHARACTERISTIC D_RO21ShortRangeThreshHi "cal comments" VALUE 0xBECC Scalar_UW 0.0 CM_mVolt_2 0.0 1023.96875 /end CHARACTERISTIC
/begin CHARACTERISTIC D_RO21ShortRangeThreshLo "cal comments" VALUE 0xBECA Scalar_UW 0.0 CM_mVolt_2 0.0 1023.96875 /end CHARACTERISTIC
/begin CHARACTERISTIC D_O2HeaterShortEnb "cal comments" VALUE 0xBF46 Scalar_UB 0.0 CM_Boolean6 0.0 255.0 /end CHARACTERISTIC
/begin CHARACTERISTIC D_O2HeaterShortFailThresh "cal comments" VALUE 0xBF47 Scalar_UB 0.0 CM_Count1 0.0 255.0 /end CHARACTERISTIC
/begin CHARACTERISTIC D_O2HeaterShortPassThresh "cal comments" VALUE 0xBF48 Scalar_UB 0.0 CM_Count1 0.0 255.0 /end CHARACTERISTIC
/begin CHARACTERISTIC D_RO2Heater1ShortEnb "cal comments" VALUE 0xBF4D Scalar_UB 0.0 CM_Boolean6 0.0 255.0 /end CHARACTERISTIC
/begin CHARACTERISTIC D_RO2Heater1ShortFailThresh "cal comments" VALUE 0xBF4E Scalar_UB 0.0 CM_Count1 0.0 255.0 /end CHARACTERISTIC
/begin CHARACTERISTIC D_RO2Heater1ShortPassThresh "cal comments" VALUE 0xBF4F Scalar_UB 0.0 CM_Count1 0.0 255.0 /end CHARACTERISTIC
/begin CHARACTERISTIC D_BSTCShortEnb "cal comments" VALUE 0xBF7E Scalar_UB 0.0 CM_Boolean6 0.0 255.0 /end CHARACTERISTIC
/begin CHARACTERISTIC D_BSTCShortFailThresh "cal comments" VALUE 0xBF7F Scalar_UB 0.0 CM_Count1 0.0 255.0 /end CHARACTERISTIC
/begin CHARACTERISTIC D_BSTCShortPassThresh "cal comments" VALUE 0xBF80 Scalar_UB 0.0 CM_Count1 0.0 255.0 /end CHARACTERISTIC
/begin CHARACTERISTIC D_REF1ShortEnb "cal comments" VALUE 0xBF70 Scalar_UB 0.0 CM_Boolean6 0.0 255.0 /end CHARACTERISTIC
/begin CHARACTERISTIC D_REF1ShortFailThresh "cal comments" VALUE 0xBF71 Scalar_UB 0.0 CM_Count1 0.0 255.0 /end CHARACTERISTIC
/begin CHARACTERISTIC D_REF1ShortPassThresh "cal comments" VALUE 0xBF72 Scalar_UB 0.0 CM_Count1 0.0 255.0 /end CHARACTERISTIC
/begin CHARACTERISTIC D_REF2ShortEnb "cal comments" VALUE 0xBF77 Scalar_UB 0.0 CM_Boolean6 0.0 255.0 /end CHARACTERISTIC
/begin CHARACTERISTIC D_REF2ShortFailThresh "cal comments" VALUE 0xBF78 Scalar_UB 0.0 CM_Count1 0.0 255.0 /end CHARACTERISTIC
/begin CHARACTERISTIC D_REF2ShortPassThresh "cal comments" VALUE 0xBF79 Scalar_UB 0.0 CM_Count1 0.0 255.0 /end CHARACTERISTIC
/begin CHARACTERISTIC D_BLM_TrimEnb "cal comments" VALUE 0xBEDA Scalar_UB 0.0 CM_Boolean6 0.0 255.0 /end CHARACTERISTIC
/begin CHARACTERISTIC D_BLM_FailThresh "cal comments" VALUE 0xBEE0 Scalar_UB 0.0 CM_Count1 0.0 255.0 /end CHARACTERISTIC
/begin CHARACTERISTIC D_BLM_PassThresh "cal comments" VALUE 0xBEE1 Scalar_UB 0.0 CM_Count1 0.0 255.0 /end CHARACTERISTIC
/begin CHARACTERISTIC D_BLM_TrimHiLimit "cal comments" VALUE 0xBEDC Scalar_UW 0.0 CM_Ratio_0to2_2 0.0 1.999969482421875 /end CHARACTERISTIC
/begin CHARACTERISTIC D_BLM_TrimLoLimit "cal comments" VALUE 0xBEDE Scalar_UW 0.0 CM_Ratio_0to2_2 0.0 1.999969482421875 /end CHARACTERISTIC
/begin CHARACTERISTIC D_BLM_CellCntThresh "cal comments" VALUE 0xBEDB Scalar_UB 0.0 CM_Count1 0.0 255.0 /end CHARACTERISTIC
/begin CHARACTERISTIC D_IACVShortEnb "cal comments" VALUE 0xBF54 Scalar_UB 0.0 CM_Boolean6 0.0 255.0 /end CHARACTERISTIC
/begin CHARACTERISTIC D_IACVShortFailThresh "cal comments" VALUE 0xBF55 Scalar_UB 0.0 CM_Count1 0.0 255.0 /end CHARACTERISTIC
/begin CHARACTERISTIC D_IACVShortPassThresh "cal comments" VALUE 0xBF56 Scalar_UB 0.0 CM_Count1 0.0 255.0 /end CHARACTERISTIC
/begin CHARACTERISTIC D_FCV1ShortEnb "cal comments" VALUE 0xBF5B Scalar_UB 0.0 CM_Boolean6 0.0 255.0 /end CHARACTERISTIC
/begin CHARACTERISTIC D_FCV1ShortFailThresh "cal comments" VALUE 0xBF5C Scalar_UB 0.0 CM_Count1 0.0 255.0 /end CHARACTERISTIC
/begin CHARACTERISTIC D_FCV1ShortPassThresh "cal comments" VALUE 0xBF5D Scalar_UB 0.0 CM_Count1 0.0 255.0 /end CHARACTERISTIC
/begin CHARACTERISTIC D_FCV2ShortEnb "cal comments" VALUE 0xBF62 Scalar_UB 0.0 CM_Boolean6 0.0 255.0 /end CHARACTERISTIC
/begin CHARACTERISTIC D_FCV2ShortFailThresh "cal comments" VALUE 0xBF63 Scalar_UB 0.0 CM_Count1 0.0 255.0 /end CHARACTERISTIC
/begin CHARACTERISTIC D_FCV2ShortPassThresh "cal comments" VALUE 0xBF64 Scalar_UB 0.0 CM_Count1 0.0 255.0 /end CHARACTERISTIC
/begin CHARACTERISTIC D_FBPVShortEnb "cal comments" VALUE 0xBF69 Scalar_UB 0.0 CM_Boolean6 0.0 255.0 /end CHARACTERISTIC
/begin CHARACTERISTIC D_FBPVShortFailThresh "cal comments" VALUE 0xBF6A Scalar_UB 0.0 CM_Count1 0.0 255.0 /end CHARACTERISTIC
/begin CHARACTERISTIC D_FBPVShortPassThresh "cal comments" VALUE 0xBF6B Scalar_UB 0.0 CM_Count1 0.0 255.0 /end CHARACTERISTIC
/begin CHARACTERISTIC D_OutputDiagEnableDelay "cal comments" VALUE 0xC020 Scalar_UB 0.0 CM_Second_0to32 0.0 31.875 /end CHARACTERISTIC
/begin CHARACTERISTIC D_SoftwareErrorEnb "cal comments" VALUE 0xC036 Scalar_UB 0.0 CM_Boolean6 0.0 255.0 /end CHARACTERISTIC
/begin CHARACTERISTIC D_SoftwareErrorFailTimeThrsh "cal comments" VALUE 0xC032 Scalar_UW 0.0 CM_Count_0to65535_2 0.0 65535.0 /end CHARACTERISTIC
/begin CHARACTERISTIC D_SoftwareErrorPassTimeThrsh "cal comments" VALUE 0xC034 Scalar_UW 0.0 CM_Count_0to65535_2 0.0 65535.0 /end CHARACTERISTIC
/begin CHARACTERISTIC D_FPFeedbackInputEnb "cal comments" VALUE 0xBF1C Scalar_UB 0.0 CM_Boolean6 0.0 255.0 /end CHARACTERISTIC
/begin CHARACTERISTIC D_FPFeedbackShortFailThresh "cal comments" VALUE 0xBF1A Scalar_UB 0.0 CM_Count3 0.0 255.0 /end CHARACTERISTIC
/begin CHARACTERISTIC D_FPFeedbackShortPassThresh "cal comments" VALUE 0xBF1B Scalar_UB 0.0 CM_Count3 0.0 255.0 /end CHARACTERISTIC
/begin CHARACTERISTIC D_OilPressureInputEnb "cal comments" VALUE 0xC011 Scalar_UB 0.0 CM_Boolean6 0.0 255.0 /end CHARACTERISTIC
/begin CHARACTERISTIC D_OilPressureShortFailThresh "cal comments" VALUE 0xC00F Scalar_UB 0.0 CM_Count3 0.0 255.0 /end CHARACTERISTIC
/begin CHARACTERISTIC D_OilPressureShortPassThresh "cal comments" VALUE 0xC010 Scalar_UB 0.0 CM_Count3 0.0 255.0 /end CHARACTERISTIC
/begin CHARACTERISTIC D_OilPressureShortDiagRunTimeThrsh "cal comments" VALUE 0xC00E Scalar_UB 0.0 CM_Count3 0.0 255.0 /end CHARACTERISTIC
/begin CHARACTERISTIC D_OilSWLowActive "cal comments" VALUE 0xC012 Scalar_UB 0.0 CM_Boolean6 0.0 255.0 /end CHARACTERISTIC
/begin CHARACTERISTIC D_OilSWDiagDucar "cal comments" VALUE 0xC013 Scalar_UB 0.0 CM_Boolean6 0.0 255.0 /end CHARACTERISTIC
/begin CHARACTERISTIC D_OPShrtFailTimeThrsh "cal comments" VALUE 0xC016 Scalar_UB 0.0 CM_Count3 0.0 255.0 /end CHARACTERISTIC
/begin CHARACTERISTIC D_OPPassTimeThrsh "cal comments" VALUE 0xC017 Scalar_UB 0.0 CM_Count3 0.0 255.0 /end CHARACTERISTIC
/begin CHARACTERISTIC D_OPShortRangeThreshHi "cal comments" VALUE 0xC018 Scalar_UW 0.0 CM_Percent_0to100_1 0.0 99.9984130859375 /end CHARACTERISTIC
/begin CHARACTERISTIC D_OPShortRangeThreshLo "cal comments" VALUE 0xC01A Scalar_UW 0.0 CM_Percent_0to100_1 0.0 99.9984130859375 /end CHARACTERISTIC
/begin CHARACTERISTIC D_SpkCoilShortFailThresh "cal comments" CURVE 0xC021 2D_Array_UB 0.0 CM_Count1 0.0 255.0
 /begin AXIS_DESCR FIX_AXIS NO_INPUT_QUANTITY CM_EOI 4 0.0 4.0 MAX_GRAD 0.0 /begin FIX_AXIS_PAR_LIST 0 1 2 3 /end FIX_AXIS_PAR_LIST /end AXIS_DESCR
/end CHARACTERISTIC
/begin CHARACTERISTIC D_SpkCoilShortPassThresh "cal comments" CURVE 0xC025 2D_Array_UB 0.0 CM_Count1 0.0 255.0
 /begin AXIS_DESCR FIX_AXIS NO_INPUT_QUANTITY CM_EOI 4 0.0 4.0 MAX_GRAD 0.0 /begin FIX_AXIS_PAR_LIST 0 1 2 3 /end FIX_AXIS_PAR_LIST /end AXIS_DESCR
/end CHARACTERISTIC
/begin CHARACTERISTIC D_TPSMotorControlEnb "cal comments" VALUE 0xBF86 Scalar_UB 0.0 CM_Boolean6 0.0 255.0 /end CHARACTERISTIC
/begin CHARACTERISTIC D_TPSMotorDiagFailTimeThresh "cal comments" VALUE 0xBF88 Scalar_UW 0.0 CM_Count_0to65535_1 0.0 65535.0 /end CHARACTERISTIC
/begin CHARACTERISTIC D_TPSMotorDiagPassTimeThresh "cal comments" VALUE 0xBF8A Scalar_UW 0.0 CM_Count_0to65535_1 0.0 65535.0 /end CHARACTERISTIC
/begin CHARACTERISTIC D_TPSMotorDiagTPSErrThresh "cal comments" VALUE 0xBF90 Scalar_UW 0.0 CM_Percent_0to200_2 0.0 199.9969024658203 /end CHARACTERISTIC
/begin CHARACTERISTIC D_TPSMotorDynErrThrDecayStep "cal comments" VALUE 0xBF8E Scalar_UW 0.0 CM_Percent_0to200_2 0.0 199.9969024658203 /end CHARACTERISTIC
/begin CHARACTERISTIC D_TPSMotorDynErrThrshGain "cal comments" VALUE 0xBF8C Scalar_UW 0.0 udf_CM_18376 0.0 15.999755859375 /end CHARACTERISTIC
/begin CHARACTERISTIC D_FCVMotorControlEnb "cal comments" VALUE 0xBF38 Scalar_UB 0.0 CM_Boolean6 0.0 255.0 /end CHARACTERISTIC
/begin CHARACTERISTIC D_FCVMotorDiagFailTimeThresh "cal comments" VALUE 0xBF3A Scalar_UW 0.0 CM_Count_0to65535_1 0.0 65535.0 /end CHARACTERISTIC
/begin CHARACTERISTIC D_FCVMotorDiagPassTimeThresh "cal comments" VALUE 0xBF3C Scalar_UW 0.0 CM_Count_0to65535_1 0.0 65535.0 /end CHARACTERISTIC
/begin CHARACTERISTIC D_FCVMotorDiagFCVPSErrThresh "cal comments" VALUE 0xBF42 Scalar_UW 0.0 CM_Percent_0to200_2 0.0 199.9969024658203 /end CHARACTERISTIC
/begin CHARACTERISTIC D_FCVMotorDynErrThrDecayStep "cal comments" VALUE 0xBF40 Scalar_UW 0.0 CM_Percent_0to200_2 0.0 199.9969024658203 /end CHARACTERISTIC
/begin CHARACTERISTIC D_FCVMotorDynErrThrshGain "cal comments" VALUE 0xBF3E Scalar_UW 0.0 udf_CM_18376 0.0 15.999755859375 /end CHARACTERISTIC
/begin CHARACTERISTIC D_SWLOnMinDuration "cal comments" VALUE 0xBE81 Scalar_UB 0.0 CM_Second_0to32 0.0 31.0 /end CHARACTERISTIC
/begin CHARACTERISTIC D_IGNOffInitDDMS "cal comments" VALUE 0xBE82 Scalar_UB 0.0 CM_Boolean1 0.0 1.0 /end CHARACTERISTIC
/begin CHARACTERISTIC D_StopLightKillEn "cal comments" VALUE 0xBE83 Scalar_UB 0.0 CM_Boolean1 0.0 1.0 /end CHARACTERISTIC
/begin CHARACTERISTIC D_ProtectLightKillEn "cal comments" VALUE 0xBE84 Scalar_UB 0.0 CM_Boolean1 0.0 1.0 /end CHARACTERISTIC
/begin CHARACTERISTIC D_MilLightMode "cal comments" VALUE 0xBE85 Scalar_UB 0.0 CM_Count1 0.0 255.0 /end CHARACTERISTIC
/begin CHARACTERISTIC D_O21ShortLoLightType "cal comments" VALUE 0xBEBD Scalar_UB 0.0 CM_LIGHT_TYPE 0.0 4.0 /end CHARACTERISTIC
/begin CHARACTERISTIC D_O21ShortHiLightType "cal comments" VALUE 0xBEBE Scalar_UB 0.0 CM_LIGHT_TYPE 0.0 4.0 /end CHARACTERISTIC
/begin CHARACTERISTIC D_O22ShortLoLightType "cal comments" VALUE 0x0 Scalar_UB 0.0 CM_LIGHT_TYPE 0.0 4.0 /end CHARACTERISTIC
/begin CHARACTERISTIC D_O22ShortHiLightType "cal comments" VALUE 0x0 Scalar_UB 0.0 CM_LIGHT_TYPE 0.0 4.0 /end CHARACTERISTIC
/begin CHARACTERISTIC D_RO21ShortLoLightType "cal comments" VALUE 0xBED5 Scalar_UB 0.0 CM_LIGHT_TYPE 0.0 4.0 /end CHARACTERISTIC
/begin CHARACTERISTIC D_RO21ShortHiLightType "cal comments" VALUE 0xBED6 Scalar_UB 0.0 CM_LIGHT_TYPE 0.0 4.0 /end CHARACTERISTIC
/begin CHARACTERISTIC D_O2HeaterShortLoLightType "cal comments" VALUE 0xBF49 Scalar_UB 0.0 CM_LIGHT_TYPE 0.0 4.0 /end CHARACTERISTIC
/begin CHARACTERISTIC D_O2HeaterShortHiLightType "cal comments" VALUE 0xBF4A Scalar_UB 0.0 CM_LIGHT_TYPE 0.0 4.0 /end CHARACTERISTIC
/begin CHARACTERISTIC D_RO2Heater1ShortLoLightType "cal comments" VALUE 0xBF50 Scalar_UB 0.0 CM_LIGHT_TYPE 0.0 4.0 /end CHARACTERISTIC
/begin CHARACTERISTIC D_RO2Heater1ShortHiLightType "cal comments" VALUE 0xBF51 Scalar_UB 0.0 CM_LIGHT_TYPE 0.0 4.0 /end CHARACTERISTIC
/begin CHARACTERISTIC D_CoolTempShortLoLightType "cal comments" VALUE 0xBEA1 Scalar_UB 0.0 CM_LIGHT_TYPE 0.0 4.0 /end CHARACTERISTIC
/begin CHARACTERISTIC D_CoolTempShortHiLightType "cal comments" VALUE 0xBEA2 Scalar_UB 0.0 CM_LIGHT_TYPE 0.0 4.0 /end CHARACTERISTIC
/begin CHARACTERISTIC D_CoolTempOH1LightType "cal comments" VALUE 0xBEA3 Scalar_UB 0.0 CM_LIGHT_TYPE 0.0 4.0 /end CHARACTERISTIC
/begin CHARACTERISTIC D_CoolTempOH2LightType "cal comments" VALUE 0xBEA4 Scalar_UB 0.0 CM_LIGHT_TYPE 0.0 4.0 /end CHARACTERISTIC
/begin CHARACTERISTIC D_IntakeAirTempShortLoLightType "cal comments" VALUE 0xBFA5 Scalar_UB 0.0 CM_LIGHT_TYPE 0.0 4.0 /end CHARACTERISTIC
/begin CHARACTERISTIC D_IntakeAirTempShortHiLightType "cal comments" VALUE 0xBFA6 Scalar_UB 0.0 CM_LIGHT_TYPE 0.0 4.0 /end CHARACTERISTIC
/begin CHARACTERISTIC D_IntakeAirTempOH1LightType "cal comments" VALUE 0xBFA7 Scalar_UB 0.0 CM_LIGHT_TYPE 0.0 4.0 /end CHARACTERISTIC
/begin CHARACTERISTIC D_IntakeAirTempOH2LightType "cal comments" VALUE 0xBFA8 Scalar_UB 0.0 CM_LIGHT_TYPE 0.0 4.0 /end CHARACTERISTIC
/begin CHARACTERISTIC D_SCIShortLoLightType "cal comments" VALUE 0xBFB7 Scalar_UB 0.0 CM_LIGHT_TYPE 0.0 4.0 /end CHARACTERISTIC
/begin CHARACTERISTIC D_SCIShortHiLightType "cal comments" VALUE 0xBFB8 Scalar_UB 0.0 CM_LIGHT_TYPE 0.0 4.0 /end CHARACTERISTIC
/begin CHARACTERISTIC D_BSTPShortLoLightType "cal comments" VALUE 0xBFDB Scalar_UB 0.0 CM_LIGHT_TYPE 0.0 4.0 /end CHARACTERISTIC
/begin CHARACTERISTIC D_BSTPShortHiLightType "cal comments" VALUE 0xBFDC Scalar_UB 0.0 CM_LIGHT_TYPE 0.0 4.0 /end CHARACTERISTIC
/begin CHARACTERISTIC D_BSTCShortLoLightType "cal comments" VALUE 0xBF81 Scalar_UB 0.0 CM_LIGHT_TYPE 0.0 4.0 /end CHARACTERISTIC
/begin CHARACTERISTIC D_BSTCShortHiLightType "cal comments" VALUE 0xBF82 Scalar_UB 0.0 CM_LIGHT_TYPE 0.0 4.0 /end CHARACTERISTIC
/begin CHARACTERISTIC D_MAPShortLoLightType "cal comments" VALUE 0xC009 Scalar_UB 0.0 CM_LIGHT_TYPE 0.0 4.0 /end CHARACTERISTIC
/begin CHARACTERISTIC D_MAPShortHiLightType "cal comments" VALUE 0xC00A Scalar_UB 0.0 CM_LIGHT_TYPE 0.0 4.0 /end CHARACTERISTIC
/begin CHARACTERISTIC D_FPShortLoLightType "cal comments" VALUE 0xBF2F Scalar_UB 0.0 CM_LIGHT_TYPE 0.0 4.0 /end CHARACTERISTIC
/begin CHARACTERISTIC D_FPShortHiLightType "cal comments" VALUE 0xBF30 Scalar_UB 0.0 CM_LIGHT_TYPE 0.0 4.0 /end CHARACTERISTIC
/begin CHARACTERISTIC D_FPLoLightType "cal comments" VALUE 0xBF32 Scalar_UB 0.0 CM_LIGHT_TYPE 0.0 4.0 /end CHARACTERISTIC
/begin CHARACTERISTIC D_FPHiLightType "cal comments" VALUE 0xBF31 Scalar_UB 0.0 CM_LIGHT_TYPE 0.0 4.0 /end CHARACTERISTIC
/begin CHARACTERISTIC D_OPShortLoLightType "cal comments" VALUE 0xC01C Scalar_UB 0.0 CM_LIGHT_TYPE 0.0 4.0 /end CHARACTERISTIC
/begin CHARACTERISTIC D_OPShortHiLightType "cal comments" VALUE 0xC01D Scalar_UB 0.0 CM_LIGHT_TYPE 0.0 4.0 /end CHARACTERISTIC
/begin CHARACTERISTIC D_OilPressureLightType "cal comments" VALUE 0xC014 Scalar_UB 0.0 CM_LIGHT_TYPE 0.0 4.0 /end CHARACTERISTIC
/begin CHARACTERISTIC D_TPSShortLoLightType "cal comments" VALUE 0xC045 Scalar_UB 0.0 CM_LIGHT_TYPE 0.0 4.0 /end CHARACTERISTIC
/begin CHARACTERISTIC D_TPSShortHiLightType "cal comments" VALUE 0xC046 Scalar_UB 0.0 CM_LIGHT_TYPE 0.0 4.0 /end CHARACTERISTIC
/begin CHARACTERISTIC D_DCMShortLoLightType "cal comments" VALUE 0xBE7D Scalar_UB 0.0 CM_LIGHT_TYPE 0.0 4.0 /end CHARACTERISTIC
/begin CHARACTERISTIC D_DCMShortHiLightType "cal comments" VALUE 0xBE7E Scalar_UB 0.0 CM_LIGHT_TYPE 0.0 4.0 /end CHARACTERISTIC
/begin CHARACTERISTIC D_TPSMotorControlLightType "cal comments" VALUE 0xBF92 Scalar_UB 0.0 CM_LIGHT_TYPE 0.0 4.0 /end CHARACTERISTIC
/begin CHARACTERISTIC D_FCVPSShortLoLightType "cal comments" VALUE 0xC053 Scalar_UB 0.0 CM_LIGHT_TYPE 0.0 4.0 /end CHARACTERISTIC
/begin CHARACTERISTIC D_FCVPSShortHiLightType "cal comments" VALUE 0xC054 Scalar_UB 0.0 CM_LIGHT_TYPE 0.0 4.0 /end CHARACTERISTIC
/begin CHARACTERISTIC D_FCVMShortLoLightType "cal comments" VALUE 0xBE86 Scalar_UB 0.0 CM_LIGHT_TYPE 0.0 4.0 /end CHARACTERISTIC
/begin CHARACTERISTIC D_FCVMShortHiLightType "cal comments" VALUE 0xBE87 Scalar_UB 0.0 CM_LIGHT_TYPE 0.0 4.0 /end CHARACTERISTIC
/begin CHARACTERISTIC D_FCVMotorControlLightType "cal comments" VALUE 0xBF44 Scalar_UB 0.0 CM_LIGHT_TYPE 0.0 4.0 /end CHARACTERISTIC
/begin CHARACTERISTIC D_FCV1ShortLoLightType "cal comments" VALUE 0xBF5E Scalar_UB 0.0 CM_LIGHT_TYPE 0.0 4.0 /end CHARACTERISTIC
/begin CHARACTERISTIC D_FCV1ShortHiLightType "cal comments" VALUE 0xBF5F Scalar_UB 0.0 CM_LIGHT_TYPE 0.0 4.0 /end CHARACTERISTIC
/begin CHARACTERISTIC D_FCV2ShortLoLightType "cal comments" VALUE 0xBF65 Scalar_UB 0.0 CM_LIGHT_TYPE 0.0 4.0 /end CHARACTERISTIC
/begin CHARACTERISTIC D_FCV2ShortHiLightType "cal comments" VALUE 0xBF66 Scalar_UB 0.0 CM_LIGHT_TYPE 0.0 4.0 /end CHARACTERISTIC
/begin CHARACTERISTIC D_FBPVShortLoLightType "cal comments" VALUE 0xBF6C Scalar_UB 0.0 CM_LIGHT_TYPE 0.0 4.0 /end CHARACTERISTIC
/begin CHARACTERISTIC D_FBPVShortHiLightType "cal comments" VALUE 0xBF6D Scalar_UB 0.0 CM_LIGHT_TYPE 0.0 4.0 /end CHARACTERISTIC
/begin CHARACTERISTIC D_REF1ShortLoLightType "cal comments" VALUE 0xBF73 Scalar_UB 0.0 CM_LIGHT_TYPE 0.0 4.0 /end CHARACTERISTIC
/begin CHARACTERISTIC D_REF1ShortHiLightType "cal comments" VALUE 0xBF74 Scalar_UB 0.0 CM_LIGHT_TYPE 0.0 4.0 /end CHARACTERISTIC
/begin CHARACTERISTIC D_REF2ShortLoLightType "cal comments" VALUE 0xBF7A Scalar_UB 0.0 CM_LIGHT_TYPE 0.0 4.0 /end CHARACTERISTIC
/begin CHARACTERISTIC D_REF2ShortHiLightType "cal comments" VALUE 0xBF7B Scalar_UB 0.0 CM_LIGHT_TYPE 0.0 4.0 /end CHARACTERISTIC
/begin CHARACTERISTIC D_BLM_TrimLoLightType "cal comments" VALUE 0xBEE2 Scalar_UB 0.0 CM_LIGHT_TYPE 0.0 4.0 /end CHARACTERISTIC
/begin CHARACTERISTIC D_BLM_TrimHiLightType "cal comments" VALUE 0xBEE3 Scalar_UB 0.0 CM_LIGHT_TYPE 0.0 4.0 /end CHARACTERISTIC
/begin CHARACTERISTIC D_IgnitionCoil1LoLightType "cal comments" VALUE 0xBF00 Scalar_UB 0.0 CM_LIGHT_TYPE 0.0 4.0 /end CHARACTERISTIC
/begin CHARACTERISTIC D_IgnitionCoil1HiLightType "cal comments" VALUE 0xBF01 Scalar_UB 0.0 CM_LIGHT_TYPE 0.0 4.0 /end CHARACTERISTIC
/begin CHARACTERISTIC D_IgnitionCoil2LoLightType "cal comments" VALUE 0xBF02 Scalar_UB 0.0 CM_LIGHT_TYPE 0.0 4.0 /end CHARACTERISTIC
/begin CHARACTERISTIC D_IgnitionCoil2HiLightType "cal comments" VALUE 0xBF03 Scalar_UB 0.0 CM_LIGHT_TYPE 0.0 4.0 /end CHARACTERISTIC
/begin CHARACTERISTIC D_IgnitionCoil3LoLightType "cal comments" VALUE 0xBF04 Scalar_UB 0.0 CM_LIGHT_TYPE 0.0 4.0 /end CHARACTERISTIC
/begin CHARACTERISTIC D_IgnitionCoil3HiLightType "cal comments" VALUE 0xBF05 Scalar_UB 0.0 CM_LIGHT_TYPE 0.0 4.0 /end CHARACTERISTIC
/begin CHARACTERISTIC D_IgnitionCoil4LoLightType "cal comments" VALUE 0xBF06 Scalar_UB 0.0 CM_LIGHT_TYPE 0.0 4.0 /end CHARACTERISTIC
/begin CHARACTERISTIC D_IgnitionCoil4HiLightType "cal comments" VALUE 0xBF07 Scalar_UB 0.0 CM_LIGHT_TYPE 0.0 4.0 /end CHARACTERISTIC
/begin CHARACTERISTIC D_InjectorCyl1LoLightType "cal comments" VALUE 0xBFE3 Scalar_UB 0.0 CM_LIGHT_TYPE 0.0 4.0 /end CHARACTERISTIC
/begin CHARACTERISTIC D_InjectorCyl1HiLightType "cal comments" VALUE 0xBFE4 Scalar_UB 0.0 CM_LIGHT_TYPE 0.0 4.0 /end CHARACTERISTIC
/begin CHARACTERISTIC D_InjectorCyl2LoLightType "cal comments" VALUE 0xBFE5 Scalar_UB 0.0 CM_LIGHT_TYPE 0.0 4.0 /end CHARACTERISTIC
/begin CHARACTERISTIC D_InjectorCyl2HiLightType "cal comments" VALUE 0xBFE6 Scalar_UB 0.0 CM_LIGHT_TYPE 0.0 4.0 /end CHARACTERISTIC
/begin CHARACTERISTIC D_InjectorCyl3LoLightType "cal comments" VALUE 0xBFE7 Scalar_UB 0.0 CM_LIGHT_TYPE 0.0 4.0 /end CHARACTERISTIC
/begin CHARACTERISTIC D_InjectorCyl3HiLightType "cal comments" VALUE 0xBFE8 Scalar_UB 0.0 CM_LIGHT_TYPE 0.0 4.0 /end CHARACTERISTIC
/begin CHARACTERISTIC D_InjectorCyl4LoLightType "cal comments" VALUE 0xBFE9 Scalar_UB 0.0 CM_LIGHT_TYPE 0.0 4.0 /end CHARACTERISTIC
/begin CHARACTERISTIC D_InjectorCyl4HiLightType "cal comments" VALUE 0xBFEA Scalar_UB 0.0 CM_LIGHT_TYPE 0.0 4.0 /end CHARACTERISTIC
/begin CHARACTERISTIC D_CrankSignalLossLightType "cal comments" VALUE 0xBEF5 Scalar_UB 0.0 CM_LIGHT_TYPE 0.0 4.0 /end CHARACTERISTIC
/begin CHARACTERISTIC D_CrankSignalNoiseLightType "cal comments" VALUE 0xBEF6 Scalar_UB 0.0 CM_LIGHT_TYPE 0.0 4.0 /end CHARACTERISTIC
/begin CHARACTERISTIC D_BatVoltLoLightType "cal comments" VALUE 0xC071 Scalar_UB 0.0 CM_LIGHT_TYPE 0.0 4.0 /end CHARACTERISTIC
/begin CHARACTERISTIC D_BatVoltHiLightType "cal comments" VALUE 0xC072 Scalar_UB 0.0 CM_LIGHT_TYPE 0.0 4.0 /end CHARACTERISTIC
/begin CHARACTERISTIC D_KNK1LightType "cal comments" VALUE 0xBE88 Scalar_UB 0.0 CM_LIGHT_TYPE 0.0 4.0 /end CHARACTERISTIC
/begin CHARACTERISTIC D_KNK2LightType "cal comments" VALUE 0xBE89 Scalar_UB 0.0 CM_LIGHT_TYPE 0.0 4.0 /end CHARACTERISTIC
/begin CHARACTERISTIC D_IACVShortLoLightType "cal comments" VALUE 0xBF57 Scalar_UB 0.0 CM_LIGHT_TYPE 0.0 4.0 /end CHARACTERISTIC
/begin CHARACTERISTIC D_IACVShortHiLightType "cal comments" VALUE 0xBF58 Scalar_UB 0.0 CM_LIGHT_TYPE 0.0 4.0 /end CHARACTERISTIC
/begin CHARACTERISTIC D_FuelPumpShortLoLightType "cal comments" VALUE 0xBF16 Scalar_UB 0.0 CM_LIGHT_TYPE 0.0 4.0 /end CHARACTERISTIC
/begin CHARACTERISTIC D_FuelPumpShortHiLightType "cal comments" VALUE 0xBF17 Scalar_UB 0.0 CM_LIGHT_TYPE 0.0 4.0 /end CHARACTERISTIC
/begin CHARACTERISTIC D_FPFeedbackLightType "cal comments" VALUE 0xBF1D Scalar_UB 0.0 CM_LIGHT_TYPE 0.0 4.0 /end CHARACTERISTIC
/begin CHARACTERISTIC D_CCPShortLoLightType "cal comments" VALUE 0x0 Scalar_UB 0.0 CM_LIGHT_TYPE 0.0 4.0 /end CHARACTERISTIC
/begin CHARACTERISTIC D_CCPShortHiLightType "cal comments" VALUE 0x0 Scalar_UB 0.0 CM_LIGHT_TYPE 0.0 4.0 /end CHARACTERISTIC
/begin CHARACTERISTIC D_SoftwareErrorLightType "cal comments" VALUE 0xC037 Scalar_UB 0.0 CM_LIGHT_TYPE 0.0 4.0 /end CHARACTERISTIC
/begin CHARACTERISTIC D_ACSShortLoLightType "cal comments" VALUE 0xBFC9 Scalar_UB 0.0 CM_LIGHT_TYPE 0.0 4.0 /end CHARACTERISTIC
/begin CHARACTERISTIC D_ACSShortHiLightType "cal comments" VALUE 0xBFCA Scalar_UB 0.0 CM_LIGHT_TYPE 0.0 4.0 /end CHARACTERISTIC
/begin CHARACTERISTIC D_WPSShortLoLightType "cal comments" VALUE 0x0 Scalar_UB 0.0 CM_LIGHT_TYPE 0.0 4.0 /end CHARACTERISTIC
/begin CHARACTERISTIC D_WPSShortHiLightType "cal comments" VALUE 0x0 Scalar_UB 0.0 CM_LIGHT_TYPE 0.0 4.0 /end CHARACTERISTIC
/begin CHARACTERISTIC D_GENVLoLightType "cal comments" VALUE 0x0 Scalar_UB 0.0 CM_LIGHT_TYPE 0.0 4.0 /end CHARACTERISTIC
/begin CHARACTERISTIC D_GENVHiLightType "cal comments" VALUE 0x0 Scalar_UB 0.0 CM_LIGHT_TYPE 0.0 4.0 /end CHARACTERISTIC
/begin CHARACTERISTIC D_COSLightType "cal comments" VALUE 0xC05F Scalar_UB 0.0 CM_LIGHT_TYPE 0.0 4.0 /end CHARACTERISTIC
/begin CHARACTERISTIC D_COALightType "cal comments" VALUE 0xC064 Scalar_UB 0.0 CM_LIGHT_TYPE 0.0 4.0 /end CHARACTERISTIC
/begin CHARACTERISTIC D_O21ShortLoFMIType "cal comments" VALUE 0xBEBF Scalar_UB 0.0 CM_Count1 0.0 255.0 /end CHARACTERISTIC
/begin CHARACTERISTIC D_O21ShortHiFMIType "cal comments" VALUE 0xBEC0 Scalar_UB 0.0 CM_Count1 0.0 255.0 /end CHARACTERISTIC
/begin CHARACTERISTIC D_O22ShortLoFMIType "cal comments" VALUE 0x0 Scalar_UB 0.0 CM_Count1 0.0 255.0 /end CHARACTERISTIC
/begin CHARACTERISTIC D_O22ShortHiFMIType "cal comments" VALUE 0x0 Scalar_UB 0.0 CM_Count1 0.0 255.0 /end CHARACTERISTIC
/begin CHARACTERISTIC D_RO21ShortLoFMIType "cal comments" VALUE 0xBED7 Scalar_UB 0.0 CM_Count1 0.0 255.0 /end CHARACTERISTIC
/begin CHARACTERISTIC D_RO21ShortHiFMIType "cal comments" VALUE 0xBED8 Scalar_UB 0.0 CM_Count1 0.0 255.0 /end CHARACTERISTIC
/begin CHARACTERISTIC D_O2HeaterShortLoFMIType "cal comments" VALUE 0xBF4B Scalar_UB 0.0 CM_Count1 0.0 255.0 /end CHARACTERISTIC
/begin CHARACTERISTIC D_O2HeaterShortHiFMIType "cal comments" VALUE 0xBF4C Scalar_UB 0.0 CM_Count1 0.0 255.0 /end CHARACTERISTIC
/begin CHARACTERISTIC D_RO2Heater1ShortLoFMIType "cal comments" VALUE 0xBF52 Scalar_UB 0.0 CM_Count1 0.0 255.0 /end CHARACTERISTIC
/begin CHARACTERISTIC D_RO2Heater1ShortHiFMIType "cal comments" VALUE 0xBF53 Scalar_UB 0.0 CM_Count1 0.0 255.0 /end CHARACTERISTIC
/begin CHARACTERISTIC D_CoolTempShortLoFMIType "cal comments" VALUE 0xBEA5 Scalar_UB 0.0 CM_Count1 0.0 255.0 /end CHARACTERISTIC
/begin CHARACTERISTIC D_CoolTempShortHiFMIType "cal comments" VALUE 0xBEA6 Scalar_UB 0.0 CM_Count1 0.0 255.0 /end CHARACTERISTIC
/begin CHARACTERISTIC D_CoolTempOH1FMIType "cal comments" VALUE 0xBEA7 Scalar_UB 0.0 CM_Count1 0.0 255.0 /end CHARACTERISTIC
/begin CHARACTERISTIC D_CoolTempOH2FMIType "cal comments" VALUE 0xBEA8 Scalar_UB 0.0 CM_Count1 0.0 255.0 /end CHARACTERISTIC
/begin CHARACTERISTIC D_IntakeAirTempShortLoFMIType "cal comments" VALUE 0xBFA9 Scalar_UB 0.0 CM_Count1 0.0 255.0 /end CHARACTERISTIC
/begin CHARACTERISTIC D_IntakeAirTempShortHiFMIType "cal comments" VALUE 0xBFAA Scalar_UB 0.0 CM_Count1 0.0 255.0 /end CHARACTERISTIC
/begin CHARACTERISTIC D_IntakeAirTempOH1FMIType "cal comments" VALUE 0xBFAB Scalar_UB 0.0 CM_Count1 0.0 255.0 /end CHARACTERISTIC
/begin CHARACTERISTIC D_IntakeAirTempOH2FMIType "cal comments" VALUE 0xBFAC Scalar_UB 0.0 CM_Count1 0.0 255.0 /end CHARACTERISTIC
/begin CHARACTERISTIC D_SCIShortLoFMIType "cal comments" VALUE 0xBFB9 Scalar_UB 0.0 CM_Count1 0.0 255.0 /end CHARACTERISTIC
/begin CHARACTERISTIC D_SCIShortHiFMIType "cal comments" VALUE 0xBFBA Scalar_UB 0.0 CM_Count1 0.0 255.0 /end CHARACTERISTIC
/begin CHARACTERISTIC D_BSTPShortLoFMIType "cal comments" VALUE 0xBFDD Scalar_UB 0.0 CM_Count1 0.0 255.0 /end CHARACTERISTIC
/begin CHARACTERISTIC D_BSTPShortHiFMIType "cal comments" VALUE 0xBFDE Scalar_UB 0.0 CM_Count1 0.0 255.0 /end CHARACTERISTIC
/begin CHARACTERISTIC D_BSTCShortLoFMIType "cal comments" VALUE 0xBF83 Scalar_UB 0.0 CM_Count1 0.0 255.0 /end CHARACTERISTIC
/begin CHARACTERISTIC D_BSTCShortHiFMIType "cal comments" VALUE 0xBF84 Scalar_UB 0.0 CM_Count1 0.0 255.0 /end CHARACTERISTIC
/begin CHARACTERISTIC D_MAPShortLoFMIType "cal comments" VALUE 0xC00B Scalar_UB 0.0 CM_Count1 0.0 255.0 /end CHARACTERISTIC
/begin CHARACTERISTIC D_MAPShortHiFMIType "cal comments" VALUE 0xC00C Scalar_UB 0.0 CM_Count1 0.0 255.0 /end CHARACTERISTIC
/begin CHARACTERISTIC D_FPShortLoFMIType "cal comments" VALUE 0xBF33 Scalar_UB 0.0 CM_Count1 0.0 255.0 /end CHARACTERISTIC
/begin CHARACTERISTIC D_FPShortHiFMIType "cal comments" VALUE 0xBF34 Scalar_UB 0.0 CM_Count1 0.0 255.0 /end CHARACTERISTIC
/begin CHARACTERISTIC D_FPLoFMIType "cal comments" VALUE 0xBF35 Scalar_UB 0.0 CM_Count1 0.0 255.0 /end CHARACTERISTIC
/begin CHARACTERISTIC D_FPHiFMIType "cal comments" VALUE 0xBF36 Scalar_UB 0.0 CM_Count1 0.0 255.0 /end CHARACTERISTIC
/begin CHARACTERISTIC D_OPShortLoFMIType "cal comments" VALUE 0xC01E Scalar_UB 0.0 CM_Count1 0.0 255.0 /end CHARACTERISTIC
/begin CHARACTERISTIC D_OPShortHiFMIType "cal comments" VALUE 0xC01F Scalar_UB 0.0 CM_Count1 0.0 255.0 /end CHARACTERISTIC
/begin CHARACTERISTIC D_OilPressureFMIType "cal comments" VALUE 0xC015 Scalar_UB 0.0 CM_Count1 0.0 255.0 /end CHARACTERISTIC
/begin CHARACTERISTIC D_TPSShortLoFMIType "cal comments" VALUE 0xC047 Scalar_UB 0.0 CM_Count1 0.0 255.0 /end CHARACTERISTIC
/begin CHARACTERISTIC D_TPSShortHiFMIType "cal comments" VALUE 0xC048 Scalar_UB 0.0 CM_Count1 0.0 255.0 /end CHARACTERISTIC
/begin CHARACTERISTIC D_DCMShortLoFMIType "cal comments" VALUE 0xBE7F Scalar_UB 0.0 CM_Count1 0.0 255.0 /end CHARACTERISTIC
/begin CHARACTERISTIC D_DCMShortHiFMIType "cal comments" VALUE 0xBE80 Scalar_UB 0.0 CM_Count1 0.0 255.0 /end CHARACTERISTIC
/begin CHARACTERISTIC D_TPSMotorControlFMIType "cal comments" VALUE 0xBF93 Scalar_UB 0.0 CM_Count1 0.0 255.0 /end CHARACTERISTIC
/begin CHARACTERISTIC D_FCVPSShortLoFMIType "cal comments" VALUE 0xC055 Scalar_UB 0.0 CM_Count1 0.0 255.0 /end CHARACTERISTIC
/begin CHARACTERISTIC D_FCVPSShortHiFMIType "cal comments" VALUE 0xC056 Scalar_UB 0.0 CM_Count1 0.0 255.0 /end CHARACTERISTIC
/begin CHARACTERISTIC D_FCVMShortLoFMIType "cal comments" VALUE 0xBE8A Scalar_UB 0.0 CM_Count1 0.0 255.0 /end CHARACTERISTIC
/begin CHARACTERISTIC D_FCVMShortHiFMIType "cal comments" VALUE 0xBE8B Scalar_UB 0.0 CM_Count1 0.0 255.0 /end CHARACTERISTIC
/begin CHARACTERISTIC D_FCVMotorControlFMIType "cal comments" VALUE 0xBF45 Scalar_UB 0.0 CM_Count1 0.0 255.0 /end CHARACTERISTIC
/begin CHARACTERISTIC D_FCV1ShortLoFMIType "cal comments" VALUE 0xBF60 Scalar_UB 0.0 CM_Count1 0.0 255.0 /end CHARACTERISTIC
/begin CHARACTERISTIC D_FCV1ShortHiFMIType "cal comments" VALUE 0xBF61 Scalar_UB 0.0 CM_Count1 0.0 255.0 /end CHARACTERISTIC
/begin CHARACTERISTIC D_FCV2ShortLoFMIType "cal comments" VALUE 0xBF67 Scalar_UB 0.0 CM_Count1 0.0 255.0 /end CHARACTERISTIC
/begin CHARACTERISTIC D_FCV2ShortHiFMIType "cal comments" VALUE 0xBF68 Scalar_UB 0.0 CM_Count1 0.0 255.0 /end CHARACTERISTIC
/begin CHARACTERISTIC D_FBPVShortLoFMIType "cal comments" VALUE 0xBF6E Scalar_UB 0.0 CM_Count1 0.0 255.0 /end CHARACTERISTIC
/begin CHARACTERISTIC D_FBPVShortHiFMIType "cal comments" VALUE 0xBF6F Scalar_UB 0.0 CM_Count1 0.0 255.0 /end CHARACTERISTIC
/begin CHARACTERISTIC D_REF1ShortLoFMIType "cal comments" VALUE 0xBF75 Scalar_UB 0.0 CM_Count1 0.0 255.0 /end CHARACTERISTIC
/begin CHARACTERISTIC D_REF1ShortHiFMIType "cal comments" VALUE 0xBF76 Scalar_UB 0.0 CM_Count1 0.0 255.0 /end CHARACTERISTIC
/begin CHARACTERISTIC D_REF2ShortLoFMIType "cal comments" VALUE 0xBF7C Scalar_UB 0.0 CM_Count1 0.0 255.0 /end CHARACTERISTIC
/begin CHARACTERISTIC D_REF2ShortHiFMIType "cal comments" VALUE 0xBF7D Scalar_UB 0.0 CM_Count1 0.0 255.0 /end CHARACTERISTIC
/begin CHARACTERISTIC D_BLM_TrimLoFMIType "cal comments" VALUE 0xBEE4 Scalar_UB 0.0 CM_Count1 0.0 255.0 /end CHARACTERISTIC
/begin CHARACTERISTIC D_BLM_TrimHiFMIType "cal comments" VALUE 0xBEE5 Scalar_UB 0.0 CM_Count1 0.0 255.0 /end CHARACTERISTIC
/begin CHARACTERISTIC D_IgnitionCoil1LoFMIType "cal comments" VALUE 0xBF08 Scalar_UB 0.0 CM_Count1 0.0 255.0 /end CHARACTERISTIC
/begin CHARACTERISTIC D_IgnitionCoil1HiFMIType "cal comments" VALUE 0xBF09 Scalar_UB 0.0 CM_Count1 0.0 255.0 /end CHARACTERISTIC
/begin CHARACTERISTIC D_IgnitionCoil2LoFMIType "cal comments" VALUE 0xBF0A Scalar_UB 0.0 CM_Count1 0.0 255.0 /end CHARACTERISTIC
/begin CHARACTERISTIC D_IgnitionCoil2HiFMIType "cal comments" VALUE 0xBF0B Scalar_UB 0.0 CM_Count1 0.0 255.0 /end CHARACTERISTIC
/begin CHARACTERISTIC D_IgnitionCoil3LoFMIType "cal comments" VALUE 0xBF0C Scalar_UB 0.0 CM_Count1 0.0 255.0 /end CHARACTERISTIC
/begin CHARACTERISTIC D_IgnitionCoil3HiFMIType "cal comments" VALUE 0xBF0D Scalar_UB 0.0 CM_Count1 0.0 255.0 /end CHARACTERISTIC
/begin CHARACTERISTIC D_IgnitionCoil4LoFMIType "cal comments" VALUE 0xBF0E Scalar_UB 0.0 CM_Count1 0.0 255.0 /end CHARACTERISTIC
/begin CHARACTERISTIC D_IgnitionCoil4HiFMIType "cal comments" VALUE 0xBF0F Scalar_UB 0.0 CM_Count1 0.0 255.0 /end CHARACTERISTIC
/begin CHARACTERISTIC D_InjectorCyl1LoFMIType "cal comments" VALUE 0xBFEB Scalar_UB 0.0 CM_Count1 0.0 255.0 /end CHARACTERISTIC
/begin CHARACTERISTIC D_InjectorCyl1HiFMIType "cal comments" VALUE 0xBFEC Scalar_UB 0.0 CM_Count1 0.0 255.0 /end CHARACTERISTIC
/begin CHARACTERISTIC D_InjectorCyl2LoFMIType "cal comments" VALUE 0xBFED Scalar_UB 0.0 CM_Count1 0.0 255.0 /end CHARACTERISTIC
/begin CHARACTERISTIC D_InjectorCyl2HiFMIType "cal comments" VALUE 0xBFEE Scalar_UB 0.0 CM_Count1 0.0 255.0 /end CHARACTERISTIC
/begin CHARACTERISTIC D_InjectorCyl1_2_LoFMIType "cal comments" VALUE 0xBFF3 Scalar_UB 0.0 CM_Count1 0.0 255.0 /end CHARACTERISTIC
/begin CHARACTERISTIC D_InjectorCyl1_2_HiFMIType "cal comments" VALUE 0xBFF4 Scalar_UB 0.0 CM_Count1 0.0 255.0 /end CHARACTERISTIC
/begin CHARACTERISTIC D_InjectorCyl2_2_LoFMIType "cal comments" VALUE 0xBFF5 Scalar_UB 0.0 CM_Count1 0.0 255.0 /end CHARACTERISTIC
/begin CHARACTERISTIC D_InjectorCyl2_2_HiFMIType "cal comments" VALUE 0xBFF6 Scalar_UB 0.0 CM_Count1 0.0 255.0 /end CHARACTERISTIC
/begin CHARACTERISTIC D_InjectorCyl1_3_LoFMIType "cal comments" VALUE 0xBFF7 Scalar_UB 0.0 CM_Count1 0.0 255.0 /end CHARACTERISTIC
/begin CHARACTERISTIC D_InjectorCyl1_3_HiFMIType "cal comments" VALUE 0xBFF8 Scalar_UB 0.0 CM_Count1 0.0 255.0 /end CHARACTERISTIC
/begin CHARACTERISTIC D_InjectorCyl2_3_LoFMIType "cal comments" VALUE 0xBFF9 Scalar_UB 0.0 CM_Count1 0.0 255.0 /end CHARACTERISTIC
/begin CHARACTERISTIC D_InjectorCyl2_3_HiFMIType "cal comments" VALUE 0xBFFA Scalar_UB 0.0 CM_Count1 0.0 255.0 /end CHARACTERISTIC
/begin CHARACTERISTIC D_InjectorCyl3LoFMIType "cal comments" VALUE 0xBFEF Scalar_UB 0.0 CM_Count1 0.0 255.0 /end CHARACTERISTIC
/begin CHARACTERISTIC D_InjectorCyl3HiFMIType "cal comments" VALUE 0xBFF0 Scalar_UB 0.0 CM_Count1 0.0 255.0 /end CHARACTERISTIC
/begin CHARACTERISTIC D_InjectorCyl4LoFMIType "cal comments" VALUE 0xBFF1 Scalar_UB 0.0 CM_Count1 0.0 255.0 /end CHARACTERISTIC
/begin CHARACTERISTIC D_InjectorCyl4HiFMIType "cal comments" VALUE 0xBFF2 Scalar_UB 0.0 CM_Count1 0.0 255.0 /end CHARACTERISTIC
/begin CHARACTERISTIC D_CrankSignalLossFMIType "cal comments" VALUE 0xBEF7 Scalar_UB 0.0 CM_Count1 0.0 255.0 /end CHARACTERISTIC
/begin CHARACTERISTIC D_CrankSignalNoiseFMIType "cal comments" VALUE 0xBEF8 Scalar_UB 0.0 CM_Count1 0.0 255.0 /end CHARACTERISTIC
/begin CHARACTERISTIC D_BatVoltLoFMIType "cal comments" VALUE 0xC073 Scalar_UB 0.0 CM_Count1 0.0 255.0 /end CHARACTERISTIC
/begin CHARACTERISTIC D_BatVoltHiFMIType "cal comments" VALUE 0xC074 Scalar_UB 0.0 CM_Count1 0.0 255.0 /end CHARACTERISTIC
/begin CHARACTERISTIC D_KNK1FMIType "cal comments" VALUE 0xBE8C Scalar_UB 0.0 CM_Count1 0.0 255.0 /end CHARACTERISTIC
/begin CHARACTERISTIC D_KNK2FMIType "cal comments" VALUE 0xBE8D Scalar_UB 0.0 CM_Count1 0.0 255.0 /end CHARACTERISTIC
/begin CHARACTERISTIC D_IACVShortLoFMIType "cal comments" VALUE 0xBF59 Scalar_UB 0.0 CM_Count1 0.0 255.0 /end CHARACTERISTIC
/begin CHARACTERISTIC D_IACVShortHiFMIType "cal comments" VALUE 0xBF5A Scalar_UB 0.0 CM_Count1 0.0 255.0 /end CHARACTERISTIC
/begin CHARACTERISTIC D_FuelPumpShortLoFMIType "cal comments" VALUE 0xBF18 Scalar_UB 0.0 CM_Count1 0.0 255.0 /end CHARACTERISTIC
/begin CHARACTERISTIC D_FuelPumpShortHiFMIType "cal comments" VALUE 0xBF19 Scalar_UB 0.0 CM_Count1 0.0 255.0 /end CHARACTERISTIC
/begin CHARACTERISTIC D_FPFeedbackFMIType "cal comments" VALUE 0xBF1E Scalar_UB 0.0 CM_Count1 0.0 255.0 /end CHARACTERISTIC
/begin CHARACTERISTIC D_CCPShortLoFMIType "cal comments" VALUE 0x0 Scalar_UB 0.0 CM_Count1 0.0 255.0 /end CHARACTERISTIC
/begin CHARACTERISTIC D_CCPShortHiFMIType "cal comments" VALUE 0x0 Scalar_UB 0.0 CM_Count1 0.0 255.0 /end CHARACTERISTIC
/begin CHARACTERISTIC D_SoftwareErrorFMIType "cal comments" VALUE 0xC038 Scalar_UB 0.0 CM_Count1 0.0 255.0 /end CHARACTERISTIC
/begin CHARACTERISTIC D_ACSShortLoFMIType "cal comments" VALUE 0xBFCB Scalar_UB 0.0 CM_Count1 0.0 255.0 /end CHARACTERISTIC
/begin CHARACTERISTIC D_ACSShortHiFMIType "cal comments" VALUE 0xBFCC Scalar_UB 0.0 CM_Count1 0.0 255.0 /end CHARACTERISTIC
/begin CHARACTERISTIC D_WPSShortLoFMIType "cal comments" VALUE 0x0 Scalar_UB 0.0 CM_Count1 0.0 255.0 /end CHARACTERISTIC
/begin CHARACTERISTIC D_WPSShortHiFMIType "cal comments" VALUE 0x0 Scalar_UB 0.0 CM_Count1 0.0 255.0 /end CHARACTERISTIC
/begin CHARACTERISTIC D_GENVLoFMIType "cal comments" VALUE 0x0 Scalar_UB 0.0 CM_Count1 0.0 255.0 /end CHARACTERISTIC
/begin CHARACTERISTIC D_GENVHiFMIType "cal comments" VALUE 0x0 Scalar_UB 0.0 CM_Count1 0.0 255.0 /end CHARACTERISTIC
/begin CHARACTERISTIC D_COSFMIType "cal comments" VALUE 0xC060 Scalar_UB 0.0 CM_Count1 0.0 255.0 /end CHARACTERISTIC
/begin CHARACTERISTIC D_COAFMIType "cal comments" VALUE 0xC065 Scalar_UB 0.0 CM_Count1 0.0 255.0 /end CHARACTERISTIC
/begin CHARACTERISTIC D_TPSShortDiagPassTimeThrsh "cal comments" VALUE 0xC03E Scalar_UW 0.0 CM_Count_0to65535_2 0.0 65535.0 /end CHARACTERISTIC
/begin CHARACTERISTIC D_TPSShortEnb "cal comments" VALUE 0xC044 Scalar_UB 0.0 CM_Boolean6 0.0 255.0 /end CHARACTERISTIC
/begin CHARACTERISTIC D_TPSShortHighFailTimeThrsh "cal comments" VALUE 0xC03A Scalar_UW 0.0 CM_Count_0to65535_2 0.0 65535.0 /end CHARACTERISTIC
/begin CHARACTERISTIC D_TPSShortLowFailTimeThrsh "cal comments" VALUE 0xC03C Scalar_UW 0.0 CM_Count_0to65535_2 0.0 65535.0 /end CHARACTERISTIC
/begin CHARACTERISTIC D_TPSShortRangeThreshHi "cal comments" VALUE 0xC042 Scalar_UW 0.0 CM_Percent_0to100_1 0.0 99.9984130859375 /end CHARACTERISTIC
/begin CHARACTERISTIC D_TPSShortRangeThreshLo "cal comments" VALUE 0xC040 Scalar_UW 0.0 CM_Percent_0to100_1 0.0 99.9984130859375 /end CHARACTERISTIC
/begin CHARACTERISTIC D_FCVPSShortEnb "cal comments" VALUE 0xC052 Scalar_UB 0.0 CM_Boolean6 0.0 255.0 /end CHARACTERISTIC
/begin CHARACTERISTIC D_FCVPSFailTimeThrsh "cal comments" VALUE 0xC04A Scalar_UW 0.0 CM_Count_0to65535_2 0.0 65535.0 /end CHARACTERISTIC
/begin CHARACTERISTIC D_FCVPSPassTimeThrsh "cal comments" VALUE 0xC04C Scalar_UW 0.0 CM_Count_0to65535_2 0.0 65535.0 /end CHARACTERISTIC
/begin CHARACTERISTIC D_FCVPSShortRangeThreshHi "cal comments" VALUE 0xC050 Scalar_UW 0.0 CM_Percent_0to100_1 0.0 99.9984130859375 /end CHARACTERISTIC
/begin CHARACTERISTIC D_FCVPSShortRangeThreshLo "cal comments" VALUE 0xC04E Scalar_UW 0.0 CM_Percent_0to100_1 0.0 99.9984130859375 /end CHARACTERISTIC
/begin CHARACTERISTIC C_FL_LoopCount "cal comments" VALUE 0x0 Scalar_UB 0.0 CM_Count1 0.0 255.0 /end CHARACTERISTIC
/begin CHARACTERISTIC C_FL_DatFormat "cal comments" VALUE 0x0 Scalar_UB 0.0 CM_DAT_TYPE 0.0 255.0 /end CHARACTERISTIC
/begin CHARACTERISTIC C_SerialDatFormat "cal comments" VALUE 0x0 Scalar_UB 0.0 CM_DAT_TYPE 0.0 255.0 /end CHARACTERISTIC
/begin CHARACTERISTIC CT_FL_DATA_TAB "cal comments" MAP 0x0 3D_Array_UB 0.0 CM_Count1 0.0 255.0
 /begin AXIS_DESCR FIX_AXIS NO_INPUT_QUANTITY CM_ID 7 0.0 7.0 MAX_GRAD 0.0 /begin FIX_AXIS_PAR_LIST 0 1 2 3 4 5 6 /end FIX_AXIS_PAR_LIST /end AXIS_DESCR
 /begin AXIS_DESCR FIX_AXIS NO_INPUT_QUANTITY CM_FL_DAT 9 0.0 9.0 MAX_GRAD 0.0 /begin FIX_AXIS_PAR_LIST 0 1 2 3 4 5 6 7 8 /end FIX_AXIS_PAR_LIST /end AXIS_DESCR
/end CHARACTERISTIC
/begin CHARACTERISTIC CT_SerialRxDat "cal comments" CURVE 0x0 2D_Array_UB 0.0 CM_Count1 0.0 255.0
 /begin AXIS_DESCR FIX_AXIS NO_INPUT_QUANTITY CM_Equaloutput1 8 0.0 8.0 MAX_GRAD 0.0 /begin FIX_AXIS_PAR_LIST 0 1 2 3 4 5 6 7 /end FIX_AXIS_PAR_LIST /end AXIS_DESCR
/end CHARACTERISTIC
/begin CHARACTERISTIC CT_SerialTxDat "cal comments" CURVE 0x0 2D_Array_UB 0.0 CM_Count1 0.0 255.0
 /begin AXIS_DESCR FIX_AXIS NO_INPUT_QUANTITY CM_Equaloutput1 24 0.0 24.0 MAX_GRAD 0.0
  /begin FIX_AXIS_PAR_LIST 0 1 2 3 4 5 6 7 8 9 10 11 12 13 14 15 16 17 18 19 20 21 22 23 /end FIX_AXIS_PAR_LIST
 /end AXIS_DESCR
/end CHARACTERISTIC
/begin CHARACTERISTIC CT_FL_ID_TAB "cal comments" CURVE 0x0 2D_Array_UL 0.0 CM_Count1 0.0 4294967295.0
 /begin AXIS_DESCR FIX_AXIS NO_INPUT_QUANTITY CM_ID 7 0.0 7.0 MAX_GRAD 0.0 /begin FIX_AXIS_PAR_LIST 0 1 2 3 4 5 6 /end FIX_AXIS_PAR_LIST /end AXIS_DESCR
/end CHARACTERISTIC
/begin AXIS_PTS CA_EngSpd10Step1 "AXIS comments" 0x8110 NO_INPUT_QUANTITY AxisPtsX_UW 0.0 CM_RPM_0to16384 10 0.0 16383.75 /end AXIS_PTS
/begin AXIS_PTS CA_EngSpd17Step1 "AXIS comments" 0x8156 NO_INPUT_QUANTITY AxisPtsX_UW 0.0 CM_RPM_0to16384 17 0.0 16383.75 /end AXIS_PTS
/begin AXIS_PTS CA_EngSpd4Step1 "AXIS comments" 0x829E NO_INPUT_QUANTITY AxisPtsX_UW 0.0 CM_RPM_0to16384 4 0.0 16383.75 /end AXIS_PTS
/begin AXIS_PTS CA_EngSpd6Step1 "AXIS comments" 0x8290 NO_INPUT_QUANTITY AxisPtsX_UW 0.0 CM_RPM_0to16384 6 0.0 16383.75 /end AXIS_PTS
/begin AXIS_PTS CA_GramStep21 "AXIS comments" 0x82F8 NO_INPUT_QUANTITY AxisPtsX_UW 0.0 udf_CM_18705 21 0.0 511.9921875 /end AXIS_PTS
/begin AXIS_PTS CA_MAP10Step1 "AXIS comments" 0x81C6 NO_INPUT_QUANTITY AxisPtsX_UW 0.0 CM_kpa_0to512_1 10 0.0 511.9921875 /end AXIS_PTS
/begin AXIS_PTS CA_MAP18Step1 "AXIS comments" 0x81DC NO_INPUT_QUANTITY AxisPtsX_UW 0.0 CM_kpa_0to512_1 18 0.0 511.9921875 /end AXIS_PTS
/begin AXIS_PTS CA_MAP22Step1 "AXIS comments" 0x8202 NO_INPUT_QUANTITY AxisPtsX_UW 0.0 CM_kpa_0to512_1 22 0.0 511.9921875 /end AXIS_PTS
/begin AXIS_PTS CA_MAP7Step1 "AXIS comments" 0xAE92 NO_INPUT_QUANTITY AxisPtsX_UW 0.0 CM_kpa_0to512_1 7 0.0 511.9921875 /end AXIS_PTS
/begin AXIS_PTS CA_MAP8Step1 "AXIS comments" 0x81B4 NO_INPUT_QUANTITY AxisPtsX_SW 0.0 CM_kpa_n256to256_1 8 -256 255.9921875 /end AXIS_PTS
/begin AXIS_PTS CA_PercentStep21 "AXIS comments" 0x82A8 NO_INPUT_QUANTITY AxisPtsX_UW 0.0 CM_Percent_0to200_2 21 0.0 199.9969024658203 /end AXIS_PTS
/begin AXIS_PTS CA_VELoad6Step "AXIS comments" 0x8324 NO_INPUT_QUANTITY AxisPtsX_UW 0.0 CM_kpa_0to512_1 6 0.0 511.9921875 /end AXIS_PTS
/begin MEASUREMENT VAI0 "var comments" UWORD CM_Count1 0 0.0 0.0 65535.0 DISPLAY_IDENTIFIER VAI[0] ECU_ADDRESS 0x0 /end MEASUREMENT
/begin MEASUREMENT VAI1 "var comments" UWORD CM_Count1 0 0.0 0.0 65535.0 DISPLAY_IDENTIFIER VAI[1] ECU_ADDRESS 0x2 /end MEASUREMENT
/begin MEASUREMENT VAI2 "var comments" UWORD CM_Count1 0 0.0 0.0 65535.0 DISPLAY_IDENTIFIER VAI[2] ECU_ADDRESS 0x4 /end MEASUREMENT
/begin MEASUREMENT VAI3 "var comments" UWORD CM_Count1 0 0.0 0.0 65535.0 DISPLAY_IDENTIFIER VAI[3] ECU_ADDRESS 0x6 /end MEASUREMENT
/begin MEASUREMENT VAI4 "var comments" UWORD CM_Count1 0 0.0 0.0 65535.0 DISPLAY_IDENTIFIER VAI[4] ECU_ADDRESS 0x8 /end MEASUREMENT
/begin MEASUREMENT VAI5 "var comments" UWORD CM_Count1 0 0.0 0.0 65535.0 DISPLAY_IDENTIFIER VAI[5] ECU_ADDRESS 0xA /end MEASUREMENT
/begin MEASUREMENT VAI6 "var comments" UWORD CM_Count1 0 0.0 0.0 65535.0 DISPLAY_IDENTIFIER VAI[6] ECU_ADDRESS 0xC /end MEASUREMENT
/begin MEASUREMENT VAI7 "var comments" UWORD CM_Count1 0 0.0 0.0 65535.0 DISPLAY_IDENTIFIER VAI[7] ECU_ADDRESS 0xE /end MEASUREMENT
/begin MEASUREMENT VAI8 "var comments" UWORD CM_Count1 0 0.0 0.0 65535.0 DISPLAY_IDENTIFIER VAI[8] ECU_ADDRESS 0x10 /end MEASUREMENT
/begin MEASUREMENT VAI9 "var comments" UWORD CM_Count1 0 0.0 0.0 65535.0 DISPLAY_IDENTIFIER VAI[9] ECU_ADDRESS 0x12 /end MEASUREMENT
/begin MEASUREMENT VAI10 "var comments" UWORD CM_Count1 0 0.0 0.0 65535.0 DISPLAY_IDENTIFIER VAI[10] ECU_ADDRESS 0x14 /end MEASUREMENT
/begin MEASUREMENT VAI11 "var comments" UWORD CM_Count1 0 0.0 0.0 65535.0 DISPLAY_IDENTIFIER VAI[11] ECU_ADDRESS 0x16 /end MEASUREMENT
/begin MEASUREMENT VAI12 "var comments" UWORD CM_Count1 0 0.0 0.0 65535.0 DISPLAY_IDENTIFIER VAI[12] ECU_ADDRESS 0x18 /end MEASUREMENT
/begin MEASUREMENT VAI13 "var comments" UWORD CM_Count1 0 0.0 0.0 65535.0 DISPLAY_IDENTIFIER VAI[13] ECU_ADDRESS 0x1A /end MEASUREMENT
/begin MEASUREMENT VAI14 "var comments" UWORD CM_Count1 0 0.0 0.0 65535.0 DISPLAY_IDENTIFIER VAI[14] ECU_ADDRESS 0x1C /end MEASUREMENT
/begin MEASUREMENT VAI15 "var comments" UWORD CM_Count1 0 0.0 0.0 65535.0 DISPLAY_IDENTIFIER VAI[15] ECU_ADDRESS 0x1E /end MEASUREMENT
/begin MEASUREMENT AFRRamped "var comments" UWORD udf_CM_15464 0 0.0 0.0 31.99951171875 ECU_ADDRESS 0x40002428 /end MEASUREMENT
/begin MEASUREMENT AFRBase "var comments" UWORD udf_CM_15422 0 0.0 0.0 31.99951171875 ECU_ADDRESS 0x400024F8 /end MEASUREMENT
/begin MEASUREMENT AFRCrankToRun "var comments" UBYTE udf_CM_15436 0 0.0 0.0 255.0 ECU_ADDRESS 0x40002424 /end MEASUREMENT
/begin MEASUREMENT AFRWarmUpEnb "var comments" UBYTE udf_CM_15513 0 0.0 0.0 255.0 ECU_ADDRESS 0x40002432 /end MEASUREMENT
/begin MEASUREMENT AFRWarmUp "var comments" UWORD udf_CM_15506 0 0.0 0.0 31.99951171875 ECU_ADDRESS 0x40002430 /end MEASUREMENT
/begin MEASUREMENT AFRWarmUpIdle "var comments" UWORD udf_CM_15520 0 0.0 0.0 31.99951171875 ECU_ADDRESS 0x4000242C /end MEASUREMENT
/begin MEASUREMENT AFRWarmUpRun "var comments" UWORD udf_CM_15527 0 0.0 0.0 31.99951171875 ECU_ADDRESS 0x4000242E /end MEASUREMENT
/begin MEASUREMENT AFRCrank "var comments" UWORD udf_CM_15429 0 0.0 0.0 31.99951171875 ECU_ADDRESS 0x400024F2 /end MEASUREMENT
/begin MEASUREMENT AFRFinal "var comments" UWORD udf_CM_15450 0 0.0 0.0 31.99951171875 ECU_ADDRESS 0x40002436 /end MEASUREMENT
/begin MEASUREMENT AFRPE "var comments" UWORD udf_CM_15457 0 0.0 0.0 31.99951171875 ECU_ADDRESS 0x40002438 /end MEASUREMENT
/begin MEASUREMENT AFRTarget "var comments" UWORD udf_CM_15485 0 0.0 0.0 31.99951171875 ECU_ADDRESS 0x40002426 /end MEASUREMENT
/begin MEASUREMENT AirFlowCyl1 "var comments" UWORD udf_CM_15534 0 0.0 0.0 511.9921875 DISPLAY_IDENTIFIER AirFlowCyl[0] ECU_ADDRESS 0x4000239E /end MEASUREMENT
/begin MEASUREMENT AirFlowCyl2 "var comments" UWORD udf_CM_15541 0 0.0 0.0 511.9921875 DISPLAY_IDENTIFIER AirFlowCyl[1] ECU_ADDRESS 0x400023A0 /end MEASUREMENT
/begin MEASUREMENT ClTSTDiagEnb "var comments" UBYTE udf_CM_15723 0 0.0 0.0 255.0 DISPLAY_IDENTIFIER ClTSTDiagEnb[0] ECU_ADDRESS 0x40002B78 /end MEASUREMENT
/begin MEASUREMENT ClTSTDiagEnb2 "var comments" UBYTE udf_CM_15723 0 0.0 0.0 255.0 DISPLAY_IDENTIFIER ClTSTDiagEnb[1] ECU_ADDRESS 0x40002B79 /end MEASUREMENT
/begin MEASUREMENT ClTSTDiagEnb3 "var comments" UBYTE udf_CM_15723 0 0.0 0.0 255.0 DISPLAY_IDENTIFIER ClTSTDiagEnb[2] ECU_ADDRESS 0x40002B7A /end MEASUREMENT
/begin MEASUREMENT ClTSTDiagEnb4 "var comments" UBYTE udf_CM_15723 0 0.0 0.0 255.0 DISPLAY_IDENTIFIER ClTSTDiagEnb[3] ECU_ADDRESS 0x40002B7B /end MEASUREMENT
/begin MEASUREMENT ClTSTDiagEnb5 "var comments" UBYTE udf_CM_15723 0 0.0 0.0 255.0 DISPLAY_IDENTIFIER ClTSTDiagEnb[4] ECU_ADDRESS 0x40002B7C /end MEASUREMENT
/begin MEASUREMENT ClTSTDiagEnb6 "var comments" UBYTE udf_CM_15723 0 0.0 0.0 255.0 DISPLAY_IDENTIFIER ClTSTDiagEnb[5] ECU_ADDRESS 0x40002B7D /end MEASUREMENT
/begin MEASUREMENT ClTOHDiagEnb "var comments" UBYTE udf_CM_15674 0 0.0 0.0 255.0 ECU_ADDRESS 0x40002B8C /end MEASUREMENT
/begin MEASUREMENT ClTSHFailCount "var comments" UWORD udf_CM_15730 0 0.0 0.0 65535.0 DISPLAY_IDENTIFIER ClTSHFailCount[0] ECU_ADDRESS 0x40002B92 /end MEASUREMENT
/begin MEASUREMENT ClTSHFailCount2 "var comments" UWORD udf_CM_15730 0 0.0 0.0 65535.0 DISPLAY_IDENTIFIER ClTSHFailCount[1] ECU_ADDRESS 0x40002B94 /end MEASUREMENT
/begin MEASUREMENT ClTSHFailCount3 "var comments" UWORD udf_CM_15730 0 0.0 0.0 65535.0 DISPLAY_IDENTIFIER ClTSHFailCount[2] ECU_ADDRESS 0x40002B96 /end MEASUREMENT
/begin MEASUREMENT ClTSHFailCount4 "var comments" UWORD udf_CM_15730 0 0.0 0.0 65535.0 DISPLAY_IDENTIFIER ClTSHFailCount[3] ECU_ADDRESS 0x40002B98 /end MEASUREMENT
/begin MEASUREMENT ClTSHFailCount5 "var comments" UWORD udf_CM_15730 0 0.0 0.0 65535.0 DISPLAY_IDENTIFIER ClTSHFailCount[4] ECU_ADDRESS 0x40002B9A /end MEASUREMENT
/begin MEASUREMENT ClTSHFailCount6 "var comments" UWORD udf_CM_15730 0 0.0 0.0 65535.0 DISPLAY_IDENTIFIER ClTSHFailCount[5] ECU_ADDRESS 0x40002B9C /end MEASUREMENT
/begin MEASUREMENT ClTSHFailMet "var comments" UBYTE udf_CM_15723 0 0.0 0.0 255.0 DISPLAY_IDENTIFIER ClTSHFailMet[0] ECU_ADDRESS 0x40002B8B /end MEASUREMENT
/begin MEASUREMENT ClTSHFailMet2 "var comments" UBYTE udf_CM_15723 0 0.0 0.0 255.0 DISPLAY_IDENTIFIER ClTSHFailMet[1] ECU_ADDRESS 0x40002B8C /end MEASUREMENT
/begin MEASUREMENT ClTSHFailMet3 "var comments" UBYTE udf_CM_15723 0 0.0 0.0 255.0 DISPLAY_IDENTIFIER ClTSHFailMet[2] ECU_ADDRESS 0x40002B8D /end MEASUREMENT
/begin MEASUREMENT ClTSHFailMet4 "var comments" UBYTE udf_CM_15723 0 0.0 0.0 255.0 DISPLAY_IDENTIFIER ClTSHFailMet[3] ECU_ADDRESS 0x40002B8E /end MEASUREMENT
/begin MEASUREMENT ClTSHFailMet5 "var comments" UBYTE udf_CM_15723 0 0.0 0.0 255.0 DISPLAY_IDENTIFIER ClTSHFailMet[4] ECU_ADDRESS 0x40002B8F /end MEASUREMENT
/begin MEASUREMENT ClTSHFailMet6 "var comments" UBYTE udf_CM_15723 0 0.0 0.0 255.0 DISPLAY_IDENTIFIER ClTSHFailMet[5] ECU_ADDRESS 0x40002B90 /end MEASUREMENT
/begin MEASUREMENT ClTSHPassCount "var comments" UWORD udf_CM_15730 0 0.0 0.0 65535.0 DISPLAY_IDENTIFIER ClTSHPassCount[0] ECU_ADDRESS 0x40002B94 /end MEASUREMENT
/begin MEASUREMENT ClTSHPassCount2 "var comments" UWORD udf_CM_15730 0 0.0 0.0 65535.0 DISPLAY_IDENTIFIER ClTSHPassCount[1] ECU_ADDRESS 0x40002B96 /end MEASUREMENT
/begin MEASUREMENT ClTSHPassCount3 "var comments" UWORD udf_CM_15730 0 0.0 0.0 65535.0 DISPLAY_IDENTIFIER ClTSHPassCount[2] ECU_ADDRESS 0x40002B98 /end MEASUREMENT
/begin MEASUREMENT ClTSHPassCount4 "var comments" UWORD udf_CM_15730 0 0.0 0.0 65535.0 DISPLAY_IDENTIFIER ClTSHPassCount[3] ECU_ADDRESS 0x40002B9A /end MEASUREMENT
/begin MEASUREMENT ClTSHPassCount5 "var comments" UWORD udf_CM_15730 0 0.0 0.0 65535.0 DISPLAY_IDENTIFIER ClTSHPassCount[4] ECU_ADDRESS 0x40002B9C /end MEASUREMENT
/begin MEASUREMENT ClTSHPassCount6 "var comments" UWORD udf_CM_15730 0 0.0 0.0 65535.0 DISPLAY_IDENTIFIER ClTSHPassCount[5] ECU_ADDRESS 0x40002B9E /end MEASUREMENT
/begin MEASUREMENT ClTSHTestFail "var comments" UBYTE udf_CM_15723 0 0.0 0.0 255.0 DISPLAY_IDENTIFIER ClTSHTestFail[0] ECU_ADDRESS 0x40002B7B /end MEASUREMENT
/begin MEASUREMENT ClTSHTestFail2 "var comments" UBYTE udf_CM_15723 0 0.0 0.0 255.0 DISPLAY_IDENTIFIER ClTSHTestFail[1] ECU_ADDRESS 0x40002B7C /end MEASUREMENT
/begin MEASUREMENT ClTSHTestFail3 "var comments" UBYTE udf_CM_15723 0 0.0 0.0 255.0 DISPLAY_IDENTIFIER ClTSHTestFail[2] ECU_ADDRESS 0x40002B7D /end MEASUREMENT
/begin MEASUREMENT ClTSHTestFail4 "var comments" UBYTE udf_CM_15723 0 0.0 0.0 255.0 DISPLAY_IDENTIFIER ClTSHTestFail[3] ECU_ADDRESS 0x40002B7E /end MEASUREMENT
/begin MEASUREMENT ClTSHTestFail5 "var comments" UBYTE udf_CM_15723 0 0.0 0.0 255.0 DISPLAY_IDENTIFIER ClTSHTestFail[4] ECU_ADDRESS 0x40002B7F /end MEASUREMENT
/begin MEASUREMENT ClTSHTestFail6 "var comments" UBYTE udf_CM_15723 0 0.0 0.0 255.0 DISPLAY_IDENTIFIER ClTSHTestFail[5] ECU_ADDRESS 0x40002B80 /end MEASUREMENT
/begin MEASUREMENT ClTSLFailCount "var comments" UWORD udf_CM_15730 0 0.0 0.0 65535.0 DISPLAY_IDENTIFIER ClTSLFailCount[0] ECU_ADDRESS 0x40002B8E /end MEASUREMENT
/begin MEASUREMENT ClTSLFailCount2 "var comments" UWORD udf_CM_15730 0 0.0 0.0 65535.0 DISPLAY_IDENTIFIER ClTSLFailCount[1] ECU_ADDRESS 0x40002B90 /end MEASUREMENT
/begin MEASUREMENT ClTSLFailCount3 "var comments" UWORD udf_CM_15730 0 0.0 0.0 65535.0 DISPLAY_IDENTIFIER ClTSLFailCount[2] ECU_ADDRESS 0x40002B92 /end MEASUREMENT
/begin MEASUREMENT ClTSLFailCount4 "var comments" UWORD udf_CM_15730 0 0.0 0.0 65535.0 DISPLAY_IDENTIFIER ClTSLFailCount[3] ECU_ADDRESS 0x40002B94 /end MEASUREMENT
/begin MEASUREMENT ClTSLFailCount5 "var comments" UWORD udf_CM_15730 0 0.0 0.0 65535.0 DISPLAY_IDENTIFIER ClTSLFailCount[4] ECU_ADDRESS 0x40002B96 /end MEASUREMENT
/begin MEASUREMENT ClTSLFailCount6 "var comments" UWORD udf_CM_15730 0 0.0 0.0 65535.0 DISPLAY_IDENTIFIER ClTSLFailCount[5] ECU_ADDRESS 0x40002B98 /end MEASUREMENT
/begin MEASUREMENT ClTSLFailMet "var comments" UBYTE udf_CM_15723 0 0.0 0.0 255.0 DISPLAY_IDENTIFIER ClTSLFailMet[0] ECU_ADDRESS 0x40002B8A /end MEASUREMENT
/begin MEASUREMENT ClTSLFailMet2 "var comments" UBYTE udf_CM_15723 0 0.0 0.0 255.0 DISPLAY_IDENTIFIER ClTSLFailMet[1] ECU_ADDRESS 0x40002B8B /end MEASUREMENT
/begin MEASUREMENT ClTSLFailMet3 "var comments" UBYTE udf_CM_15723 0 0.0 0.0 255.0 DISPLAY_IDENTIFIER ClTSLFailMet[2] ECU_ADDRESS 0x40002B8C /end MEASUREMENT
/begin MEASUREMENT ClTSLFailMet4 "var comments" UBYTE udf_CM_15723 0 0.0 0.0 255.0 DISPLAY_IDENTIFIER ClTSLFailMet[3] ECU_ADDRESS 0x40002B8D /end MEASUREMENT
/begin MEASUREMENT ClTSLFailMet5 "var comments" UBYTE udf_CM_15723 0 0.0 0.0 255.0 DISPLAY_IDENTIFIER ClTSLFailMet[4] ECU_ADDRESS 0x40002B8E /end MEASUREMENT
/begin MEASUREMENT ClTSLFailMet6 "var comments" UBYTE udf_CM_15723 0 0.0 0.0 255.0 DISPLAY_IDENTIFIER ClTSLFailMet[5] ECU_ADDRESS 0x40002B8F /end MEASUREMENT
/begin MEASUREMENT ClTSLPassCount "var comments" UWORD udf_CM_15730 0 0.0 0.0 65535.0 DISPLAY_IDENTIFIER ClTSLPassCount[0] ECU_ADDRESS 0x40002B90 /end MEASUREMENT
/begin MEASUREMENT ClTSLPassCount2 "var comments" UWORD udf_CM_15730 0 0.0 0.0 65535.0 DISPLAY_IDENTIFIER ClTSLPassCount[1] ECU_ADDRESS 0x40002B92 /end MEASUREMENT
/begin MEASUREMENT ClTSLPassCount3 "var comments" UWORD udf_CM_15730 0 0.0 0.0 65535.0 DISPLAY_IDENTIFIER ClTSLPassCount[2] ECU_ADDRESS 0x40002B94 /end MEASUREMENT
/begin MEASUREMENT ClTSLPassCount4 "var comments" UWORD udf_CM_15730 0 0.0 0.0 65535.0 DISPLAY_IDENTIFIER ClTSLPassCount[3] ECU_ADDRESS 0x40002B96 /end MEASUREMENT
/begin MEASUREMENT ClTSLPassCount5 "var comments" UWORD udf_CM_15730 0 0.0 0.0 65535.0 DISPLAY_IDENTIFIER ClTSLPassCount[4] ECU_ADDRESS 0x40002B98 /end MEASUREMENT
/begin MEASUREMENT ClTSLPassCount6 "var comments" UWORD udf_CM_15730 0 0.0 0.0 65535.0 DISPLAY_IDENTIFIER ClTSLPassCount[5] ECU_ADDRESS 0x40002B9A /end MEASUREMENT
/begin MEASUREMENT ClTSLTestFail "var comments" UBYTE udf_CM_15723 0 0.0 0.0 255.0 DISPLAY_IDENTIFIER ClTSLTestFail[0] ECU_ADDRESS 0x40002B79 /end MEASUREMENT
/begin MEASUREMENT ClTSLTestFail2 "var comments" UBYTE udf_CM_15723 0 0.0 0.0 255.0 DISPLAY_IDENTIFIER ClTSLTestFail[1] ECU_ADDRESS 0x40002B7A /end MEASUREMENT
/begin MEASUREMENT ClTSLTestFail3 "var comments" UBYTE udf_CM_15723 0 0.0 0.0 255.0 DISPLAY_IDENTIFIER ClTSLTestFail[2] ECU_ADDRESS 0x40002B7B /end MEASUREMENT
/begin MEASUREMENT ClTSLTestFail4 "var comments" UBYTE udf_CM_15723 0 0.0 0.0 255.0 DISPLAY_IDENTIFIER ClTSLTestFail[3] ECU_ADDRESS 0x40002B7C /end MEASUREMENT
/begin MEASUREMENT ClTSLTestFail5 "var comments" UBYTE udf_CM_15723 0 0.0 0.0 255.0 DISPLAY_IDENTIFIER ClTSLTestFail[4] ECU_ADDRESS 0x40002B7D /end MEASUREMENT
/begin MEASUREMENT ClTSLTestFail6 "var comments" UBYTE udf_CM_15723 0 0.0 0.0 255.0 DISPLAY_IDENTIFIER ClTSLTestFail[5] ECU_ADDRESS 0x40002B7E /end MEASUREMENT
/begin MEASUREMENT ClTOH1FailCount "var comments" UWORD udf_CM_15716 0 0.0 0.0 65535.0 ECU_ADDRESS 0x40002B82 /end MEASUREMENT
/begin MEASUREMENT ClTOH1FailMet "var comments" UBYTE udf_CM_15723 0 0.0 0.0 255.0 ECU_ADDRESS 0x40002B8D /end MEASUREMENT
/begin MEASUREMENT ClTOH1PassCount "var comments" UWORD udf_CM_15730 0 0.0 0.0 65535.0 ECU_ADDRESS 0x40002B84 /end MEASUREMENT
/begin MEASUREMENT ClTOH1TestFail "var comments" UBYTE udf_CM_15737 0 0.0 0.0 255.0 ECU_ADDRESS 0x40002B80 /end MEASUREMENT
/begin MEASUREMENT ClTOH2FailCount "var comments" UWORD udf_CM_15716 0 0.0 0.0 65535.0 ECU_ADDRESS 0x40002B86 /end MEASUREMENT
/begin MEASUREMENT ClTOH2FailMet "var comments" UBYTE udf_CM_15723 0 0.0 0.0 255.0 ECU_ADDRESS 0x40002B77 /end MEASUREMENT
/begin MEASUREMENT ClTOH2PassCount "var comments" UWORD udf_CM_15730 0 0.0 0.0 65535.0 ECU_ADDRESS 0x40002B88 /end MEASUREMENT
/begin MEASUREMENT ClTOH2TestFail "var comments" UBYTE udf_CM_15737 0 0.0 0.0 255.0 ECU_ADDRESS 0x40002B81 /end MEASUREMENT
/begin MEASUREMENT FPDiagEnb "var comments" UBYTE udf_CM_17382 0 0.0 0.0 255.0 ECU_ADDRESS 0x40002C39 /end MEASUREMENT
/begin MEASUREMENT FPLoDiagEnb "var comments" UBYTE udf_CM_17382 0 0.0 0.0 255.0 ECU_ADDRESS 0x40002C3E /end MEASUREMENT
/begin MEASUREMENT FPSLFailMet "var comments" UBYTE udf_CM_17410 0 0.0 0.0 255.0 ECU_ADDRESS 0x40002C47 /end MEASUREMENT
/begin MEASUREMENT FPSLTestComp "var comments" UBYTE udf_CM_17424 0 0.0 0.0 255.0 ECU_ADDRESS 0x40002C3F /end MEASUREMENT
/begin MEASUREMENT FPSLTestFail "var comments" UBYTE udf_CM_17431 0 0.0 0.0 255.0 ECU_ADDRESS 0x40002C43 /end MEASUREMENT
/begin MEASUREMENT FPSLFailCount "var comments" UWORD udf_CM_17389 0 0.0 0.0 65535.0 ECU_ADDRESS 0x40002C48 /end MEASUREMENT
/begin MEASUREMENT FPSLPassCount "var comments" UWORD udf_CM_17417 0 0.0 0.0 65535.0 ECU_ADDRESS 0x40002C4A /end MEASUREMENT
/begin MEASUREMENT FPSHFailMet "var comments" UBYTE udf_CM_17410 0 0.0 0.0 255.0 ECU_ADDRESS 0x40002C3A /end MEASUREMENT
/begin MEASUREMENT FPSHTestComp "var comments" UBYTE udf_CM_17424 0 0.0 0.0 255.0 ECU_ADDRESS 0x40002C40 /end MEASUREMENT
/begin MEASUREMENT FPSHTestFail "var comments" UBYTE udf_CM_17431 0 0.0 0.0 255.0 ECU_ADDRESS 0x40002C44 /end MEASUREMENT
/begin MEASUREMENT FPSHFailCount "var comments" UWORD udf_CM_17389 0 0.0 0.0 65535.0 ECU_ADDRESS 0x40002C4C /end MEASUREMENT
/begin MEASUREMENT FPSHPassCount "var comments" UWORD udf_CM_17417 0 0.0 0.0 65535.0 ECU_ADDRESS 0x40002C4E /end MEASUREMENT
/begin MEASUREMENT FPLoFailMet "var comments" UBYTE udf_CM_17410 0 0.0 0.0 255.0 ECU_ADDRESS 0x40002C3B /end MEASUREMENT
/begin MEASUREMENT FPLoTestComp "var comments" UBYTE udf_CM_17424 0 0.0 0.0 255.0 ECU_ADDRESS 0x40002C41 /end MEASUREMENT
/begin MEASUREMENT FPLoTestFail "var comments" UBYTE udf_CM_17431 0 0.0 0.0 255.0 ECU_ADDRESS 0x40002C45 /end MEASUREMENT
/begin MEASUREMENT FPLoFailCount "var comments" UWORD udf_CM_17389 0 0.0 0.0 65535.0 ECU_ADDRESS 0x40002C50 /end MEASUREMENT
/begin MEASUREMENT FPLoPassCount "var comments" UWORD udf_CM_17417 0 0.0 0.0 65535.0 ECU_ADDRESS 0x40002C52 /end MEASUREMENT
/begin MEASUREMENT FPHiFailMet "var comments" UBYTE udf_CM_17410 0 0.0 0.0 255.0 ECU_ADDRESS 0x40002C3C /end MEASUREMENT
/begin MEASUREMENT FPHiTestComp "var comments" UBYTE udf_CM_17424 0 0.0 0.0 255.0 ECU_ADDRESS 0x40002C42 /end MEASUREMENT
/begin MEASUREMENT FPHiTestFail "var comments" UBYTE udf_CM_17431 0 0.0 0.0 255.0 ECU_ADDRESS 0x40002C46 /end MEASUREMENT
/begin MEASUREMENT FPHiFailCount "var comments" UWORD udf_CM_17389 0 0.0 0.0 65535.0 ECU_ADDRESS 0x40002C54 /end MEASUREMENT
/begin MEASUREMENT FPHiPassCount "var comments" UWORD udf_CM_17417 0 0.0 0.0 65535.0 ECU_ADDRESS 0x40002C56 /end MEASUREMENT
/begin MEASUREMENT Coil1DiagEnb "var comments" UBYTE udf_CM_18019 0 0.0 0.0 255.0 DISPLAY_IDENTIFIER CoilDiagEnb[0] ECU_ADDRESS 0x40002CA0 /end MEASUREMENT
/begin MEASUREMENT Coil1SLFailMet "var comments" UBYTE udf_CM_18047 0 0.0 0.0 255.0 DISPLAY_IDENTIFIER CoilSLFailMet[0] ECU_ADDRESS 0x40002C98 /end MEASUREMENT
/begin MEASUREMENT Coil1SLTestComp "var comments" UBYTE udf_CM_18061 0 0.0 0.0 255.0 DISPLAY_IDENTIFIER CoilSLTestComp[0] ECU_ADDRESS 0x40002CA4 /end MEASUREMENT
/begin MEASUREMENT Coil1SLTestFail "var comments" UBYTE udf_CM_18068 0 0.0 0.0 255.0 DISPLAY_IDENTIFIER CoilSLTestFail[0] ECU_ADDRESS 0x40002CCC /end MEASUREMENT
/begin MEASUREMENT Coil1SLFailCount "var comments" UWORD udf_CM_18026 0 0.0 0.0 65535.0 DISPLAY_IDENTIFIER CoilSLFailCount[0] ECU_ADDRESS 0x40002CAC /end MEASUREMENT
/begin MEASUREMENT Coil1SLPassCount "var comments" UWORD udf_CM_18054 0 0.0 0.0 65535.0 DISPLAY_IDENTIFIER CoilSLPassCount[0] ECU_ADDRESS 0x40002CB4 /end MEASUREMENT
/begin MEASUREMENT Coil1SHFailMet "var comments" UBYTE udf_CM_18047 0 0.0 0.0 255.0 DISPLAY_IDENTIFIER CoilSHFailMet[0] ECU_ADDRESS 0x40002C9C /end MEASUREMENT
/begin MEASUREMENT Coil1SHTestComp "var comments" UBYTE udf_CM_18061 0 0.0 0.0 255.0 DISPLAY_IDENTIFIER CoilSHTestComp[0] ECU_ADDRESS 0x40002CA8 /end MEASUREMENT
/begin MEASUREMENT Coil1SHTestFail "var comments" UBYTE udf_CM_18068 0 0.0 0.0 255.0 DISPLAY_IDENTIFIER CoilSHTestFail[0] ECU_ADDRESS 0x40002CD0 /end MEASUREMENT
/begin MEASUREMENT Coil1SHFailCount "var comments" UWORD udf_CM_18026 0 0.0 0.0 65535.0 DISPLAY_IDENTIFIER CoilSHFailCount[0] ECU_ADDRESS 0x40002CBC /end MEASUREMENT
/begin MEASUREMENT Coil1SHPassCount "var comments" UWORD udf_CM_18054 0 0.0 0.0 65535.0 DISPLAY_IDENTIFIER CoilSHPassCount[0] ECU_ADDRESS 0x40002CC4 /end MEASUREMENT
/begin MEASUREMENT Coil2DiagEnb "var comments" UBYTE udf_CM_18019 0 0.0 0.0 255.0 DISPLAY_IDENTIFIER CoilDiagEnb[1] ECU_ADDRESS 0x40002CA1 /end MEASUREMENT
/begin MEASUREMENT Coil2SLFailMet "var comments" UBYTE udf_CM_18047 0 0.0 0.0 255.0 DISPLAY_IDENTIFIER CoilSLFailMet[1] ECU_ADDRESS 0x40002C99 /end MEASUREMENT
/begin MEASUREMENT Coil2SLTestComp "var comments" UBYTE udf_CM_18061 0 0.0 0.0 255.0 DISPLAY_IDENTIFIER CoilSLTestComp[1] ECU_ADDRESS 0x40002CA5 /end MEASUREMENT
/begin MEASUREMENT Coil2SLTestFail "var comments" UBYTE udf_CM_18068 0 0.0 0.0 255.0 DISPLAY_IDENTIFIER CoilSLTestFail[1] ECU_ADDRESS 0x40002CCD /end MEASUREMENT
/begin MEASUREMENT Coil2SLFailCount "var comments" UWORD udf_CM_18026 0 0.0 0.0 65535.0 DISPLAY_IDENTIFIER CoilSLFailCount[1] ECU_ADDRESS 0x40002CAE /end MEASUREMENT
/begin MEASUREMENT Coil2SLPassCount "var comments" UWORD udf_CM_18054 0 0.0 0.0 65535.0 DISPLAY_IDENTIFIER CoilSLPassCount[1] ECU_ADDRESS 0x40002CB6 /end MEASUREMENT
/begin MEASUREMENT Coil2SHFailMet "var comments" UBYTE udf_CM_18047 0 0.0 0.0 255.0 DISPLAY_IDENTIFIER CoilSHFailMet[1] ECU_ADDRESS 0x40002C9D /end MEASUREMENT
/begin MEASUREMENT Coil2SHTestComp "var comments" UBYTE udf_CM_18061 0 0.0 0.0 255.0 DISPLAY_IDENTIFIER CoilSHTestComp[1] ECU_ADDRESS 0x40002CA9 /end MEASUREMENT
/begin MEASUREMENT Coil2SHTestFail "var comments" UBYTE udf_CM_18068 0 0.0 0.0 255.0 DISPLAY_IDENTIFIER CoilSHTestFail[1] ECU_ADDRESS 0x40002CD1 /end MEASUREMENT
/begin MEASUREMENT Coil2SHFailCount "var comments" UWORD udf_CM_18026 0 0.0 0.0 65535.0 DISPLAY_IDENTIFIER CoilSHFailCount[1] ECU_ADDRESS 0x40002CBE /end MEASUREMENT
/begin MEASUREMENT Coil2SHPassCount "var comments" UWORD udf_CM_18054 0 0.0 0.0 65535.0 DISPLAY_IDENTIFIER CoilSHPassCount[1] ECU_ADDRESS 0x40002CC6 /end MEASUREMENT
/begin MEASUREMENT Coil3DiagEnb "var comments" UBYTE udf_CM_18019 0 0.0 0.0 255.0 DISPLAY_IDENTIFIER CoilDiagEnb[2] ECU_ADDRESS 0x40002CA2 /end MEASUREMENT
/begin MEASUREMENT Coil3SLFailMet "var comments" UBYTE udf_CM_18047 0 0.0 0.0 255.0 DISPLAY_IDENTIFIER CoilSLFailMet[2] ECU_ADDRESS 0x40002C9A /end MEASUREMENT
/begin MEASUREMENT Coil3SLTestComp "var comments" UBYTE udf_CM_18061 0 0.0 0.0 255.0 DISPLAY_IDENTIFIER CoilSLTestComp[2] ECU_ADDRESS 0x40002CA6 /end MEASUREMENT
/begin MEASUREMENT Coil3SLTestFail "var comments" UBYTE udf_CM_18068 0 0.0 0.0 255.0 DISPLAY_IDENTIFIER CoilSLTestFail[2] ECU_ADDRESS 0x40002CCE /end MEASUREMENT
/begin MEASUREMENT Coil3SLFailCount "var comments" UWORD udf_CM_18026 0 0.0 0.0 65535.0 DISPLAY_IDENTIFIER CoilSLFailCount[2] ECU_ADDRESS 0x40002CB0 /end MEASUREMENT
/begin MEASUREMENT Coil3SLPassCount "var comments" UWORD udf_CM_18054 0 0.0 0.0 65535.0 DISPLAY_IDENTIFIER CoilSLPassCount[2] ECU_ADDRESS 0x40002CB8 /end MEASUREMENT
/begin MEASUREMENT Coil3SHFailMet "var comments" UBYTE udf_CM_18047 0 0.0 0.0 255.0 DISPLAY_IDENTIFIER CoilSHFailMet[2] ECU_ADDRESS 0x40002C9E /end MEASUREMENT
/begin MEASUREMENT Coil3SHTestComp "var comments" UBYTE udf_CM_18061 0 0.0 0.0 255.0 DISPLAY_IDENTIFIER CoilSHTestComp[2] ECU_ADDRESS 0x40002CAA /end MEASUREMENT
/begin MEASUREMENT Coil3SHTestFail "var comments" UBYTE udf_CM_18068 0 0.0 0.0 255.0 DISPLAY_IDENTIFIER CoilSHTestFail[2] ECU_ADDRESS 0x40002CD2 /end MEASUREMENT
/begin MEASUREMENT Coil3SHFailCount "var comments" UWORD udf_CM_18026 0 0.0 0.0 65535.0 DISPLAY_IDENTIFIER CoilSHFailCount[2] ECU_ADDRESS 0x40002CC0 /end MEASUREMENT
/begin MEASUREMENT Coil3SHPassCount "var comments" UWORD udf_CM_18054 0 0.0 0.0 65535.0 DISPLAY_IDENTIFIER CoilSHPassCount[2] ECU_ADDRESS 0x40002CC8 /end MEASUREMENT
/begin MEASUREMENT Coil4DiagEnb "var comments" UBYTE udf_CM_18019 0 0.0 0.0 255.0 DISPLAY_IDENTIFIER CoilDiagEnb[3] ECU_ADDRESS 0x40002CA3 /end MEASUREMENT
/begin MEASUREMENT Coil4SLFailMet "var comments" UBYTE udf_CM_18047 0 0.0 0.0 255.0 DISPLAY_IDENTIFIER CoilSLFailMet[3] ECU_ADDRESS 0x40002C9B /end MEASUREMENT
/begin MEASUREMENT Coil4SLTestComp "var comments" UBYTE udf_CM_18061 0 0.0 0.0 255.0 DISPLAY_IDENTIFIER CoilSLTestComp[3] ECU_ADDRESS 0x40002CA7 /end MEASUREMENT
/begin MEASUREMENT Coil4SLTestFail "var comments" UBYTE udf_CM_18068 0 0.0 0.0 255.0 DISPLAY_IDENTIFIER CoilSLTestFail[3] ECU_ADDRESS 0x40002CCF /end MEASUREMENT
/begin MEASUREMENT Coil4SLFailCount "var comments" UWORD udf_CM_18026 0 0.0 0.0 65535.0 DISPLAY_IDENTIFIER CoilSLFailCount[3] ECU_ADDRESS 0x40002CB2 /end MEASUREMENT
/begin MEASUREMENT Coil4SLPassCount "var comments" UWORD udf_CM_18054 0 0.0 0.0 65535.0 DISPLAY_IDENTIFIER CoilSLPassCount[3] ECU_ADDRESS 0x40002CBA /end MEASUREMENT
/begin MEASUREMENT Coil4SHFailMet "var comments" UBYTE udf_CM_18047 0 0.0 0.0 255.0 DISPLAY_IDENTIFIER CoilSHFailMet[3] ECU_ADDRESS 0x40002C9F /end MEASUREMENT
/begin MEASUREMENT Coil4SHTestComp "var comments" UBYTE udf_CM_18061 0 0.0 0.0 255.0 DISPLAY_IDENTIFIER CoilSHTestComp[3] ECU_ADDRESS 0x40002CAB /end MEASUREMENT
/begin MEASUREMENT Coil4SHTestFail "var comments" UBYTE udf_CM_18068 0 0.0 0.0 255.0 DISPLAY_IDENTIFIER CoilSHTestFail[3] ECU_ADDRESS 0x40002CD3 /end MEASUREMENT
/begin MEASUREMENT Coil4SHFailCount "var comments" UWORD udf_CM_18026 0 0.0 0.0 65535.0 DISPLAY_IDENTIFIER CoilSHFailCount[3] ECU_ADDRESS 0x40002CC2 /end MEASUREMENT
/begin MEASUREMENT Coil4SHPassCount "var comments" UWORD udf_CM_18054 0 0.0 0.0 65535.0 DISPLAY_IDENTIFIER CoilSHPassCount[3] ECU_ADDRESS 0x40002CCA /end MEASUREMENT
/begin MEASUREMENT CrkNoSigDiagEnb "var comments" UBYTE udf_CM_15905 0 0.0 0.0 255.0 ECU_ADDRESS 0x40002BB8 /end MEASUREMENT
/begin MEASUREMENT CrkNoSigFailMet "var comments" UBYTE udf_CM_15912 0 0.0 0.0 255.0 ECU_ADDRESS 0x40002BC1 /end MEASUREMENT
/begin MEASUREMENT CrkNoSigTestFail "var comments" UBYTE udf_CM_15926 0 0.0 0.0 255.0 ECU_ADDRESS 0x40002BBF /end MEASUREMENT
/begin MEASUREMENT CrkNoSigTestComp "var comments" UBYTE udf_CM_15919 0 0.0 0.0 255.0 ECU_ADDRESS 0x40002BBD /end MEASUREMENT
/begin MEASUREMENT CrkNoSigFailCount "var comments" UWORD udf_CM_18054 0 0.0 0.0 65535.0 ECU_ADDRESS 0x40002BC4 /end MEASUREMENT
/begin MEASUREMENT CrkNoSigPassCount "var comments" UWORD udf_CM_18054 0 0.0 0.0 65535.0 ECU_ADDRESS 0x40002BC2 /end MEASUREMENT
/begin MEASUREMENT CrkNoSigMAPFilt "var comments" UWORD CM_kpa_0to512_1 0 0.0 0.0 511.9921875 ECU_ADDRESS 0x40002BBA /end MEASUREMENT
/begin MEASUREMENT CrkNoSigMAPDelta "var comments" UWORD CM_kpa_0to512_1 0 0.0 0.0 511.9921875 ECU_ADDRESS 0x40002BCA /end MEASUREMENT
/begin MEASUREMENT CrkNoisyDiagEnb "var comments" UBYTE udf_CM_15856 0 0.0 0.0 255.0 ECU_ADDRESS 0x40002BB9 /end MEASUREMENT
/begin MEASUREMENT CrkNoisyFailCnt "var comments" UWORD udf_CM_15863 0 0.0 0.0 65535.0 ECU_ADDRESS 0x40002BC8 /end MEASUREMENT
/begin MEASUREMENT CrkNoisyFailMet "var comments" UBYTE udf_CM_15870 0 0.0 0.0 255.0 ECU_ADDRESS 0x40002BBC /end MEASUREMENT
/begin MEASUREMENT CrkNoisyPassCnt "var comments" UWORD udf_CM_15877 0 0.0 0.0 65535.0 ECU_ADDRESS 0x40002BC6 /end MEASUREMENT
/begin MEASUREMENT CrkNoisyTestComp "var comments" UBYTE udf_CM_15884 0 0.0 0.0 255.0 ECU_ADDRESS 0x40002BBE /end MEASUREMENT
/begin MEASUREMENT CrkNoisyTestFail "var comments" UBYTE udf_CM_15891 0 0.0 0.0 255.0 ECU_ADDRESS 0x40002BC0 /end MEASUREMENT
/begin MEASUREMENT CrankToRunMet "var comments" UBYTE udf_CM_15821 0 0.0 0.0 255.0 ECU_ADDRESS 0x4000291D /end MEASUREMENT
/begin MEASUREMENT CrankToStallMet "var comments" UBYTE udf_CM_15828 0 0.0 0.0 255.0 ECU_ADDRESS 0x4000291E /end MEASUREMENT
/begin MEASUREMENT MAPCIDEnb "var comments" UBYTE udf_CM_17095 0 0.0 0.0 255.0 ECU_ADDRESS 0x40002907 /end MEASUREMENT
/begin MEASUREMENT DesireTPS "var comments" UWORD udf_CM_15989 0 0.0 0.0 199.9969482421875 ECU_ADDRESS 0x40002A60 /end MEASUREMENT
/begin MEASUREMENT DiagWarningLamp "var comments" UBYTE udf_CM_16010 0 0.0 0.0 1.0 ECU_ADDRESS 0x40002ADE /end MEASUREMENT
/begin MEASUREMENT IdlDsrdEngSpdStep "var comments" UWORD udf_CM_16787 0 0.0 0.0 16383.75 ECU_ADDRESS 0x40002682 /end MEASUREMENT
/begin MEASUREMENT IdlDsrdEngSpdTarget "var comments" UWORD udf_CM_16794 0 0.0 0.0 16383.75 ECU_ADDRESS 0x4000267E /end MEASUREMENT
/begin MEASUREMENT DsrdThrFlow "var comments" UWORD udf_CM_15982 0 0.0 0.0 511.9921875 ECU_ADDRESS 0x40002A76 /end MEASUREMENT
/begin MEASUREMENT DesireTPSOld "var comments" UWORD udf_CM_15996 0 0.0 0.0 199.9969482421875 ECU_ADDRESS 0x40002A78 /end MEASUREMENT
/begin MEASUREMENT EngSpdOld0 "var comments" UWORD udf_CM_16073 0 0.0 0.0 16383.75 DISPLAY_IDENTIFIER EngineSpeedOld[0] ECU_ADDRESS 0x400029E8 /end MEASUREMENT
/begin MEASUREMENT EngSpdOld1 "var comments" UWORD udf_CM_16122 0 0.0 0.0 16383.75 DISPLAY_IDENTIFIER EngineSpeedOld[1] ECU_ADDRESS 0x400029EA /end MEASUREMENT
/begin MEASUREMENT EngSpdOld10 "var comments" UWORD udf_CM_16080 0 0.0 0.0 16383.75 DISPLAY_IDENTIFIER EngineSpeedOld[10] ECU_ADDRESS 0x400029FC /end MEASUREMENT
/begin MEASUREMENT EngSpdOld11 "var comments" UWORD udf_CM_16087 0 0.0 0.0 16383.75 DISPLAY_IDENTIFIER EngineSpeedOld[11] ECU_ADDRESS 0x400029FE /end MEASUREMENT
/begin MEASUREMENT EngSpdOld12 "var comments" UWORD udf_CM_16094 0 0.0 0.0 16383.75 DISPLAY_IDENTIFIER EngineSpeedOld[12] ECU_ADDRESS 0x40002A00 /end MEASUREMENT
/begin MEASUREMENT EngSpdOld13 "var comments" UWORD udf_CM_16101 0 0.0 0.0 16383.75 DISPLAY_IDENTIFIER EngineSpeedOld[13] ECU_ADDRESS 0x40002A02 /end MEASUREMENT
/begin MEASUREMENT EngSpdOld14 "var comments" UWORD udf_CM_16108 0 0.0 0.0 16383.75 DISPLAY_IDENTIFIER EngineSpeedOld[14] ECU_ADDRESS 0x40002A04 /end MEASUREMENT
/begin MEASUREMENT EngSpdOld15 "var comments" UWORD udf_CM_16115 0 0.0 0.0 16383.75 DISPLAY_IDENTIFIER EngineSpeedOld[15] ECU_ADDRESS 0x40002A06 /end MEASUREMENT
/begin MEASUREMENT EngSpdOld2 "var comments" UWORD udf_CM_16129 0 0.0 0.0 16383.75 DISPLAY_IDENTIFIER EngineSpeedOld[2] ECU_ADDRESS 0x400029EC /end MEASUREMENT
/begin MEASUREMENT EngSpdOld3 "var comments" UWORD udf_CM_16136 0 0.0 0.0 16383.75 DISPLAY_IDENTIFIER EngineSpeedOld[3] ECU_ADDRESS 0x400029EE /end MEASUREMENT
/begin MEASUREMENT EngSpdOld4 "var comments" UWORD udf_CM_16143 0 0.0 0.0 16383.75 DISPLAY_IDENTIFIER EngineSpeedOld[4] ECU_ADDRESS 0x400029F0 /end MEASUREMENT
/begin MEASUREMENT EngSpdOld5 "var comments" UWORD udf_CM_16150 0 0.0 0.0 16383.75 DISPLAY_IDENTIFIER EngineSpeedOld[5] ECU_ADDRESS 0x400029F2 /end MEASUREMENT
/begin MEASUREMENT EngSpdOld6 "var comments" UWORD udf_CM_16157 0 0.0 0.0 16383.75 DISPLAY_IDENTIFIER EngineSpeedOld[6] ECU_ADDRESS 0x400029F4 /end MEASUREMENT
/begin MEASUREMENT EngSpdOld7 "var comments" UWORD udf_CM_16164 0 0.0 0.0 16383.75 DISPLAY_IDENTIFIER EngineSpeedOld[7] ECU_ADDRESS 0x400029F6 /end MEASUREMENT
/begin MEASUREMENT EngSpdOld8 "var comments" UWORD udf_CM_16171 0 0.0 0.0 16383.75 DISPLAY_IDENTIFIER EngineSpeedOld[8] ECU_ADDRESS 0x400029F8 /end MEASUREMENT
/begin MEASUREMENT EngSpdOld9 "var comments" UWORD udf_CM_16178 0 0.0 0.0 16383.75 DISPLAY_IDENTIFIER EngineSpeedOld[9] ECU_ADDRESS 0x400029FA /end MEASUREMENT
/begin MEASUREMENT MultFuelType "var comments" UBYTE udf_CM_16193 0 0.0 0.0 255.0 ECU_ADDRESS 0x40002A46 /end MEASUREMENT
/begin MEASUREMENT EngineState "var comments" UBYTE udf_CM_16192 0 0.0 0.0 255.0 ECU_ADDRESS 0x40002918 /end MEASUREMENT
/begin MEASUREMENT EngTorque "var comments" SWORD udf_CM_16059 0 0.0 -128.0 127.99609375 DISPLAY_IDENTIFIER EngineFlywheelTorq ECU_ADDRESS 0x40002404 /end MEASUREMENT
/begin MEASUREMENT EngineTuning "var comments" UBYTE udf_CM_16199 0 0.0 0.0 255.0 ECU_ADDRESS 0x40002926 /end MEASUREMENT
/begin MEASUREMENT O2_1_SHTestFail "var comments" UBYTE udf_CM_17508 0 0.0 0.0 255.0 ECU_ADDRESS 0x40002B9A /end MEASUREMENT
/begin MEASUREMENT O2_1_ShrtDiagEnb "var comments" UBYTE udf_CM_17494 0 0.0 0.0 255.0 ECU_ADDRESS 0x40002B98 /end MEASUREMENT
/begin MEASUREMENT O2_1_SHFailMet "var comments" UBYTE udf_CM_17487 0 0.0 0.0 255.0 ECU_ADDRESS 0x40002B9E /end MEASUREMENT
/begin MEASUREMENT O2_1_SHFailCount "var comments" UWORD udf_CM_17480 0 0.0 0.0 65535.0 ECU_ADDRESS 0x40002BA0 /end MEASUREMENT
/begin MEASUREMENT O2_1_SLFailMet "var comments" UBYTE udf_CM_17522 0 0.0 0.0 255.0 ECU_ADDRESS 0x40002B9D /end MEASUREMENT
/begin MEASUREMENT O2_1_SLFailCount "var comments" UWORD udf_CM_17515 0 0.0 0.0 65535.0 ECU_ADDRESS 0x40002BA2 /end MEASUREMENT
/begin MEASUREMENT O2_1_SLTestFail "var comments" UBYTE udf_CM_17529 0 0.0 0.0 255.0 ECU_ADDRESS 0x40002B9B /end MEASUREMENT
/begin MEASUREMENT O2_1_ShrtPassCount "var comments" UWORD udf_CM_17501 0 0.0 0.0 65535.0 ECU_ADDRESS 0x40002BA4 /end MEASUREMENT
/begin MEASUREMENT O2_2_SHTestFail "var comments" UBYTE udf_CM_17508 0 0.0 0.0 255.0 ECU_ADDRESS 0x0 /end MEASUREMENT
/begin MEASUREMENT O2_2_ShrtDiagEnb "var comments" UBYTE udf_CM_17494 0 0.0 0.0 255.0 ECU_ADDRESS 0x0 /end MEASUREMENT
/begin MEASUREMENT O2_2_SHFailMet "var comments" UBYTE udf_CM_17487 0 0.0 0.0 255.0 ECU_ADDRESS 0x0 /end MEASUREMENT
/begin MEASUREMENT O2_2_SHFailCount "var comments" UWORD udf_CM_17480 0 0.0 0.0 65535.0 ECU_ADDRESS 0x0 /end MEASUREMENT
/begin MEASUREMENT O2_2_SLFailMet "var comments" UBYTE udf_CM_17522 0 0.0 0.0 255.0 ECU_ADDRESS 0x0 /end MEASUREMENT
/begin MEASUREMENT O2_2_SLFailCount "var comments" UWORD udf_CM_17515 0 0.0 0.0 65535.0 ECU_ADDRESS 0x0 /end MEASUREMENT
/begin MEASUREMENT O2_2_SLTestFail "var comments" UBYTE udf_CM_17529 0 0.0 0.0 255.0 ECU_ADDRESS 0x0 /end MEASUREMENT
/begin MEASUREMENT O2_2_ShrtPassCount "var comments" UWORD udf_CM_17501 0 0.0 0.0 65535.0 ECU_ADDRESS 0x0 /end MEASUREMENT
/begin MEASUREMENT RO2_1_SHTestFail "var comments" UBYTE udf_CM_17508 0 0.0 0.0 255.0 ECU_ADDRESS 0x40002BA9 /end MEASUREMENT
/begin MEASUREMENT RO2_1_ShrtDiagEnb "var comments" UBYTE udf_CM_17494 0 0.0 0.0 255.0 ECU_ADDRESS 0x40002BA6 /end MEASUREMENT
/begin MEASUREMENT RO2_1_SHFailMet "var comments" UBYTE udf_CM_17487 0 0.0 0.0 255.0 ECU_ADDRESS 0x40002BAC /end MEASUREMENT
/begin MEASUREMENT RO2_1_SHFailCount "var comments" UWORD udf_CM_17480 0 0.0 0.0 65535.0 ECU_ADDRESS 0x40002BAE /end MEASUREMENT
/begin MEASUREMENT RO2_1_SLFailMet "var comments" UBYTE udf_CM_17522 0 0.0 0.0 255.0 ECU_ADDRESS 0x40002BAB /end MEASUREMENT
/begin MEASUREMENT RO2_1_SLFailCount "var comments" UWORD udf_CM_17515 0 0.0 0.0 65535.0 ECU_ADDRESS 0x40002BB0 /end MEASUREMENT
/begin MEASUREMENT RO2_1_SLTestFail "var comments" UBYTE udf_CM_17529 0 0.0 0.0 255.0 ECU_ADDRESS 0x40002BA8 /end MEASUREMENT
/begin MEASUREMENT RO2_1_ShrtPassCount "var comments" UWORD udf_CM_17501 0 0.0 0.0 65535.0 ECU_ADDRESS 0x40002BB2 /end MEASUREMENT
/begin MEASUREMENT BaseFPWCyl1 "var comments" UWORD udf_CM_15597 0 0.0 0.0 1023.984375 DISPLAY_IDENTIFIER BaseFPWCyl ECU_ADDRESS 0x40002412 /end MEASUREMENT
/begin MEASUREMENT BaseFPWCyl2 "var comments" UWORD udf_CM_15597 0 0.0 0.0 1023.984375 DISPLAY_IDENTIFIER BaseFPWCyl[1] ECU_ADDRESS 0x40002414 /end MEASUREMENT
/begin MEASUREMENT BaseFuelMassCyl1 "var comments" UWORD udf_CM_15604 0 0.0 0.0 0.9999849796295166 DISPLAY_IDENTIFIER BaseFuelMassCyl ECU_ADDRESS 0x4000241A /end MEASUREMENT
/begin MEASUREMENT BaseFuelMassCyl2 "var comments" UWORD udf_CM_15604 0 0.0 0.0 0.9999849796295166 DISPLAY_IDENTIFIER BaseFuelMassCyl[1] ECU_ADDRESS 0x4000241C /end MEASUREMENT
/begin MEASUREMENT BaseFMPrevCyl1 "var comments" UWORD udf_CM_15590 0 0.0 0.0 0.9999849796295166 DISPLAY_IDENTIFIER BaseFMPrevCyl ECU_ADDRESS 0x40002422 /end MEASUREMENT
/begin MEASUREMENT BaseFMPrevCyl2 "var comments" UWORD udf_CM_15590 0 0.0 0.0 0.9999849796295166 DISPLAY_IDENTIFIER BaseFMPrevCyl[1] ECU_ADDRESS 0x40002424 /end MEASUREMENT
/begin MEASUREMENT FPWClCorrCyl1 "var comments" UWORD udf_CM_16409 0 0.0 0.0 1023.984375 DISPLAY_IDENTIFIER FPWClCorrCyl[0] ECU_ADDRESS 0x4000240A /end MEASUREMENT
/begin MEASUREMENT FPWClCorrCyl2 "var comments" UWORD udf_CM_16416 0 0.0 0.0 1023.984375 DISPLAY_IDENTIFIER FPWClCorrCyl[1] ECU_ADDRESS 0x4000240C /end MEASUREMENT
/begin MEASUREMENT ChrgAirTmpCyl1 "var comments" SWORD udf_CM_15646 0 0.0 -256.0 255.9921875 DISPLAY_IDENTIFIER ChrgAirTmpCyl ECU_ADDRESS 0x400023A8 /end MEASUREMENT
/begin MEASUREMENT FuelCLTermCyl1 "var comments" SWORD udf_CM_16437 0 0.0 -4.0 3.9998779296875 DISPLAY_IDENTIFIER FuelCLTermCyl ECU_ADDRESS 0x400025F6 /end MEASUREMENT
/begin MEASUREMENT FuelCLTermCyl2 "var comments" SWORD udf_CM_16437 0 0.0 -4.0 3.9998779296875 DISPLAY_IDENTIFIER FuelCLTermCyl[1] ECU_ADDRESS 0x400025F8 /end MEASUREMENT
/begin MEASUREMENT FuelCLEnbCyl1 "var comments" UBYTE udf_CM_16423 0 0.0 0.0 255.0 DISPLAY_IDENTIFIER FuelCLEnbCyl ECU_ADDRESS 0x400025E2 /end MEASUREMENT
/begin MEASUREMENT FuelCLEnbCyl2 "var comments" UBYTE udf_CM_16423 0 0.0 0.0 255.0 DISPLAY_IDENTIFIER FuelCLEnbCyl[1] ECU_ADDRESS 0x400025E3 /end MEASUREMENT
/begin MEASUREMENT FuelINTCyl1 "var comments" SWORD udf_CM_16500 0 0.0 -32768.0 32767.0 DISPLAY_IDENTIFIER FuelINTCyl ECU_ADDRESS 0x400025DE /end MEASUREMENT
/begin MEASUREMENT FuelINTCyl2 "var comments" SWORD udf_CM_16500 0 0.0 -32768.0 32767.0 DISPLAY_IDENTIFIER FuelINTCyl[1] ECU_ADDRESS 0x400025E0 /end MEASUREMENT
/begin MEASUREMENT FuelINTDlyCyl1 "var comments" UWORD udf_CM_16507 0 0.0 0.0 1023.984375 DISPLAY_IDENTIFIER FuelINTDlyCyl ECU_ADDRESS 0x400025EE /end MEASUREMENT
/begin MEASUREMENT FuelINTDlyCyl2 "var comments" UWORD udf_CM_16507 0 0.0 0.0 1023.984375 DISPLAY_IDENTIFIER FuelINTDlyCyl[1] ECU_ADDRESS 0x400025F0 /end MEASUREMENT
/begin MEASUREMENT FPropMinDurEnb "var comments" UBYTE udf_CM_16395 0 0.0 0.0 255.0 ECU_ADDRESS 0x400025E9 /end MEASUREMENT
/begin MEASUREMENT FuelCLC_MultTerm1 "var comments" SWORD udf_CM_17067 0 0.0 -32.0 31.9990234375 DISPLAY_IDENTIFIER FuelCLC_MultTerm[0] ECU_ADDRESS 0x400025C8 /end MEASUREMENT
/begin MEASUREMENT FuelCLC_MultTerm2 "var comments" SWORD udf_CM_17067 0 0.0 -32.0 31.9990234375 DISPLAY_IDENTIFIER FuelCLC_MultTerm[1] ECU_ADDRESS 0x400025CA /end MEASUREMENT
/begin MEASUREMENT RawO2RLThresh "var comments" UWORD udf_CM_17648 0 0.0 0.0 1023.984375 ECU_ADDRESS 0x400025F4 /end MEASUREMENT
/begin MEASUREMENT FPropLoLoadCond "var comments" UBYTE udf_CM_19230 0 0.0 0.0 255.0 ECU_ADDRESS 0x400025E7 /end MEASUREMENT
/begin MEASUREMENT FPropAddFuelCyl1 "var comments" UBYTE udf_CM_16381 0 0.0 0.0 255.0 DISPLAY_IDENTIFIER FPropAddFuelCyl[0] ECU_ADDRESS 0x400025D1 /end MEASUREMENT
/begin MEASUREMENT FPropAddFuelCyl2 "var comments" UBYTE udf_CM_16381 0 0.0 0.0 255.0 DISPLAY_IDENTIFIER FPropAddFuelCyl[1] ECU_ADDRESS 0x400025D2 /end MEASUREMENT
/begin MEASUREMENT FuelINTRstCyl1 "var comments" UBYTE udf_CM_16521 0 0.0 0.0 255.0 DISPLAY_IDENTIFIER FuelINTRstCyl ECU_ADDRESS 0x400025CF /end MEASUREMENT
/begin MEASUREMENT FuelINTRstCyl2 "var comments" UBYTE udf_CM_16521 0 0.0 0.0 255.0 DISPLAY_IDENTIFIER FuelINTRstCyl[1] ECU_ADDRESS 0x400025D0 /end MEASUREMENT
/begin MEASUREMENT FuelINTDlyPass1 "var comments" UBYTE udf_CM_16514 0 0.0 0.0 255.0 DISPLAY_IDENTIFIER FuelINTDlyPass ECU_ADDRESS 0x400025CE /end MEASUREMENT
/begin MEASUREMENT FuelINTDlyPass2 "var comments" UBYTE udf_CM_16514 0 0.0 0.0 255.0 DISPLAY_IDENTIFIER FuelINTDlyPass[1] ECU_ADDRESS 0x400025CF /end MEASUREMENT
/begin MEASUREMENT INTRatioCyl1 "var comments" UWORD udf_CM_19048 0 0.0 0.0 1.999969005584717 DISPLAY_IDENTIFIER INTRatioCyl ECU_ADDRESS 0x400025CA /end MEASUREMENT
/begin MEASUREMENT INTRatioCyl2 "var comments" UWORD udf_CM_19048 0 0.0 0.0 1.999969005584717 DISPLAY_IDENTIFIER INTRatioCyl[1] ECU_ADDRESS 0x400025CC /end MEASUREMENT
/begin MEASUREMENT FPropRichHold1 "var comments" UBYTE udf_CM_16402 0 0.0 0.0 255.0 DISPLAY_IDENTIFIER FPropRichHold ECU_ADDRESS 0x400025DB /end MEASUREMENT
/begin MEASUREMENT FPropRichHold2 "var comments" UBYTE udf_CM_16402 0 0.0 0.0 255.0 DISPLAY_IDENTIFIER FPropRichHold[1] ECU_ADDRESS 0x400025DC /end MEASUREMENT
/begin MEASUREMENT FuelPropCyl1 "var comments" UWORD udf_CM_16535 0 0.0 0.0 199.9969482421875 DISPLAY_IDENTIFIER FuelPropCyl ECU_ADDRESS 0x400025E0 /end MEASUREMENT
/begin MEASUREMENT FuelPropCyl2 "var comments" UWORD udf_CM_16535 0 0.0 0.0 199.9969482421875 DISPLAY_IDENTIFIER FuelPropCyl[1] ECU_ADDRESS 0x400025E2 /end MEASUREMENT
/begin MEASUREMENT FuelCLRstCyl1 "var comments" UBYTE udf_CM_16430 0 0.0 0.0 255.0 DISPLAY_IDENTIFIER FuelCLRstCyl ECU_ADDRESS 0x400025E3 /end MEASUREMENT
/begin MEASUREMENT FuelCLRstCyl2 "var comments" UBYTE udf_CM_16430 0 0.0 0.0 255.0 DISPLAY_IDENTIFIER FuelCLRstCyl[1] ECU_ADDRESS 0x400025E4 /end MEASUREMENT
/begin MEASUREMENT CATFactorCyl1 "var comments" SWORD udf_CM_15639 0 0.0 -1.998847961425781 1.998787045478821 DISPLAY_IDENTIFIER CATFactorCyl ECU_ADDRESS 0x400023A6 /end MEASUREMENT
/begin MEASUREMENT AIRF_T_Inverse_CAT_Term "var comments" UWORD udf_CM_15261 0 0.0 0.0 0.9999849796295166 ECU_ADDRESS 0x4000239C /end MEASUREMENT
/begin MEASUREMENT FuelEOI "var comments" UWORD udf_CM_16465 0 0.0 0.0 1023.984375 ECU_ADDRESS 0x400024B4 /end MEASUREMENT
/begin MEASUREMENT FuelEOITarget "var comments" UWORD udf_CM_16472 0 0.0 0.0 1023.984375 ECU_ADDRESS 0x400024C0 /end MEASUREMENT
/begin MEASUREMENT FuelEOITrim "var comments" UWORD udf_CM_16479 0 0.0 0.0 1023.984375 ECU_ADDRESS 0x400024CA /end MEASUREMENT
/begin MEASUREMENT O2HeaterOutputEnable "var comments" UBYTE udf_CM_17452 0 0.0 0.0 255.0 ECU_ADDRESS 0x400023F7 /end MEASUREMENT
/begin MEASUREMENT FuelInj1Enb "var comments" UBYTE udf_CM_16486 0 0.0 0.0 255.0 DISPLAY_IDENTIFIER FuelInjEnb[0] ECU_ADDRESS 0x400024C2 /end MEASUREMENT
/begin MEASUREMENT FuelInj2Enb "var comments" UBYTE udf_CM_16493 0 0.0 0.0 255.0 DISPLAY_IDENTIFIER FuelInjEnb[1] ECU_ADDRESS 0x400024C3 /end MEASUREMENT
/begin MEASUREMENT InjectorOffset "var comments" UWORD udf_CM_17046 0 0.0 0.0 1023.984375 ECU_ADDRESS 0x400024CC /end MEASUREMENT
/begin MEASUREMENT FO21Filt1 "var comments" UWORD udf_CM_16325 0 0.0 0.0 1023.984375 DISPLAY_IDENTIFIER FO2Filt[0] ECU_ADDRESS 0x400025EC /end MEASUREMENT
/begin MEASUREMENT FO21Filt2 "var comments" UWORD udf_CM_16325 0 0.0 0.0 1023.984375 DISPLAY_IDENTIFIER FO2Filt[1] ECU_ADDRESS 0x400025EE /end MEASUREMENT
/begin MEASUREMENT FO2Error1 "var comments" UWORD udf_CM_17536 0 0.0 0.0 1023.984375 DISPLAY_IDENTIFIER FO2Error[0] ECU_ADDRESS 0x400025F8 /end MEASUREMENT
/begin MEASUREMENT FO2Error2 "var comments" UWORD udf_CM_17536 0 0.0 0.0 1023.984375 DISPLAY_IDENTIFIER FO2Error[1] ECU_ADDRESS 0x400025FA /end MEASUREMENT
/begin MEASUREMENT FO21Ready "var comments" UBYTE udf_CM_16339 0 0.0 0.0 255.0 DISPLAY_IDENTIFIER FO2Ready ECU_ADDRESS 0x400025E6 /end MEASUREMENT
/begin MEASUREMENT FO21Ready2 "var comments" UBYTE udf_CM_16339 0 0.0 0.0 255.0 DISPLAY_IDENTIFIER FO2Ready[1] ECU_ADDRESS 0x400025E7 /end MEASUREMENT
/begin MEASUREMENT FO21RichOld1 "var comments" UBYTE udf_CM_16311 0 0.0 0.0 1.0 DISPLAY_IDENTIFIER FO21RichOld[0] ECU_ADDRESS 0x400025D0 /end MEASUREMENT
/begin MEASUREMENT FO21RichOld2 "var comments" UBYTE udf_CM_16311 0 0.0 0.0 1.0 DISPLAY_IDENTIFIER FO21RichOld[1] ECU_ADDRESS 0x400025D1 /end MEASUREMENT
/begin MEASUREMENT FO21FiltRich1 "var comments" UBYTE udf_CM_16332 0 0.0 0.0 1.0 DISPLAY_IDENTIFIER FO2FiltRich ECU_ADDRESS 0x400025E8 /end MEASUREMENT
/begin MEASUREMENT FO21FiltRich2 "var comments" UBYTE udf_CM_16332 0 0.0 0.0 1.0 DISPLAY_IDENTIFIER FO2FiltRich[1] ECU_ADDRESS 0x400025E9 /end MEASUREMENT
/begin MEASUREMENT FO21Rich1 "var comments" UBYTE udf_CM_16346 0 0.0 0.0 1.0 DISPLAY_IDENTIFIER FO2Rich ECU_ADDRESS 0x400025DA /end MEASUREMENT
/begin MEASUREMENT FO21Rich2 "var comments" UBYTE udf_CM_16346 0 0.0 0.0 1.0 DISPLAY_IDENTIFIER FO2Rich[1] ECU_ADDRESS 0x400025DB /end MEASUREMENT
/begin MEASUREMENT FO2RLThresh "var comments" UWORD udf_CM_16360 0 0.0 0.0 1023.984375 ECU_ADDRESS 0x400025DC /end MEASUREMENT
/begin MEASUREMENT FO21RLChange1 "var comments" UBYTE udf_CM_16353 0 0.0 0.0 255.0 DISPLAY_IDENTIFIER FO2RLChange[0] ECU_ADDRESS 0x400025D3 /end MEASUREMENT
/begin MEASUREMENT FO21RLChange2 "var comments" UBYTE udf_CM_16353 0 0.0 0.0 255.0 DISPLAY_IDENTIFIER FO2RLChange[1] ECU_ADDRESS 0x400025D4 /end MEASUREMENT
/begin MEASUREMENT FO2FiltRLChange1 "var comments" UBYTE udf_CM_16353 0 0.0 0.0 255.0 DISPLAY_IDENTIFIER FO2FiltRLChange[0] ECU_ADDRESS 0x400025D8 /end MEASUREMENT
/begin MEASUREMENT FO2FiltRLChange2 "var comments" UBYTE udf_CM_16353 0 0.0 0.0 255.0 DISPLAY_IDENTIFIER FO2FiltRLChange[1] ECU_ADDRESS 0x400025D9 /end MEASUREMENT
/begin MEASUREMENT O2HeaterEnb "var comments" UBYTE udf_CM_17445 0 0.0 0.0 255.0 DISPLAY_IDENTIFIER O2HeaterEnable ECU_ADDRESS 0x400023F6 /end MEASUREMENT
/begin MEASUREMENT ExtPEModeEnb "var comments" UBYTE udf_CM_16269 0 0.0 0.0 255.0 ECU_ADDRESS 0x40002433 /end MEASUREMENT
/begin MEASUREMENT FuelPumpEnb "var comments" UBYTE udf_CM_16605 0 0.0 0.0 255.0 ECU_ADDRESS 0x400024D8 /end MEASUREMENT
/begin MEASUREMENT FuelPumpCurr "var comments" UWORD udf_CM_17389 0 0.0 0.0 65535.0 ECU_ADDRESS 0x400024DA /end MEASUREMENT
/begin MEASUREMENT PowerEnrich "var comments" UBYTE udf_CM_17613 0 0.0 0.0 255.0 ECU_ADDRESS 0x400024CE /end MEASUREMENT
/begin MEASUREMENT RO2_LrnMult "var comments" UWORD udf_CM_16626 0 0.0 0.0 1.999969005584717 ECU_ADDRESS 0x4000260C /end MEASUREMENT
/begin MEASUREMENT RO2_Updated "var comments" UBYTE udf_CM_16710 0 0.0 0.0 255.0 ECU_ADDRESS 0x4000260B /end MEASUREMENT
/begin MEASUREMENT RO2_LrnAllowed "var comments" UBYTE udf_CM_16710 0 0.0 0.0 255.0 ECU_ADDRESS 0x400025FF /end MEASUREMENT
/begin MEASUREMENT RO2_CellCol "var comments" UBYTE CM_Count1 0 0.0 0.0 255.0 ECU_ADDRESS 0x400025FC /end MEASUREMENT
/begin MEASUREMENT RO2_Cell_NG "var comments" UWORD udf_CM_16626 0 0.0 0.0 1.999969005584717 LAYOUT COLUMN_DIR MATRIX_DIM 9 ECU_ADDRESS 0x400003EA /end MEASUREMENT
/begin MEASUREMENT RO2_Cell_LPG "var comments" UWORD udf_CM_16626 0 0.0 0.0 1.999969005584717 LAYOUT COLUMN_DIR MATRIX_DIM 9 ECU_ADDRESS 0x400003FC /end MEASUREMENT
/begin MEASUREMENT FuelPumpDiagEnb "var comments" UBYTE udf_CM_17382 0 0.0 0.0 255.0 ECU_ADDRESS 0x40002CDA /end MEASUREMENT
/begin MEASUREMENT FuelPumpSLFailMet "var comments" UBYTE udf_CM_17410 0 0.0 0.0 255.0 ECU_ADDRESS 0x40002CDB /end MEASUREMENT
/begin MEASUREMENT FuelPumpSLTestComp "var comments" UBYTE udf_CM_17424 0 0.0 0.0 255.0 ECU_ADDRESS 0x40002CDD /end MEASUREMENT
/begin MEASUREMENT FuelPumpSLTestFail "var comments" UBYTE udf_CM_17431 0 0.0 0.0 255.0 ECU_ADDRESS 0x40002CDF /end MEASUREMENT
/begin MEASUREMENT FuelPumpSLFailCount "var comments" UWORD udf_CM_17389 0 0.0 0.0 65535.0 ECU_ADDRESS 0x40002CE0 /end MEASUREMENT
/begin MEASUREMENT FuelPumpSLPassCount "var comments" UWORD udf_CM_17417 0 0.0 0.0 65535.0 ECU_ADDRESS 0x40002CE4 /end MEASUREMENT
/begin MEASUREMENT FuelPumpSHFailMet "var comments" UBYTE udf_CM_17410 0 0.0 0.0 255.0 ECU_ADDRESS 0x40002CDC /end MEASUREMENT
/begin MEASUREMENT FuelPumpSHTestComp "var comments" UBYTE udf_CM_17424 0 0.0 0.0 255.0 ECU_ADDRESS 0x40002CDE /end MEASUREMENT
/begin MEASUREMENT FuelPumpSHTestFail "var comments" UBYTE udf_CM_17431 0 0.0 0.0 255.0 ECU_ADDRESS 0x40002CE8 /end MEASUREMENT
/begin MEASUREMENT FuelPumpSHFailCount "var comments" UWORD udf_CM_17389 0 0.0 0.0 65535.0 ECU_ADDRESS 0x40002CE2 /end MEASUREMENT
/begin MEASUREMENT FuelPumpSHPassCount "var comments" UWORD udf_CM_17417 0 0.0 0.0 65535.0 ECU_ADDRESS 0x40002CE6 /end MEASUREMENT
/begin MEASUREMENT FuelPumpRunEnb "var comments" UBYTE udf_CM_16619 0 0.0 0.0 255.0 ECU_ADDRESS 0x400024D1 /end MEASUREMENT
/begin MEASUREMENT FuelPumpDC "var comments" UWORD udf_CM_16598 0 0.0 0.0 199.9969482421875 ECU_ADDRESS 0x400024D4 /end MEASUREMENT
/begin MEASUREMENT FuelPumpPPDsrd "var comments" UBYTE udf_CM_19244 0 0.0 0.0 255.0 ECU_ADDRESS 0x400024E1 /end MEASUREMENT
/begin MEASUREMENT FuelPumpPrmEnb "var comments" UBYTE udf_CM_16612 0 0.0 0.0 255.0 ECU_ADDRESS 0x400024D0 /end MEASUREMENT
/begin MEASUREMENT FuelVoltCorr "var comments" UWORD udf_CM_16626 0 0.0 0.0 1.999969005584717 ECU_ADDRESS 0x400024C6 /end MEASUREMENT
/begin MEASUREMENT FuelPressureCorr "var comments" UWORD udf_CM_16627 0 0.0 0.0 3.99993896484375 ECU_ADDRESS 0x400024C8 /end MEASUREMENT
/begin COMPU_METHOD udf_CM_15261 "Ax + B" RAT_FUNC "%4.4" "ratio" COEFFS 0.0 65536.00026843546 0.0 0.0 0.0 1.0 /end COMPU_METHOD
/begin COMPU_METHOD udf_CM_15422 "Ax + B" RAT_FUNC "%4.4" "ratio" COEFFS 0.0 2048.0 0.0 0.0 0.0 1.0 /end COMPU_METHOD
/begin COMPU_METHOD udf_CM_15429 "Ax + B" RAT_FUNC "%4.4" "ratio" COEFFS 0.0 2048.0 0.0 0.0 0.0 1.0 /end COMPU_METHOD
/begin COMPU_METHOD udf_CM_15436 "Ax + B" RAT_FUNC "%4.0" "boolean" COEFFS 0 1 0 0 0 1 /end COMPU_METHOD
/begin COMPU_METHOD udf_CM_15450 "Ax + B" RAT_FUNC "%4.4" "ratio" COEFFS 0.0 2048.0 0.0 0.0 0.0 1.0 /end COMPU_METHOD
/begin COMPU_METHOD udf_CM_15457 "Ax + B" RAT_FUNC "%4.4" "ratio" COEFFS 0.0 2048.0 0.0 0.0 0.0 1.0 /end COMPU_METHOD
/begin COMPU_METHOD udf_CM_15464 "Ax + B" RAT_FUNC "%4.4" "ratio" COEFFS 0.0 2048.0 0.0 0.0 0.0 1.0 /end COMPU_METHOD
/begin COMPU_METHOD udf_CM_15485 "Ax + B" RAT_FUNC "%4.4" "ratio" COEFFS 0.0 2048.0 0.0 0.0 0.0 1.0 /end COMPU_METHOD
/begin COMPU_METHOD udf_CM_15506 "Ax + B" RAT_FUNC "%4.4" "ratio" COEFFS 0.0 2048.0 0.0 0.0 0.0 1.0 /end COMPU_METHOD
/begin COMPU_METHOD udf_CM_15513 "Ax + B" RAT_FUNC "%4.0" "boolean" COEFFS 0 1 0 0 0 1 /end COMPU_METHOD
/begin COMPU_METHOD udf_CM_15520 "Ax + B" RAT_FUNC "%4.4" "ratio" COEFFS 0.0 2048.0 0.0 0.0 0.0 1.0 /end COMPU_METHOD
/begin COMPU_METHOD udf_CM_15527 "Ax + B" RAT_FUNC "%4.4" "ratio" COEFFS 0.0 2048.0 0.0 0.0 0.0 1.0 /end COMPU_METHOD
/begin COMPU_METHOD udf_CM_15534 "Ax + B" RAT_FUNC "%4.4" "gm/sec" COEFFS 0.0 128.0 0.0 0.0 0.0 1.0 /end COMPU_METHOD
/begin COMPU_METHOD udf_CM_15541 "Ax + B" RAT_FUNC "%4.4" "gm/sec" COEFFS 0.0 128.0 0.0 0.0 0.0 1.0 /end COMPU_METHOD
/begin COMPU_METHOD udf_CM_15590 "Ax + B" RAT_FUNC "%4.4" "gm" COEFFS 0.0 65536.00026843546 0.0 0.0 0.0 1.0 /end COMPU_METHOD
/begin COMPU_METHOD udf_CM_15597 "Ax + B" RAT_FUNC "%4.4" "msec" COEFFS 0.0 64.0 0.0 0.0 0.0 1.0 /end COMPU_METHOD
/begin COMPU_METHOD udf_CM_15604 "Ax + B" RAT_FUNC "%4.4" "gm" COEFFS 0.0 65536.00026843546 0.0 0.0 0.0 1.0 /end COMPU_METHOD
/begin COMPU_METHOD CM_Boolean1 "" RAT_FUNC "%1.0" "bool" COEFFS 0 1 0 0 0 1 /end COMPU_METHOD
/begin COMPU_METHOD udf_CM_15639 "Ax + B" RAT_FUNC "%4.4" "ratio" COEFFS 0.0 16393.44262295082 0.0 0.0 0.0 1.0 /end COMPU_METHOD
/begin COMPU_METHOD udf_CM_15646 "Ax + B" RAT_FUNC "%4.4" "degC" COEFFS 0.0 128.0 0.0 0.0 0.0 1.0 /end COMPU_METHOD
/begin COMPU_METHOD udf_CM_15674 "Ax + B" RAT_FUNC "%4.0" "None" COEFFS 0 1 0 0 0 1 /end COMPU_METHOD
/begin COMPU_METHOD udf_CM_15716 "Ax + B" RAT_FUNC "%4.0" "Counts" COEFFS 0 1 0 0 0 1 /end COMPU_METHOD
/begin COMPU_METHOD udf_CM_15723 "Ax + B" RAT_FUNC "%4.0" "None" COEFFS 0 1 0 0 0 1 /end COMPU_METHOD
/begin COMPU_METHOD udf_CM_15730 "Ax + B" RAT_FUNC "%4.0" "Counts" COEFFS 0 1 0 0 0 1 /end COMPU_METHOD
/begin COMPU_METHOD udf_CM_15737 "Ax + B" RAT_FUNC "%4.0" "None" COEFFS 0 1 0 0 0 1 /end COMPU_METHOD
/begin COMPU_METHOD CM_Count1 "" RAT_FUNC "%3.0" "count" COEFFS 0 1 0 0 0 1 /end COMPU_METHOD
/begin COMPU_METHOD CM_Count3 "" RAT_FUNC "%3.0" "None" COEFFS 0 1 0 0 0 1 /end COMPU_METHOD
/begin COMPU_METHOD udf_CM_15821 "Ax + B" RAT_FUNC "%4.0" "None" COEFFS 0 1 0 0 0 1 /end COMPU_METHOD
/begin COMPU_METHOD udf_CM_15828 "Ax + B" RAT_FUNC "%4.0" "None" COEFFS 0 1 0 0 0 1 /end COMPU_METHOD
/begin COMPU_METHOD udf_CM_15856 "Ax + B" RAT_FUNC "%4.0" "" COEFFS 0 1 0 0 0 1 /end COMPU_METHOD
/begin COMPU_METHOD udf_CM_15863 "Ax + B" RAT_FUNC "%4.0" "" COEFFS 0 1 0 0 0 1 /end COMPU_METHOD
/begin COMPU_METHOD udf_CM_15870 "Ax + B" RAT_FUNC "%4.0" "" COEFFS 0 1 0 0 0 1 /end COMPU_METHOD
/begin COMPU_METHOD udf_CM_15877 "Ax + B" RAT_FUNC "%4.0" "" COEFFS 0 1 0 0 0 1 /end COMPU_METHOD
/begin COMPU_METHOD udf_CM_15884 "Ax + B" RAT_FUNC "%4.0" "" COEFFS 0 1 0 0 0 1 /end COMPU_METHOD
/begin COMPU_METHOD udf_CM_15891 "Ax + B" RAT_FUNC "%4.0" "" COEFFS 0 1 0 0 0 1 /end COMPU_METHOD
/begin COMPU_METHOD udf_CM_15905 "Ax + B" RAT_FUNC "%4.0" "" COEFFS 0 1 0 0 0 1 /end COMPU_METHOD
/begin COMPU_METHOD udf_CM_15912 "Ax + B" RAT_FUNC "%4.0" "" COEFFS 0 1 0 0 0 1 /end COMPU_METHOD
/begin COMPU_METHOD udf_CM_15919 "Ax + B" RAT_FUNC "%4.0" "" COEFFS 0 1 0 0 0 1 /end COMPU_METHOD
/begin COMPU_METHOD udf_CM_15926 "Ax + B" RAT_FUNC "%4.0" "" COEFFS 0 1 0 0 0 1 /end COMPU_METHOD
/begin COMPU_METHOD CM_DAT_TYPE "" TAB_VERB "%10.4" "" COMPU_TAB_REF CM_DAT_TYPE_TAB /end COMPU_METHOD
/begin COMPU_METHOD CM_EOI "" TAB_VERB "%10.4" "" COMPU_TAB_REF CM_EOI_TAB /end COMPU_METHOD
/begin COMPU_METHOD CM_CYL "" TAB_VERB "%10.4" "" COMPU_TAB_REF CM_CYL_TAB /end COMPU_METHOD
/begin COMPU_METHOD CM_ID "" TAB_VERB "%10.4" "" COMPU_TAB_REF CM_ID_TAB /end COMPU_METHOD
/begin COMPU_METHOD CM_FL_DAT "" TAB_VERB "%10.4" "" COMPU_TAB_REF CM_FL_DAT_TAB /end COMPU_METHOD
/begin COMPU_METHOD CM_LIGHT_TYPE "" TAB_VERB "%4.0" "" COMPU_TAB_REF CM_LIGHT_TYPE_TAB /end COMPU_METHOD
/begin COMPU_METHOD CM_KNK_HZ "" TAB_VERB "%4.0" "" COMPU_TAB_REF CM_KNK_HZ_TAB /end COMPU_METHOD
/begin COMPU_METHOD CM_KNK_GAIN "" TAB_VERB "%4.0" "" COMPU_TAB_REF CM_KNK_GAIN_TAB /end COMPU_METHOD
/begin COMPU_METHOD CM_KNK_INT "" TAB_VERB "%4.0" "" COMPU_TAB_REF CM_KNK_INT_TAB /end COMPU_METHOD
/begin COMPU_METHOD udf_CM_15982 "Ax + B" RAT_FUNC "%4.4" "Gram" COEFFS 0.0 128.0 0.0 0.0 0.0 1.0 /end COMPU_METHOD
/begin COMPU_METHOD udf_CM_15989 "Ax + B" RAT_FUNC "%4.4" "percent" COEFFS 0.0 327.6800000536871 0.0 0.0 0.0 1.0 /end COMPU_METHOD
/begin COMPU_METHOD udf_CM_15996 "Ax + B" RAT_FUNC "%4.0" "percent" COEFFS 0.0 327.6800000536871 0.0 0.0 0.0 1.0 /end COMPU_METHOD
/begin COMPU_METHOD udf_CM_16010 "" TAB_VERB "%10.4" "" COMPU_TAB_REF udf_CV_19704 /end COMPU_METHOD
/begin COMPU_METHOD udf_CM_16059 "Ax + B" RAT_FUNC "%4.4" "NM" COEFFS 0.0 256.0 0.0 0.0 0.0 1.0 /end COMPU_METHOD
/begin COMPU_METHOD udf_CM_16073 "Ax + B" RAT_FUNC "%4.4" "rpm" COEFFS 0.0 4.0 0.0 0.0 0.0 1.0 /end COMPU_METHOD
/begin COMPU_METHOD udf_CM_16080 "Ax + B" RAT_FUNC "%4.4" "rpm" COEFFS 0.0 4.0 0.0 0.0 0.0 1.0 /end COMPU_METHOD
/begin COMPU_METHOD udf_CM_16087 "Ax + B" RAT_FUNC "%4.4" "rpm" COEFFS 0.0 4.0 0.0 0.0 0.0 1.0 /end COMPU_METHOD
/begin COMPU_METHOD udf_CM_16094 "Ax + B" RAT_FUNC "%4.4" "rpm" COEFFS 0.0 4.0 0.0 0.0 0.0 1.0 /end COMPU_METHOD
/begin COMPU_METHOD udf_CM_16101 "Ax + B" RAT_FUNC "%4.4" "rpm" COEFFS 0.0 4.0 0.0 0.0 0.0 1.0 /end COMPU_METHOD
/begin COMPU_METHOD udf_CM_16108 "Ax + B" RAT_FUNC "%4.4" "rpm" COEFFS 0.0 4.0 0.0 0.0 0.0 1.0 /end COMPU_METHOD
/begin COMPU_METHOD udf_CM_16115 "Ax + B" RAT_FUNC "%4.4" "rpm" COEFFS 0.0 4.0 0.0 0.0 0.0 1.0 /end COMPU_METHOD
/begin COMPU_METHOD udf_CM_16122 "Ax + B" RAT_FUNC "%4.4" "rpm" COEFFS 0.0 4.0 0.0 0.0 0.0 1.0 /end COMPU_METHOD
/begin COMPU_METHOD udf_CM_16129 "Ax + B" RAT_FUNC "%4.4" "rpm" COEFFS 0.0 4.0 0.0 0.0 0.0 1.0 /end COMPU_METHOD
/begin COMPU_METHOD udf_CM_16136 "Ax + B" RAT_FUNC "%4.4" "rpm" COEFFS 0.0 4.0 0.0 0.0 0.0 1.0 /end COMPU_METHOD
/begin COMPU_METHOD udf_CM_16143 "Ax + B" RAT_FUNC "%4.4" "rpm" COEFFS 0.0 4.0 0.0 0.0 0.0 1.0 /end COMPU_METHOD
/begin COMPU_METHOD udf_CM_16150 "Ax + B" RAT_FUNC "%4.4" "rpm" COEFFS 0.0 4.0 0.0 0.0 0.0 1.0 /end COMPU_METHOD
/begin COMPU_METHOD udf_CM_16157 "Ax + B" RAT_FUNC "%4.4" "rpm" COEFFS 0.0 4.0 0.0 0.0 0.0 1.0 /end COMPU_METHOD
/begin COMPU_METHOD udf_CM_16164 "Ax + B" RAT_FUNC "%4.4" "rpm" COEFFS 0.0 4.0 0.0 0.0 0.0 1.0 /end COMPU_METHOD
/begin COMPU_METHOD udf_CM_16171 "Ax + B" RAT_FUNC "%4.4" "rpm" COEFFS 0.0 4.0 0.0 0.0 0.0 1.0 /end COMPU_METHOD
/begin COMPU_METHOD udf_CM_16178 "Ax + B" RAT_FUNC "%4.4" "rpm" COEFFS 0.0 4.0 0.0 0.0 0.0 1.0 /end COMPU_METHOD
/begin COMPU_METHOD udf_CM_16192 "" TAB_VERB "%10.4" "" COMPU_TAB_REF udf_CV_19710 /end COMPU_METHOD
/begin COMPU_METHOD udf_CM_16193 "" TAB_VERB "%10.4" "" COMPU_TAB_REF udf_CV_19711 /end COMPU_METHOD
/begin COMPU_METHOD udf_CM_16199 "Ax + B" RAT_FUNC "%4.0" "None" COEFFS 0 1 0 0 0 1 /end COMPU_METHOD
/begin COMPU_METHOD udf_CM_16269 "Ax + B" RAT_FUNC "%4.0" "boolean" COEFFS 0 1 0 0 0 1 /end COMPU_METHOD
/begin COMPU_METHOD udf_CM_16311 "" TAB_VERB "%10.4" "" COMPU_TAB_REF udf_CV_19716 /end COMPU_METHOD
/begin COMPU_METHOD udf_CM_16325 "Ax + B" RAT_FUNC "%4.4" "millivolt" COEFFS 0.0 64.0 0.0 0.0 0.0 1.0 /end COMPU_METHOD
/begin COMPU_METHOD udf_CM_16332 "" TAB_VERB "%10.4" "" COMPU_TAB_REF udf_CV_19722 /end COMPU_METHOD
/begin COMPU_METHOD udf_CM_16339 "Ax + B" RAT_FUNC "%4.0" "boolean" COEFFS 0 1 0 0 0 1 /end COMPU_METHOD
/begin COMPU_METHOD udf_CM_16346 "" TAB_VERB "%10.4" "" COMPU_TAB_REF udf_CV_19728 /end COMPU_METHOD
/begin COMPU_METHOD udf_CM_16353 "Ax + B" RAT_FUNC "%4.0" "boolean" COEFFS 0 1 0 0 0 1 /end COMPU_METHOD
/begin COMPU_METHOD udf_CM_16360 "Ax + B" RAT_FUNC "%4.4" "millivolt" COEFFS 0.0 64.0 0.0 0.0 0.0 1.0 /end COMPU_METHOD
/begin COMPU_METHOD udf_CM_16381 "Ax + B" RAT_FUNC "%4.0" "boolean" COEFFS 0 1 0 0 0 1 /end COMPU_METHOD
/begin COMPU_METHOD udf_CM_16395 "Ax + B" RAT_FUNC "%4.0" "boolean" COEFFS 0 1 0 0 0 1 /end COMPU_METHOD
/begin COMPU_METHOD udf_CM_16402 "Ax + B" RAT_FUNC "%4.0" "boolean" COEFFS 0 1 0 0 0 1 /end COMPU_METHOD
/begin COMPU_METHOD udf_CM_16409 "Ax + B" RAT_FUNC "%4.4" "msec" COEFFS 0.0 64.0 0.0 0.0 0.0 1.0 /end COMPU_METHOD
/begin COMPU_METHOD udf_CM_16416 "Ax + B" RAT_FUNC "%4.4" "msec" COEFFS 0.0 64.0 0.0 0.0 0.0 1.0 /end COMPU_METHOD
/begin COMPU_METHOD udf_CM_16423 "Ax + B" RAT_FUNC "%4.0" "boolean" COEFFS 0 1 0 0 0 1 /end COMPU_METHOD
/begin COMPU_METHOD udf_CM_16430 "Ax + B" RAT_FUNC "%4.0" "boolean" COEFFS 0 1 0 0 0 1 /end COMPU_METHOD
/begin COMPU_METHOD udf_CM_16437 "Ax + B" RAT_FUNC "%4.4" "msec" COEFFS 0.0 8192.000033554432 0.0 0.0 0.0 1.0 /end COMPU_METHOD
/begin COMPU_METHOD udf_CM_16465 "Ax + B" RAT_FUNC "%4.4" "angle" COEFFS 0.0 64.0 0.0 0.0 0.0 1.0 /end COMPU_METHOD
/begin COMPU_METHOD udf_CM_16472 "Ax + B" RAT_FUNC "%4.4" "angle" COEFFS 0.0 64.0 0.0 0.0 0.0 1.0 /end COMPU_METHOD
/begin COMPU_METHOD udf_CM_16479 "Ax + B" RAT_FUNC "%4.4" "angle" COEFFS 0.0 64.0 0.0 0.0 0.0 1.0 /end COMPU_METHOD
/begin COMPU_METHOD udf_CM_16486 "Ax + B" RAT_FUNC "%4.0" "boolean" COEFFS 0 1 0 0 0 1 /end COMPU_METHOD
/begin COMPU_METHOD udf_CM_16493 "Ax + B" RAT_FUNC "%4.0" "boolean" COEFFS 0 1 0 0 0 1 /end COMPU_METHOD
/begin COMPU_METHOD udf_CM_16500 "Ax + B" RAT_FUNC "%4.4" "counts" COEFFS 0 1 0 0 0 1 /end COMPU_METHOD
/begin COMPU_METHOD udf_CM_16507 "Ax + B" RAT_FUNC "%4.4" "msec" COEFFS 0.0 64.0 0.0 0.0 0.0 1.0 /end COMPU_METHOD
/begin COMPU_METHOD udf_CM_16514 "Ax + B" RAT_FUNC "%4.0" "boolean" COEFFS 0 1 0 0 0 1 /end COMPU_METHOD
/begin COMPU_METHOD udf_CM_16521 "Ax + B" RAT_FUNC "%4.0" "boolean" COEFFS 0 1 0 0 0 1 /end COMPU_METHOD
/begin COMPU_METHOD udf_CM_16535 "Ax + B" RAT_FUNC "%4.4" "percent" COEFFS 0.0 327.6800000536871 0.0 0.0 0.0 1.0 /end COMPU_METHOD
/begin COMPU_METHOD udf_CM_16549 "Ax + B" RAT_FUNC "%4.0" "Counts" COEFFS 0 1 0 0 0 1 /end COMPU_METHOD
/begin COMPU_METHOD udf_CM_16556 "Ax + B" RAT_FUNC "%4.0" "None" COEFFS 0 1 0 0 0 1 /end COMPU_METHOD
/begin COMPU_METHOD udf_CM_16563 "Ax + B" RAT_FUNC "%4.0" "None" COEFFS 0 1 0 0 0 1 /end COMPU_METHOD
/begin COMPU_METHOD udf_CM_16570 "Ax + B" RAT_FUNC "%4.0" "None" COEFFS 0 1 0 0 0 1 /end COMPU_METHOD
/begin COMPU_METHOD udf_CM_16577 "Ax + B" RAT_FUNC "%4.0" "Counts" COEFFS 0 1 0 0 0 1 /end COMPU_METHOD
/begin COMPU_METHOD udf_CM_16584 "Ax + B" RAT_FUNC "%4.0" "None" COEFFS 0 1 0 0 0 1 /end COMPU_METHOD
/begin COMPU_METHOD udf_CM_16591 "Ax + B" RAT_FUNC "%4.0" "None" COEFFS 0 1 0 0 0 1 /end COMPU_METHOD
/begin COMPU_METHOD udf_CM_16598 "Ax + B" RAT_FUNC "%4.4" "percent" COEFFS 0.0 327.6800000536871 0.0 0.0 0.0 1.0 /end COMPU_METHOD
/begin COMPU_METHOD udf_CM_16605 "Ax + B" RAT_FUNC "%4.0" "None" COEFFS 0 1 0 0 0 1 /end COMPU_METHOD
/begin COMPU_METHOD udf_CM_16612 "Ax + B" RAT_FUNC "%4.0" "None" COEFFS 0 1 0 0 0 1 /end COMPU_METHOD
/begin COMPU_METHOD udf_CM_16619 "Ax + B" RAT_FUNC "%4.0" "None" COEFFS 0 1 0 0 0 1 /end COMPU_METHOD
/begin COMPU_METHOD udf_CM_16626 "Ax + B" RAT_FUNC "%4.4" "ratio" COEFFS 0.0 32768.00013421773 0.0 0.0 0.0 1.0 /end COMPU_METHOD
/begin COMPU_METHOD udf_CM_16627 "Ax + B" RAT_FUNC "%4.4" "ratio" COEFFS 0.0 16384 0.0 0.0 0.0 1.0 /end COMPU_METHOD
/begin COMPU_METHOD udf_CM_16696 "Ax + B" RAT_FUNC "%4.0" "None" COEFFS 0 1 0 0 0 1 /end COMPU_METHOD
/begin COMPU_METHOD udf_CM_16710 "Ax + B" RAT_FUNC "%4.0" "None" COEFFS 0 1 0 0 0 1 /end COMPU_METHOD
/begin COMPU_METHOD udf_CM_16787 "Ax + B" RAT_FUNC "%4.4" "rpm" COEFFS 0.0 4.0 0.0 0.0 0.0 1.0 /end COMPU_METHOD
/begin COMPU_METHOD udf_CM_16794 "Ax + B" RAT_FUNC "%4.4" "rpm" COEFFS 0.0 4.0 0.0 0.0 0.0 1.0 /end COMPU_METHOD
/begin COMPU_METHOD udf_CM_16878 "Ax + B" RAT_FUNC "%4.4" "msec" COEFFS 0.0 64.0 0.0 0.0 0.0 1.0 /end COMPU_METHOD
/begin COMPU_METHOD udf_CM_16920 "Ax + B" RAT_FUNC "%4.1" "" COEFFS 0.0 2048.0 0.0 0.0 0.0 1.0 /end COMPU_METHOD
/begin COMPU_METHOD udf_CM_16948 "Ax + B" RAT_FUNC "%4.0" "None" COEFFS 0 1 0 0 0 1 /end COMPU_METHOD
/begin COMPU_METHOD udf_CM_16955 "Ax + B" RAT_FUNC "%4.0" "None" COEFFS 0 1 0 0 0 1 /end COMPU_METHOD
/begin COMPU_METHOD udf_CM_16997 "Ax + B" RAT_FUNC "%4.0" "Counts" COEFFS 0 1 0 0 0 1 /end COMPU_METHOD
/begin COMPU_METHOD udf_CM_17004 "Ax + B" RAT_FUNC "%4.0" "None" COEFFS 0 1 0 0 0 1 /end COMPU_METHOD
/begin COMPU_METHOD udf_CM_17011 "Ax + B" RAT_FUNC "%4.0" "None" COEFFS 0 1 0 0 0 1 /end COMPU_METHOD
/begin COMPU_METHOD udf_CM_17018 "Ax + B" RAT_FUNC "%4.0" "None" COEFFS 0 1 0 0 0 1 /end COMPU_METHOD
/begin COMPU_METHOD udf_CM_17025 "Ax + B" RAT_FUNC "%4.0" "Counts" COEFFS 0 1 0 0 0 1 /end COMPU_METHOD
/begin COMPU_METHOD udf_CM_17032 "Ax + B" RAT_FUNC "%4.0" "None" COEFFS 0 1 0 0 0 1 /end COMPU_METHOD
/begin COMPU_METHOD udf_CM_17039 "Ax + B" RAT_FUNC "%4.0" "None" COEFFS 0 1 0 0 0 1 /end COMPU_METHOD
/begin COMPU_METHOD udf_CM_17046 "Ax + B" RAT_FUNC "%4.4" "msec" COEFFS 0.0 64.0 0.0 0.0 0.0 1.0 /end COMPU_METHOD
/begin COMPU_METHOD udf_CM_17067 "Ax + B" RAT_FUNC "%4.4" "ratio" COEFFS 0.0 1024.0 0.0 0.0 0.0 1.0 /end COMPU_METHOD
/begin COMPU_METHOD udf_CM_17095 "Ax + B" RAT_FUNC "%4.0" "None" COEFFS 0 1 0 0 0 1 /end COMPU_METHOD
/begin COMPU_METHOD udf_CM_17235 "Ax + B" RAT_FUNC "%4.0" "boolean" COEFFS 0 1 0 0 0 1 /end COMPU_METHOD
/begin COMPU_METHOD udf_CM_17256 "Ax + B" RAT_FUNC "%4.0" "None" COEFFS 0 1 0 0 0 1 /end COMPU_METHOD
/begin COMPU_METHOD CM_Microsecond_1 "" RAT_FUNC "%6.0" "micro-seconds" COEFFS 0.0 0.125 0.0 0.0 0.0 1.0 /end COMPU_METHOD
/begin COMPU_METHOD CM_Mult_0to2 "" RAT_FUNC "%5.4" "Mul_0_to_2" COEFFS 0.0 128.0 0.0 0.0 0.0 1.0 /end COMPU_METHOD
/begin COMPU_METHOD CM_Mult0_to_2_ratio "" RAT_FUNC "%5.4" "ratio" COEFFS 0.0 128.0 0.0 0.0 0.0 1.0 /end COMPU_METHOD
/begin COMPU_METHOD CM_Mult0_to_2_second "" RAT_FUNC "%5.4" "sec" COEFFS 0.0 128.0 0.0 0.0 0.0 1.0 /end COMPU_METHOD
/begin COMPU_METHOD CM_Equaloutput1 "Default N=E compu method" RAT_FUNC "%10.4" "" COEFFS 0 1 0 0 0 1 /end COMPU_METHOD
/begin COMPU_METHOD CM_Boolean6 "Default N=E compu method" RAT_FUNC "%10.4" "Boolean" COEFFS 0 1 0 0 0 1 /end COMPU_METHOD
/begin COMPU_METHOD udf_CM_17382 "Ax + B" RAT_FUNC "%4.0" "None" COEFFS 0 1 0 0 0 1 /end COMPU_METHOD
/begin COMPU_METHOD udf_CM_17389 "Ax + B" RAT_FUNC "%4.0" "Counts" COEFFS 0 1 0 0 0 1 /end COMPU_METHOD
/begin COMPU_METHOD udf_CM_17396 "Ax + B" RAT_FUNC "%4.0" "None" COEFFS 0 1 0 0 0 1 /end COMPU_METHOD
/begin COMPU_METHOD udf_CM_17403 "Ax + B" RAT_FUNC "%4.0" "None" COEFFS 0 1 0 0 0 1 /end COMPU_METHOD
/begin COMPU_METHOD udf_CM_17410 "Ax + B" RAT_FUNC "%4.0" "None" COEFFS 0 1 0 0 0 1 /end COMPU_METHOD
/begin COMPU_METHOD udf_CM_17417 "Ax + B" RAT_FUNC "%4.0" "Counts" COEFFS 0 1 0 0 0 1 /end COMPU_METHOD
/begin COMPU_METHOD udf_CM_17424 "Ax + B" RAT_FUNC "%4.0" "None" COEFFS 0 1 0 0 0 1 /end COMPU_METHOD
/begin COMPU_METHOD udf_CM_17431 "Ax + B" RAT_FUNC "%4.0" "None" COEFFS 0 1 0 0 0 1 /end COMPU_METHOD
/begin COMPU_METHOD udf_CM_17445 "Ax + B" RAT_FUNC "%4.0" "boolean" COEFFS 0 1 0 0 0 1 /end COMPU_METHOD
/begin COMPU_METHOD udf_CM_17452 "Ax + B" RAT_FUNC "%4.0" "boolean" COEFFS 0 1 0 0 0 1 /end COMPU_METHOD
/begin COMPU_METHOD udf_CM_17480 "Ax + B" RAT_FUNC "%4.0" "counts" COEFFS 0 1 0 0 0 1 /end COMPU_METHOD
/begin COMPU_METHOD udf_CM_17487 "Ax + B" RAT_FUNC "%4.0" "None" COEFFS 0 1 0 0 0 1 /end COMPU_METHOD
/begin COMPU_METHOD udf_CM_17494 "Ax + B" RAT_FUNC "%4.0" "None" COEFFS 0 1 0 0 0 1 /end COMPU_METHOD
/begin COMPU_METHOD udf_CM_17501 "Ax + B" RAT_FUNC "%4.0" "counts" COEFFS 0 1 0 0 0 1 /end COMPU_METHOD
/begin COMPU_METHOD udf_CM_17508 "Ax + B" RAT_FUNC "%4.0" "None" COEFFS 0 1 0 0 0 1 /end COMPU_METHOD
/begin COMPU_METHOD udf_CM_17515 "Ax + B" RAT_FUNC "%4.0" "counts" COEFFS 0 1 0 0 0 1 /end COMPU_METHOD
/begin COMPU_METHOD udf_CM_17522 "Ax + B" RAT_FUNC "%4.0" "None" COEFFS 0 1 0 0 0 1 /end COMPU_METHOD
/begin COMPU_METHOD udf_CM_17529 "Ax + B" RAT_FUNC "%4.0" "None" COEFFS 0 1 0 0 0 1 /end COMPU_METHOD
/begin COMPU_METHOD udf_CM_17536 "Ax + B" RAT_FUNC "%4.4" "millivolt" COEFFS 0.0 64.0 0.0 0.0 0.0 1.0 /end COMPU_METHOD
/begin COMPU_METHOD udf_CM_17613 "Ax + B" RAT_FUNC "%4.0" "boolean" COEFFS 0 1 0 0 0 1 /end COMPU_METHOD
/begin COMPU_METHOD udf_CM_17648 "Ax + B" RAT_FUNC "%4.4" "millivolt" COEFFS 0.0 64.0 0.0 0.0 0.0 1.0 /end COMPU_METHOD
/begin COMPU_METHOD udf_CM_18019 "Ax + B" RAT_FUNC "%4.0" "None" COEFFS 0 1 0 0 0 1 /end COMPU_METHOD
/begin COMPU_METHOD udf_CM_18026 "Ax + B" RAT_FUNC "%4.0" "Counts" COEFFS 0 1 0 0 0 1 /end COMPU_METHOD
/begin COMPU_METHOD udf_CM_18047 "Ax + B" RAT_FUNC "%4.0" "None" COEFFS 0 1 0 0 0 1 /end COMPU_METHOD
/begin COMPU_METHOD udf_CM_18054 "Ax + B" RAT_FUNC "%4.0" "Counts" COEFFS 0 1 0 0 0 1 /end COMPU_METHOD
/begin COMPU_METHOD udf_CM_18061 "Ax + B" RAT_FUNC "%4.0" "None" COEFFS 0 1 0 0 0 1 /end COMPU_METHOD
/begin COMPU_METHOD udf_CM_18068 "Ax + B" RAT_FUNC "%4.0" "None" COEFFS 0 1 0 0 0 1 /end COMPU_METHOD
/begin COMPU_METHOD CM_Angle_8bit "" RAT_FUNC "%3.1" "angle" COEFFS 0.0 2.0 0.0 0.0 0.0 1.0 /end COMPU_METHOD
/begin COMPU_METHOD CM_Angle_8bit_2 "" RAT_FUNC "%3.1" "angle" COEFFS 0.0 8.0 0.0 0.0 0.0 1.0 /end COMPU_METHOD
/begin COMPU_METHOD CM_FiltCoef "" RAT_FUNC "%7.6" "coef" COEFFS 0.0 65536.00026843546 0.0 0.0 0.0 1.0 /end COMPU_METHOD
/begin COMPU_METHOD CM_FactorRatio "" RAT_FUNC "%7.6" "ratio" COEFFS 0.0 65536.00026843546 0.0 0.0 0.0 1.0 /end COMPU_METHOD
/begin COMPU_METHOD udf_CM_18376 "" RAT_FUNC "%7.5" "ratio" COEFFS 0.0 4096.0 0.0 0.0 0.0 1.0 /end COMPU_METHOD
/begin COMPU_METHOD CM_msec "" RAT_FUNC "%5.3" "msec" COEFFS 0.0 16.0 0.0 0.0 0.0 1.0 /end COMPU_METHOD
/begin COMPU_METHOD CM_mVolt_2 "" RAT_FUNC "%7.3" "mvolt" COEFFS 0.0 64.0 0.0 0.0 0.0 1.0 /end COMPU_METHOD
/begin COMPU_METHOD CM_Ratio_0to2_2 "" RAT_FUNC "%6.5" "ratio" COEFFS 0.0 32768.00013421773 0.0 0.0 0.0 1.0 /end COMPU_METHOD
/begin COMPU_METHOD CM_Seconds_1 "" RAT_FUNC "%7.3" "sec" COEFFS 0.0 32.0 0.0 0.0 0.0 1.0 /end COMPU_METHOD
/begin COMPU_METHOD CM_SparkAngle_N256to256 "" RAT_FUNC "%7.4" "angle" COEFFS 0.0 128.0 0.0 0.0 0.0 1.0 /end COMPU_METHOD
/begin COMPU_METHOD CM_DegC_N256to256 "" RAT_FUNC "%7.4" "degC" COEFFS 0.0 128.0 0.0 0.0 0.0 1.0 /end COMPU_METHOD
/begin COMPU_METHOD CM_Percent_0to100 "" RAT_FUNC "%5.3" "percent" COEFFS 0.0 2.56 0.0 0.0 0.0 1.0 /end COMPU_METHOD
/begin COMPU_METHOD CM_Percent_0to100_1 "" RAT_FUNC "%6.4" "percent" COEFFS 0.0 655.36 0.0 0.0 0.0 1.0 /end COMPU_METHOD
/begin COMPU_METHOD CM_Percent_0to200_2 "" RAT_FUNC "%7.4" "percent" COEFFS 0.0 327.6800872415464 0.0 0.0 0.0 1.0 /end COMPU_METHOD
/begin COMPU_METHOD CM_Percent_0to200_3 "" RAT_FUNC "%6.3" "percent" COEFFS 0.0 1.28 0.0 0.0 0.0 1.0 /end COMPU_METHOD
/begin COMPU_METHOD CM_Ratio_0to16 "" RAT_FUNC "%6.5" "ratio" COEFFS 0.0 4096.0 0.0 0.0 0.0 1.0 /end COMPU_METHOD
/begin COMPU_METHOD CM_RPM_0to16384 "" RAT_FUNC "%7.2" "rpm" COEFFS 0.0 4.0 0.0 0.0 0.0 1.0 /end COMPU_METHOD
/begin COMPU_METHOD CM_kpa_0to512_1 "" RAT_FUNC "%7.4" "kpa" COEFFS 0.0 128.0 0.0 0.0 0.0 1.0 /end COMPU_METHOD
/begin COMPU_METHOD CM_kpa_n256to256_1 "" RAT_FUNC "%7.4" "kpa" COEFFS 0.0 128.0 0.0 0.0 0.0 1.0 /end COMPU_METHOD
/begin COMPU_METHOD CM_msec_0to1024 "" RAT_FUNC "%7.3" "msec" COEFFS 0.0 64.0 0.0 0.0 0.0 1.0 /end COMPU_METHOD
/begin COMPU_METHOD CM_Second_0to32 "" RAT_FUNC "%7.3" "sec" COEFFS 0.0 8.0 0.0 0.0 0.0 1.0 /end COMPU_METHOD
/begin COMPU_METHOD CM_Volt_0to32_1 "" RAT_FUNC "%6.4" "volt" COEFFS 0.0 2048.001048576537 0.0 0.0 0.0 1.0 /end COMPU_METHOD
/begin COMPU_METHOD CM_Volt_0to1024_1 "" RAT_FUNC "%6.4" "volt" COEFFS 0.0 64.0 0.0 0.0 0.0 1.0 /end COMPU_METHOD
/begin COMPU_METHOD udf_CM_18698 "" RAT_FUNC "%7.4" "gram" COEFFS 0.0 128.0 0.0 0.0 0.0 1.0 /end COMPU_METHOD
/begin COMPU_METHOD udf_CM_18705 "" RAT_FUNC "%7.4" "grams" COEFFS 0.0 128.0 0.0 0.0 0.0 1.0 /end COMPU_METHOD
/begin COMPU_METHOD CM_Second_0to512 "" RAT_FUNC "%7.4" "sec" COEFFS 0.0 128.0 0.0 0.0 0.0 1.0 /end COMPU_METHOD
/begin COMPU_METHOD CM_Second_0to512_1 "" RAT_FUNC "%7.4" "seconds" COEFFS 0.0 128.0 0.0 0.0 0.0 1.0 /end COMPU_METHOD
/begin COMPU_METHOD CM_Count_0to65535 "" RAT_FUNC "%5.0" "count" COEFFS 0 1 0 0 0 1 /end COMPU_METHOD
/begin COMPU_METHOD CM_Count_0to65535_1 "" RAT_FUNC "%5.0" "counts" COEFFS 0 1 0 0 0 1 /end COMPU_METHOD
/begin COMPU_METHOD CM_Count_0to65535_2 "" RAT_FUNC "%5.0" "None" COEFFS 0 1 0 0 0 1 /end COMPU_METHOD
/begin COMPU_METHOD CM_Count_0to65535_3 "" RAT_FUNC "%5.0" "percent" COEFFS 0 1 0 0 0 1 /end COMPU_METHOD
/begin COMPU_METHOD CM_Second_0to65535 "" RAT_FUNC "%5.0" "sec" COEFFS 0 1 0 0 0 1 /end COMPU_METHOD
/begin COMPU_METHOD CM_Mult_0to8 "" RAT_FUNC "%4.3" "ratio" COEFFS 0.0 32.0 0.0 0.0 0.0 1.0 /end COMPU_METHOD
/begin COMPU_METHOD CM_Mult_0to16 "" RAT_FUNC "%4.3" "ratio" COEFFS 0.0 16.0 0.0 0.0 0.0 1.0 /end COMPU_METHOD
/begin COMPU_METHOD udf_CM_19048 "Ax + B" RAT_FUNC "%4.4" "ratio" COEFFS 0.0 32768.00013421773 0.0 0.0 0.0 1.0 /end COMPU_METHOD
/begin COMPU_METHOD udf_CM_19230 "Ax + B" RAT_FUNC "%4.0" "boolean" COEFFS 0 1 0 0 0 1 /end COMPU_METHOD
/begin COMPU_METHOD udf_CM_19244 "Ax + B" RAT_FUNC "%4.0" "None" COEFFS 0 1 0 0 0 1 /end COMPU_METHOD
/begin COMPU_VTAB CM_DAT_TYPE_TAB "" TAB_VERB 2 0 "Intel" 1 "Motorola" /end COMPU_VTAB
/begin COMPU_VTAB CM_EOI_TAB "" TAB_VERB 4 0 "Cyl1" 1 "Cyl2" 2 "Cyl3" 3 "Cyl4" /end COMPU_VTAB
/begin COMPU_VTAB CM_CYL_TAB "" TAB_VERB 8 0 "Cyl1" 1 "Cyl2" 2 "Cyl3" 3 "Cyl4" 4 "Cyl5" 5 "Cyl6" 6 "Cyl7" 7 "Cyl8" /end COMPU_VTAB
/begin COMPU_VTAB CM_ID_TAB "" TAB_VERB 7 0 "ID1" 1 "ID2" 2 "ID3" 3 "ID4" 4 "ID5" 5 "ID6" 6 "ID7" /end COMPU_VTAB
/begin COMPU_VTAB CM_FL_DAT_TAB "" TAB_VERB 9 0 "LOOP" 1 "DAT1" 2 "DAT2" 3 "DAT3" 4 "DAT4" 5 "DAT5" 6 "DAT6" 7 "DAT7" 8 "DAT8" /end COMPU_VTAB
/begin COMPU_VTAB CM_LIGHT_TYPE_TAB "" TAB_VERB 5 0 "NONE" 1 "MIL" 2 "STOP" 3 "WARNING" 4 "PROTECT" /end COMPU_VTAB
/begin COMPU_VTAB CM_KNK_HZ_TAB "" TAB_VERB 64 0 "1.22KHz" 1 "1.26KHz" 2 "1.31KHz" 3 "1.35KHz" 4 "1.40KHz" 5 "1.45KHz" 6 "1.51KHz" 7 "1.57KHz" 8 "1.63KHz" 9 "1.71KHz" 10 "1.78KHz" 11 "1.87KHz" 12 "1.96KHz" 13 "2.07KHz" 14 "2.18KHz" 15 "2.31KHz" 16 "2.46KHz" 17 "2.54KHz" 18 "2.62KHz" 19 "2.71KHz" 20 "2.81KHz" 21 "2.92KHz" 22 "3.03KHz" 23 "3.15KHz" 24 "3.28KHz" 25 "3.43KHz" 26 "3.59KHz" 27 "3.76KHz" 28 "3.95KHz" 29 "4.16KHz" 30 "4.39KHz" 31 "4.66KHz" 32 "4.95KHz" 33 "5.12KHz" 34 "5.29KHz" 35 "5.48KHz" 36 "5.68KHz" 37 "5.90KHz" 38 "6.12KHz" 39 "6.37KHz" 40 "6.64KHz" 41 "6.94KHz" 42 "7.27KHz" 43 "7.63KHz" 44 "8.02KHz" 45 "8.46KHz" 46 "8.95KHz" 47 "9.50KHz" 48 "10.12KHz" 49 "10.46KHz" 50 "10.83KHz" 51 "11.22KHz" 52 "11.65KHz" 53 "12.10KHz" 54 "12.60KHz" 55 "13.14KHz" 56 "13.72KHz" 57 "14.36KHz" 58 "15.07KHz" 59 "15.84KHz" 60 "16.71KHz" 61 "17.67KHz" 62 "18.76KHz" 63 "19.98KHz" /end COMPU_VTAB
/begin COMPU_VTAB CM_KNK_GAIN_TAB "" TAB_VERB 64 0 "2.000" 1 "1.882" 2 "1.778" 3 "1.684" 4 "1.600" 5 "1.523" 6 "1.455" 7 "1.391" 8 "1.333" 9 "1.280" 10 "1.231" 11 "1.185" 12 "1.143" 13 "1.063" 14 "1.0" 15 "0.944" 16 "0.895" 17 "0.850" 18 "0.810" 19 "0.773" 20 "0.739" 21 "0.708" 22 "0.680" 23 "0.654" 24 "0.630" 25 "0.607" 26 "0.586" 27 "0.567" 28 "0.548" 29 "0.500" 30 "0.471" 31 "0.444" 32 "0.421" 33 "0.400" 34 "0.381" 35 "0.364" 36 "0.348" 37 "0.333" 38 "0.320" 39 "0.308" 40 "0.296" 41 "0.286" 42 "0.276" 43 "0.267" 44 "0.258" 45 "0.250" 46 "0.236" 47 "0.222" 48 "0.211" 49 "0.200" 50 "0.190" 51 "0.182" 52 "0.174" 53 "0.167" 54 "0.160" 55 "0.154" 56 "0.148" 57 "0.143" 58 "0.138" 59 "0.133" 60 "0.129" 61 "0.125" 62 "0.118" 63 "0.111" /end COMPU_VTAB
/begin COMPU_VTAB CM_KNK_INT_TAB "" TAB_VERB 32 0 "40us" 1 "45us" 2 "50us" 3 "55us" 4 "60us" 5 "65us" 6 "70us" 7 "75us" 8 "80us" 9 "90us" 10 "100us" 11 "110us" 12 "120us" 13 "130us" 14 "140us" 15 "150us" 16 "160us" 17 "180us" 18 "200us" 19 "220us" 20 "240us" 21 "260us" 22 "280us" 23 "300us" 24 "320us" 25 "360us" 26 "400us" 27 "440us" 28 "480us" 29 "520us" 30 "560us" 31 "600us" /end COMPU_VTAB
/begin COMPU_VTAB udf_CV_19704 "" TAB_VERB 2 0 "OFF" 1 "ON" /end COMPU_VTAB
/begin COMPU_VTAB udf_CV_19710 "" TAB_VERB 7 0 "0_EngineOff" 1 "1_KeyOn" 2 "2_Cranking" 3 "3_Run" 4 "4_Stall" 5 "5_ShutDownDelay" 6 "6_ShutDown" /end COMPU_VTAB
/begin COMPU_VTAB udf_CV_19711 "" TAB_VERB 3 0 "0_GSL" 1 "1_NG" 2 "2_LPG" /end COMPU_VTAB
/begin COMPU_VTAB udf_CV_19716 "" TAB_VERB 2 0 "LEAN" 1 "RICH" /end COMPU_VTAB
/begin COMPU_VTAB udf_CV_19722 "" TAB_VERB 2 0 "LEAN" 1 "RICH" /end COMPU_VTAB
/begin COMPU_VTAB udf_CV_19728 "" TAB_VERB 2 0 "LEAN" 1 "RICH" /end COMPU_VTAB
/begin RECORD_LAYOUT 2D_Array_SB FNC_VALUES 1 SBYTE COLUMN_DIR DIRECT ALIGNMENT_WORD 1 ALIGNMENT_LONG 2 /end RECORD_LAYOUT
/begin RECORD_LAYOUT 2D_Array_UB FNC_VALUES 1 UBYTE COLUMN_DIR DIRECT ALIGNMENT_WORD 1 ALIGNMENT_LONG 2 /end RECORD_LAYOUT
/begin RECORD_LAYOUT 2D_Array_UW FNC_VALUES 1 UWORD COLUMN_DIR DIRECT ALIGNMENT_WORD 1 ALIGNMENT_LONG 2 /end RECORD_LAYOUT
/begin RECORD_LAYOUT 2D_Array_UL FNC_VALUES 1 ULONG COLUMN_DIR DIRECT ALIGNMENT_WORD 1 ALIGNMENT_LONG 2 /end RECORD_LAYOUT
/begin RECORD_LAYOUT D_Array_SB FNC_VALUES 1 SBYTE COLUMN_DIR DIRECT ALIGNMENT_WORD 1 ALIGNMENT_LONG 2 /end RECORD_LAYOUT
/begin RECORD_LAYOUT 3D_Array_UB FNC_VALUES 1 UBYTE COLUMN_DIR DIRECT ALIGNMENT_WORD 1 ALIGNMENT_LONG 2 /end RECORD_LAYOUT
/begin RECORD_LAYOUT 3D_Array_UW FNC_VALUES 1 UWORD COLUMN_DIR DIRECT ALIGNMENT_WORD 1 ALIGNMENT_LONG 2 /end RECORD_LAYOUT
/begin RECORD_LAYOUT AxisPtsX_UW AXIS_PTS_X 1 UWORD INDEX_INCR DIRECT ALIGNMENT_WORD 1 ALIGNMENT_LONG 2 /end RECORD_LAYOUT
/begin RECORD_LAYOUT AxisPtsX_SW AXIS_PTS_X 1 SWORD INDEX_INCR DIRECT ALIGNMENT_WORD 1 ALIGNMENT_LONG 2 /end RECORD_LAYOUT
/begin RECORD_LAYOUT Scalar_SW FNC_VALUES 1 SWORD COLUMN_DIR DIRECT ALIGNMENT_WORD 1 ALIGNMENT_LONG 2 /end RECORD_LAYOUT
/begin RECORD_LAYOUT Scalar_UB FNC_VALUES 1 UBYTE COLUMN_DIR DIRECT ALIGNMENT_WORD 1 ALIGNMENT_LONG 2 /end RECORD_LAYOUT
/begin RECORD_LAYOUT Scalar_UW FNC_VALUES 1 UWORD COLUMN_DIR DIRECT ALIGNMENT_WORD 1 ALIGNMENT_LONG 2 /end RECORD_LAYOUT
/end MODULE
/end PROJECT
