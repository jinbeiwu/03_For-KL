ASAP2_VERSION 1 40
/begin PROJECT RS19_Prod ""
/begin HEADER "" VERSION "" /end HEADER
/begin MODULE RS19_Prod ""
/begin MOD_PAR "SAILOR" CPU_TYPE "SPC560P"
 /begin MEMORY_SEGMENT Code "External Flash Calibration Space" DATA FLASH INTERN 0x8000 0x5000 -1 -1 -1 -1 -1 /end MEMORY_SEGMENT
 /begin MEMORY_SEGMENT Code "External Flash unuse Space" CODE FLASH INTERN 0xD000 0x0000 -1 -1 -1 -1 -1 /end MEMORY_SEGMENT
 /begin MEMORY_SEGMENT Code "External Flash Code Space" CODE FLASH INTERN 0xD000 0x33000 -1 -1 -1 -1 -1 /end MEMORY_SEGMENT
 /begin MEMORY_SEGMENT Ram "External Ram BSS Space" VARIABLES RAM EXTERN 0x40000000 0x4800 -1 -1 -1 -1 -1 /end MEMORY_SEGMENT
 /begin MEMORY_SEGMENT Data "External RAM Calibration Space" DATA RAM EXTERN 0x40004800 0x5000 -1 -1 -1 -1 -1 /end MEMORY_SEGMENT
 /begin MEMORY_SEGMENT Ram "External Ram Stack Space" VARIABLES RAM EXTERN 0x40009800 0x800 -1 -1 -1 -1 -1 /end MEMORY_SEGMENT
/end MOD_PAR
/begin MOD_COMMON "" BYTE_ORDER MSB_FIRST ALIGNMENT_BYTE 1 ALIGNMENT_WORD 1 ALIGNMENT_LONG 2 ALIGNMENT_FLOAT32_IEEE 4 ALIGNMENT_FLOAT64_IEEE 8 /end MOD_COMMON
/begin IF_DATA ASAP1B_CCP
 /begin SOURCE "Cyl Event" 103 1
  /begin QP_BLOB 0 LENGTH 0x14 CAN_ID_FIXED 0x7D5 RASTER 0 REDUCTION_ALLOWED FIRST_PID 0x00 /end QP_BLOB
  DISPLAY_IDENTIFIER DAQ0 /end SOURCE
 /begin SOURCE "7.82ms" 1 782
  /begin QP_BLOB 1 LENGTH 0x14 CAN_ID_FIXED 0x7D6 RASTER 10 REDUCTION_ALLOWED FIRST_PID 0x14 /end QP_BLOB
  DISPLAY_IDENTIFIER DAQ1 /end SOURCE
 /begin SOURCE "15.6ms" 1 1562
  /begin QP_BLOB 2 LENGTH 0x14 CAN_ID_FIXED 0x7D7 RASTER 11 REDUCTION_ALLOWED FIRST_PID 0x28 /end QP_BLOB
  DISPLAY_IDENTIFIER DAQ2 /end SOURCE
 /begin SOURCE "125ms" 3 125
  /begin QP_BLOB 3 LENGTH 0x3A CAN_ID_FIXED 0x7D8 RASTER 25 REDUCTION_ALLOWED FIRST_PID 0x3C /end QP_BLOB
  DISPLAY_IDENTIFIER DAQ3 /end SOURCE
 /begin TP_BLOB 0x201 0x202 0x7D0 0x7D4 0x0 0x1 DAQ_MODE 1 CONSISTENCY 1 ADDRESS_EXTENSION 0
  /begin DEFINED_PAGES 1 "Working page" 0x0 0x40004800 0x5000 RAM RAM_INIT_BY_ECU DEFAULT /end DEFINED_PAGES
  /begin DEFINED_PAGES 2 "Reference page" 0x0 0x8000 0x5000 FLASH DEFAULT /end DEFINED_PAGES
  OPTIONAL_CMD 0xC OPTIONAL_CMD 0xD OPTIONAL_CMD 0xE OPTIONAL_CMD 0x11 OPTIONAL_CMD 0x19 BAUDRATE 250000 SAMPLE_POINT 70 SAMPLE_RATE 1 BTL_CYCLES 16 SJW 2 SYNC_EDGE 0 /begin CHECKSUM_PARAM 0x8001 20480 CHECKSUM_CALCULATION ACTIVE_PAGE /end CHECKSUM_PARAM RESUME_SUPPORTED /end TP_BLOB
 /begin SEED_KEY "" /end SEED_KEY
 /begin RASTER "Cyl Event Trigger" Cyl 0 103 1 /end RASTER
 /begin RASTER "AMAF Trigger" 1.00 1 3 1 /end RASTER
 /begin RASTER "3.91ms Trigger" 3.91 2 1 391 /end RASTER
 /begin RASTER "7.81ms Trigger" 7.81 10 1 781 /end RASTER
 /begin RASTER "15.62ms Trigger" 15.62 11 1 1562 /end RASTER
 /begin RASTER "125ms Trigger" 125 25 3 125 /end RASTER
/end IF_DATA
/begin CHARACTERISTIC C_AECutoffDltTPSThresh "cal comments" VALUE 0x9A14 Scalar_UW 0.0 CM_Percent_0to200_2 0.0 199.9969024658203 /end CHARACTERISTIC
/begin CHARACTERISTIC C_AEEnableDltTPSThresh "cal comments" VALUE 0x9A12 Scalar_SW 0.0 CM_Percent_N200to200 -199.9999847412109 199.9938812255859 /end CHARACTERISTIC
/begin CHARACTERISTIC C_AETPSDecFiltCoef "cal comments" VALUE 0xB43E Scalar_UW 0.0 CM_FiltCoef 0.0 0.9999847412109375 /end CHARACTERISTIC
/begin CHARACTERISTIC C_AETPSIncFiltCoef "cal comments" VALUE 0xB43C Scalar_UW 0.0 CM_FiltCoef 0.0 0.9999847412109375 /end CHARACTERISTIC
/begin CHARACTERISTIC C_AFLCBaroMinThresh "cal comments" VALUE 0xB3EA Scalar_UW 0.0 CM_kpa_0to256_1 0.0 255.99609375 /end CHARACTERISTIC
/begin CHARACTERISTIC C_AFLCCellEngSpdBoundaryHyst "cal comments" VALUE 0xB400 Scalar_UW 0.0 CM_RPM_0to16384 0.0 16383.75 /end CHARACTERISTIC
/begin CHARACTERISTIC C_AFLCCellTPSBoundaryHyst "cal comments" VALUE 0xB402 Scalar_UW 0.0 CM_Percent_0to200_2 0.0 199.9969024658203 /end CHARACTERISTIC
/begin CHARACTERISTIC C_AFLCChargeAirTempMaxThresh "cal comments" VALUE 0xB3F6 Scalar_SW 0.0 CM_DegC_N256to256 -256.0 255.9921875 /end CHARACTERISTIC
/begin CHARACTERISTIC C_AFLCChargeAirTempMinThresh "cal comments" VALUE 0xB3F4 Scalar_SW 0.0 CM_DegC_N256to256 -256.0 255.9921875 /end CHARACTERISTIC
/begin CHARACTERISTIC C_AFLCCoolTempMaxThresh "cal comments" VALUE 0xB3F2 Scalar_SW 0.0 CM_DegC_N256to256 -256.0 255.9921875 /end CHARACTERISTIC
/begin CHARACTERISTIC C_AFLCCoolTempMinThresh "cal comments" VALUE 0xB3F0 Scalar_SW 0.0 CM_DegC_N256to256 -256.0 255.9921875 /end CHARACTERISTIC
/begin CHARACTERISTIC C_AFLCEngSpdDeltaThresh "cal comments" VALUE 0xB3E8 Scalar_UW 0.0 CM_RPM_0to16384 0.0 16383.75 /end CHARACTERISTIC
/begin CHARACTERISTIC C_AFLCEngSpdMaxThresh "cal comments" VALUE 0xB3EE Scalar_UW 0.0 CM_RPM_0to16384 0.0 16383.75 /end CHARACTERISTIC
/begin CHARACTERISTIC C_AFLCEngSpdMinThresh "cal comments" VALUE 0xB3EC Scalar_UW 0.0 CM_RPM_0to16384 0.0 16383.75 /end CHARACTERISTIC
/begin CHARACTERISTIC C_AFLCLearnedMultMax "cal comments" VALUE 0xB3FA Scalar_UW 0.0 CM_Ratio_0to2_2 0.0 1.999969482421875 /end CHARACTERISTIC
/begin CHARACTERISTIC C_AFLCLearnedMultMin "cal comments" VALUE 0xB3FC Scalar_UW 0.0 CM_Ratio_0to2_2 0.0 1.999969482421875 /end CHARACTERISTIC
/begin CHARACTERISTIC C_AFLCMultLearnCoef "cal comments" VALUE 0xB3FE Scalar_UW 0.0 CM_FiltCoef 0.0 0.9999847412109375 /end CHARACTERISTIC
/begin CHARACTERISTIC C_AFLCSteadyStateTime "cal comments" VALUE 0xB3F8 Scalar_UW 0.0 CM_Second_0to1024 0.0 1023.984375 /end CHARACTERISTIC
/begin CHARACTERISTIC C_AFLCTPSDeltaThresh "cal comments" VALUE 0xB3E6 Scalar_SW 0.0 CM_Percent_N200to200 -199.9999847412109 199.9938812255859 /end CHARACTERISTIC
/begin CHARACTERISTIC C_AFRLeanLimitDuringAE "cal comments" VALUE 0x9276 Scalar_UW 0.0 CM_AFR_0to32 0.0 31.99900627136231 /end CHARACTERISTIC
/begin CHARACTERISTIC C_AFRPERampDownStep "cal comments" VALUE 0x95F0 Scalar_UW 0.0 CM_AFR_0to32 0.0 31.99900627136231 /end CHARACTERISTIC
/begin CHARACTERISTIC C_AFRPERampInterval "cal comments" VALUE 0x95F2 Scalar_UW 0.0 CM_Seconds_1 0.0 2047.96875 /end CHARACTERISTIC
/begin CHARACTERISTIC C_AFRPERampUpStep "cal comments" VALUE 0x95EE Scalar_UW 0.0 CM_AFR_0to32 0.0 31.99900627136231 /end CHARACTERISTIC
/begin CHARACTERISTIC C_AFRRampDownStep "cal comments" VALUE 0x9280 Scalar_UW 0.0 CM_AFR_0to32 0.0 31.99900627136231 /end CHARACTERISTIC
/begin CHARACTERISTIC C_AFRRampIntervalRun "cal comments" VALUE 0x927A Scalar_UW 0.0 CM_Seconds_1 0.0 2047.96875 /end CHARACTERISTIC
/begin CHARACTERISTIC C_AFRRampUpStepIdle "cal comments" VALUE 0x927C Scalar_UW 0.0 CM_AFR_0to32 0.0 31.99900627136231 /end CHARACTERISTIC
/begin CHARACTERISTIC C_AFRRampUpStepRun "cal comments" VALUE 0x927E Scalar_UW 0.0 CM_AFR_0to32 0.0 31.99900627136231 /end CHARACTERISTIC
/begin CHARACTERISTIC C_AFR1SensorFiltCoef "cal comments" VALUE 0xB55C Scalar_UW 0.0 CM_FiltCoef 0.0 0.9999847412109375 /end CHARACTERISTIC
/begin CHARACTERISTIC C_AFRWarmUpOffsetDecayFactor "cal comments" VALUE 0x9770 Scalar_UW 0.0 CM_FactorRatio 0.0 0.9999847412109375 /end CHARACTERISTIC
/begin CHARACTERISTIC C_AltMAPCalcOffset "cal comments" VALUE 0xB556 Scalar_UW 0.0 CM_kpa_0to256_1 0.0 255.99609375 /end CHARACTERISTIC
/begin CHARACTERISTIC C_BaroDefault "cal comments" VALUE 0xB506 Scalar_UW 0.0 CM_kpa_0to256_1 0.0 255.99609375 /end CHARACTERISTIC
/begin CHARACTERISTIC C_BaroMaxLimit "cal comments" VALUE 0xB50A Scalar_UW 0.0 CM_kpa_0to256_1 0.0 255.99609375 /end CHARACTERISTIC
/begin CHARACTERISTIC C_BaroMinLimit "cal comments" VALUE 0xB50C Scalar_UW 0.0 CM_kpa_0to256_1 0.0 255.99609375 /end CHARACTERISTIC
/begin CHARACTERISTIC C_BaroStallUpdateMAPCheckTimes "cal comments" VALUE 0xB56E Scalar_UW 0.0 CM_Count_0to65535_1 0.0 65535.0 /end CHARACTERISTIC
/begin CHARACTERISTIC C_BaroUpdateDltEngSpdThresh "cal comments" VALUE 0xB57E Scalar_UW 0.0 CM_RPM_0to16384 0.0 16383.75 /end CHARACTERISTIC
/begin CHARACTERISTIC C_BaroUpdtEngRunTPSDeltaMaxThrsh "cal comments" VALUE 0xB5A8 Scalar_SW 0.0 CM_Percent_N200to200 -199.9999847412109 199.9938812255859 /end CHARACTERISTIC
/begin CHARACTERISTIC C_BaroUpdtEngSpdThrshHi "cal comments" VALUE 0xB57C Scalar_UW 0.0 CM_RPM_0to16384 0.0 16383.75 /end CHARACTERISTIC
/begin CHARACTERISTIC C_BaroUpdtFiltCoefRun "cal comments" VALUE 0xB580 Scalar_UW 0.0 CM_FiltCoef 0.0 0.9999847412109375 /end CHARACTERISTIC
/begin CHARACTERISTIC C_BaroUpdtFiltCoefStall "cal comments" VALUE 0xB508 Scalar_UW 0.0 CM_FiltCoef 0.0 0.9999847412109375 /end CHARACTERISTIC
/begin CHARACTERISTIC C_ChargeAirTempFiltCoef "cal comments" VALUE 0x8334 Scalar_UW 0.0 CM_FiltCoef 0.0 0.9999847412109375 /end CHARACTERISTIC
/begin CHARACTERISTIC C_CIDFailThreshold "cal comments" VALUE 0xB51A Scalar_UW 0.0 CM_Count_0to65535_1 0.0 65535.0 /end CHARACTERISTIC
/begin CHARACTERISTIC C_CIDPassThreshold "cal comments" VALUE 0xB518 Scalar_UW 0.0 CM_Count_0to65535_1 0.0 65535.0 /end CHARACTERISTIC
/begin CHARACTERISTIC C_CLAFREnbCoolTempThresh "cal comments" VALUE 0x94D8 Scalar_SW 0.0 CM_DegC_N256to256 -256.0 255.9921875 /end CHARACTERISTIC
/begin CHARACTERISTIC C_CLFuelControlEnb "cal comments" VALUE 0x9842 Scalar_UB 0.0 CM_Boolean1 0.0 1.0 /end CHARACTERISTIC
/begin CHARACTERISTIC C_CLFuelIntegralMultUsed "cal comments" VALUE 0x9843 Scalar_UB 0.0 CM_Boolean1 0.0 1.0 /end CHARACTERISTIC
/begin CHARACTERISTIC C_FUEL_CLCStatus_Option "cal comments" VALUE 0x9844 Scalar_UB 0.0 CM_Count1 0.0 255.0 /end CHARACTERISTIC
/begin CHARACTERISTIC C_StepForceControlEnable "cal comments" VALUE 0x9C8E Scalar_UB 0.0 CM_Boolean6 0.0 255.0 /end CHARACTERISTIC
/begin CHARACTERISTIC C_CCPS_MaxVolt "cal comments" VALUE 0x0 Scalar_UW 0.0 CM_Volt_0to32_1 0.0 31.99900627136231 /end CHARACTERISTIC
/begin CHARACTERISTIC C_CCPS_RunTimeCold "cal comments" VALUE 0x0 Scalar_UW 0.0 CM_Count_0to65535_1 0.0 65535.0 /end CHARACTERISTIC
/begin CHARACTERISTIC C_CCPS_RunTimeHot "cal comments" VALUE 0x0 Scalar_UW 0.0 CM_Count_0to65535_1 0.0 65535.0 /end CHARACTERISTIC
/begin CHARACTERISTIC C_CCPS_StartupCold "cal comments" VALUE 0x0 Scalar_SW 0.0 CM_DegC_N256to256 -256.0 255.9921875 /end CHARACTERISTIC
/begin CHARACTERISTIC C_CCPS_CoolantHigh "cal comments" VALUE 0x0 Scalar_SW 0.0 CM_DegC_N256to256 -256.0 255.9921875 /end CHARACTERISTIC
/begin CHARACTERISTIC C_CCPS_CoolantLow "cal comments" VALUE 0x0 Scalar_SW 0.0 CM_DegC_N256to256 -256.0 255.9921875 /end CHARACTERISTIC
/begin CHARACTERISTIC C_CCPS_CoolantHyst "cal comments" VALUE 0x0 Scalar_SW 0.0 CM_DegC_N256to256 -256.0 255.9921875 /end CHARACTERISTIC
/begin CHARACTERISTIC C_CCPS_DFCOTime "cal comments" VALUE 0x0 Scalar_UW 0.0 CM_Second_0to1024 0.0 1023.984375 /end CHARACTERISTIC
/begin CHARACTERISTIC C_CCPS_RichO2Time "cal comments" VALUE 0x0 Scalar_UW 0.0 CM_Second_0to1024 0.0 1023.984375 /end CHARACTERISTIC
/begin CHARACTERISTIC C_CCPS_RichO2TimeHyst "cal comments" VALUE 0x0 Scalar_UW 0.0 CM_Second_0to1024 0.0 1023.984375 /end CHARACTERISTIC
/begin CHARACTERISTIC C_CCPS_TPSHigh "cal comments" VALUE 0x0 Scalar_UW 0.0 CM_Percent_0to200_2 0.0 199.9969024658203 /end CHARACTERISTIC
/begin CHARACTERISTIC C_CCPS_TPSLow "cal comments" VALUE 0x0 Scalar_UW 0.0 CM_Percent_0to200_2 0.0 199.9969024658203 /end CHARACTERISTIC
/begin CHARACTERISTIC C_CCPS_TPSHyst "cal comments" VALUE 0x0 Scalar_UW 0.0 CM_Percent_0to200_2 0.0 199.9969024658203 /end CHARACTERISTIC
/begin CHARACTERISTIC C_CCPS_DutyCycleMin "cal comments" VALUE 0x0 Scalar_UW 0.0 CM_Percent_0to200_2 0.0 199.9969024658203 /end CHARACTERISTIC
/begin CHARACTERISTIC C_CCPS_DutyCycleIdleMax "cal comments" VALUE 0x0 Scalar_UW 0.0 CM_Percent_0to200_2 0.0 199.9969024658203 /end CHARACTERISTIC
/begin CHARACTERISTIC C_CCPS_BLM_BlmHigh "cal comments" VALUE 0x0 Scalar_UW 0.0 CM_Ratio_0to2_2 0.0 1.999969482421875 /end CHARACTERISTIC
/begin CHARACTERISTIC C_CCPS_BLM_BlmLow "cal comments" VALUE 0x0 Scalar_UW 0.0 CM_Ratio_0to2_2 0.0 1.999969482421875 /end CHARACTERISTIC
/begin CHARACTERISTIC C_CCPS_CL_IntHigh "cal comments" VALUE 0x0 Scalar_SW 0.0 CM_SignedWord_n32768to32768_2 -32768.0 32766.0 /end CHARACTERISTIC
/begin CHARACTERISTIC C_CCPS_CL_IntLow "cal comments" VALUE 0x0 Scalar_SW 0.0 CM_SignedWord_n32768to32768_2 -32768.0 32766.0 /end CHARACTERISTIC
/begin CHARACTERISTIC C_CCPS_DutyCycleStepUp "cal comments" VALUE 0x0 Scalar_UW 0.0 CM_Percent_0to200_2 0.0 199.9969024658203 /end CHARACTERISTIC
/begin CHARACTERISTIC C_CCPS_DutyCycleStepDown "cal comments" VALUE 0x0 Scalar_UW 0.0 CM_Percent_0to200_2 0.0 199.9969024658203 /end CHARACTERISTIC
/begin CHARACTERISTIC C_CCPS_DutyCycleStepTime "cal comments" VALUE 0x0 Scalar_UW 0.0 CM_Second_0to8192 0.0 8191.0 /end CHARACTERISTIC
/begin CHARACTERISTIC C_CCPS_RPMMinHigh "cal comments" VALUE 0x0 Scalar_UW 0.0 udf_CM_18586 0.0 16383.75 /end CHARACTERISTIC
/begin CHARACTERISTIC C_CCPS_RPMMinLow "cal comments" VALUE 0x0 Scalar_UW 0.0 udf_CM_18586 0.0 16383.75 /end CHARACTERISTIC
/begin CHARACTERISTIC C_CCPS_BPWHigh "cal comments" VALUE 0x0 Scalar_UW 0.0 CM_msec_0to1024 0.0 1023.984375 /end CHARACTERISTIC
/begin CHARACTERISTIC C_CCPS_BPWLow "cal comments" VALUE 0x0 Scalar_UW 0.0 CM_msec_0to1024 0.0 1023.984375 /end CHARACTERISTIC
/begin CHARACTERISTIC CT_CCPS_DutyCycleMax "cal comments" CURVE 0x2 2D_Array_UB 0.0 CM_Percent_0to100 0.0 99.609375
 /begin AXIS_DESCR COM_AXIS NO_INPUT_QUANTITY CM_RPM_0to16384 17 0.0 16383.75 AXIS_PTS_REF CA_EngSpd17Step1 MAX_GRAD 0.0 /end AXIS_DESCR
/end CHARACTERISTIC
/begin CHARACTERISTIC C_CLIdleEnableDelay "cal comments" VALUE 0x9C24 Scalar_UW 0.0 CM_Second_0to1024 0.0 1023.984375 /end CHARACTERISTIC
/begin CHARACTERISTIC C_CLIdleSwitchDelay "cal comments" VALUE 0x9C26 Scalar_UW 0.0 CM_Second_0to1024 0.0 1023.984375 /end CHARACTERISTIC
/begin CHARACTERISTIC C_CLIdleSpdUpDelay "cal comments" VALUE 0x9C28 Scalar_UW 0.0 CM_Second_0to1024 0.0 1023.984375 /end CHARACTERISTIC
/begin CHARACTERISTIC C_CLIdleSpdDwnDelay "cal comments" VALUE 0x9C2A Scalar_UW 0.0 CM_Second_0to1024 0.0 1023.984375 /end CHARACTERISTIC
/begin CHARACTERISTIC C_CLIdleSpdH2LDelay "cal comments" VALUE 0x9C2C Scalar_UW 0.0 CM_Second_0to1024 0.0 1023.984375 /end CHARACTERISTIC
/begin CHARACTERISTIC C_ClosedLoopAFR "cal comments" VALUE 0x94CE Scalar_UW 0.0 CM_AFR_0to32 0.0 31.99900627136231 /end CHARACTERISTIC
/begin CHARACTERISTIC C_CLTThreshToEnbNextPrimePulse "cal comments" VALUE 0x9240 Scalar_SW 0.0 CM_DegC_N256to256 -256.0 255.9921875 /end CHARACTERISTIC
/begin CHARACTERISTIC C_ColdEngineIdleEnrichEnable "cal comments" VALUE 0x9274 Scalar_UB 0.0 CM_Boolean2 0.0 1.0 /end CHARACTERISTIC
/begin CHARACTERISTIC C_ColdEnrichCompTempThresh "cal comments" VALUE 0x9278 Scalar_SW 0.0 CM_DegC_N256to256 -256.0 255.9921875 /end CHARACTERISTIC
/begin CHARACTERISTIC C_CoolantTempFiltCoef "cal comments" VALUE 0xB524 Scalar_UW 0.0 CM_FiltCoef 0.0 0.9999847412109375 /end CHARACTERISTIC
/begin CHARACTERISTIC C_CrankAFROffset "cal comments" VALUE 0x960E Scalar_UW 0.0 CM_AFR_0to32 0.0 31.99900627136231 /end CHARACTERISTIC
/begin CHARACTERISTIC C_CrankAFROffsetDecayDealy "cal comments" VALUE 0x9610 Scalar_UW 0.0 CM_Count_0to65535 0.0 65535.0 /end CHARACTERISTIC
/begin CHARACTERISTIC C_CrankAFROffsetDecayFactor "cal comments" VALUE 0x9612 Scalar_UW 0.0 CM_FactorRatio 0.0 0.9999847412109375 /end CHARACTERISTIC
/begin CHARACTERISTIC C_CrankAFROffsetDecayInterval "cal comments" VALUE 0x9614 Scalar_UB 0.0 CM_Second_0to8 0.0 7.96875 /end CHARACTERISTIC
/begin CHARACTERISTIC C_CrankAFROffsetResetCltTempThrsh "cal comments" VALUE 0x9616 Scalar_SW 0.0 CM_DegC_N256to256 -256.0 255.9921875 /end CHARACTERISTIC
/begin CHARACTERISTIC C_CrankAFROffsetResetRunTimeThrsh "cal comments" VALUE 0x9618 Scalar_UW 0.0 CM_Second_0to65535 0.0 65535.0 /end CHARACTERISTIC
/begin CHARACTERISTIC C_CrankToRunEngSpdThresh "cal comments" VALUE 0xB4E4 Scalar_UW 0.0 CM_RPM_0to16384 0.0 16383.75 /end CHARACTERISTIC
/begin CHARACTERISTIC C_CylinderDisplacement "cal comments" VALUE 0x8332 Scalar_UW 0.0 CM_milliliter_0to1024 0.0 1023.984375 /end CHARACTERISTIC
/begin CHARACTERISTIC C_DECutoffDltTPSThresh "cal comments" VALUE 0x9A16 Scalar_UW 0.0 CM_Percent_0to200_2 0.0 199.9969024658203 /end CHARACTERISTIC
/begin CHARACTERISTIC C_DEEnableDltTPSThresh "cal comments" VALUE 0x9A10 Scalar_SW 0.0 CM_Percent_N200to200 -199.9999847412109 199.9938812255859 /end CHARACTERISTIC
/begin CHARACTERISTIC C_DEEnableEngSpdThresh "cal comments" VALUE 0x94AE Scalar_UW 0.0 CM_RPM_0to16384 0.0 16383.75 /end CHARACTERISTIC
/begin CHARACTERISTIC C_AEEnableRunTimeThrsh "cal comments" VALUE 0x94B0 Scalar_UB 0.0 CM_Count3 0.0 255.0 /end CHARACTERISTIC
/begin CHARACTERISTIC C_DefaultCoolTemp "cal comments" VALUE 0xB564 Scalar_SW 0.0 CM_DegC_N256to256 -256.0 255.9921875 /end CHARACTERISTIC
/begin CHARACTERISTIC C_DefaultCoolTempRunTimeFactor "cal comments" VALUE 0xB562 Scalar_UW 0.0 CM_FactorRatio 0.0 0.9999847412109375 /end CHARACTERISTIC
/begin CHARACTERISTIC C_DeltaMAPThrshForBaroUpdtStall "cal comments" VALUE 0xB55E Scalar_UW 0.0 CM_kpa_0to256_1 0.0 255.99609375 /end CHARACTERISTIC
/begin CHARACTERISTIC C_IDLELoopCounter "cal comments" VALUE 0xB645 Scalar_UB 0.0 CM_Count1 0.0 255.0 /end CHARACTERISTIC
/begin CHARACTERISTIC C_DesireSpeedMoveFactor "cal comments" VALUE 0x9CFA Scalar_UW 0.0 CM_FactorRatio 0.0 0.9999847412109375 /end CHARACTERISTIC
/begin CHARACTERISTIC C_DesireSpeedDecreaseStepFactor "cal comments" VALUE 0x9CF8 Scalar_UW 0.0 CM_Ratio_0to2_2 0.0 1.999969482421875 /end CHARACTERISTIC
/begin CHARACTERISTIC C_DesireSpeedDecreaseStepMin "cal comments" VALUE 0x9CF6 Scalar_UW 0.0 udf_CM_18586 0.0 16383.75 /end CHARACTERISTIC
/begin CHARACTERISTIC C_DesireSpeedIncreaseStepFactor "cal comments" VALUE 0x9CF4 Scalar_UW 0.0 CM_Ratio_0to2_2 0.0 1.999969482421875 /end CHARACTERISTIC
/begin CHARACTERISTIC C_DesireSpeedIncreaseStepMin "cal comments" VALUE 0x9CEC Scalar_UW 0.0 udf_CM_18586 0.0 16383.75 /end CHARACTERISTIC
/begin CHARACTERISTIC C_DesireSpeedUpOfst "cal comments" VALUE 0x9CEE Scalar_UW 0.0 udf_CM_18586 0.0 16383.75 /end CHARACTERISTIC
/begin CHARACTERISTIC C_DesireSpeedDwnOfst "cal comments" VALUE 0x9CF0 Scalar_UW 0.0 udf_CM_18586 0.0 16383.75 /end CHARACTERISTIC
/begin CHARACTERISTIC C_DesireSpeedH2LOfst "cal comments" VALUE 0x9CF2 Scalar_UW 0.0 udf_CM_18586 0.0 16383.75 /end CHARACTERISTIC
/begin CHARACTERISTIC C_DETPSDecFiltCoef "cal comments" VALUE 0xB442 Scalar_UW 0.0 CM_FiltCoef 0.0 0.9999847412109375 /end CHARACTERISTIC
/begin CHARACTERISTIC C_DETPSIncFiltCoef "cal comments" VALUE 0xB440 Scalar_UW 0.0 CM_FiltCoef 0.0 0.9999847412109375 /end CHARACTERISTIC
/begin CHARACTERISTIC C_EngineRunThreshCold "cal comments" VALUE 0xB4F3 Scalar_UB 0.0 CM_Count2 0.0 255.0 /end CHARACTERISTIC
/begin CHARACTERISTIC C_EngineRunThreshCoolTempHi "cal comments" VALUE 0xB4EE Scalar_SW 0.0 CM_DegC_N256to256 -256.0 255.9921875 /end CHARACTERISTIC
/begin CHARACTERISTIC C_EngineRunThreshCoolTempLo "cal comments" VALUE 0xB4EC Scalar_SW 0.0 CM_DegC_N256to256 -256.0 255.9921875 /end CHARACTERISTIC
/begin CHARACTERISTIC C_EngineRunThreshHot "cal comments" VALUE 0xB4EA Scalar_UB 0.0 CM_Count2 0.0 255.0 /end CHARACTERISTIC
/begin CHARACTERISTIC C_EngineRunThreshWarm "cal comments" VALUE 0xB4F4 Scalar_UB 0.0 CM_Count2 0.0 255.0 /end CHARACTERISTIC
/begin CHARACTERISTIC C_EngineTurningResetDelayTime "cal comments" VALUE 0xB516 Scalar_UW 0.0 CM_Second_0to512 0.0 511.9921875 /end CHARACTERISTIC
/begin CHARACTERISTIC C_EngSpdDeltaCalcNumber "cal comments" VALUE 0xB510 Scalar_UB 0.0 CM_Count2 0.0 255.0 /end CHARACTERISTIC
/begin CHARACTERISTIC C_EngSpdDeltaSAGovCalcNumber "cal comments" VALUE 0xB511 Scalar_UB 0.0 CM_Count2 0.0 255.0 /end CHARACTERISTIC
/begin CHARACTERISTIC C_EngSpdFiltCoef "cal comments" VALUE 0xB50E Scalar_UW 0.0 CM_FiltCoef 0.0 0.9999847412109375 /end CHARACTERISTIC
/begin CHARACTERISTIC C_EOIRampInterval "cal comments" VALUE 0x9272 Scalar_UW 0.0 CM_Second_0to1024 0.0 1023.984375 /end CHARACTERISTIC
/begin CHARACTERISTIC C_EOIRampStep "cal comments" VALUE 0x9270 Scalar_UW 0.0 CM_CrankAngle_0to1024 0.0 1023.984375 /end CHARACTERISTIC
/begin CHARACTERISTIC C_ExpectMAPUsedTPSThreshHi "cal comments" VALUE 0xB416 Scalar_UW 0.0 CM_Percent_0to200_2 0.0 199.9969024658203 /end CHARACTERISTIC
/begin CHARACTERISTIC C_ExpectMAPUsedTPSThreshLo "cal comments" VALUE 0xB414 Scalar_UW 0.0 CM_Percent_0to200_2 0.0 199.9969024658203 /end CHARACTERISTIC
/begin CHARACTERISTIC C_ExtPEModeAFRExtraOffset "cal comments" VALUE 0x94D6 Scalar_UW 0.0 CM_AFR_0to32 0.0 31.99900627136231 /end CHARACTERISTIC
/begin CHARACTERISTIC C_ExtPEModeCoolTempThresh "cal comments" VALUE 0x94D0 Scalar_SW 0.0 CM_DegC_N256to256 -256.0 255.9921875 /end CHARACTERISTIC
/begin CHARACTERISTIC C_ExtPEModeDisableDelay "cal comments" VALUE 0x94D4 Scalar_UW 0.0 CM_Second_0to65535 0.0 65535.0 /end CHARACTERISTIC
/begin CHARACTERISTIC C_ExtPEModeEnableDelay "cal comments" VALUE 0x94D2 Scalar_UW 0.0 CM_Second_0to65535 0.0 65535.0 /end CHARACTERISTIC
/begin CHARACTERISTIC C_FPWIgnoreThresh "cal comments" VALUE 0x94B8 Scalar_UW 0.0 CM_msec_0to1024 0.0 1023.984375 /end CHARACTERISTIC
/begin CHARACTERISTIC C_FPWMaxThresh "cal comments" VALUE 0x94B4 Scalar_UW 0.0 CM_msec_0to1024 0.0 1023.984375 /end CHARACTERISTIC
/begin CHARACTERISTIC C_FPW_IAC_Max "cal comments" VALUE 0x94B6 Scalar_UW 0.0 CM_msec_0to1024 0.0 1023.984375 /end CHARACTERISTIC
/begin CHARACTERISTIC C_FPWMinThresh "cal comments" VALUE 0x94B2 Scalar_UW 0.0 CM_msec_0to1024 0.0 1023.984375 /end CHARACTERISTIC
/begin CHARACTERISTIC C_CylPhase "cal comments" CURVE 0x80D4 2D_Array_UW 0.0 CM_Count1 0.0 720.0
 /begin AXIS_DESCR FIX_AXIS NO_INPUT_QUANTITY CM_EOI 4 0.0 4.0 MAX_GRAD 0.0 /begin FIX_AXIS_PAR_LIST 0 1 2 3 /end FIX_AXIS_PAR_LIST /end AXIS_DESCR
/end CHARACTERISTIC
/begin CHARACTERISTIC C_9177_HSY_CFG_VRS "cal comments" VALUE 0x80CF Scalar_UB 0.0 CM_Count1 0.0 255.0 /end CHARACTERISTIC
/begin CHARACTERISTIC C_NbOfCyls "cal comments" VALUE 0x80D0 Scalar_UB 0.0 CM_Count1 0.0 4.0 /end CHARACTERISTIC
/begin CHARACTERISTIC C_FuelRateMult "cal comments" VALUE 0x9620 Scalar_UW 0.0 udf_CM_18376 0.0 15.999755859375 /end CHARACTERISTIC
/begin CHARACTERISTIC CT_GPIO_FUNC "cal comments" MAP 0x0 3D_Array_UB 0.0 CM_FUNC 0.0 255.0
 /begin AXIS_DESCR FIX_AXIS NO_INPUT_QUANTITY CM_GPIO 6 0.0 6.0 MAX_GRAD 0.0 /begin FIX_AXIS_PAR_LIST 0 1 2 3 4 5 /end FIX_AXIS_PAR_LIST /end AXIS_DESCR
 /begin AXIS_DESCR FIX_AXIS NO_INPUT_QUANTITY CM_Count1 16 0.0 16.0 MAX_GRAD 0.0 /begin FIX_AXIS_PAR_LIST 0 1 2 3 4 5 6 7 8 9 10 11 12 13 14 15 /end FIX_AXIS_PAR_LIST /end AXIS_DESCR
/end CHARACTERISTIC
/begin CHARACTERISTIC CT_GPIO_FUNC_EX "cal comments" MAP 0x8024 3D_Array_UB 0.0 CM_FUNC 0.0 255.0
 /begin AXIS_DESCR FIX_AXIS NO_INPUT_QUANTITY CM_GPIO_EX 9 0.0 9.0 MAX_GRAD 0.0 /begin FIX_AXIS_PAR_LIST 0 1 2 3 4 5 6 7 8 /end FIX_AXIS_PAR_LIST /end AXIS_DESCR
 /begin AXIS_DESCR FIX_AXIS NO_INPUT_QUANTITY CM_Count1 16 0.0 16.0 MAX_GRAD 0.0 /begin FIX_AXIS_PAR_LIST 0 1 2 3 4 5 6 7 8 9 10 11 12 13 14 15 /end FIX_AXIS_PAR_LIST /end AXIS_DESCR
/end CHARACTERISTIC
/begin CHARACTERISTIC C_NbOfWheelTeeth "cal comments" VALUE 0x80D1 Scalar_UB 0.0 CM_Count1 0.0 60.0 /end CHARACTERISTIC
/begin CHARACTERISTIC C_NbOfMissingTeeth "cal comments" VALUE 0x80D2 Scalar_UB 0.0 CM_Count1 0.0 2.0 /end CHARACTERISTIC
/begin CHARACTERISTIC C_MapCylTDCtooth "cal comments" VALUE 0x80D3 Scalar_UB 0.0 CM_Count1 0.0 60.0 /end CHARACTERISTIC
/begin CHARACTERISTIC C_RubbishSignalForDucar "cal comments" VALUE 0x80DC Scalar_UB 0.0 CM_Boolean6 0.0 255.0 /end CHARACTERISTIC
/begin CHARACTERISTIC C_TwoStrokeCylinder "cal comments" VALUE 0x80DD Scalar_UB 0.0 CM_Boolean6 0.0 255.0 /end CHARACTERISTIC
/begin CHARACTERISTIC C_L9960Used "cal comments" VALUE 0x80DE Scalar_UB 0.0 CM_Boolean6 0.0 255.0 /end CHARACTERISTIC
/begin CHARACTERISTIC C_L9960_CL "cal comments" VALUE 0x80E3 Scalar_UB 0.0 CM_Boolean6 0.0 255.0 /end CHARACTERISTIC
/begin CHARACTERISTIC C_L9960_NOSR "cal comments" VALUE 0x80E4 Scalar_UB 0.0 CM_Boolean6 0.0 255.0 /end CHARACTERISTIC
/begin CHARACTERISTIC C_L9960_ISR "cal comments" VALUE 0x80E5 Scalar_UB 0.0 CM_Boolean6 0.0 255.0 /end CHARACTERISTIC
/begin CHARACTERISTIC C_L9960_VSR "cal comments" VALUE 0x80E6 Scalar_UB 0.0 CM_Boolean6 0.0 255.0 /end CHARACTERISTIC
/begin CHARACTERISTIC C_L9960_TDIAG1 "cal comments" VALUE 0x80E7 Scalar_UB 0.0 CM_Boolean6 0.0 255.0 /end CHARACTERISTIC
/begin CHARACTERISTIC C_L9960_TSW_LOW_CURRENT "cal comments" VALUE 0x80E8 Scalar_UB 0.0 CM_Boolean6 0.0 255.0 /end CHARACTERISTIC
/begin CHARACTERISTIC C_L9960_DIAG_CLR_EN "cal comments" VALUE 0x80E9 Scalar_UB 0.0 CM_Boolean6 0.0 255.0 /end CHARACTERISTIC
/begin CHARACTERISTIC C_L9960_IN1_IN2_IF "cal comments" VALUE 0x80EA Scalar_UB 0.0 CM_Boolean6 0.0 255.0 /end CHARACTERISTIC
/begin CHARACTERISTIC C_L9960_OTSD_THR_VAR "cal comments" VALUE 0x80EB Scalar_UB 0.0 CM_Boolean6 0.0 255.0 /end CHARACTERISTIC
/begin CHARACTERISTIC C_L9960_OTWARN_THR_VAR "cal comments" VALUE 0x80EC Scalar_UB 0.0 CM_Boolean6 0.0 255.0 /end CHARACTERISTIC
/begin CHARACTERISTIC C_L9960_UV_PROT_EN "cal comments" VALUE 0x80ED Scalar_UB 0.0 CM_Boolean6 0.0 255.0 /end CHARACTERISTIC
/begin CHARACTERISTIC C_L9960_NSPREAD "cal comments" VALUE 0x80EE Scalar_UB 0.0 CM_Boolean6 0.0 255.0 /end CHARACTERISTIC
/begin CHARACTERISTIC C_L9960_UV_WIN "cal comments" VALUE 0x80EF Scalar_UB 0.0 CM_Boolean6 0.0 255.0 /end CHARACTERISTIC
/begin CHARACTERISTIC C_L9960_VVL_MODE "cal comments" VALUE 0x80F0 Scalar_UB 0.0 CM_Boolean6 0.0 255.0 /end CHARACTERISTIC
/begin CHARACTERISTIC C_L9960_TVVL "cal comments" VALUE 0x80F1 Scalar_UB 0.0 CM_Boolean6 0.0 255.0 /end CHARACTERISTIC
/begin CHARACTERISTIC C_L9960_OTWARN_TSEC_EN "cal comments" VALUE 0x80F2 Scalar_UB 0.0 CM_Boolean6 0.0 255.0 /end CHARACTERISTIC
/begin CHARACTERISTIC C_L9960_TDSR "cal comments" VALUE 0x80F3 Scalar_UB 0.0 CM_Boolean6 0.0 255.0 /end CHARACTERISTIC
/begin CHARACTERISTIC C_L9960_OL_ON "cal comments" VALUE 0x80F4 Scalar_UB 0.0 CM_Boolean6 0.0 255.0 /end CHARACTERISTIC
/begin CHARACTERISTIC C_PGN65252Mask "cal comments" VALUE 0x80DF Scalar_UB 0.0 CM_Boolean6 0.0 255.0 /end CHARACTERISTIC
/begin CHARACTERISTIC C_PGN_DM_Mask "cal comments" VALUE 0x80E0 Scalar_UB 0.0 CM_Boolean6 0.0 255.0 /end CHARACTERISTIC
/begin CHARACTERISTIC C_EngOffEeBackupEn "cal comments" VALUE 0x80E1 Scalar_UB 0.0 CM_Boolean6 0.0 255.0 /end CHARACTERISTIC
/begin CHARACTERISTIC C_RefPeriodBuffLen "cal comments" VALUE 0x80E2 Scalar_UB 0.0 CM_Count1 1.0 8.0 /end CHARACTERISTIC
/begin CHARACTERISTIC C_L9779VrsFullAdptiveEn "cal comments" VALUE 0x80F6 Scalar_UB 0.0 CM_Count1 0.0 255.0 /end CHARACTERISTIC
/begin CHARACTERISTIC C_L9779VrsHystFallingFilterEn "cal comments" VALUE 0x80F7 Scalar_UB 0.0 CM_Count1 0.0 255.0 /end CHARACTERISTIC
/begin CHARACTERISTIC C_L9779VrsHystAfterFilterEn "cal comments" VALUE 0x80F8 Scalar_UB 0.0 CM_Count1 0.0 255.0 /end CHARACTERISTIC
/begin CHARACTERISTIC C_L9779VrsMinHsytEn "cal comments" VALUE 0x80F9 Scalar_UB 0.0 CM_Count1 0.0 255.0 /end CHARACTERISTIC
/begin CHARACTERISTIC C_L9779VrsMode "cal comments" VALUE 0x80FA Scalar_UB 0.0 CM_Count1 0.0 255.0 /end CHARACTERISTIC
/begin CHARACTERISTIC C_L9779VrsHyst "cal comments" VALUE 0x80FB Scalar_UB 0.0 CM_Count1 0.0 255.0 /end CHARACTERISTIC
/begin CHARACTERISTIC C_FirmwareName "cal comments" CURVE 0x8004 2D_Array_UB 0.0 CM_Count1 0.0 255.0
 /begin AXIS_DESCR FIX_AXIS NO_INPUT_QUANTITY CM_Equaloutput1 16 0.0 16.0 MAX_GRAD 0.0 /begin FIX_AXIS_PAR_LIST 0 1 2 3 4 5 6 7 8 9 10 11 12 13 14 15 /end FIX_AXIS_PAR_LIST /end AXIS_DESCR
/end CHARACTERISTIC
/begin CHARACTERISTIC C_CalibrationName "cal comments" CURVE 0x8014 2D_Array_UB 0.0 CM_Count1 0.0 255.0
 /begin AXIS_DESCR FIX_AXIS NO_INPUT_QUANTITY CM_Equaloutput1 16 0.0 16.0 MAX_GRAD 0.0 /begin FIX_AXIS_PAR_LIST 0 1 2 3 4 5 6 7 8 9 10 11 12 13 14 15 /end FIX_AXIS_PAR_LIST /end AXIS_DESCR
/end CHARACTERISTIC
/begin CHARACTERISTIC C_FuelCLEnbRunTimeThrsh "cal comments" VALUE 0x9846 Scalar_UW 0.0 CM_Second_0to65535 0.0 65535.0 /end CHARACTERISTIC
/begin CHARACTERISTIC C_FuellLowLoadCondEngSpdThrsh "cal comments" VALUE 0x9924 Scalar_UW 0.0 CM_RPM_0to16384 0.0 16383.75 /end CHARACTERISTIC
/begin CHARACTERISTIC C_FuellLowLoadCondMAPThrsh "cal comments" VALUE 0x9926 Scalar_UW 0.0 CM_kpa_0to256_1 0.0 255.99609375 /end CHARACTERISTIC
/begin CHARACTERISTIC C_FuelO2RichLeanWindowDelta "cal comments" VALUE 0x9928 Scalar_UW 0.0 CM_mVolt_1 0.0 1023.96875 /end CHARACTERISTIC
/begin CHARACTERISTIC C_FuelO2RLThreshMaxLimit "cal comments" VALUE 0x98F0 Scalar_UW 0.0 CM_mVolt_1 0.0 1023.96875 /end CHARACTERISTIC
/begin CHARACTERISTIC C_FuelO2RLThreshMinLimit "cal comments" VALUE 0x98F2 Scalar_UW 0.0 CM_mVolt_1 0.0 1023.96875 /end CHARACTERISTIC
/begin CHARACTERISTIC C_FuelPropLowLoadCond "cal comments" VALUE 0x9982 Scalar_UW 0.0 CM_Percent_0to200_2 0.0 199.9969024658203 /end CHARACTERISTIC
/begin CHARACTERISTIC C_DiagFuelPumpDC "cal comments" VALUE 0x961E Scalar_UW 0.0 CM_Percent_0to200_2 0.0 199.9969024658203 /end CHARACTERISTIC
/begin CHARACTERISTIC C_FuelPumpFreq "cal comments" VALUE 0x80B8 Scalar_UW 0.0 CM_Hz_0to16384 0.0 16383.75 /end CHARACTERISTIC
/begin CHARACTERISTIC C_SerialTxInterval "cal comments" VALUE 0x80BA Scalar_UB 0.0 CM_Count1 0.0 255.0 /end CHARACTERISTIC
/begin CHARACTERISTIC C_SerialTestMode "cal comments" VALUE 0x80C0 Scalar_UB 0.0 CM_Count1 0.0 255.0 /end CHARACTERISTIC
/begin CHARACTERISTIC C_SerialDeviceAddr "cal comments" VALUE 0x80C1 Scalar_UB 0.0 CM_Count1 0.0 255.0 /end CHARACTERISTIC
/begin CHARACTERISTIC C_SerialBaudRate "cal comments" VALUE 0x80BC Scalar_UL 0.0 CM_Count1 0.0 4294836225.0 /end CHARACTERISTIC
/begin CHARACTERISTIC C_FuelPumpOffDelay "cal comments" VALUE 0x9242 Scalar_UW 0.0 CM_Second_0to512 0.0 511.9921875 /end CHARACTERISTIC
/begin CHARACTERISTIC C_FuelSTFTRichClampCltThrsh "cal comments" VALUE 0x9932 Scalar_SW 0.0 CM_DegC_N256to256 -256.0 255.9921875 /end CHARACTERISTIC
/begin CHARACTERISTIC C_FuelSTFTRichClampVacThrsh "cal comments" VALUE 0x9930 Scalar_UW 0.0 CM_kpa_0to256_1 0.0 255.99609375 /end CHARACTERISTIC
/begin CHARACTERISTIC C_FUEL_T_LightOffAFR_CltThrshHi "cal comments" VALUE 0x992A Scalar_SW 0.0 CM_DegC_N256to256 -256.0 255.9921875 /end CHARACTERISTIC
/begin CHARACTERISTIC C_FUEL_T_LightOffAFR_CltThrshLo "cal comments" VALUE 0x992C Scalar_SW 0.0 CM_DegC_N256to256 -256.0 255.9921875 /end CHARACTERISTIC
/begin CHARACTERISTIC C_FUEL_p_CL_LeanBiasThrsh "cal comments" VALUE 0x992E Scalar_UW 0.0 CM_kpa_0to256_1 0.0 255.99609375 /end CHARACTERISTIC
/begin CHARACTERISTIC C_FuelSTFuelTrimMax "cal comments" VALUE 0x990A Scalar_SW 0.0 CM_SignedWord_n32768to32768_2 -32768.0 32766.0 /end CHARACTERISTIC
/begin CHARACTERISTIC C_FuelSTFuelTrimMaxPE "cal comments" VALUE 0x990C Scalar_SW 0.0 CM_SignedWord_n32768to32768_2 -32768.0 32766.0 /end CHARACTERISTIC
/begin CHARACTERISTIC C_FuelSTFuelTrimMin "cal comments" VALUE 0x990E Scalar_SW 0.0 CM_SignedWord_n32768to32768_2 -32768.0 32766.0 /end CHARACTERISTIC
/begin CHARACTERISTIC C_FuelSTFuelTrimPctConvFactor "cal comments" VALUE 0x9990 Scalar_UW 0.0 CM_Percent_0to200 0.0 199.9969482421875 /end CHARACTERISTIC
/begin CHARACTERISTIC C_FuelSTFuelTrimPWConvFactor "cal comments" VALUE 0x9910 Scalar_UW 0.0 CM_Ratio_0to2_1 0.0 1.999969482421875 /end CHARACTERISTIC
/begin CHARACTERISTIC C_FuelSTFuelTrimPWConvFactor_NG "cal comments" VALUE 0x9912 Scalar_UW 0.0 CM_Ratio_0to2_1 0.0 1.999969482421875 /end CHARACTERISTIC
/begin CHARACTERISTIC C_FuelSTFuelTrimPWConvFactor_LPG "cal comments" VALUE 0x9914 Scalar_UW 0.0 CM_Ratio_0to2_1 0.0 1.999969482421875 /end CHARACTERISTIC
/begin CHARACTERISTIC C_FUEL_Pct_ClearFloodTPS "cal comments" VALUE 0x0 Scalar_UW 0.0 CM_Percent_0to200_2 0.0 199.9969024658203 /end CHARACTERISTIC
/begin CHARACTERISTIC C_FUEL_t_ClearFloodTime "cal comments" VALUE 0x0 Scalar_UW 0.0 CM_Second_0to4096 0.0 4095.9375 /end CHARACTERISTIC
/begin CHARACTERISTIC CT_FUEL_Pct_DFCO_TPS_Thrsh "cal comments" CURVE 0x2 2D_Array_UW 0.0 CM_Percent_0to200_2 0.0 199.9969024658203
 /begin AXIS_DESCR FIX_AXIS NO_INPUT_QUANTITY CM_Equaloutput1 17 0.0 12800.0 MAX_GRAD 0.0
  /begin FIX_AXIS_PAR_LIST 0 800 1600 2400 3200 4000 4800 5600 6400 7200 8000 8800 9600 10400 11200 12000 12800 /end FIX_AXIS_PAR_LIST
 /end AXIS_DESCR
/end CHARACTERISTIC
/begin CHARACTERISTIC C_FUEL_Pct_DFCO_TPS_Hys "cal comments" VALUE 0x0 Scalar_UW 0.0 CM_Percent_0to200_2 0.0 199.9969024658203 /end CHARACTERISTIC
/begin CHARACTERISTIC CT_FUEL_t_DFCOMetTime "cal comments" CURVE 0x2 2D_Array_UB 0.0 CM_Second_0to4 0.0 3.984375
 /begin AXIS_DESCR COM_AXIS NO_INPUT_QUANTITY CM_RPM_0to16384 9 0.0 16383.75 AXIS_PTS_REF CA_EngSpd9Step1 MAX_GRAD 0.0 /end AXIS_DESCR
/end CHARACTERISTIC
/begin CHARACTERISTIC C_FUEL_n_DFCOdRPMDa "cal comments" VALUE 0x0 Scalar_UW 0.0 CM_RPM_0to16384 0.0 16383.75 /end CHARACTERISTIC
/begin CHARACTERISTIC C_FUEL_n_DFCOEnable_RPMThrsh "cal comments" VALUE 0x0 Scalar_UW 0.0 CM_RPM_0to16384 0.0 16383.75 /end CHARACTERISTIC
/begin CHARACTERISTIC C_FUEL_T_DFCO_CoolTempThrsh "cal comments" VALUE 0x0 Scalar_SW 0.0 CM_DegC_N256to256 -256.0 255.9921875 /end CHARACTERISTIC
/begin CHARACTERISTIC C_FUEL_p_DFCO_MAP_Hys "cal comments" VALUE 0x0 Scalar_UW 0.0 CM_kpa_0to256_1 0.0 255.99609375 /end CHARACTERISTIC
/begin CHARACTERISTIC CT_FUEL_p_DFCO_MAP_Thrsh "cal comments" CURVE 0x2 2D_Array_UB 0.0 CM_kpa_8bit 0.0 127.5
 /begin AXIS_DESCR FIX_AXIS NO_INPUT_QUANTITY CM_Equaloutput1 17 0.0 12800.0 MAX_GRAD 0.0
  /begin FIX_AXIS_PAR_LIST 0 800 1600 2400 3200 4000 4800 5600 6400 7200 8000 8800 9600 10400 11200 12000 12800 /end FIX_AXIS_PAR_LIST
 /end AXIS_DESCR
/end CHARACTERISTIC
/begin CHARACTERISTIC C_FUEL_n_DFCOExit_Thrsh "cal comments" VALUE 0x0 Scalar_UW 0.0 CM_RPM_0to16384 0.0 16383.75 /end CHARACTERISTIC
/begin CHARACTERISTIC C_FUEL_r_DFCOExit_FuelDecayFactor "cal comments" VALUE 0x0 Scalar_UB 0.0 CM_Mult_0to1_2 0.0 0.99609375 /end CHARACTERISTIC
/begin CHARACTERISTIC C_FUEL_t_DFCOExit_FuelDecayTime "cal comments" VALUE 0x0 Scalar_UW 0.0 CM_Second_0to1024 0.0 1023.984375 /end CHARACTERISTIC
/begin CHARACTERISTIC C_FUEL_t_DFCO_RunTimeThrsh "cal comments" VALUE 0x0 Scalar_UW 0.0 CM_Count_0to65535_1 0.0 65535.0 /end CHARACTERISTIC
/begin CHARACTERISTIC C_FUEL_t_DFCO_Spark_Exit_Dly "cal comments" VALUE 0x0 Scalar_UW 0.0 CM_Second_0to1024 0.0 1023.984375 /end CHARACTERISTIC
/begin CHARACTERISTIC C_FUEL_t_DFCO_RampOUT_Interval "cal comments" VALUE 0x0 Scalar_UW 0.0 CM_Second_0to1024 0.0 1023.984375 /end CHARACTERISTIC
/begin CHARACTERISTIC C_FUEL_r_DFCO_RampOUT_Step "cal comments" VALUE 0x0 Scalar_UW 0.0 CM_Ratio_0to2_2 0.0 1.999969482421875 /end CHARACTERISTIC
/begin CHARACTERISTIC C_FUEL_n_DFCO_RampOUT_ExitThresh "cal comments" VALUE 0x0 Scalar_UW 0.0 CM_RPM_0to16384 0.0 16383.75 /end CHARACTERISTIC
/begin CHARACTERISTIC C_FUEL_r_DFCO_RampOUT_Initial "cal comments" VALUE 0x0 Scalar_UW 0.0 CM_Ratio_0to2_2 0.0 1.999969482421875 /end CHARACTERISTIC
/begin CHARACTERISTIC C_FUEL_n_DFCO_RampOUT_MinVSS "cal comments" VALUE 0x0 Scalar_UW 0.0 CM_KPH_0to512 0.0 511.9921875 /end CHARACTERISTIC
/begin CHARACTERISTIC CT_FUEL_r_DFCOExit_TempFactor "cal comments" CURVE 0x2 2D_Array_UB 0.0 CM_Mult0_to_2_ratio 0.0 1.9921875
 /begin AXIS_DESCR FIX_AXIS NO_INPUT_QUANTITY CM_Equaloutput1 17 -28.0 164.0 MAX_GRAD 0.0 /begin FIX_AXIS_PAR_LIST -28 -16 -4 8 20 32 44 56 68 80 92 104 116 128 140 152 164 /end FIX_AXIS_PAR_LIST /end AXIS_DESCR
/end CHARACTERISTIC
/begin CHARACTERISTIC CT_FUEL_t_DFCOExitBPW "cal comments" CURVE 0x2 2D_Array_UW 0.0 CM_msec_0to1024 0.0 1023.984375
 /begin AXIS_DESCR FIX_AXIS NO_INPUT_QUANTITY CM_Second_0to1024 17 0 16.0 MAX_GRAD 0.0
  /begin FIX_AXIS_PAR_LIST 0.0 1.0 2.0 3.0 4.0 5.0 6.0 7.0 8.0 9.0 10.0 11.0 12.0 13.0 14.0 15.0 16.0 /end FIX_AXIS_PAR_LIST
 /end AXIS_DESCR
/end CHARACTERISTIC
/begin CHARACTERISTIC C_RO2_LrnDelay "cal comments" VALUE 0x9992 Scalar_UW 0.0 CM_Second_0to4096 0.0 4095.9375 /end CHARACTERISTIC
/begin CHARACTERISTIC C_RO2_U_LowerLimit "cal comments" VALUE 0x9994 Scalar_UW 0.0 CM_mVolt_1 0.0 1023.96875 /end CHARACTERISTIC
/begin CHARACTERISTIC C_RO2_U_UpperLimit "cal comments" VALUE 0x9996 Scalar_UW 0.0 CM_mVolt_1 0.0 1023.96875 /end CHARACTERISTIC
/begin CHARACTERISTIC C_RO2_LrnStep "cal comments" VALUE 0x9998 Scalar_UW 0.0 CM_Ratio_0to2_2 0.0 1.999969482421875 /end CHARACTERISTIC
/begin CHARACTERISTIC C_RO2_LrnMin "cal comments" VALUE 0x999A Scalar_UW 0.0 CM_Ratio_0to2_2 0.0 1.999969482421875 /end CHARACTERISTIC
/begin CHARACTERISTIC C_RO2_LrnMax "cal comments" VALUE 0x999C Scalar_UW 0.0 CM_Ratio_0to2_2 0.0 1.999969482421875 /end CHARACTERISTIC
/begin CHARACTERISTIC C_RO2_LrnDiffMax "cal comments" VALUE 0x999E Scalar_UW 0.0 CM_Ratio_0to2_2 0.0 1.999969482421875 /end CHARACTERISTIC
/begin CHARACTERISTIC C_RO2_RstValue "cal comments" VALUE 0x99A4 Scalar_UW 0.0 CM_Ratio_0to2_2 0.0 1.999969482421875 /end CHARACTERISTIC
/begin CHARACTERISTIC C_RO2_AllRst "cal comments" VALUE 0x99A1 Scalar_UB 0.0 CM_Boolean6 0.0 255.0 /end CHARACTERISTIC
/begin CHARACTERISTIC C_RO2_CellRst "cal comments" VALUE 0x99A2 Scalar_UB 0.0 CM_Boolean6 0.0 255.0 /end CHARACTERISTIC
/begin CHARACTERISTIC C_RO2_LrnEn "cal comments" VALUE 0x99A0 Scalar_UB 0.0 CM_Boolean6 0.0 255.0 /end CHARACTERISTIC
/begin CHARACTERISTIC C_RO2_MAP_COEF "cal comments" VALUE 0x99A8 Scalar_UW 0.0 CM_FiltCoef 0.0 0.9999847412109375 /end CHARACTERISTIC
/begin CHARACTERISTIC C_RO2_COL_MAP_HYST "cal comments" VALUE 0x99A6 Scalar_UW 0.0 CM_kpa_0to256_1 0.0 255.99609375 /end CHARACTERISTIC
/begin CHARACTERISTIC C_HeatedO2SensorUsed "cal comments" VALUE 0x923A Scalar_UB 0.0 CM_Boolean2 0.0 1.0 /end CHARACTERISTIC
/begin CHARACTERISTIC C_HighEngSpdFCOThreshHi "cal comments" VALUE 0x93DE Scalar_UW 0.0 CM_RPM_0to16384 0.0 16383.75 /end CHARACTERISTIC
/begin CHARACTERISTIC C_HighEngSpdFCOThreshLo "cal comments" VALUE 0x93DC Scalar_UW 0.0 CM_RPM_0to16384 0.0 16383.75 /end CHARACTERISTIC
/begin CHARACTERISTIC C_OSWPFiltCoef "cal comments" VALUE 0xBE34 Scalar_UW 0.0 CM_FiltCoef 0.0 0.9999847412109375 /end CHARACTERISTIC
/begin CHARACTERISTIC C_OSWPSignalConvSlope "cal comments" VALUE 0xBE36 Scalar_UW 0.0 CM_Percent_0to200_2 0.0 199.9969024658203 /end CHARACTERISTIC
/begin CHARACTERISTIC C_OSWPSignalConvIntercept "cal comments" VALUE 0xBE38 Scalar_SW 0.0 CM_Percent_N200to200 -199.9999847412109 199.9938812255859 /end CHARACTERISTIC
/begin CHARACTERISTIC C_OPSignalConvIntercept "cal comments" VALUE 0xBE3C Scalar_SW 0.0 CM_kpa_n512to512 -512.0 511.984375 /end CHARACTERISTIC
/begin CHARACTERISTIC C_OPSignalConvSlope "cal comments" VALUE 0xBE3A Scalar_UW 0.0 CM_kpa_0to2048_1 0.0 2047.96875 /end CHARACTERISTIC
/begin CHARACTERISTIC C_FUEL_COA_PulseOut "cal comments" VALUE 0xBE3E Scalar_UB 0.0 CM_Boolean6 0.0 255.0 /end CHARACTERISTIC
/begin CHARACTERISTIC C_FUEL_t_COA_Ignore "cal comments" VALUE 0xBE40 Scalar_UW 0.0 CM_Seconds_1 0.0 2047.96875 /end CHARACTERISTIC
/begin CHARACTERISTIC C_FUEL_t_COA_Lost "cal comments" VALUE 0xBE42 Scalar_UW 0.0 CM_Seconds_1 0.0 2047.96875 /end CHARACTERISTIC
/begin CHARACTERISTIC C_VIOS_MultFuelSWLowActive "cal comments" VALUE 0xBE23 Scalar_UB 0.0 CM_Boolean6 0.0 255.0 /end CHARACTERISTIC
/begin CHARACTERISTIC C_MultFuelType "cal comments" VALUE 0xBE24 Scalar_UB 0.0 CM_Count1 0.0 255.0 /end CHARACTERISTIC
/begin CHARACTERISTIC C_MultFuelValvePulseOnCount "cal comments" VALUE 0xBE22 Scalar_UB 0.0 CM_Count1 0.0 255.0 /end CHARACTERISTIC
/begin CHARACTERISTIC C_MultFuelTypeLvl_Gas_NG "cal comments" VALUE 0xBE26 Scalar_UW 0.0 CM_Percent_0to100_1 0.0 99.9984130859375 /end CHARACTERISTIC
/begin CHARACTERISTIC C_MultFuelTypeLvl_NG_LPG "cal comments" VALUE 0xBE28 Scalar_UW 0.0 CM_Percent_0to100_1 0.0 99.9984130859375 /end CHARACTERISTIC
/begin CHARACTERISTIC C_GV_Frequency "cal comments" VALUE 0xBE2A Scalar_UW 0.0 CM_Hz_0to16384 0.0 16383.75 /end CHARACTERISTIC
/begin CHARACTERISTIC C_GV_DutyCycle "cal comments" VALUE 0xBE2C Scalar_UW 0.0 CM_Percent_0to200_2 0.0 199.9969024658203 /end CHARACTERISTIC
/begin CHARACTERISTIC C_ProtectEngSpdFCOThreshHi "cal comments" VALUE 0x93E2 Scalar_UW 0.0 CM_RPM_0to16384 0.0 16383.75 /end CHARACTERISTIC
/begin CHARACTERISTIC C_ProtectEngSpdFCOThreshLo "cal comments" VALUE 0x93E0 Scalar_UW 0.0 CM_RPM_0to16384 0.0 16383.75 /end CHARACTERISTIC
/begin CHARACTERISTIC C_ProtectEngSpdFCOEnb "cal comments" VALUE 0x93E4 Scalar_UB 0.0 CM_Boolean6 0.0 255.0 /end CHARACTERISTIC
/begin CHARACTERISTIC C_Fuel_Cont_IGNOff_HiRPM "cal comments" VALUE 0x961C Scalar_UW 0.0 CM_RPM_0to16384 0.0 16383.75 /end CHARACTERISTIC
/begin CHARACTERISTIC C_ACCurrentHigh "cal comments" VALUE 0xB09A Scalar_UW 0.0 CM_amp_0to512_1 0.0 511.9921875 /end CHARACTERISTIC
/begin CHARACTERISTIC C_ACCurrentLow "cal comments" VALUE 0xB09C Scalar_UW 0.0 CM_amp_0to512_1 0.0 511.9921875 /end CHARACTERISTIC
/begin CHARACTERISTIC C_ACLow2HighTime "cal comments" VALUE 0xB0A0 Scalar_UW 0.0 CM_Second_0to512 0.0 511.9921875 /end CHARACTERISTIC
/begin CHARACTERISTIC C_ACHigh2LowTime "cal comments" VALUE 0xB09E Scalar_UW 0.0 CM_Second_0to512 0.0 511.9921875 /end CHARACTERISTIC
/begin CHARACTERISTIC C_DC_CurrentSignalConvIntercept "cal comments" VALUE 0xB0A4 Scalar_SW 0.0 CM_Ratio_n256to256 -256.0 255.9921875 /end CHARACTERISTIC
/begin CHARACTERISTIC C_DC_CurrentSignalConvSlope "cal comments" VALUE 0xB0A2 Scalar_UW 0.0 CM_amp_0to512_1 0.0 511.9921875 /end CHARACTERISTIC
/begin CHARACTERISTIC C_DC_CurrentFiltCoef "cal comments" VALUE 0xB0A6 Scalar_UW 0.0 CM_FiltCoef 0.0 0.9999847412109375 /end CHARACTERISTIC
/begin CHARACTERISTIC C_IDLEMoveBatVoltMaxLimit "cal comments" VALUE 0xB634 Scalar_UW 0.0 CM_Volt_0to32_1 0.0 31.99900627136231 /end CHARACTERISTIC
/begin CHARACTERISTIC C_IDLEMoveBatVoltMinLimit "cal comments" VALUE 0xB636 Scalar_UW 0.0 CM_Volt_0to32_1 0.0 31.99900627136231 /end CHARACTERISTIC
/begin CHARACTERISTIC C_IdleDerivEngSpdHiDeadBand "cal comments" VALUE 0x9D00 Scalar_UW 0.0 CM_RPM_0to16384 0.0 16383.75 /end CHARACTERISTIC
/begin CHARACTERISTIC C_IdleDerivEngSpdLoDeadBand "cal comments" VALUE 0x9D02 Scalar_UW 0.0 CM_RPM_0to16384 0.0 16383.75 /end CHARACTERISTIC
/begin CHARACTERISTIC C_IdleDerivEngSpdUpDeltaDeadBand "cal comments" VALUE 0x9D04 Scalar_UW 0.0 CM_RPM_0to16384 0.0 16383.75 /end CHARACTERISTIC
/begin CHARACTERISTIC C_IdleDerivEngSpdDwnDeltaDeadBand "cal comments" VALUE 0x9D06 Scalar_UW 0.0 CM_RPM_0to16384 0.0 16383.75 /end CHARACTERISTIC
/begin CHARACTERISTIC C_IdleEnableEngSpdThresh "cal comments" VALUE 0x9D2C Scalar_UW 0.0 CM_RPM_0to16384 0.0 16383.75 /end CHARACTERISTIC
/begin CHARACTERISTIC C_IdleEnableTPSThresh "cal comments" VALUE 0x9D2E Scalar_UW 0.0 CM_Percent_0to200_2 0.0 199.9969024658203 /end CHARACTERISTIC
/begin CHARACTERISTIC C_IdleIntEnbEngSpdErrorThresh "cal comments" VALUE 0x9CFC Scalar_UW 0.0 CM_RPM_0to16384 0.0 16383.75 /end CHARACTERISTIC
/begin CHARACTERISTIC C_IdleIntDltRange "cal comments" VALUE 0x9CFE Scalar_UW 0.0 CM_RPM_0to16384 0.0 16383.75 /end CHARACTERISTIC
/begin CHARACTERISTIC C_IdleIntInitDefault "cal comments" VALUE 0x9D2A Scalar_UW 0.0 CM_Percent_0to200_2 0.0 199.9969024658203 /end CHARACTERISTIC
/begin CHARACTERISTIC C_IdlePropEngSpdHiDeadBand "cal comments" VALUE 0x9D08 Scalar_UW 0.0 CM_RPM_0to16384 0.0 16383.75 /end CHARACTERISTIC
/begin CHARACTERISTIC C_IdlePropEngSpdLoDeadBand "cal comments" VALUE 0x9D0A Scalar_UW 0.0 CM_RPM_0to16384 0.0 16383.75 /end CHARACTERISTIC
/begin CHARACTERISTIC CT_IdlePropEngSpdHigh_EX "cal comments" MAP 0x9D33 3D_Array_UB 0.0 CM_Percent_0to100 0.0 99.609375
 /begin AXIS_DESCR COM_AXIS NO_INPUT_QUANTITY CM_RPM_0to16384 17 0.0 16383.75 AXIS_PTS_REF CA_EngSpd17Step4 MAX_GRAD 0.0 /end AXIS_DESCR
 /begin AXIS_DESCR COM_AXIS NO_INPUT_QUANTITY CM_kpa_0to256_1 8 0.0 255.99609375 AXIS_PTS_REF CA_MAP8Step3 MAX_GRAD 0.0 /end AXIS_DESCR
/end CHARACTERISTIC
/begin CHARACTERISTIC CT_IdlePropEngSpdLow_EX "cal comments" MAP 0x9DBE 3D_Array_UB 0.0 CM_Percent_0to100 0.0 99.609375
 /begin AXIS_DESCR COM_AXIS NO_INPUT_QUANTITY CM_RPM_0to16384 17 0.0 16383.75 AXIS_PTS_REF CA_EngSpd17Step4 MAX_GRAD 0.0 /end AXIS_DESCR
 /begin AXIS_DESCR COM_AXIS NO_INPUT_QUANTITY CM_kpa_0to256_1 8 0.0 255.99609375 AXIS_PTS_REF CA_MAP8Step3 MAX_GRAD 0.0 /end AXIS_DESCR
/end CHARACTERISTIC
/begin CHARACTERISTIC CT_IdleIntGainEngSpdHigh_EX "cal comments" MAP 0x9E49 3D_Array_UB 0.0 CM_Mult0_to_2_ratio1 0.0 1.9921875
 /begin AXIS_DESCR COM_AXIS NO_INPUT_QUANTITY CM_RPM_0to16384 11 0.0 16383.75 AXIS_PTS_REF CA_EngSpd11Step2 MAX_GRAD 0.0 /end AXIS_DESCR
 /begin AXIS_DESCR COM_AXIS NO_INPUT_QUANTITY CM_kpa_0to256_1 8 0.0 255.99609375 AXIS_PTS_REF CA_MAP8Step3 MAX_GRAD 0.0 /end AXIS_DESCR
/end CHARACTERISTIC
/begin CHARACTERISTIC CT_IdleIntGainEngSpdLow_EX "cal comments" MAP 0x9EA4 3D_Array_UB 0.0 CM_Mult0_to_2_ratio1 0.0 1.9921875
 /begin AXIS_DESCR COM_AXIS NO_INPUT_QUANTITY CM_RPM_0to16384 11 0.0 16383.75 AXIS_PTS_REF CA_EngSpd11Step2 MAX_GRAD 0.0 /end AXIS_DESCR
 /begin AXIS_DESCR COM_AXIS NO_INPUT_QUANTITY CM_kpa_0to256_1 8 0.0 255.99609375 AXIS_PTS_REF CA_MAP8Step3 MAX_GRAD 0.0 /end AXIS_DESCR
/end CHARACTERISTIC
/begin CHARACTERISTIC CT_IdleDerivEngSpdHigh_EX "cal comments" MAP 0x9EFF 3D_Array_UB 0.0 CM_Percent_0to100 0.0 99.609375
 /begin AXIS_DESCR COM_AXIS NO_INPUT_QUANTITY CM_RPM_0to16384 11 0.0 16383.75 AXIS_PTS_REF CA_EngSpd11Step3 MAX_GRAD 0.0 /end AXIS_DESCR
 /begin AXIS_DESCR COM_AXIS NO_INPUT_QUANTITY CM_kpa_0to256_1 8 0.0 255.99609375 AXIS_PTS_REF CA_MAP8Step3 MAX_GRAD 0.0 /end AXIS_DESCR
/end CHARACTERISTIC
/begin CHARACTERISTIC CT_IdleDerivEngSpdLow_EX "cal comments" MAP 0x9F5A 3D_Array_UB 0.0 CM_Percent_0to100 0.0 99.609375
 /begin AXIS_DESCR COM_AXIS NO_INPUT_QUANTITY CM_RPM_0to16384 11 0.0 16383.75 AXIS_PTS_REF CA_EngSpd11Step3 MAX_GRAD 0.0 /end AXIS_DESCR
 /begin AXIS_DESCR COM_AXIS NO_INPUT_QUANTITY CM_kpa_0to256_1 8 0.0 255.99609375 AXIS_PTS_REF CA_MAP8Step3 MAX_GRAD 0.0 /end AXIS_DESCR
/end CHARACTERISTIC
/begin CHARACTERISTIC CT_IdleDerivEngSpdHighEnh "cal comments" MAP 0x9FB5 3D_Array_UB 0.0 CM_Percent_0to100 0.0 99.609375
 /begin AXIS_DESCR COM_AXIS NO_INPUT_QUANTITY CM_RPM_0to16384 11 0.0 16383.75 AXIS_PTS_REF CA_EngSpd11Step3 MAX_GRAD 0.0 /end AXIS_DESCR
 /begin AXIS_DESCR COM_AXIS NO_INPUT_QUANTITY CM_kpa_0to256_1 8 0.0 255.99609375 AXIS_PTS_REF CA_MAP8Step3 MAX_GRAD 0.0 /end AXIS_DESCR
/end CHARACTERISTIC
/begin CHARACTERISTIC CT_IdleDerivEngSpdLowEnh "cal comments" MAP 0xA010 3D_Array_UB 0.0 CM_Percent_0to100 0.0 99.609375
 /begin AXIS_DESCR COM_AXIS NO_INPUT_QUANTITY CM_RPM_0to16384 11 0.0 16383.75 AXIS_PTS_REF CA_EngSpd11Step3 MAX_GRAD 0.0 /end AXIS_DESCR
 /begin AXIS_DESCR COM_AXIS NO_INPUT_QUANTITY CM_kpa_0to256_1 8 0.0 255.99609375 AXIS_PTS_REF CA_MAP8Step3 MAX_GRAD 0.0 /end AXIS_DESCR
/end CHARACTERISTIC
/begin CHARACTERISTIC C_IACV_n_BattOffsetMax "cal comments" VALUE 0x9A18 Scalar_UW 0.0 udf_CM_18586 0.0 16383.75 /end CHARACTERISTIC
/begin CHARACTERISTIC C_IACV_n_BattRPMStep "cal comments" VALUE 0x9A1A Scalar_UW 0.0 udf_CM_18586 0.0 16383.75 /end CHARACTERISTIC
/begin CHARACTERISTIC C_IACV_r_StartUpFactor "cal comments" VALUE 0x9A1C Scalar_UW 0.0 CM_FactorRatio 0.0 0.9999847412109375 /end CHARACTERISTIC
/begin CHARACTERISTIC C_IACV_t_BattWaitTime "cal comments" VALUE 0x9A1E Scalar_UW 0.0 CM_Second_0to1024 0.0 1023.984375 /end CHARACTERISTIC
/begin CHARACTERISTIC C_IACV_t_DsrdSpdSUDecayTime "cal comments" VALUE 0x9A20 Scalar_UW 0.0 CM_Second_0to1024 0.0 1023.984375 /end CHARACTERISTIC
/begin CHARACTERISTIC C_IACV_t_LowBattWaitTime "cal comments" VALUE 0x9A22 Scalar_UW 0.0 CM_Second_0to1024 0.0 1023.984375 /end CHARACTERISTIC
/begin CHARACTERISTIC C_IACV_U_BattHigh "cal comments" VALUE 0x9A24 Scalar_UW 0.0 CM_Volt_0to32_1 0.0 31.99900627136231 /end CHARACTERISTIC
/begin CHARACTERISTIC C_IACV_U_BattLow "cal comments" VALUE 0x9A26 Scalar_UW 0.0 CM_Volt_0to32_1 0.0 31.99900627136231 /end CHARACTERISTIC
/begin CHARACTERISTIC CT_IACV_n_BaseDsrdSpd "cal comments" CURVE 0x9A2A 2D_Array_UW 0.0 CM_RPM_0to16384 0.0 16383.75
 /begin AXIS_DESCR FIX_AXIS NO_INPUT_QUANTITY CM_Equaloutput1 17 -28.0 164.0 MAX_GRAD 0.0 /begin FIX_AXIS_PAR_LIST -28 -16 -4 8 20 32 44 56 68 80 92 104 116 128 140 152 164 /end FIX_AXIS_PAR_LIST /end AXIS_DESCR
/end CHARACTERISTIC
/begin CHARACTERISTIC CT_IACV_pct_DsrdThrotFollow "cal comments" MAP 0x9A86 3D_Array_UB 0.0 CM_Percent_0to100 0.0 99.609375
 /begin AXIS_DESCR FIX_AXIS NO_INPUT_QUANTITY CM_Equaloutput1 9 0.0 50.0 MAX_GRAD 0.0 /begin FIX_AXIS_PAR_LIST 0 6.25 12.5 18.75 25 31.25 37.5 43.75 50 /end FIX_AXIS_PAR_LIST /end AXIS_DESCR
 /begin AXIS_DESCR FIX_AXIS NO_INPUT_QUANTITY CM_Equaloutput1 9 800.0 7200.0 MAX_GRAD 0.0 /begin FIX_AXIS_PAR_LIST 800 1600 2400 3200 4000 4800 5600 6400 7200 /end FIX_AXIS_PAR_LIST /end AXIS_DESCR
/end CHARACTERISTIC
/begin CHARACTERISTIC CT_IACV_r_TFDecayCoeff "cal comments" CURVE 0x9ADA 2D_Array_UB 0.0 CM_Mult_0to1 0.0 0.99609375
 /begin AXIS_DESCR FIX_AXIS NO_INPUT_QUANTITY CM_Equaloutput1 9 800.0 7200.0 MAX_GRAD 0.0 /begin FIX_AXIS_PAR_LIST 800 1600 2400 3200 4000 4800 5600 6400 7200 /end FIX_AXIS_PAR_LIST /end AXIS_DESCR
/end CHARACTERISTIC
/begin CHARACTERISTIC CT_IACV_r_TFRampUpCoeff "cal comments" CURVE 0x9AE5 2D_Array_UB 0.0 CM_Mult_0to1 0.0 0.99609375
 /begin AXIS_DESCR FIX_AXIS NO_INPUT_QUANTITY CM_Equaloutput1 9 0.0 50.0 MAX_GRAD 0.0 /begin FIX_AXIS_PAR_LIST 0 6.25 12.5 18.75 25 31.25 37.5 43.75 50 /end FIX_AXIS_PAR_LIST /end AXIS_DESCR
/end CHARACTERISTIC
/begin CHARACTERISTIC CT_IACV_r_ThrotFollowFactor "cal comments" CURVE 0x9AF0 2D_Array_UB 0.0 CM_Mult0_to_2_ratio 0.0 1.9921875
 /begin AXIS_DESCR FIX_AXIS NO_INPUT_QUANTITY CM_Equaloutput1 17 -28.0 164.0 MAX_GRAD 0.0 /begin FIX_AXIS_PAR_LIST -28 -16 -4 8 20 32 44 56 68 80 92 104 116 128 140 152 164 /end FIX_AXIS_PAR_LIST /end AXIS_DESCR
/end CHARACTERISTIC
/begin CHARACTERISTIC C_IACV_r_TF_NeutralDecayCoeff "cal comments" VALUE 0x9B02 Scalar_UW 0.0 CM_FactorRatio 0.0 0.9999847412109375 /end CHARACTERISTIC
/begin CHARACTERISTIC C_IACVEnableEngSpdThresh "cal comments" VALUE 0x9A80 Scalar_UW 0.0 CM_RPM_0to16384 0.0 16383.75 /end CHARACTERISTIC
/begin CHARACTERISTIC C_IACVEnableTPSThresh "cal comments" VALUE 0x9A82 Scalar_UW 0.0 CM_Percent_0to200_2 0.0 199.9969024658203 /end CHARACTERISTIC
/begin CHARACTERISTIC C_IACVIntEnbEngSpdErrorThresh "cal comments" VALUE 0x9B04 Scalar_UW 0.0 CM_RPM_0to16384 0.0 16383.75 /end CHARACTERISTIC
/begin CHARACTERISTIC C_IACVPropEngSpdHiDeadBand "cal comments" VALUE 0x9B0C Scalar_UW 0.0 CM_RPM_0to16384 0.0 16383.75 /end CHARACTERISTIC
/begin CHARACTERISTIC C_IACVPropEngSpdLoDeadBand "cal comments" VALUE 0x9B0E Scalar_UW 0.0 CM_RPM_0to16384 0.0 16383.75 /end CHARACTERISTIC
/begin CHARACTERISTIC C_IACV_pct_AiflowLrnBaseVal "cal comments" VALUE 0x9B10 Scalar_UW 0.0 CM_Percent_0to200_2 0.0 199.9969024658203 /end CHARACTERISTIC
/begin CHARACTERISTIC C_IACV_pct_AirflowMaxIntgOffset "cal comments" VALUE 0x9B12 Scalar_UW 0.0 CM_Percent_0to200_2 0.0 199.9969024658203 /end CHARACTERISTIC
/begin CHARACTERISTIC C_IACV_pct_AirflowSlowLrnOffset "cal comments" VALUE 0x9B14 Scalar_UW 0.0 CM_Percent_0to200_2 0.0 199.9969024658203 /end CHARACTERISTIC
/begin CHARACTERISTIC C_IACV_r_AirflowRPMErrCoeff "cal comments" VALUE 0x9B16 Scalar_UW 0.0 CM_FactorRatio 0.0 0.9999847412109375 /end CHARACTERISTIC
/begin CHARACTERISTIC C_IACV_r_CrankDecayFactor "cal comments" VALUE 0x9B18 Scalar_UW 0.0 CM_FactorRatio 0.0 0.9999847412109375 /end CHARACTERISTIC
/begin CHARACTERISTIC C_IACV_r_AirflowICoolMaxFactor "cal comments" VALUE 0x9BBE Scalar_UW 0.0 CM_FactorRatio 0.0 0.9999847412109375 /end CHARACTERISTIC
/begin CHARACTERISTIC C_IACV_t_AirflowBattDelayTime "cal comments" VALUE 0x9B1A Scalar_UW 0.0 CM_Second_0to1024 0.0 1023.984375 /end CHARACTERISTIC
/begin CHARACTERISTIC C_IACV_t_CrankDecayTime "cal comments" VALUE 0x9B1C Scalar_UW 0.0 CM_Second_0to1024 0.0 1023.984375 /end CHARACTERISTIC
/begin CHARACTERISTIC C_IACV_t_MotorResetDly "cal comments" VALUE 0x9B20 Scalar_UW 0.0 CM_Second_0to1024 0.0 1023.984375 /end CHARACTERISTIC
/begin CHARACTERISTIC C_IACVCLDelayAftStartUp "cal comments" VALUE 0x9B22 Scalar_UW 0.0 CM_Second_0to1024 0.0 1023.984375 /end CHARACTERISTIC
/begin CHARACTERISTIC C_IACV_U_AirflowAltCrank "cal comments" VALUE 0x9B24 Scalar_UW 0.0 CM_Volt_0to32_1 0.0 31.99900627136231 /end CHARACTERISTIC
/begin CHARACTERISTIC C_IACV_U_AirflowAltIncVolt "cal comments" VALUE 0x9B26 Scalar_UW 0.0 CM_Volt_0to32_1 0.0 31.99900627136231 /end CHARACTERISTIC
/begin CHARACTERISTIC C_IACV_T_EngTmpWarm "cal comments" VALUE 0x9B1E Scalar_SW 0.0 CM_DegC_N256to256 -256.0 255.9921875 /end CHARACTERISTIC
/begin CHARACTERISTIC C_IACV_pct_AirflowSlowLrnLimit "cal comments" VALUE 0x9C22 Scalar_UW 0.0 CM_Percent_0to200_2 0.0 199.9969024658203 /end CHARACTERISTIC
/begin CHARACTERISTIC CT_IACV_p_IntegralDeltaHiThrs "cal comments" CURVE 0x9B2A 2D_Array_UB 0.0 CM_kpa_8bit 0.0 127.5
 /begin AXIS_DESCR FIX_AXIS NO_INPUT_QUANTITY CM_Equaloutput1 7 -28.0 164.0 MAX_GRAD 0.0 /begin FIX_AXIS_PAR_LIST -28 4 36 68 100 132 164 /end FIX_AXIS_PAR_LIST /end AXIS_DESCR
/end CHARACTERISTIC
/begin CHARACTERISTIC CT_IACV_p_IntegralDeltaLowThrs "cal comments" CURVE 0x9C14 2D_Array_UW 0.0 CM_kpa_0to256_1 0.0 255.99609375
 /begin AXIS_DESCR FIX_AXIS NO_INPUT_QUANTITY CM_Equaloutput1 7 -28.0 164.0 MAX_GRAD 0.0 /begin FIX_AXIS_PAR_LIST -28 4 36 68 100 132 164 /end FIX_AXIS_PAR_LIST /end AXIS_DESCR
/end CHARACTERISTIC
/begin CHARACTERISTIC CT_IACV_pct_AirflowBattVoltOff "cal comments" CURVE 0x9B33 2D_Array_UB 0.0 CM_Percent_0to100 0.0 99.609375
 /begin AXIS_DESCR FIX_AXIS NO_INPUT_QUANTITY CM_Equaloutput1 17 6 18.8 MAX_GRAD 0.0
  /begin FIX_AXIS_PAR_LIST 6 6.8 7.6 8.4 9.2 10 10.8 11.6 12.4 13.2 14.0 14.8 15.6 16.4 17.2 18 18.8 /end FIX_AXIS_PAR_LIST
 /end AXIS_DESCR
/end CHARACTERISTIC
/begin CHARACTERISTIC CT_IACV_pct_AirflowCrankOffset "cal comments" CURVE 0x9B46 2D_Array_UB 0.0 CM_Percent_0to100 0.0 99.609375
 /begin AXIS_DESCR FIX_AXIS NO_INPUT_QUANTITY CM_Equaloutput1 17 -28.0 164.0 MAX_GRAD 0.0 /begin FIX_AXIS_PAR_LIST -28 -16 -4 8 20 32 44 56 68 80 92 104 116 128 140 152 164 /end FIX_AXIS_PAR_LIST /end AXIS_DESCR
/end CHARACTERISTIC
/begin CHARACTERISTIC CT_IACV_r_AirflowICoolOffsetFact "cal comments" CURVE 0x9BC2 2D_Array_UB 0.0 CM_Mult_0to1_2 0.0 0.99609375
 /begin AXIS_DESCR FIX_AXIS NO_INPUT_QUANTITY CM_Equaloutput1 17 -28.0 164.0 MAX_GRAD 0.0 /begin FIX_AXIS_PAR_LIST -28 -16 -4 8 20 32 44 56 68 80 92 104 116 128 140 152 164 /end FIX_AXIS_PAR_LIST /end AXIS_DESCR
/end CHARACTERISTIC
/begin CHARACTERISTIC C_CLIACVEnableDelay "cal comments" VALUE 0x9A4C Scalar_UW 0.0 CM_Second_0to1024 0.0 1023.984375 /end CHARACTERISTIC
/begin CHARACTERISTIC CT_IACVFlowBaroMult "cal comments" CURVE 0x9B6C 2D_Array_UB 0.0 CM_Mult_0to8 0.0 7.96875
 /begin AXIS_DESCR FIX_AXIS NO_INPUT_QUANTITY CM_Equaloutput1 6 55.0 105.0 MAX_GRAD 0.0 /begin FIX_AXIS_PAR_LIST 55 65 75 85 95 105 /end FIX_AXIS_PAR_LIST /end AXIS_DESCR
/end CHARACTERISTIC
/begin CHARACTERISTIC CT_IACVAirflowColdOffset "cal comments" CURVE 0x9B59 2D_Array_UB 0.0 CM_Percent_0to100 0.0 99.609375
 /begin AXIS_DESCR FIX_AXIS NO_INPUT_QUANTITY CM_Equaloutput1 17 -28.0 164.0 MAX_GRAD 0.0 /begin FIX_AXIS_PAR_LIST -28 -16 -4 8 20 32 44 56 68 80 92 104 116 128 140 152 164 /end FIX_AXIS_PAR_LIST /end AXIS_DESCR
/end CHARACTERISTIC
/begin CHARACTERISTIC CT_IACVDerivEngSpdHigh "cal comments" CURVE 0x9B74 2D_Array_UB 0.0 CM_Percent_0to100 0.0 99.609375
 /begin AXIS_DESCR FIX_AXIS NO_INPUT_QUANTITY CM_Equaloutput1 17 0.0 128.0 MAX_GRAD 0.0 /begin FIX_AXIS_PAR_LIST 0 8 16 24 32 40 48 56 64 72 80 88 96 104 112 120 128 /end FIX_AXIS_PAR_LIST /end AXIS_DESCR
/end CHARACTERISTIC
/begin CHARACTERISTIC CT_IACVDerivEngSpdLow "cal comments" CURVE 0x9B87 2D_Array_UB 0.0 CM_Percent_0to100 0.0 99.609375
 /begin AXIS_DESCR FIX_AXIS NO_INPUT_QUANTITY CM_Equaloutput1 17 0.0 128.0 MAX_GRAD 0.0 /begin FIX_AXIS_PAR_LIST 0 8 16 24 32 40 48 56 64 72 80 88 96 104 112 120 128 /end FIX_AXIS_PAR_LIST /end AXIS_DESCR
/end CHARACTERISTIC
/begin CHARACTERISTIC CT_IACVDesireSpdStartup "cal comments" CURVE 0x9A50 2D_Array_UW 0.0 CM_RPM_0to16384 0.0 16383.75
 /begin AXIS_DESCR FIX_AXIS NO_INPUT_QUANTITY CM_Equaloutput1 17 -28.0 164.0 MAX_GRAD 0.0 /begin FIX_AXIS_PAR_LIST -28 -16 -4 8 20 32 44 56 68 80 92 104 116 128 140 152 164 /end FIX_AXIS_PAR_LIST /end AXIS_DESCR
/end CHARACTERISTIC
/begin CHARACTERISTIC CT_IACVIntGainEngSpdHigh "cal comments" CURVE 0x9BD5 2D_Array_UB 0.0 CM_Mult0_to_2_ratio1 0.0 1.9921875
 /begin AXIS_DESCR FIX_AXIS NO_INPUT_QUANTITY CM_Equaloutput1 11 0.0 500.0 MAX_GRAD 0.0 /begin FIX_AXIS_PAR_LIST 0 50 100 150 200 250 300 350 400 450 500 /end FIX_AXIS_PAR_LIST /end AXIS_DESCR
/end CHARACTERISTIC
/begin CHARACTERISTIC CT_IACVIntGainEngSpdLow "cal comments" CURVE 0x9BE2 2D_Array_UB 0.0 CM_Mult0_to_2_ratio1 0.0 1.9921875
 /begin AXIS_DESCR FIX_AXIS NO_INPUT_QUANTITY CM_Equaloutput1 11 0.0 500.0 MAX_GRAD 0.0 /begin FIX_AXIS_PAR_LIST 0 50 100 150 200 250 300 350 400 450 500 /end FIX_AXIS_PAR_LIST /end AXIS_DESCR
/end CHARACTERISTIC
/begin CHARACTERISTIC CT_IACVPropEngSpdHigh "cal comments" CURVE 0x9B9A 2D_Array_UB 0.0 CM_Percent_0to100 0.0 99.609375
 /begin AXIS_DESCR COM_AXIS NO_INPUT_QUANTITY CM_RPM_0to16384 17 0.0 16383.75 AXIS_PTS_REF CA_EngSpd17Step4 MAX_GRAD 0.0 /end AXIS_DESCR
/end CHARACTERISTIC
/begin CHARACTERISTIC CT_IACVPropEngSpdLow "cal comments" CURVE 0x9BAD 2D_Array_UB 0.0 CM_Percent_0to100 0.0 99.609375
 /begin AXIS_DESCR COM_AXIS NO_INPUT_QUANTITY CM_RPM_0to16384 17 0.0 16383.75 AXIS_PTS_REF CA_EngSpd17Step4 MAX_GRAD 0.0 /end AXIS_DESCR
/end CHARACTERISTIC
/begin CHARACTERISTIC CT_IACV_t_CoolantDecayTime "cal comments" CURVE 0x9BF0 2D_Array_UW 0.0 CM_Second_0to1024 0.0 1023.984375
 /begin AXIS_DESCR FIX_AXIS NO_INPUT_QUANTITY CM_Equaloutput1 17 -28.0 164.0 MAX_GRAD 0.0 /begin FIX_AXIS_PAR_LIST -28 -16 -4 8 20 32 44 56 68 80 92 104 116 128 140 152 164 /end FIX_AXIS_PAR_LIST /end AXIS_DESCR
/end CHARACTERISTIC
/begin CHARACTERISTIC C_VIOS_IACV_PstnDft "cal comments" VALUE 0xB62B Scalar_UB 0.0 CM_Count4 0.0 255.0 /end CHARACTERISTIC
/begin CHARACTERISTIC C_VIOS_IACV_PstnMax "cal comments" VALUE 0xB62C Scalar_UB 0.0 CM_Count4 0.0 255.0 /end CHARACTERISTIC
/begin CHARACTERISTIC C_VIOS_IACV_PstnMin "cal comments" VALUE 0xB62D Scalar_UB 0.0 CM_Count4 0.0 255.0 /end CHARACTERISTIC
/begin CHARACTERISTIC C_IACVMotorParkDelay "cal comments" VALUE 0xB62E Scalar_UW 0.0 CM_Count_0to65535 0.0 65535.0 /end CHARACTERISTIC
/begin CHARACTERISTIC C_IACVStepMotorHiEn "cal comments" VALUE 0xB630 Scalar_UB 0.0 CM_Boolean6 0.0 255.0 /end CHARACTERISTIC
/begin CHARACTERISTIC C_IACVStepMotorDir "cal comments" VALUE 0xB631 Scalar_UB 0.0 CM_Boolean6 0.0 255.0 /end CHARACTERISTIC
/begin CHARACTERISTIC C_IACVLoopCounter "cal comments" VALUE 0xB632 Scalar_UB 0.0 CM_Count1 0.0 255.0 /end CHARACTERISTIC
/begin CHARACTERISTIC C_IACVMoveBatVoltMaxLimit "cal comments" VALUE 0xB5FE Scalar_UW 0.0 CM_Volt_0to32_1 0.0 31.99900627136231 /end CHARACTERISTIC
/begin CHARACTERISTIC C_IACVMoveBatVoltMinLimit "cal comments" VALUE 0xB600 Scalar_UW 0.0 CM_Volt_0to32_1 0.0 31.99900627136231 /end CHARACTERISTIC
/begin CHARACTERISTIC C_IACVMotorDirChangeDelay "cal comments" VALUE 0xB604 Scalar_UB 0.0 CM_Count4 0.0 255.0 /end CHARACTERISTIC
/begin CHARACTERISTIC C_IACVMotorStartDelay "cal comments" VALUE 0xB602 Scalar_UB 0.0 CM_Count4 0.0 255.0 /end CHARACTERISTIC
/begin CHARACTERISTIC C_IACVMotorStartDelaySteps "cal comments" VALUE 0xB603 Scalar_UB 0.0 CM_Count4 0.0 255.0 /end CHARACTERISTIC
/begin CHARACTERISTIC CT_IACVDsrdMtrPstn "cal comments" CURVE 0xB607 2D_Array_UB 0.0 CM_Count4 0.0 255.0
 /begin AXIS_DESCR FIX_AXIS NO_INPUT_QUANTITY CM_Equaloutput1 17 0.0 100.0 MAX_GRAD 0.0
  /begin FIX_AXIS_PAR_LIST 0.0 6.25 12.5 18.75 25.0 31.25 37.5 43.75 50.0 56.25 62.5 68.75 75.0 81.25 87.5 93.75 100.0 /end FIX_AXIS_PAR_LIST
 /end AXIS_DESCR
/end CHARACTERISTIC
/begin CHARACTERISTIC CT_IACV_ParkPstn "cal comments" CURVE 0xB61A 2D_Array_UB 0.0 CM_Count4 0.0 255.0
 /begin AXIS_DESCR FIX_AXIS NO_INPUT_QUANTITY CM_Equaloutput1 17 -28.0 164.0 MAX_GRAD 0.0 /begin FIX_AXIS_PAR_LIST -28 -16 -4 8 20 32 44 56 68 80 92 104 116 128 140 152 164 /end FIX_AXIS_PAR_LIST /end AXIS_DESCR
/end CHARACTERISTIC
/begin CHARACTERISTIC C_IACV_ForChokeEnable "cal comments" VALUE 0x9A72 Scalar_UB 0.0 CM_Boolean6 0.0 255.0 /end CHARACTERISTIC
/begin CHARACTERISTIC C_IACVMotorResetEachPowerDown "cal comments" VALUE 0x9A7C Scalar_UB 0.0 CM_Boolean1 0.0 1.0 /end CHARACTERISTIC
/begin CHARACTERISTIC C_IACVMotorRstEn "cal comments" VALUE 0x9A7E Scalar_UB 0.0 CM_Boolean1 0.0 1.0 /end CHARACTERISTIC
/begin CHARACTERISTIC C_IACVMotorResetEngSpdThresh "cal comments" VALUE 0x9A76 Scalar_UW 0.0 CM_RPM_0to16384 0.0 16383.75 /end CHARACTERISTIC
/begin CHARACTERISTIC C_IACVMotorResetIGNOffDelay "cal comments" VALUE 0x9A7A Scalar_UW 0.0 CM_Second_0to512 0.0 511.9921875 /end CHARACTERISTIC
/begin CHARACTERISTIC C_IACVMotorResetMaxPintleSeatStep "cal comments" VALUE 0x9A7D Scalar_UB 0.0 CM_Count4 0.0 255.0 /end CHARACTERISTIC
/begin CHARACTERISTIC C_IACVMotorResetTPSThresh "cal comments" VALUE 0x9A78 Scalar_UW 0.0 CM_Percent_0to200_2 0.0 199.9969024658203 /end CHARACTERISTIC
/begin CHARACTERISTIC C_IACVPosLostCoolTempThresh "cal comments" VALUE 0x9A74 Scalar_SW 0.0 CM_DegC_N256to256 -256.0 255.9921875 /end CHARACTERISTIC
/begin CHARACTERISTIC CT_BSTPPropHigh "cal comments" CURVE 0x8FEA 2D_Array_UB 0.0 CM_Percent_0to100 0.0 99.609375
 /begin AXIS_DESCR COM_AXIS NO_INPUT_QUANTITY CM_kpa_0to256_1 9 0.0 255.99609375 AXIS_PTS_REF CA_MAP9Step2 MAX_GRAD 0.0 /end AXIS_DESCR
/end CHARACTERISTIC
/begin CHARACTERISTIC CT_BSTPPropLow "cal comments" CURVE 0x8FFD 2D_Array_UB 0.0 CM_Percent_0to100 0.0 99.609375
 /begin AXIS_DESCR COM_AXIS NO_INPUT_QUANTITY CM_kpa_0to256_1 9 0.0 255.99609375 AXIS_PTS_REF CA_MAP9Step2 MAX_GRAD 0.0 /end AXIS_DESCR
/end CHARACTERISTIC
/begin CHARACTERISTIC CT_BSTPIntGainHigh "cal comments" CURVE 0x9010 2D_Array_UB 0.0 CM_Mult0_to_2_ratio 0.0 1.9921875
 /begin AXIS_DESCR COM_AXIS NO_INPUT_QUANTITY CM_kpa_0to256_1 9 0.0 255.99609375 AXIS_PTS_REF CA_MAP9Step2 MAX_GRAD 0.0 /end AXIS_DESCR
/end CHARACTERISTIC
/begin CHARACTERISTIC CT_BSTPIntGainLow "cal comments" CURVE 0x901D 2D_Array_UB 0.0 CM_Mult0_to_2_ratio 0.0 1.9921875
 /begin AXIS_DESCR COM_AXIS NO_INPUT_QUANTITY CM_kpa_0to256_1 9 0.0 255.99609375 AXIS_PTS_REF CA_MAP9Step2 MAX_GRAD 0.0 /end AXIS_DESCR
/end CHARACTERISTIC
/begin CHARACTERISTIC C_BSTPIntDeadBand "cal comments" VALUE 0x8FE4 Scalar_UW 0.0 CM_kpa_0to256_1 0.0 255.99609375 /end CHARACTERISTIC
/begin CHARACTERISTIC C_BSTPPropDeadBand "cal comments" VALUE 0x8FE6 Scalar_UW 0.0 CM_kpa_0to256_1 0.0 255.99609375 /end CHARACTERISTIC
/begin CHARACTERISTIC C_BSTP_CL_Enb "cal comments" VALUE 0x8FE2 Scalar_UB 0.0 CM_Count1 0.0 255.0 /end CHARACTERISTIC
/begin CHARACTERISTIC CT_BSTPDsrd "cal comments" MAP 0x902B 3D_Array_UB 0.0 CM_kpa_0_256_8bit 0.0 255
 /begin AXIS_DESCR COM_AXIS NO_INPUT_QUANTITY udf_CM_18705 17 0.0 511.9921875 AXIS_PTS_REF CA_AirGramStep17 MAX_GRAD 0.0 /end AXIS_DESCR
 /begin AXIS_DESCR COM_AXIS NO_INPUT_QUANTITY CM_RPM_0to16384 4 0.0 16383.75 AXIS_PTS_REF CA_EngSpd4Step1 MAX_GRAD 0.0 /end AXIS_DESCR
/end CHARACTERISTIC
/begin CHARACTERISTIC CT_BSTPDsrdIATCorr "cal comments" CURVE 0x9071 2D_Array_UB 0.0 CM_Mult0_to_2_ratio 0.0 1.9921875
 /begin AXIS_DESCR FIX_AXIS NO_INPUT_QUANTITY CM_Equaloutput1 17 -28.0 164.0 MAX_GRAD 0.0 /begin FIX_AXIS_PAR_LIST -28 -16 -4 8 20 32 44 56 68 80 92 104 116 128 140 152 164 /end FIX_AXIS_PAR_LIST /end AXIS_DESCR
/end CHARACTERISTIC
/begin CHARACTERISTIC C_IgnCoil_Prot_Current "cal comments" CURVE 0x80C3 2D_Array_UB 0.0 CM_Count1 0.0 255.0
 /begin AXIS_DESCR FIX_AXIS NO_INPUT_QUANTITY CM_EOI 4 0.0 4.0 MAX_GRAD 0.0 /begin FIX_AXIS_PAR_LIST 0 1 2 3 /end FIX_AXIS_PAR_LIST /end AXIS_DESCR
/end CHARACTERISTIC
/begin CHARACTERISTIC C_IgnCoil_STG_Threhold "cal comments" CURVE 0x80C7 2D_Array_UB 0.0 CM_Count1 0.0 255.0
 /begin AXIS_DESCR FIX_AXIS NO_INPUT_QUANTITY CM_EOI 4 0.0 4.0 MAX_GRAD 0.0 /begin FIX_AXIS_PAR_LIST 0 1 2 3 /end FIX_AXIS_PAR_LIST /end AXIS_DESCR
/end CHARACTERISTIC
/begin CHARACTERISTIC CT_InjectorType "cal comments" CURVE 0x80CB 2D_Array_UB 0.0 CM_Count1 0.0 255.0
 /begin AXIS_DESCR FIX_AXIS NO_INPUT_QUANTITY CM_EOI 4 0.0 4.0 MAX_GRAD 0.0 /begin FIX_AXIS_PAR_LIST 0 1 2 3 /end FIX_AXIS_PAR_LIST /end AXIS_DESCR
/end CHARACTERISTIC
/begin CHARACTERISTIC C_IGNOffDelayTime "cal comments" VALUE 0xB4FE Scalar_UW 0.0 CM_Second_0to512 0.0 511.9921875 /end CHARACTERISTIC
/begin CHARACTERISTIC C_IGNOnDelay "cal comments" VALUE 0xB568 Scalar_UW 0.0 CM_Second_0to512 0.0 511.9921875 /end CHARACTERISTIC
/begin CHARACTERISTIC C_IGNOnDelayEngSpdThreshHi "cal comments" VALUE 0xB56C Scalar_UW 0.0 CM_RPM_0to16384 0.0 16383.75 /end CHARACTERISTIC
/begin CHARACTERISTIC C_IGNOnDelayEngSpdThreshLo "cal comments" VALUE 0xB56A Scalar_UW 0.0 CM_RPM_0to16384 0.0 16383.75 /end CHARACTERISTIC
/begin CHARACTERISTIC C_IGNOnVoltThreshHi "cal comments" VALUE 0xB4F6 Scalar_UW 0.0 CM_Volt_0to32_1 0.0 31.99900627136231 /end CHARACTERISTIC
/begin CHARACTERISTIC C_IGNOnVoltThreshLo "cal comments" VALUE 0xB4F8 Scalar_UW 0.0 CM_Volt_0to32_1 0.0 31.99900627136231 /end CHARACTERISTIC
/begin CHARACTERISTIC C_IGNOnVoltLvlMax "cal comments" VALUE 0xB4FA Scalar_UW 0.0 CM_Volt_0to32_1 0.0 31.99900627136231 /end CHARACTERISTIC
/begin CHARACTERISTIC C_IGNOnVoltLvlMin "cal comments" VALUE 0xB4FC Scalar_UW 0.0 CM_Volt_0to32_1 0.0 31.99900627136231 /end CHARACTERISTIC
/begin CHARACTERISTIC C_IGNVoltFiltCoef "cal comments" VALUE 0xB500 Scalar_UW 0.0 CM_FiltCoef 0.0 0.9999847412109375 /end CHARACTERISTIC
/begin CHARACTERISTIC C_InjectorFlow "cal comments" VALUE 0x9268 Scalar_UW 0.0 CM_GramPerSecond 0.0 15.999755859375 /end CHARACTERISTIC
/begin CHARACTERISTIC C_ValveFlow_NG "cal comments" VALUE 0x926A Scalar_UW 0.0 CM_GramPerSecond 0.0 15.999755859375 /end CHARACTERISTIC
/begin CHARACTERISTIC C_ValveFlow_LPG "cal comments" VALUE 0x926C Scalar_UW 0.0 CM_GramPerSecond 0.0 15.999755859375 /end CHARACTERISTIC
/begin CHARACTERISTIC C_IntakeAirTempDefault "cal comments" VALUE 0xB560 Scalar_SW 0.0 CM_DegC_N256to256 -256.0 255.9921875 /end CHARACTERISTIC
/begin CHARACTERISTIC C_IntakeAirTempFiltCoef "cal comments" VALUE 0xB4E8 Scalar_UW 0.0 CM_FiltCoef 0.0 0.9999847412109375 /end CHARACTERISTIC
/begin CHARACTERISTIC C_MAPCIDEnable "cal comments" VALUE 0xB098 Scalar_UB 0.0 CM_Boolean4 0.0 1.0 /end CHARACTERISTIC
/begin CHARACTERISTIC C_MAPCIDEngSpdErrorThresh "cal comments" VALUE 0xB520 Scalar_SW 0.0 CM_RPM_n8192to8192 -8192.0 8191.75 /end CHARACTERISTIC
/begin CHARACTERISTIC C_MAPCIDEngSpdThreshHi "cal comments" VALUE 0xB51C Scalar_UW 0.0 CM_RPM_0to16384 0.0 16383.75 /end CHARACTERISTIC
/begin CHARACTERISTIC C_MAPCIDEngSpdThreshLo "cal comments" VALUE 0xB51E Scalar_UW 0.0 CM_RPM_0to16384 0.0 16383.75 /end CHARACTERISTIC
/begin CHARACTERISTIC C_MAPCIDMAPFiltCoef "cal comments" VALUE 0xB528 Scalar_UW 0.0 CM_FiltCoef 0.0 0.9999847412109375 /end CHARACTERISTIC
/begin CHARACTERISTIC C_MAPCIDMAPThresh "cal comments" VALUE 0xB526 Scalar_UW 0.0 CM_kpa_0to256_1 0.0 255.99609375 /end CHARACTERISTIC
/begin CHARACTERISTIC C_MAPCIDTPSDeltaThresh "cal comments" VALUE 0xB3C0 Scalar_SW 0.0 CM_Percent_N200to200 -199.9999847412109 199.9938812255859 /end CHARACTERISTIC
/begin CHARACTERISTIC C_MAPFiltCoef "cal comments" VALUE 0xB546 Scalar_UW 0.0 CM_FiltCoef 0.0 0.9999847412109375 /end CHARACTERISTIC
/begin CHARACTERISTIC C_MAPMaxLimit "cal comments" VALUE 0xB52A Scalar_UW 0.0 CM_kpa_0to256_1 0.0 255.99609375 /end CHARACTERISTIC
/begin CHARACTERISTIC C_MAPMinLimit "cal comments" VALUE 0xB52C Scalar_UW 0.0 CM_kpa_0to256_1 0.0 255.99609375 /end CHARACTERISTIC
/begin CHARACTERISTIC C_MAPReadingAngleMaxLimit "cal comments" VALUE 0xB558 Scalar_UW 0.0 CM_CrankAngle_0to1024 0.0 1023.984375 /end CHARACTERISTIC
/begin CHARACTERISTIC C_MAPReadingAngleMinLimit "cal comments" VALUE 0xB55A Scalar_UW 0.0 CM_CrankAngle_0to1024 0.0 1023.984375 /end CHARACTERISTIC
/begin CHARACTERISTIC C_MAPSignalConvIntercept "cal comments" VALUE 0xB504 Scalar_SW 0.0 CM_Ratio_n128to128 -128.0 127.99609375 /end CHARACTERISTIC
/begin CHARACTERISTIC C_MAPSignalConvSlope "cal comments" VALUE 0xB502 Scalar_UW 0.0 CM_kpa_0to512_1 0.0 511.9921875 /end CHARACTERISTIC
/begin CHARACTERISTIC C_FPMaxUsed "cal comments" VALUE 0xBE48 Scalar_UB 0.0 CM_Boolean4 0.0 1.0 /end CHARACTERISTIC
/begin CHARACTERISTIC C_FPSignalConvIntercept "cal comments" VALUE 0xBE46 Scalar_SW 0.0 CM_Ratio_n128to128 -128.0 127.99609375 /end CHARACTERISTIC
/begin CHARACTERISTIC C_FPSignalConvSlope "cal comments" VALUE 0xBE44 Scalar_UW 0.0 CM_kpa_0to512_1 0.0 511.9921875 /end CHARACTERISTIC
/begin CHARACTERISTIC C_FPPetrolSignalConvSlope "cal comments" VALUE 0xBE5C Scalar_UW 0.0 CM_kpa_0to1024_1 0.0 1023.984375 /end CHARACTERISTIC
/begin CHARACTERISTIC CT_FPFiltCoef "cal comments" CURVE 0xBE4C 2D_Array_UW 0.0 CM_FiltCoef 0.0 0.9999847412109375
 /begin AXIS_DESCR FIX_AXIS NO_INPUT_QUANTITY CM_Equaloutput1 8 0 511.9921875 MAX_GRAD 0.0 /begin FIX_AXIS_PAR_LIST 0 10 20 30 40 50 60 70 /end FIX_AXIS_PAR_LIST /end AXIS_DESCR
/end CHARACTERISTIC
/begin CHARACTERISTIC C_BSTPSignalConvIntercept "cal comments" VALUE 0xBE1E Scalar_SW 0.0 CM_Ratio_n128to128 -128.0 127.99609375 /end CHARACTERISTIC
/begin CHARACTERISTIC C_BSTPSignalConvSlope "cal comments" VALUE 0xBE1C Scalar_UW 0.0 CM_kpa_0to512_1 0.0 511.9921875 /end CHARACTERISTIC
/begin CHARACTERISTIC C_BSTPFiltCoef "cal comments" VALUE 0xBE20 Scalar_UW 0.0 CM_FiltCoef 0.0 0.9999847412109375 /end CHARACTERISTIC
/begin CHARACTERISTIC CT_BSTP_OL "cal comments" MAP 0x90A5 3D_Array_UB 0.0 CM_Percent_0to100 0.0 99.609375
 /begin AXIS_DESCR COM_AXIS NO_INPUT_QUANTITY udf_CM_18705 17 0.0 511.9921875 AXIS_PTS_REF CA_AirGramStep17 MAX_GRAD 0.0 /end AXIS_DESCR
 /begin AXIS_DESCR COM_AXIS NO_INPUT_QUANTITY CM_kpa_0to256_1 15 0.0 255.99609375 AXIS_PTS_REF CA_MAP15Step1 MAX_GRAD 0.0 /end AXIS_DESCR
/end CHARACTERISTIC
/begin CHARACTERISTIC CT_BSTP_OL_BaroCorr "cal comments" MAP 0x91A7 D_Array_SB 0.0 CM_Percent_N100to100 -100.0 99.21875
 /begin AXIS_DESCR COM_AXIS NO_INPUT_QUANTITY udf_CM_18705 17 0.0 511.9921875 AXIS_PTS_REF CA_AirGramStep17 MAX_GRAD 0.0 /end AXIS_DESCR
 /begin AXIS_DESCR FIX_AXIS NO_INPUT_QUANTITY CM_Equaloutput1 6 55.0 105.0 MAX_GRAD 0.0 /begin FIX_AXIS_PAR_LIST 55 65 75 85 95 105 /end FIX_AXIS_PAR_LIST /end AXIS_DESCR
/end CHARACTERISTIC
/begin CHARACTERISTIC C_BSTP_PWM_Freq "cal comments" VALUE 0x920E Scalar_UW 0.0 CM_Hz_0to16384 0.0 16383.75 /end CHARACTERISTIC
/begin CHARACTERISTIC C_WPSignalConvIntercept "cal comments" VALUE 0x0 Scalar_SW 0.0 CM_Ratio_n8to8 -8.0 7.999755859375 /end CHARACTERISTIC
/begin CHARACTERISTIC C_WPSignalConvSlope "cal comments" VALUE 0x0 Scalar_UW 0.0 CM_mpa_0to16_1 0.0 15.999755859375 /end CHARACTERISTIC
/begin CHARACTERISTIC C_WPFiltCoef "cal comments" VALUE 0x0 Scalar_UW 0.0 CM_FiltCoef 0.0 0.9999847412109375 /end CHARACTERISTIC
/begin CHARACTERISTIC C_WPStartTrgTime "cal comments" VALUE 0x0 Scalar_UW 0.0 CM_Seconds_1 0.0 2047.96875 /end CHARACTERISTIC
/begin CHARACTERISTIC C_WPStartTrgMin "cal comments" VALUE 0x0 Scalar_UW 0.0 CM_mpa_0to16_1 0.0 15.999755859375 /end CHARACTERISTIC
/begin CHARACTERISTIC C_WPStartTrgMax "cal comments" VALUE 0x0 Scalar_UW 0.0 CM_mpa_0to16_1 0.0 15.999755859375 /end CHARACTERISTIC
/begin CHARACTERISTIC C_WPAutoTrigEn "cal comments" VALUE 0x0 Scalar_UB 0.0 CM_Boolean6 0.0 255.0 /end CHARACTERISTIC
/begin CHARACTERISTIC C_WPP_AMP_RESCALE "cal comments" VALUE 0x0 Scalar_UW 0.0 CM_amp_0to512_1 0.0 511.9921875 /end CHARACTERISTIC
/begin CHARACTERISTIC C_WPPCurrThresh "cal comments" VALUE 0x0 Scalar_UW 0.0 CM_amp_0to512_1 0.0 511.9921875 /end CHARACTERISTIC
/begin CHARACTERISTIC C_WPPCurrHyst "cal comments" VALUE 0x0 Scalar_UW 0.0 CM_amp_0to512_1 0.0 511.9921875 /end CHARACTERISTIC
/begin CHARACTERISTIC C_WPP_PWM_Freq "cal comments" VALUE 0x0 Scalar_UW 0.0 CM_Hz_0to16384 0.0 16383.75 /end CHARACTERISTIC
/begin CHARACTERISTIC C_WPP_NoWaterTime "cal comments" VALUE 0x0 Scalar_UW 0.0 CM_Seconds_1 0.0 2047.96875 /end CHARACTERISTIC
/begin CHARACTERISTIC C_WPP_WakeupTime "cal comments" VALUE 0x0 Scalar_UW 0.0 CM_Seconds_1 0.0 2047.96875 /end CHARACTERISTIC
/begin CHARACTERISTIC C_WPPCurrFiltCoef "cal comments" VALUE 0x0 Scalar_UW 0.0 CM_FiltCoef 0.0 0.9999847412109375 /end CHARACTERISTIC
/begin CHARACTERISTIC C_WPPForceCleanLowActive "cal comments" VALUE 0x0 Scalar_UB 0.0 CM_Boolean6 0.0 255.0 /end CHARACTERISTIC
/begin CHARACTERISTIC C_WPP_ControlMode "cal comments" VALUE 0x0 Scalar_UB 0.0 CM_Count1 0.0 255.0 /end CHARACTERISTIC
/begin CHARACTERISTIC CT_WPP_DC "cal comments" CURVE 0x2 2D_Array_UB 0.0 CM_Percent_0to100 0.0 99.609375
 /begin AXIS_DESCR FIX_AXIS NO_INPUT_QUANTITY CM_Equaloutput1 9 -28.0 164.0 MAX_GRAD 0.0 /begin FIX_AXIS_PAR_LIST -28 -4 20 44 68 92 116 140 164 /end FIX_AXIS_PAR_LIST /end AXIS_DESCR
/end CHARACTERISTIC
/begin CHARACTERISTIC C_MaxBatteryVoltForO2Heater "cal comments" VALUE 0x9238 Scalar_UW 0.0 CM_Volt_0to32_1 0.0 31.99900627136231 /end CHARACTERISTIC
/begin CHARACTERISTIC C_MinRefPeriodUpdtMinEngSpd "cal comments" VALUE 0xB512 Scalar_UW 0.0 CM_Second_0to512 0.0 511.9921875 /end CHARACTERISTIC
/begin CHARACTERISTIC C_NVMForceReset "cal comments" VALUE 0x9210 Scalar_UB 0.0 CM_Boolean2 0.0 1.0 /end CHARACTERISTIC
/begin CHARACTERISTIC C_O2ErrorMaxLimit "cal comments" VALUE 0x98FA Scalar_UW 0.0 CM_mVolt_1 0.0 1023.96875 /end CHARACTERISTIC
/begin CHARACTERISTIC C_O2FiltVoltInitValue "cal comments" VALUE 0x9878 Scalar_UW 0.0 CM_mVolt_1 0.0 1023.96875 /end CHARACTERISTIC
/begin CHARACTERISTIC C_O2HeaterAccFuelMassUpdateTime "cal comments" VALUE 0x923C Scalar_UW 0.0 CM_Second_0to4096 0.0 4095.9375 /end CHARACTERISTIC
/begin CHARACTERISTIC C_O2HeaterCoolantTempThresh "cal comments" VALUE 0x9212 Scalar_SW 0.0 CM_DegC_N256to256 -256.0 255.9921875 /end CHARACTERISTIC
/begin CHARACTERISTIC C_O2HeaterDCNormFactor "cal comments" VALUE 0xB0CE Scalar_UB 0.0 CM_Mult0_to_2_ratio 0.0 1.9921875 /end CHARACTERISTIC
/begin CHARACTERISTIC C_O2HeaterDCReducedEngSpdThrsh "cal comments" VALUE 0xB0D0 Scalar_UW 0.0 CM_RPM_0to16384 0.0 16383.75 /end CHARACTERISTIC
/begin CHARACTERISTIC C_O2HeaterDCReducedFactor "cal comments" VALUE 0xB0CF Scalar_UB 0.0 CM_Mult0_to_2_ratio 0.0 1.9921875 /end CHARACTERISTIC
/begin CHARACTERISTIC C_O2HeaterDCReducedMAPThrsh "cal comments" VALUE 0xB0D2 Scalar_UW 0.0 CM_kpa_0to256_1 0.0 255.99609375 /end CHARACTERISTIC
/begin CHARACTERISTIC C_O2HeaterEnbKeyOnDelay "cal comments" VALUE 0x923E Scalar_UW 0.0 CM_Second_0to4096 0.0 4095.9375 /end CHARACTERISTIC
/begin CHARACTERISTIC C_O2HeaterPWMFrequency "cal comments" VALUE 0xB0CC Scalar_UW 0.0 CM_Hz_0to16384 0.0 16383.75 /end CHARACTERISTIC
/begin CHARACTERISTIC C_O2ReadyResetTimeThresh "cal comments" VALUE 0x986E Scalar_UW 0.0 CM_Second_0to1024 0.0 1023.984375 /end CHARACTERISTIC
/begin CHARACTERISTIC C_O2ReadyThresh "cal comments" VALUE 0x986C Scalar_UW 0.0 CM_mVolt_1 0.0 1023.96875 /end CHARACTERISTIC
/begin CHARACTERISTIC C_O2ReadyTimeThresh "cal comments" VALUE 0x9870 Scalar_UW 0.0 CM_Second_0to1024 0.0 1023.984375 /end CHARACTERISTIC
/begin CHARACTERISTIC C_PEIdleWithAFROLEngSpdThresh "cal comments" VALUE 0x99C0 Scalar_UW 0.0 CM_RPM_0to16384 0.0 16383.75 /end CHARACTERISTIC
/begin CHARACTERISTIC C_PowerdownDelayTime "cal comments" VALUE 0xB4F0 Scalar_UW 0.0 CM_Second_0to1024 0.0 1023.984375 /end CHARACTERISTIC
/begin CHARACTERISTIC C_EngNotRunPowerdownEnb "cal comments" VALUE 0xB4F2 Scalar_UB 0.0 CM_Boolean6 0.0 255.0 /end CHARACTERISTIC
/begin CHARACTERISTIC C_PowerEnrichDsblTPSThrshHyst "cal comments" VALUE 0x99BE Scalar_UW 0.0 CM_Percent_0to200_2 0.0 199.9969024658203 /end CHARACTERISTIC
/begin CHARACTERISTIC C_FuelPumpOffNoDelay "cal comments" VALUE 0x961A Scalar_UB 0.0 CM_Boolean1 0.0 1.0 /end CHARACTERISTIC
/begin CHARACTERISTIC C_FuelPumpForGas "cal comments" VALUE 0x961B Scalar_UB 0.0 CM_Boolean1 0.0 1.0 /end CHARACTERISTIC
/begin CHARACTERISTIC C_PrimeToSequentialFuelDelay "cal comments" VALUE 0x926E Scalar_UB 0.0 CM_Count1 0.0 255.0 /end CHARACTERISTIC
/begin CHARACTERISTIC C_ReferenceBaro "cal comments" VALUE 0xB444 Scalar_UW 0.0 CM_kpa_0to256_1 0.0 255.99609375 /end CHARACTERISTIC
/begin CHARACTERISTIC C_TurboEngUsed "cal comments" VALUE 0xB446 Scalar_UB 0.0 CM_Boolean4 0.0 1.0 /end CHARACTERISTIC
/begin CHARACTERISTIC C_DualO2SensorEnb "cal comments" VALUE 0xB447 Scalar_UB 0.0 CM_Boolean4 0.0 1.0 /end CHARACTERISTIC
/begin CHARACTERISTIC C_RunToCrankEngSpdThresh "cal comments" VALUE 0xB4E6 Scalar_UW 0.0 CM_RPM_0to16384 0.0 16383.75 /end CHARACTERISTIC
/begin CHARACTERISTIC C_SMTR_LowActive "cal comments" VALUE 0xA06C Scalar_UB 0.0 CM_Boolean6 0.0 255.0 /end CHARACTERISTIC
/begin CHARACTERISTIC C_SMTR_FaultStart_Forbid "cal comments" VALUE 0xA06D Scalar_UB 0.0 CM_Boolean6 0.0 255.0 /end CHARACTERISTIC
/begin CHARACTERISTIC C_SMTR_IGN_Start "cal comments" VALUE 0xA06E Scalar_UB 0.0 CM_Boolean6 0.0 255.0 /end CHARACTERISTIC
/begin CHARACTERISTIC C_SMTR_t_Duration "cal comments" VALUE 0xA070 Scalar_UW 0.0 CM_Seconds_1 0.0 2047.96875 /end CHARACTERISTIC
/begin CHARACTERISTIC C_SMTR_t_Interval "cal comments" VALUE 0xA072 Scalar_UW 0.0 CM_Seconds_1 0.0 2047.96875 /end CHARACTERISTIC
/begin CHARACTERISTIC C_SMTR_t_Button_Delay "cal comments" VALUE 0xA076 Scalar_UW 0.0 CM_Seconds_1 0.0 2047.96875 /end CHARACTERISTIC
/begin CHARACTERISTIC C_SMTR_c_Attempt "cal comments" VALUE 0xA074 Scalar_UB 0.0 CM_Count3 0.0 255.0 /end CHARACTERISTIC
/begin CHARACTERISTIC C_SMTR_DutyCycle "cal comments" VALUE 0xA078 Scalar_UW 0.0 CM_Percent_0to200_2 0.0 199.9969024658203 /end CHARACTERISTIC
/begin CHARACTERISTIC C_FUEL_STP_LowActive "cal comments" VALUE 0xBE30 Scalar_UB 0.0 CM_Boolean6 0.0 255.0 /end CHARACTERISTIC
/begin CHARACTERISTIC C_StopEnbRunTimeThrsh "cal comments" VALUE 0xBE31 Scalar_UB 0.0 CM_Count3 0.0 255.0 /end CHARACTERISTIC
/begin CHARACTERISTIC C_TachEnbRunTimeThrsh "cal comments" VALUE 0xBE32 Scalar_UB 0.0 CM_Count3 0.0 255.0 /end CHARACTERISTIC
/begin CHARACTERISTIC CT_ETCMSprTPSHigh "cal comments" CURVE 0xA094 2D_Array_UB 0.0 CM_Percent_0to100 0.0 99.609375
 /begin AXIS_DESCR COM_AXIS NO_INPUT_QUANTITY CM_Percent_0to200_2 11 0.0 199.9969024658203 AXIS_PTS_REF CA_TPS11Step MAX_GRAD 0.0 /end AXIS_DESCR
/end CHARACTERISTIC
/begin CHARACTERISTIC CT_ETCMSprTPSLow "cal comments" CURVE 0xA0A1 2D_Array_UB 0.0 CM_Percent_0to100 0.0 99.609375
 /begin AXIS_DESCR COM_AXIS NO_INPUT_QUANTITY CM_Percent_0to200_2 11 0.0 199.9969024658203 AXIS_PTS_REF CA_TPS11Step MAX_GRAD 0.0 /end AXIS_DESCR
/end CHARACTERISTIC
/begin CHARACTERISTIC CT_ETCMPropTPSHigh "cal comments" CURVE 0xA0AE 2D_Array_UB 0.0 CM_Percent_0to100 0.0 99.609375
 /begin AXIS_DESCR COM_AXIS NO_INPUT_QUANTITY CM_Percent_0to200_2 11 0.0 199.9969024658203 AXIS_PTS_REF CA_TPS11Step MAX_GRAD 0.0 /end AXIS_DESCR
/end CHARACTERISTIC
/begin CHARACTERISTIC CT_ETCMPropTPSLow "cal comments" CURVE 0xA0BB 2D_Array_UB 0.0 CM_Percent_0to100 0.0 99.609375
 /begin AXIS_DESCR COM_AXIS NO_INPUT_QUANTITY CM_Percent_0to200_2 11 0.0 199.9969024658203 AXIS_PTS_REF CA_TPS11Step MAX_GRAD 0.0 /end AXIS_DESCR
/end CHARACTERISTIC
/begin CHARACTERISTIC CT_ETCMIntGainTPSHigh "cal comments" CURVE 0xA0C8 2D_Array_UB 0.0 CM_Mult0_to_2_ratio1 0.0 1.9921875
 /begin AXIS_DESCR COM_AXIS NO_INPUT_QUANTITY CM_Percent_0to200_2 11 0.0 199.9969024658203 AXIS_PTS_REF CA_TPS11Step MAX_GRAD 0.0 /end AXIS_DESCR
/end CHARACTERISTIC
/begin CHARACTERISTIC CT_ETCMIntGainTPSLow "cal comments" CURVE 0xA0D5 2D_Array_UB 0.0 CM_Mult0_to_2_ratio1 0.0 1.9921875
 /begin AXIS_DESCR COM_AXIS NO_INPUT_QUANTITY CM_Percent_0to200_2 11 0.0 199.9969024658203 AXIS_PTS_REF CA_TPS11Step MAX_GRAD 0.0 /end AXIS_DESCR
/end CHARACTERISTIC
/begin CHARACTERISTIC CT_ETCM_LTermOpenMax "cal comments" CURVE 0xA0E2 2D_Array_UB 0.0 CM_Percent_0to200_3 0.0 199.21875
 /begin AXIS_DESCR FIX_AXIS NO_INPUT_QUANTITY CM_Equaloutput1 9 6.400000095367432 19.20000076293945 MAX_GRAD 0.0 /begin FIX_AXIS_PAR_LIST 6.4 8 9.6 11.2 12.8 14.4 16 17.6 19.2 /end FIX_AXIS_PAR_LIST /end AXIS_DESCR
/end CHARACTERISTIC
/begin CHARACTERISTIC CT_ETCM_LTermCloseMax "cal comments" CURVE 0xA0ED 2D_Array_UB 0.0 CM_Percent_0to200_3 0.0 199.21875
 /begin AXIS_DESCR FIX_AXIS NO_INPUT_QUANTITY CM_Equaloutput1 9 6.400000095367432 19.20000076293945 MAX_GRAD 0.0 /begin FIX_AXIS_PAR_LIST 6.4 8 9.6 11.2 12.8 14.4 16 17.6 19.2 /end FIX_AXIS_PAR_LIST /end AXIS_DESCR
/end CHARACTERISTIC
/begin CHARACTERISTIC C_ETCM_AntiFrictClsPulse "cal comments" VALUE 0xA0F6 Scalar_UW 0.0 CM_Percent_0to200_2 0.0 199.9969024658203 /end CHARACTERISTIC
/begin CHARACTERISTIC C_ETCM_AntiFrictOpnPulse "cal comments" VALUE 0xA0F8 Scalar_UW 0.0 CM_Percent_0to200_2 0.0 199.9969024658203 /end CHARACTERISTIC
/begin CHARACTERISTIC C_DC_ETCM_OpeningMax "cal comments" VALUE 0xA100 Scalar_UW 0.0 CM_Percent_0to200_2 0.0 199.9969024658203 /end CHARACTERISTIC
/begin CHARACTERISTIC C_DC_ETCM_ClosingMax "cal comments" VALUE 0xA102 Scalar_UW 0.0 CM_Percent_0to200_2 0.0 199.9969024658203 /end CHARACTERISTIC
/begin CHARACTERISTIC C_ETCM_AboveLTDCTime "cal comments" VALUE 0xA104 Scalar_UW 0.0 CM_Second_0to512 0.0 511.9921875 /end CHARACTERISTIC
/begin CHARACTERISTIC C_ETCM_ClipLTDCTime "cal comments" VALUE 0xA106 Scalar_UW 0.0 CM_Second_0to512 0.0 511.9921875 /end CHARACTERISTIC
/begin CHARACTERISTIC C_ETCMSprTPSDeadBand "cal comments" VALUE 0xA10A Scalar_UW 0.0 CM_Percent_0to200_2 0.0 199.9969024658203 /end CHARACTERISTIC
/begin CHARACTERISTIC C_ETCMPropTPSHiDeadBand "cal comments" VALUE 0xA10C Scalar_UW 0.0 CM_Percent_0to200_2 0.0 199.9969024658203 /end CHARACTERISTIC
/begin CHARACTERISTIC C_ETCMPropTPSLoDeadBand "cal comments" VALUE 0xA10E Scalar_UW 0.0 CM_Percent_0to200_2 0.0 199.9969024658203 /end CHARACTERISTIC
/begin CHARACTERISTIC C_ETCMIntTPSDeadBand "cal comments" VALUE 0xA110 Scalar_UW 0.0 CM_Percent_0to200_2 0.0 199.9969024658203 /end CHARACTERISTIC
/begin CHARACTERISTIC C_ETCMIntTPSDltRange "cal comments" VALUE 0xA112 Scalar_UW 0.0 CM_Percent_0to200_2 0.0 199.9969024658203 /end CHARACTERISTIC
/begin CHARACTERISTIC C_ETCM_IntegralNegLimit "cal comments" VALUE 0xA114 Scalar_SW 0.0 CM_Percent_N200to200 -199.9999847412109 199.9938812255859 /end CHARACTERISTIC
/begin CHARACTERISTIC C_ETCM_IntegralPosLimit "cal comments" VALUE 0xA116 Scalar_SW 0.0 CM_Percent_N200to200 -199.9999847412109 199.9938812255859 /end CHARACTERISTIC
/begin CHARACTERISTIC C_ETCM_SteeringDCmin "cal comments" VALUE 0xA118 Scalar_SW 0.0 CM_Percent_N200to200 -199.9999847412109 199.9938812255859 /end CHARACTERISTIC
/begin CHARACTERISTIC C_ETCM_SteeringDCmax "cal comments" VALUE 0xA11A Scalar_SW 0.0 CM_Percent_N200to200 -199.9999847412109 199.9938812255859 /end CHARACTERISTIC
/begin CHARACTERISTIC C_ETCM_UsedForSteering "cal comments" VALUE 0xA0FA Scalar_UB 0.0 CM_Boolean6 0.0 255.0 /end CHARACTERISTIC
/begin CHARACTERISTIC C_ETCM_DirLogic "cal comments" VALUE 0xA0FB Scalar_UB 0.0 CM_Boolean6 0.0 255.0 /end CHARACTERISTIC
/begin CHARACTERISTIC C_ETCMMotorHiEn "cal comments" VALUE 0xA0FC Scalar_UB 0.0 CM_Boolean6 0.0 255.0 /end CHARACTERISTIC
/begin CHARACTERISTIC C_ETCM_Frequency "cal comments" VALUE 0xA108 Scalar_UW 0.0 CM_Hz_0to16384 0.0 16383.75 /end CHARACTERISTIC
/begin CHARACTERISTIC C_ETCM_IGNRef "cal comments" VALUE 0xA0FE Scalar_UW 0.0 CM_Volt_0to32_1 0.0 31.99900627136231 /end CHARACTERISTIC
/begin CHARACTERISTIC C_U_GEN_VOLT_RESCALE "cal comments" VALUE 0x0 Scalar_UW 0.0 CM_Volt_0to1024_1 0.0 1023.984375 /end CHARACTERISTIC
/begin CHARACTERISTIC C_GENVFiltCoef "cal comments" VALUE 0x0 Scalar_UW 0.0 CM_FiltCoef 0.0 0.9999847412109375 /end CHARACTERISTIC
/begin CHARACTERISTIC C_GENVDesired "cal comments" VALUE 0x0 Scalar_UW 0.0 CM_Volt_0to1024_1 0.0 1023.984375 /end CHARACTERISTIC
/begin CHARACTERISTIC C_GENVPropVOLTHiDeadBand "cal comments" VALUE 0x0 Scalar_UW 0.0 CM_Volt_0to1024_1 0.0 1023.984375 /end CHARACTERISTIC
/begin CHARACTERISTIC C_GENVPropVOLTLoDeadBand "cal comments" VALUE 0x0 Scalar_UW 0.0 CM_Volt_0to1024_1 0.0 1023.984375 /end CHARACTERISTIC
/begin CHARACTERISTIC C_GENVIntVOLTDeadBand "cal comments" VALUE 0x0 Scalar_UW 0.0 CM_Volt_0to1024_1 0.0 1023.984375 /end CHARACTERISTIC
/begin CHARACTERISTIC C_GENVIntVOLTDltRange "cal comments" VALUE 0x0 Scalar_UW 0.0 CM_Volt_0to1024_1 0.0 1023.984375 /end CHARACTERISTIC
/begin CHARACTERISTIC CT_GENVPropVOLTHigh "cal comments" CURVE 0x2 2D_Array_UB 0.0 CM_Percent_0to100 0.0 99.609375
 /begin AXIS_DESCR COM_AXIS NO_INPUT_QUANTITY CM_Volt_0to1024_1 11 0.0 1023.984375 AXIS_PTS_REF CA_GENV11Step MAX_GRAD 0.0 /end AXIS_DESCR
/end CHARACTERISTIC
/begin CHARACTERISTIC CT_GENVPropVOLTLow "cal comments" CURVE 0x2 2D_Array_UB 0.0 CM_Percent_0to100 0.0 99.609375
 /begin AXIS_DESCR COM_AXIS NO_INPUT_QUANTITY CM_Volt_0to1024_1 11 0.0 1023.984375 AXIS_PTS_REF CA_GENV11Step MAX_GRAD 0.0 /end AXIS_DESCR
/end CHARACTERISTIC
/begin CHARACTERISTIC CT_GENVIntGainVOLTHigh "cal comments" CURVE 0x2 2D_Array_UB 0.0 CM_Mult0_to_2_ratio1 0.0 1.9921875
 /begin AXIS_DESCR COM_AXIS NO_INPUT_QUANTITY CM_Volt_0to1024_1 11 0.0 1023.984375 AXIS_PTS_REF CA_GENV11Step MAX_GRAD 0.0 /end AXIS_DESCR
/end CHARACTERISTIC
/begin CHARACTERISTIC CT_GENVIntGainVOLTLow "cal comments" CURVE 0x2 2D_Array_UB 0.0 CM_Mult0_to_2_ratio1 0.0 1.9921875
 /begin AXIS_DESCR COM_AXIS NO_INPUT_QUANTITY CM_Volt_0to1024_1 11 0.0 1023.984375 AXIS_PTS_REF CA_GENV11Step MAX_GRAD 0.0 /end AXIS_DESCR
/end CHARACTERISTIC
/begin CHARACTERISTIC C_GENV_DutyCycle "cal comments" VALUE 0x0 Scalar_UW 0.0 CM_Percent_0to200_2 0.0 199.9969024658203 /end CHARACTERISTIC
/begin CHARACTERISTIC C_WPGOVDesired "cal comments" VALUE 0x0 Scalar_UW 0.0 CM_mpa_0to16_1 0.0 15.999755859375 /end CHARACTERISTIC
/begin CHARACTERISTIC C_WPGOVPropHiDeadBand "cal comments" VALUE 0x0 Scalar_UW 0.0 CM_mpa_0to16_1 0.0 15.999755859375 /end CHARACTERISTIC
/begin CHARACTERISTIC C_WPGOVPropLoDeadBand "cal comments" VALUE 0x0 Scalar_UW 0.0 CM_mpa_0to16_1 0.0 15.999755859375 /end CHARACTERISTIC
/begin CHARACTERISTIC C_WPGOVIntDeadBand "cal comments" VALUE 0x0 Scalar_UW 0.0 CM_mpa_0to16_1 0.0 15.999755859375 /end CHARACTERISTIC
/begin CHARACTERISTIC C_WPGOVIntDltRange "cal comments" VALUE 0x0 Scalar_UW 0.0 CM_mpa_0to16_1 0.0 15.999755859375 /end CHARACTERISTIC
/begin CHARACTERISTIC CT_WPGOVPropHigh "cal comments" CURVE 0x2 2D_Array_UB 0.0 CM_Percent_0to100 0.0 99.609375
 /begin AXIS_DESCR COM_AXIS NO_INPUT_QUANTITY CM_mpa_0to16_1 9 0.0 15.999755859375 AXIS_PTS_REF CA_WPGOV9Step MAX_GRAD 0.0 /end AXIS_DESCR
/end CHARACTERISTIC
/begin CHARACTERISTIC CT_WPGOVPropLow "cal comments" CURVE 0x2 2D_Array_UB 0.0 CM_Percent_0to100 0.0 99.609375
 /begin AXIS_DESCR COM_AXIS NO_INPUT_QUANTITY CM_mpa_0to16_1 9 0.0 15.999755859375 AXIS_PTS_REF CA_WPGOV9Step MAX_GRAD 0.0 /end AXIS_DESCR
/end CHARACTERISTIC
/begin CHARACTERISTIC CT_WPGOVIntGainHigh "cal comments" CURVE 0x2 2D_Array_UB 0.0 CM_Mult0_to_2_ratio1 0.0 1.9921875
 /begin AXIS_DESCR COM_AXIS NO_INPUT_QUANTITY CM_mpa_0to16_1 9 0.0 15.999755859375 AXIS_PTS_REF CA_WPGOV9Step MAX_GRAD 0.0 /end AXIS_DESCR
/end CHARACTERISTIC
/begin CHARACTERISTIC CT_WPGOVIntGainLow "cal comments" CURVE 0x2 2D_Array_UB 0.0 CM_Mult0_to_2_ratio1 0.0 1.9921875
 /begin AXIS_DESCR COM_AXIS NO_INPUT_QUANTITY CM_mpa_0to16_1 9 0.0 15.999755859375 AXIS_PTS_REF CA_WPGOV9Step MAX_GRAD 0.0 /end AXIS_DESCR
/end CHARACTERISTIC
/begin CHARACTERISTIC C_WPGOV_CL_EnTime "cal comments" VALUE 0x0 Scalar_UW 0.0 CM_Seconds_1 0.0 2047.96875 /end CHARACTERISTIC
/begin CHARACTERISTIC C_WPGOV_CL_DisTime "cal comments" VALUE 0x0 Scalar_UW 0.0 CM_Seconds_1 0.0 2047.96875 /end CHARACTERISTIC
/begin CHARACTERISTIC C_WPGOV_CL_EnThresh "cal comments" VALUE 0x0 Scalar_UW 0.0 CM_mpa_0to16_1 0.0 15.999755859375 /end CHARACTERISTIC
/begin CHARACTERISTIC C_WPGOV_CL_DisThresh "cal comments" VALUE 0x0 Scalar_UW 0.0 CM_mpa_0to16_1 0.0 15.999755859375 /end CHARACTERISTIC
/begin CHARACTERISTIC C_PWRGOVDesired_NG "cal comments" VALUE 0xC05A Scalar_UW 0.0 CM_GramPerSecond_1 0.0 511.9921875 /end CHARACTERISTIC
/begin CHARACTERISTIC C_PWRGOVDesired_LPG "cal comments" VALUE 0xC05C Scalar_UW 0.0 CM_GramPerSecond_1 0.0 511.9921875 /end CHARACTERISTIC
/begin CHARACTERISTIC C_PWRGOVIntDeadBand "cal comments" VALUE 0xC05E Scalar_UW 0.0 CM_GramPerSecond_1 0.0 511.9921875 /end CHARACTERISTIC
/begin CHARACTERISTIC CT_PWRGOVIntGainHigh "cal comments" CURVE 0xC076 2D_Array_UB 0.0 CM_Mult0_to_2_ratio1 0.0 1.9921875
 /begin AXIS_DESCR COM_AXIS NO_INPUT_QUANTITY udf_CM_18705 9 0.0 511.9921875 AXIS_PTS_REF CA_PWRGOV9Step MAX_GRAD 0.0 /end AXIS_DESCR
/end CHARACTERISTIC
/begin CHARACTERISTIC CT_PWRGOVIntGainLow "cal comments" CURVE 0xC081 2D_Array_UB 0.0 CM_Mult0_to_2_ratio1 0.0 1.9921875
 /begin AXIS_DESCR COM_AXIS NO_INPUT_QUANTITY udf_CM_18705 9 0.0 511.9921875 AXIS_PTS_REF CA_PWRGOV9Step MAX_GRAD 0.0 /end AXIS_DESCR
/end CHARACTERISTIC
/begin CHARACTERISTIC C_SMTR_n_Rotate_Dsbl_Thrsh "cal comments" VALUE 0xA068 Scalar_UW 0.0 CM_RPM_0to16384 0.0 16383.75 /end CHARACTERISTIC
/begin CHARACTERISTIC C_SMTR_n_Rotate_Enbl_Thrsh "cal comments" VALUE 0xA06A Scalar_UW 0.0 CM_RPM_0to16384 0.0 16383.75 /end CHARACTERISTIC
/begin CHARACTERISTIC C_SACrankExitRampInterval "cal comments" VALUE 0xA130 Scalar_UW 0.0 CM_Second_0to1024 0.0 1023.984375 /end CHARACTERISTIC
/begin CHARACTERISTIC C_SACrankExitRampStep "cal comments" VALUE 0xA136 Scalar_SW 0.0 CM_SparkAngle_N256to256 -256.0 255.9921875 /end CHARACTERISTIC
/begin CHARACTERISTIC C_SANormalRampDownStep "cal comments" VALUE 0xA132 Scalar_SW 0.0 CM_SparkAngle_N256to256 -256.0 255.9921875 /end CHARACTERISTIC
/begin CHARACTERISTIC C_SANormalRampUpStep "cal comments" VALUE 0xA134 Scalar_SW 0.0 CM_SparkAngle_N256to256 -256.0 255.9921875 /end CHARACTERISTIC
/begin CHARACTERISTIC C_SparkAdvanceMaxLimit "cal comments" VALUE 0xA11C Scalar_SW 0.0 CM_SparkAngle_N256to256 -256.0 255.9921875 /end CHARACTERISTIC
/begin CHARACTERISTIC C_SparkAdvanceMinLimit "cal comments" VALUE 0xA11E Scalar_SW 0.0 CM_SparkAngle_N256to256 -256.0 255.9921875 /end CHARACTERISTIC
/begin CHARACTERISTIC C_SPRK_phi_DFCO "cal comments" VALUE 0xA120 Scalar_SW 0.0 CM_SparkAngle_N256to256 -256.0 255.9921875 /end CHARACTERISTIC
/begin CHARACTERISTIC C_SparkDeliverModeAfterCID "cal comments" VALUE 0xB522 Scalar_UB 0.0 CM_Boolean4 0.0 1.0 /end CHARACTERISTIC
/begin CHARACTERISTIC C_SparkDwellIATMultRumTimeThrsh "cal comments" VALUE 0xAA68 Scalar_UW 0.0 CM_Second_0to65535 0.0 65535.0 /end CHARACTERISTIC
/begin CHARACTERISTIC C_SPRK_DFCO_ExitDuration "cal comments" VALUE 0xA124 Scalar_UW 0.0 CM_Second_0to1024 0.0 1023.984375 /end CHARACTERISTIC
/begin CHARACTERISTIC C_SPRK_DFCO_EntryDuration "cal comments" VALUE 0xA126 Scalar_UW 0.0 CM_Second_0to1024 0.0 1023.984375 /end CHARACTERISTIC
/begin CHARACTERISTIC C_SPRK_IDLE_ExitDuration "cal comments" VALUE 0xA12C Scalar_UW 0.0 CM_Second_0to1024 0.0 1023.984375 /end CHARACTERISTIC
/begin CHARACTERISTIC C_SPRK_IDLE_EntryDuration "cal comments" VALUE 0xA12E Scalar_UW 0.0 CM_Second_0to1024 0.0 1023.984375 /end CHARACTERISTIC
/begin CHARACTERISTIC C_SPRK_IDLE_EntryStep "cal comments" VALUE 0xA128 Scalar_SW 0.0 CM_SparkAngle_N256to256 -256.0 255.9921875 /end CHARACTERISTIC
/begin CHARACTERISTIC C_SPRK_DFCOEntryStep "cal comments" VALUE 0xA12A Scalar_SW 0.0 CM_SparkAngle_N256to256 -256.0 255.9921875 /end CHARACTERISTIC
/begin CHARACTERISTIC CT_SPRK_DFCOExitStepTPS "cal comments" CURVE 0xAA6C 2D_Array_SB 0.0 CM_Angle_8bit -64.0 63.5
 /begin AXIS_DESCR FIX_AXIS NO_INPUT_QUANTITY CM_Equaloutput1 17 0.0 100.0 MAX_GRAD 0.0
  /begin FIX_AXIS_PAR_LIST 0.0 6.25 12.5 18.75 25.0 31.25 37.5 43.75 50.0 56.25 62.5 68.75 75.0 81.25 87.5 93.75 100.0 /end FIX_AXIS_PAR_LIST
 /end AXIS_DESCR
/end CHARACTERISTIC
/begin CHARACTERISTIC CT_SPRK_IDLEExitStepTPS "cal comments" CURVE 0xAA7F 2D_Array_SB 0.0 CM_Angle_8bit -64.0 63.5
 /begin AXIS_DESCR FIX_AXIS NO_INPUT_QUANTITY CM_Equaloutput1 17 0.0 100.0 MAX_GRAD 0.0
  /begin FIX_AXIS_PAR_LIST 0.0 6.25 12.5 18.75 25.0 31.25 37.5 43.75 50.0 56.25 62.5 68.75 75.0 81.25 87.5 93.75 100.0 /end FIX_AXIS_PAR_LIST
 /end AXIS_DESCR
/end CHARACTERISTIC
/begin CHARACTERISTIC C_IGNOff_Through_Spark "cal comments" VALUE 0xAA90 Scalar_UB 0.0 CM_Boolean1 0.0 1.0 /end CHARACTERISTIC
/begin CHARACTERISTIC C_SparkDwellCorrByCooltant "cal comments" VALUE 0xAA66 Scalar_UB 0.0 CM_Boolean1 0.0 1.0 /end CHARACTERISTIC
/begin CHARACTERISTIC C_SAGovCntrlEn "cal comments" VALUE 0xAE64 Scalar_UB 0.0 CM_Boolean1 0.0 1.0 /end CHARACTERISTIC
/begin CHARACTERISTIC C_SAGovDerivRampInterval "cal comments" VALUE 0xAE66 Scalar_UW 0.0 CM_Second_0to512 0.0 511.9921875 /end CHARACTERISTIC
/begin CHARACTERISTIC C_SAGovDerivRampUpStep "cal comments" VALUE 0xAE68 Scalar_UW 0.0 CM_Percent_0to200_2 0.0 199.9969024658203 /end CHARACTERISTIC
/begin CHARACTERISTIC C_SAGovDerivRampDwnStep "cal comments" VALUE 0xAE6A Scalar_UW 0.0 CM_Percent_0to200_2 0.0 199.9969024658203 /end CHARACTERISTIC
/begin CHARACTERISTIC C_SAGovPropDeadBand "cal comments" VALUE 0xAB18 Scalar_UW 0.0 CM_RPM_0to16384 0.0 16383.75 /end CHARACTERISTIC
/begin CHARACTERISTIC C_SAGovAngleCntrlRange "cal comments" VALUE 0xAB1A Scalar_SW 0.0 CM_SparkAngle_N256to256 -256.0 255.9921875 /end CHARACTERISTIC
/begin CHARACTERISTIC CT_SAGovMaxLimit_NG "cal comments" MAP 0xAB47 D_Array_SB 0.0 CM_Angle_8bit -64.0 63.5
 /begin AXIS_DESCR COM_AXIS NO_INPUT_QUANTITY CM_kpa_0to256_1 18 0.0 255.99609375 AXIS_PTS_REF CA_MAP18Step1 MAX_GRAD 0.0 /end AXIS_DESCR
 /begin AXIS_DESCR COM_AXIS NO_INPUT_QUANTITY CM_RPM_0to16384 17 0.0 16383.75 AXIS_PTS_REF CA_EngSpd17Step1 MAX_GRAD 0.0 /end AXIS_DESCR
/end CHARACTERISTIC
/begin CHARACTERISTIC CT_SAGovMaxLimit_LPG "cal comments" MAP 0xAC7C D_Array_SB 0.0 CM_Angle_8bit -64.0 63.5
 /begin AXIS_DESCR COM_AXIS NO_INPUT_QUANTITY CM_kpa_0to256_1 18 0.0 255.99609375 AXIS_PTS_REF CA_MAP18Step1 MAX_GRAD 0.0 /end AXIS_DESCR
 /begin AXIS_DESCR COM_AXIS NO_INPUT_QUANTITY CM_RPM_0to16384 17 0.0 16383.75 AXIS_PTS_REF CA_EngSpd17Step1 MAX_GRAD 0.0 /end AXIS_DESCR
/end CHARACTERISTIC
/begin CHARACTERISTIC CT_SAGovMinLimit_NG "cal comments" CURVE 0xAB1E 2D_Array_SB 0.0 CM_Angle_8bit -64.0 63.5
 /begin AXIS_DESCR COM_AXIS NO_INPUT_QUANTITY CM_kpa_0to256_1 18 0.0 255.99609375 AXIS_PTS_REF CA_MAP18Step1 MAX_GRAD 0.0 /end AXIS_DESCR
/end CHARACTERISTIC
/begin CHARACTERISTIC CT_SAGovMinLimit_LPG "cal comments" CURVE 0xAB32 2D_Array_SB 0.0 CM_Angle_8bit -64.0 63.5
 /begin AXIS_DESCR COM_AXIS NO_INPUT_QUANTITY CM_kpa_0to256_1 18 0.0 255.99609375 AXIS_PTS_REF CA_MAP18Step1 MAX_GRAD 0.0 /end AXIS_DESCR
/end CHARACTERISTIC
/begin CHARACTERISTIC CT_SAGovPropHigh_EX "cal comments" MAP 0xADB1 3D_Array_UB 0.0 CM_Percent_0to100 0.0 99.609375
 /begin AXIS_DESCR COM_AXIS NO_INPUT_QUANTITY CM_RPM_0to16384 11 0.0 16383.75 AXIS_PTS_REF CA_EngSpd11Step1 MAX_GRAD 0.0 /end AXIS_DESCR
 /begin AXIS_DESCR COM_AXIS NO_INPUT_QUANTITY CM_kpa_0to256_1 8 0.0 255.99609375 AXIS_PTS_REF CA_MAP8Step3 MAX_GRAD 0.0 /end AXIS_DESCR
/end CHARACTERISTIC
/begin CHARACTERISTIC CT_SAGovPropLow_EX "cal comments" MAP 0xAE0C 3D_Array_UB 0.0 CM_Percent_0to100 0.0 99.609375
 /begin AXIS_DESCR COM_AXIS NO_INPUT_QUANTITY CM_RPM_0to16384 11 0.0 16383.75 AXIS_PTS_REF CA_EngSpd11Step1 MAX_GRAD 0.0 /end AXIS_DESCR
 /begin AXIS_DESCR COM_AXIS NO_INPUT_QUANTITY CM_kpa_0to256_1 8 0.0 255.99609375 AXIS_PTS_REF CA_MAP8Step3 MAX_GRAD 0.0 /end AXIS_DESCR
/end CHARACTERISTIC
/begin CHARACTERISTIC CT_SAGovPropHigh "cal comments" CURVE 0x2 2D_Array_UB 0.0 CM_Percent_0to100 0.0 99.609375
 /begin AXIS_DESCR COM_AXIS NO_INPUT_QUANTITY CM_RPM_0to16384 17 0.0 16383.75 AXIS_PTS_REF CA_EngSpd11Step1 MAX_GRAD 0.0 /end AXIS_DESCR
/end CHARACTERISTIC
/begin CHARACTERISTIC CT_SAGovPropLow "cal comments" CURVE 0x2 2D_Array_UB 0.0 CM_Percent_0to100 0.0 99.609375
 /begin AXIS_DESCR COM_AXIS NO_INPUT_QUANTITY CM_RPM_0to16384 17 0.0 16383.75 AXIS_PTS_REF CA_EngSpd11Step1 MAX_GRAD 0.0 /end AXIS_DESCR
/end CHARACTERISTIC
/begin CHARACTERISTIC CT_SAGovDerivHigh "cal comments" CURVE 0xAAF6 2D_Array_UB 0.0 CM_Percent_0to100 0.0 99.609375
 /begin AXIS_DESCR COM_AXIS NO_INPUT_QUANTITY CM_RPM_0to16384 17 0.0 16383.75 AXIS_PTS_REF CA_EngSpd11Step4 MAX_GRAD 0.0 /end AXIS_DESCR
/end CHARACTERISTIC
/begin CHARACTERISTIC CT_SAGovDerivLow "cal comments" CURVE 0xAB03 2D_Array_UB 0.0 CM_Percent_0to100 0.0 99.609375
 /begin AXIS_DESCR COM_AXIS NO_INPUT_QUANTITY CM_RPM_0to16384 17 0.0 16383.75 AXIS_PTS_REF CA_EngSpd11Step4 MAX_GRAD 0.0 /end AXIS_DESCR
/end CHARACTERISTIC
/begin CHARACTERISTIC C_SAGovDerivInterval "cal comments" VALUE 0xAB0E Scalar_UB 0.0 CM_Count4 0.0 255.0 /end CHARACTERISTIC
/begin CHARACTERISTIC C_SAGovDerivHiDeadBand "cal comments" VALUE 0xAB10 Scalar_UW 0.0 CM_RPM_0to16384 0.0 16383.75 /end CHARACTERISTIC
/begin CHARACTERISTIC C_SAGovDerivLoDeadBand "cal comments" VALUE 0xAB12 Scalar_UW 0.0 CM_RPM_0to16384 0.0 16383.75 /end CHARACTERISTIC
/begin CHARACTERISTIC C_SAGovDerivUpDeltaDeadBand "cal comments" VALUE 0xAB14 Scalar_UW 0.0 CM_RPM_0to16384 0.0 16383.75 /end CHARACTERISTIC
/begin CHARACTERISTIC C_SAGovDerivDwnDeltaDeadBand "cal comments" VALUE 0xAB16 Scalar_UW 0.0 CM_RPM_0to16384 0.0 16383.75 /end CHARACTERISTIC
/begin CHARACTERISTIC C_SparkPowerOffDwell "cal comments" VALUE 0xAA50 Scalar_UW 0.0 CM_msec_0to1024 0.0 1023.984375 /end CHARACTERISTIC
/begin CHARACTERISTIC C_SpdCntrlDerivInterval "cal comments" VALUE 0x9D27 Scalar_UB 0.0 CM_Count4 0.0 255.0 /end CHARACTERISTIC
/begin CHARACTERISTIC C_SpdCntrlDerivInterval2 "cal comments" VALUE 0x9D28 Scalar_UB 0.0 CM_Count4 0.0 255.0 /end CHARACTERISTIC
/begin CHARACTERISTIC C_TPSNoMoveAsEngineKilledEn "cal comments" VALUE 0x9C8C Scalar_UB 0.0 CM_Count1 0.0 255.0 /end CHARACTERISTIC
/begin CHARACTERISTIC C_SpeedControlEnable "cal comments" VALUE 0x9C8D Scalar_UB 0.0 CM_Count1 0.0 255.0 /end CHARACTERISTIC
/begin CHARACTERISTIC C_SpeedControlIntDerivLearnning "cal comments" VALUE 0x9C8F Scalar_UB 0.0 CM_Boolean6 0.0 255.0 /end CHARACTERISTIC
/begin CHARACTERISTIC C_SpeedControlDerivEnhanced "cal comments" VALUE 0x9C90 Scalar_UB 0.0 CM_Boolean6 0.0 255.0 /end CHARACTERISTIC
/begin CHARACTERISTIC C_SpeedControlLvl0 "cal comments" VALUE 0x9C7E Scalar_UW 0.0 CM_Percent_0to100_1 0.0 99.9984130859375 /end CHARACTERISTIC
/begin CHARACTERISTIC C_SpeedControlLvl1 "cal comments" VALUE 0x9C80 Scalar_UW 0.0 CM_Percent_0to100_1 0.0 99.9984130859375 /end CHARACTERISTIC
/begin CHARACTERISTIC C_SpeedControlLvl2 "cal comments" VALUE 0x9C82 Scalar_UW 0.0 CM_Percent_0to100_1 0.0 99.9984130859375 /end CHARACTERISTIC
/begin CHARACTERISTIC C_SpeedControlLvl3 "cal comments" VALUE 0x9C84 Scalar_UW 0.0 CM_Percent_0to100_1 0.0 99.9984130859375 /end CHARACTERISTIC
/begin CHARACTERISTIC C_SpeedControlLvl4 "cal comments" VALUE 0x9C86 Scalar_UW 0.0 CM_Percent_0to100_1 0.0 99.9984130859375 /end CHARACTERISTIC
/begin CHARACTERISTIC C_SpeedControlLvl5 "cal comments" VALUE 0x9C88 Scalar_UW 0.0 CM_Percent_0to100_1 0.0 99.9984130859375 /end CHARACTERISTIC
/begin CHARACTERISTIC C_IDLEMotorDirChangeDelay "cal comments" VALUE 0xB63A Scalar_UB 0.0 CM_Count4 0.0 255.0 /end CHARACTERISTIC
/begin CHARACTERISTIC C_IDLEMotorStartDelay "cal comments" VALUE 0xB638 Scalar_UB 0.0 CM_Count4 0.0 255.0 /end CHARACTERISTIC
/begin CHARACTERISTIC C_IDLEMotorStartDelaySteps "cal comments" VALUE 0xB639 Scalar_UB 0.0 CM_Count4 0.0 255.0 /end CHARACTERISTIC
/begin CHARACTERISTIC C_IDLEStepMotorHiEn "cal comments" VALUE 0xB63B Scalar_UB 0.0 CM_Boolean6 0.0 255.0 /end CHARACTERISTIC
/begin CHARACTERISTIC C_IDLEStepMotorDir "cal comments" VALUE 0xB63C Scalar_UB 0.0 CM_Boolean6 0.0 255.0 /end CHARACTERISTIC
/begin CHARACTERISTIC C_FCVMoveBatVoltMaxLimit "cal comments" VALUE 0xB646 Scalar_UW 0.0 CM_Volt_0to32_1 0.0 31.99900627136231 /end CHARACTERISTIC
/begin CHARACTERISTIC C_FCVMoveBatVoltMinLimit "cal comments" VALUE 0xB648 Scalar_UW 0.0 CM_Volt_0to32_1 0.0 31.99900627136231 /end CHARACTERISTIC
/begin CHARACTERISTIC C_FCVMotorDirChangeDelay "cal comments" VALUE 0xB64C Scalar_UB 0.0 CM_Count4 0.0 255.0 /end CHARACTERISTIC
/begin CHARACTERISTIC C_FCVMotorStartDelay "cal comments" VALUE 0xB64A Scalar_UB 0.0 CM_Count4 0.0 255.0 /end CHARACTERISTIC
/begin CHARACTERISTIC C_FCVMotorStartDelaySteps "cal comments" VALUE 0xB64B Scalar_UB 0.0 CM_Count4 0.0 255.0 /end CHARACTERISTIC
/begin CHARACTERISTIC C_FCVStepMotorHiEn "cal comments" VALUE 0xB64D Scalar_UB 0.0 CM_Boolean6 0.0 255.0 /end CHARACTERISTIC
/begin CHARACTERISTIC C_FCVStepMotorDir "cal comments" VALUE 0xB64E Scalar_UB 0.0 CM_Boolean6 0.0 255.0 /end CHARACTERISTIC
/begin CHARACTERISTIC C_FCVPSCloseSlowZone "cal comments" VALUE 0xB652 Scalar_UW 0.0 CM_Percent_0to200_2 0.0 199.9969024658203 /end CHARACTERISTIC
/begin CHARACTERISTIC C_FCVMtrFCVPSDeltaOneStep "cal comments" VALUE 0xB650 Scalar_UW 0.0 CM_Percent_0to200_2 0.0 199.9969024658203 /end CHARACTERISTIC
/begin CHARACTERISTIC C_FCVPSFiltCoef "cal comments" VALUE 0xBE1A Scalar_UW 0.0 CM_FiltCoef 0.0 0.9999847412109375 /end CHARACTERISTIC
/begin CHARACTERISTIC C_FCVPSOpenSlowZone "cal comments" VALUE 0xB654 Scalar_UW 0.0 CM_Percent_0to200_2 0.0 199.9969024658203 /end CHARACTERISTIC
/begin CHARACTERISTIC C_FCVPSSlope "cal comments" VALUE 0xBE18 Scalar_UW 0.0 CM_Ratio_0to8 0.0 7.9998779296875 /end CHARACTERISTIC
/begin CHARACTERISTIC C_FCVPSZeroInitial "cal comments" VALUE 0xBE16 Scalar_UW 0.0 CM_Percent_0to200_2 0.0 199.9969024658203 /end CHARACTERISTIC
/begin CHARACTERISTIC C_FCVPSMinimumLrnCntThresh "cal comments" VALUE 0xB656 Scalar_UB 0.0 CM_Count1 0.0 255.0 /end CHARACTERISTIC
/begin CHARACTERISTIC C_FCVLoopCounter "cal comments" VALUE 0xB657 Scalar_UB 0.0 CM_Count1 0.0 255.0 /end CHARACTERISTIC
/begin CHARACTERISTIC C_FCV_PstnMax "cal comments" VALUE 0xB658 Scalar_UB 0.0 CM_Count4 0.0 255.0 /end CHARACTERISTIC
/begin CHARACTERISTIC C_FCVStepMotorCLEn "cal comments" VALUE 0xB659 Scalar_UB 0.0 CM_Boolean6 0.0 255.0 /end CHARACTERISTIC
/begin CHARACTERISTIC C_FCVMotorParkDelay "cal comments" VALUE 0xB682 Scalar_UW 0.0 CM_Count_0to65535 0.0 65535.0 /end CHARACTERISTIC
/begin CHARACTERISTIC CT_FCVPS_NG_ParkPstn "cal comments" CURVE 0xB65C 2D_Array_UW 0.0 CM_Percent_0to200_2 0.0 199.9969024658203
 /begin AXIS_DESCR FIX_AXIS NO_INPUT_QUANTITY CM_Equaloutput1 9 -40.0 152.0 MAX_GRAD 0.0 /begin FIX_AXIS_PAR_LIST -40 -16 8 32 56 80 104 128 152 /end FIX_AXIS_PAR_LIST /end AXIS_DESCR
/end CHARACTERISTIC
/begin CHARACTERISTIC CT_FCVPS_LPG_ParkPstn "cal comments" CURVE 0xB670 2D_Array_UW 0.0 CM_Percent_0to200_2 0.0 199.9969024658203
 /begin AXIS_DESCR FIX_AXIS NO_INPUT_QUANTITY CM_Equaloutput1 9 -40.0 152.0 MAX_GRAD 0.0 /begin FIX_AXIS_PAR_LIST -40 -16 8 32 56 80 104 128 152 /end FIX_AXIS_PAR_LIST /end AXIS_DESCR
/end CHARACTERISTIC
/begin CHARACTERISTIC CT_FBPV_PP_Corr_NG "cal comments" MAP 0xBD93 3D_Array_UB 0.0 CM_Mult0_to_4_ratio 0.0 3.984375
 /begin AXIS_DESCR COM_AXIS NO_INPUT_QUANTITY CM_kpa_n256to256_1 8 -256 255.9921875 AXIS_PTS_REF CA_MAP8Step1 MAX_GRAD 0.0 /end AXIS_DESCR
 /begin AXIS_DESCR COM_AXIS NO_INPUT_QUANTITY CM_kpa_0to256_1 8 0.0 255.99609375 AXIS_PTS_REF CA_MAP8Step2 MAX_GRAD 0.0 /end AXIS_DESCR
/end CHARACTERISTIC
/begin CHARACTERISTIC CT_FBPV_PP_Corr_LPG "cal comments" MAP 0xBDD6 3D_Array_UB 0.0 CM_Mult0_to_4_ratio 0.0 3.984375
 /begin AXIS_DESCR COM_AXIS NO_INPUT_QUANTITY CM_kpa_n256to256_1 8 -256 255.9921875 AXIS_PTS_REF CA_MAP8Step1 MAX_GRAD 0.0 /end AXIS_DESCR
 /begin AXIS_DESCR COM_AXIS NO_INPUT_QUANTITY CM_kpa_0to256_1 8 0.0 255.99609375 AXIS_PTS_REF CA_MAP8Step2 MAX_GRAD 0.0 /end AXIS_DESCR
/end CHARACTERISTIC
/begin CHARACTERISTIC C_FBPV_OffEngSpdThrsh "cal comments" VALUE 0xBD72 Scalar_UW 0.0 CM_RPM_0to16384 0.0 16383.75 /end CHARACTERISTIC
/begin CHARACTERISTIC CT_FBPV_PP_NG "cal comments" CURVE 0xBD76 2D_Array_UW 0.0 CM_Second_0to512 0.0 511.9921875
 /begin AXIS_DESCR FIX_AXIS NO_INPUT_QUANTITY CM_Equaloutput1 6 -28.0 92.0 MAX_GRAD 0.0 /begin FIX_AXIS_PAR_LIST -28 -4 20 44 68 92 /end FIX_AXIS_PAR_LIST /end AXIS_DESCR
/end CHARACTERISTIC
/begin CHARACTERISTIC CT_FBPV_PP_LPG "cal comments" CURVE 0xBD84 2D_Array_UW 0.0 CM_Second_0to512 0.0 511.9921875
 /begin AXIS_DESCR FIX_AXIS NO_INPUT_QUANTITY CM_Equaloutput1 6 -28.0 92.0 MAX_GRAD 0.0 /begin FIX_AXIS_PAR_LIST -28 -4 20 44 68 92 /end FIX_AXIS_PAR_LIST /end AXIS_DESCR
/end CHARACTERISTIC
/begin CHARACTERISTIC CT_FCVPS_FP_CorrFactor_NG "cal comments" MAP 0xB6BD 3D_Array_UB 0.0 CM_Mult0_to_2_ratio 0.0 1.9921875
 /begin AXIS_DESCR COM_AXIS NO_INPUT_QUANTITY udf_CM_18705 17 0.0 511.9921875 AXIS_PTS_REF CA_AirGramStep17 MAX_GRAD 0.0 /end AXIS_DESCR
 /begin AXIS_DESCR COM_AXIS NO_INPUT_QUANTITY CM_kpa_n256to256_1 8 -256 255.9921875 AXIS_PTS_REF CA_MAP8Step1 MAX_GRAD 0.0 /end AXIS_DESCR
/end CHARACTERISTIC
/begin CHARACTERISTIC CT_FCVPS_Baro_CorrFactor_NG "cal comments" MAP 0xB748 3D_Array_UB 0.0 CM_Mult0_to_2_ratio 0.0 1.9921875
 /begin AXIS_DESCR COM_AXIS NO_INPUT_QUANTITY udf_CM_18705 17 0.0 511.9921875 AXIS_PTS_REF CA_AirGramStep17 MAX_GRAD 0.0 /end AXIS_DESCR
 /begin AXIS_DESCR COM_AXIS NO_INPUT_QUANTITY CM_kpa_0to256_1 8 0.0 255.99609375 AXIS_PTS_REF CA_MAP8Step2 MAX_GRAD 0.0 /end AXIS_DESCR
/end CHARACTERISTIC
/begin CHARACTERISTIC CT_FCVPS_FP_CorrFactor_LPG "cal comments" MAP 0xB7D3 3D_Array_UB 0.0 CM_Mult0_to_2_ratio 0.0 1.9921875
 /begin AXIS_DESCR COM_AXIS NO_INPUT_QUANTITY udf_CM_18705 17 0.0 511.9921875 AXIS_PTS_REF CA_AirGramStep17 MAX_GRAD 0.0 /end AXIS_DESCR
 /begin AXIS_DESCR COM_AXIS NO_INPUT_QUANTITY CM_kpa_n256to256_1 8 -256 255.9921875 AXIS_PTS_REF CA_MAP8Step1 MAX_GRAD 0.0 /end AXIS_DESCR
/end CHARACTERISTIC
/begin CHARACTERISTIC CT_FCVPS_Baro_CorrFactor_LPG "cal comments" MAP 0xB85E 3D_Array_UB 0.0 CM_Mult0_to_2_ratio 0.0 1.9921875
 /begin AXIS_DESCR COM_AXIS NO_INPUT_QUANTITY udf_CM_18705 17 0.0 511.9921875 AXIS_PTS_REF CA_AirGramStep17 MAX_GRAD 0.0 /end AXIS_DESCR
 /begin AXIS_DESCR COM_AXIS NO_INPUT_QUANTITY CM_kpa_0to256_1 8 0.0 255.99609375 AXIS_PTS_REF CA_MAP8Step2 MAX_GRAD 0.0 /end AXIS_DESCR
/end CHARACTERISTIC
/begin CHARACTERISTIC CT_DesireFCVPS_NG "cal comments" MAP 0xB8EA 3D_Array_UW 0.0 CM_Percent_0to200_2 0.0 199.9969024658203
 /begin AXIS_DESCR COM_AXIS NO_INPUT_QUANTITY udf_CM_18705 17 0.0 511.9921875 AXIS_PTS_REF CA_AirGramStep17 MAX_GRAD 0.0 /end AXIS_DESCR
 /begin AXIS_DESCR COM_AXIS NO_INPUT_QUANTITY udf_CM_16444 17 0.0 15.999755859375 AXIS_PTS_REF CA_FuelGramStep17 MAX_GRAD 0.0 /end AXIS_DESCR
/end CHARACTERISTIC
/begin CHARACTERISTIC CT_DesireFCVPS_LPG "cal comments" MAP 0xBB30 3D_Array_UW 0.0 CM_Percent_0to200_2 0.0 199.9969024658203
 /begin AXIS_DESCR COM_AXIS NO_INPUT_QUANTITY udf_CM_18705 17 0.0 511.9921875 AXIS_PTS_REF CA_AirGramStep17 MAX_GRAD 0.0 /end AXIS_DESCR
 /begin AXIS_DESCR COM_AXIS NO_INPUT_QUANTITY udf_CM_16444 17 0.0 15.999755859375 AXIS_PTS_REF CA_FuelGramStep17 MAX_GRAD 0.0 /end AXIS_DESCR
/end CHARACTERISTIC
/begin CHARACTERISTIC C_TachOutOption "cal comments" VALUE 0x80C2 Scalar_UB 0.0 CM_Enum_0to4 0.0 255.0 /end CHARACTERISTIC
/begin CHARACTERISTIC C_TargetWheelErrorOfst "cal comments" VALUE 0xB566 Scalar_SW 0.0 CM_SparkAngle_N256to256 -256.0 255.9921875 /end CHARACTERISTIC
/begin CHARACTERISTIC C_IDLETPSCloseSlowZone "cal comments" VALUE 0xB640 Scalar_UW 0.0 CM_Percent_0to200_2 0.0 199.9969024658203 /end CHARACTERISTIC
/begin CHARACTERISTIC C_IDLEMtrTPSDeltaOneStep "cal comments" VALUE 0xB63E Scalar_UW 0.0 CM_Percent_0to200_2 0.0 199.9969024658203 /end CHARACTERISTIC
/begin CHARACTERISTIC C_TPSFiltCoef "cal comments" VALUE 0xB3BC Scalar_UW 0.0 CM_FiltCoef 0.0 0.9999847412109375 /end CHARACTERISTIC
/begin CHARACTERISTIC C_IDLETPSMinimumLrnCntThresh "cal comments" VALUE 0xB644 Scalar_UB 0.0 CM_Count1 0.0 255.0 /end CHARACTERISTIC
/begin CHARACTERISTIC C_IDLETPSOpenSlowZone "cal comments" VALUE 0xB642 Scalar_UW 0.0 CM_Percent_0to200_2 0.0 199.9969024658203 /end CHARACTERISTIC
/begin CHARACTERISTIC C_HDLPSZeroInitial "cal comments" VALUE 0x0 Scalar_UW 0.0 CM_Percent_0to200_2 0.0 199.9969024658203 /end CHARACTERISTIC
/begin CHARACTERISTIC C_HDLPSMin "cal comments" VALUE 0x0 Scalar_UW 0.0 CM_Percent_0to200_2 0.0 199.9969024658203 /end CHARACTERISTIC
/begin CHARACTERISTIC C_HDLPSCoef "cal comments" VALUE 0x0 Scalar_UW 0.0 CM_FiltCoef 0.0 0.9999847412109375 /end CHARACTERISTIC
/begin CHARACTERISTIC C_HDLPSSlope "cal comments" VALUE 0x0 Scalar_UW 0.0 CM_Ratio_0to8 0.0 7.9998779296875 /end CHARACTERISTIC
/begin CHARACTERISTIC C_HDLPSGearLowActive "cal comments" VALUE 0x0 Scalar_UB 0.0 CM_Boolean4 0.0 255.0 /end CHARACTERISTIC
/begin CHARACTERISTIC C_HDLPSGearLowPct "cal comments" VALUE 0x0 Scalar_UW 0.0 CM_Percent_0to200_2 0.0 199.9969024658203 /end CHARACTERISTIC
/begin CHARACTERISTIC C_TPSSensorPresent "cal comments" VALUE 0x80B6 Scalar_UB 0.0 CM_Boolean4 0.0 1.0 /end CHARACTERISTIC
/begin CHARACTERISTIC C_TPSSlope "cal comments" VALUE 0xB3BE Scalar_UW 0.0 CM_Ratio_0to8 0.0 7.9998779296875 /end CHARACTERISTIC
/begin CHARACTERISTIC CT_TPS "cal comments" CURVE 0x2 2D_Array_UW 0.0 udf_CM_18726 0.0 199.9969482421875
 /begin AXIS_DESCR COM_AXIS NO_INPUT_QUANTITY CM_Percent_0to100_1 4 0.0 99.9984130859375 AXIS_PTS_REF CA_PercentStep4 MAX_GRAD 0.0 /end AXIS_DESCR
/end CHARACTERISTIC
/begin CHARACTERISTIC C_TPS_CurveSel "cal comments" VALUE 0x0 Scalar_UB 0.0 CM_Boolean6 0.0 255.0 /end CHARACTERISTIC
/begin CHARACTERISTIC C_TPSSpdCtrlMinimum "cal comments" VALUE 0x9CEA Scalar_UW 0.0 CM_Percent_0to200_2 0.0 199.9969024658203 /end CHARACTERISTIC
/begin CHARACTERISTIC C_TPSZeroInitialDefault "cal comments" VALUE 0xB3BA Scalar_UW 0.0 CM_Percent_0to200_2 0.0 199.9969024658203 /end CHARACTERISTIC
/begin CHARACTERISTIC C_TransientFuelEnable "cal comments" VALUE 0x9526 Scalar_UB 0.0 CM_Boolean1 0.0 1.0 /end CHARACTERISTIC
/begin CHARACTERISTIC C_TrimPulseEnbEngSpdThresh "cal comments" VALUE 0x9A06 Scalar_UW 0.0 CM_RPM_0to16384 0.0 16383.75 /end CHARACTERISTIC
/begin CHARACTERISTIC C_TrimPulseEnbEngSpdThreshHyst "cal comments" VALUE 0x9A08 Scalar_UW 0.0 CM_RPM_0to16384 0.0 16383.75 /end CHARACTERISTIC
/begin CHARACTERISTIC C_TrimPulseScalarCyl "cal comments" CURVE 0x99FE 2D_Array_UW 0.0 CM_Ratio_0to2_2 0.0 1.999969482421875
 /begin AXIS_DESCR FIX_AXIS NO_INPUT_QUANTITY CM_EOI 4 0.0 4.0 MAX_GRAD 0.0 /begin FIX_AXIS_PAR_LIST 0 1 2 3 /end FIX_AXIS_PAR_LIST /end AXIS_DESCR
/end CHARACTERISTIC
/begin CHARACTERISTIC C_TrimPulseWidthMinLimit "cal comments" VALUE 0x99FC Scalar_UW 0.0 CM_msec_0to1024 0.0 1023.984375 /end CHARACTERISTIC
/begin CHARACTERISTIC C_TwoCylinderEngine "cal comments" VALUE 0xB099 Scalar_UB 0.0 CM_Boolean4 0.0 1.0 /end CHARACTERISTIC
/begin CHARACTERISTIC C_ValidToothOccurredResetTime "cal comments" VALUE 0xB514 Scalar_UW 0.0 CM_Second_0to512 0.0 511.9921875 /end CHARACTERISTIC
/begin CHARACTERISTIC CT_AccEnrichDecayFactorCoolTemp "cal comments" CURVE 0x9690 2D_Array_UB 0.0 CM_Mult_0to1 0.0 0.99609375
 /begin AXIS_DESCR FIX_AXIS NO_INPUT_QUANTITY CM_Equaloutput1 17 -28.0 164.0 MAX_GRAD 0.0 /begin FIX_AXIS_PAR_LIST -28 -16 -4 8 20 32 44 56 68 80 92 104 116 128 140 152 164 /end FIX_AXIS_PAR_LIST /end AXIS_DESCR
/end CHARACTERISTIC
/begin CHARACTERISTIC CT_AccEnrichDecayFactorEngSpd "cal comments" CURVE 0x93E7 2D_Array_UB 0.0 CM_Mult_0to1_2 0.0 0.99609375
 /begin AXIS_DESCR COM_AXIS NO_INPUT_QUANTITY CM_RPM_0to16384 17 0.0 16383.75 AXIS_PTS_REF CA_EngSpd17Step1 MAX_GRAD 0.0 /end AXIS_DESCR
/end CHARACTERISTIC
/begin CHARACTERISTIC CT_AEDeltaFuelMultBase "cal comments" CURVE 0x940E 2D_Array_UW 0.0 CM_Grams0to8 0.0 7.999755859375
 /begin AXIS_DESCR FIX_AXIS NO_INPUT_QUANTITY CM_Equaloutput1 18 0.0 1.700000092387199e-002 MAX_GRAD 0.0
  /begin FIX_AXIS_PAR_LIST 0 1.e-003 2.e-003 3.e-003 4.e-003 5.e-003 6.e-003 7.e-003 8.e-003 8.999999999999999e-003 1.e-002 1.1e-002 1.2e-002 1.3e-002 1.4e-002 1.5e-002 1.6e-002 1.7e-002 /end FIX_AXIS_PAR_LIST
 /end AXIS_DESCR
/end CHARACTERISTIC
/begin CHARACTERISTIC CT_AEDeltaFuelMultCoolTemp "cal comments" CURVE 0x96B6 2D_Array_UB 0.0 CM_mult_0to4 0.0 3.984375
 /begin AXIS_DESCR FIX_AXIS NO_INPUT_QUANTITY CM_Equaloutput1 17 -28.0 164.0 MAX_GRAD 0.0 /begin FIX_AXIS_PAR_LIST -28 -16 -4 8 20 32 44 56 68 80 92 104 116 128 140 152 164 /end FIX_AXIS_PAR_LIST /end AXIS_DESCR
/end CHARACTERISTIC
/begin CHARACTERISTIC CT_AEDeltaFuelMultSpeedLoad "cal comments" MAP 0x945B 3D_Array_UB 0.0 CM_Grams0to2 0.0 1.9921875
 /begin AXIS_DESCR COM_AXIS NO_INPUT_QUANTITY CM_RPM_0to16384 4 0.0 16383.75 AXIS_PTS_REF CA_EngSpd4Step1 MAX_GRAD 0.0 /end AXIS_DESCR
 /begin AXIS_DESCR FIX_AXIS NO_INPUT_QUANTITY CM_Equaloutput1 10 15.0 105.0 MAX_GRAD 0.0 /begin FIX_AXIS_PAR_LIST 15 25 35 45 55 65 75 85 95 105 /end FIX_AXIS_PAR_LIST /end AXIS_DESCR
/end CHARACTERISTIC
/begin CHARACTERISTIC CT_AFLCCellEngSpdBoundary "cal comments" VAL_BLK 0xB40E ValueBlock_UW 0.0 CM_RPM_0to16384_1 0.0 16383.75 NUMBER 3 /end CHARACTERISTIC
/begin CHARACTERISTIC CT_AFLCCellTPSBoundary "cal comments" VAL_BLK 0xB404 ValueBlock_UW 0.0 CM_Percent_0to200_1 0.0 199.9969024658203 NUMBER 5 /end CHARACTERISTIC
/begin CHARACTERISTIC CT_AFLCTPSMaxThresh "cal comments" CURVE 0xB3C4 2D_Array_UW 0.0 CM_Percent_0to200_2 0.0 199.9969024658203
 /begin AXIS_DESCR COM_AXIS NO_INPUT_QUANTITY CM_RPM_0to16384 17 0.0 16383.75 AXIS_PTS_REF CA_EngSpd17Step1 MAX_GRAD 0.0 /end AXIS_DESCR
/end CHARACTERISTIC
/begin CHARACTERISTIC CT_AFRCrank "cal comments" CURVE 0x9736 2D_Array_UB 0.0 CM_AFR_8bit 0.0 31.875
 /begin AXIS_DESCR FIX_AXIS NO_INPUT_QUANTITY CM_Equaloutput1 17 -28.0 164.0 MAX_GRAD 0.0 /begin FIX_AXIS_PAR_LIST -28 -16 -4 8 20 32 44 56 68 80 92 104 116 128 140 152 164 /end FIX_AXIS_PAR_LIST /end AXIS_DESCR
/end CHARACTERISTIC
/begin CHARACTERISTIC CT_AFRCrankNG "cal comments" CURVE 0x9749 2D_Array_UB 0.0 CM_AFR_8bit 0.0 31.875
 /begin AXIS_DESCR FIX_AXIS NO_INPUT_QUANTITY CM_Equaloutput1 9 -28.0 92.0 MAX_GRAD 0.0 /begin FIX_AXIS_PAR_LIST -16 -4 8 20 32 44 56 68 80 /end FIX_AXIS_PAR_LIST /end AXIS_DESCR
/end CHARACTERISTIC
/begin CHARACTERISTIC CT_AFRCrankLPG "cal comments" CURVE 0x9754 2D_Array_UB 0.0 CM_AFR_8bit 0.0 31.875
 /begin AXIS_DESCR FIX_AXIS NO_INPUT_QUANTITY CM_Equaloutput1 9 -28.0 92.0 MAX_GRAD 0.0 /begin FIX_AXIS_PAR_LIST -16 -4 8 20 32 44 56 68 80 /end FIX_AXIS_PAR_LIST /end AXIS_DESCR
/end CHARACTERISTIC
/begin CHARACTERISTIC CT_AFRCrankBaroComp "cal comments" CURVE 0x9529 2D_Array_SB 0.0 CM_AFR_n4to4 -4.0 3.96875
 /begin AXIS_DESCR FIX_AXIS NO_INPUT_QUANTITY CM_Equaloutput1 6 55.0 105.0 MAX_GRAD 0.0 /begin FIX_AXIS_PAR_LIST 55 65 75 85 95 105 /end FIX_AXIS_PAR_LIST /end AXIS_DESCR
/end CHARACTERISTIC
/begin CHARACTERISTIC C_AFRCrankToRunDecayFactor "cal comments" VALUE 0x97AC Scalar_UW 0.0 CM_FactorRatio 0.0 0.9999847412109375 /end CHARACTERISTIC
/begin CHARACTERISTIC CT_AFRCrankToRunDecayInterval "cal comments" CURVE 0x979A 2D_Array_UB 0.0 CM_Second_0to8 0.0 7.96875
 /begin AXIS_DESCR FIX_AXIS NO_INPUT_QUANTITY CM_Equaloutput1 17 -28.0 164.0 MAX_GRAD 0.0 /begin FIX_AXIS_PAR_LIST -28 -16 -4 8 20 32 44 56 68 80 92 104 116 128 140 152 164 /end FIX_AXIS_PAR_LIST /end AXIS_DESCR
/end CHARACTERISTIC
/begin CHARACTERISTIC CT_AFRLeanLimit "cal comments" CURVE 0x9284 2D_Array_UB 0.0 CM_AFR_8bit 0.0 31.875
 /begin AXIS_DESCR FIX_AXIS NO_INPUT_QUANTITY CM_Equaloutput1 17 -28.0 164.0 MAX_GRAD 0.0 /begin FIX_AXIS_PAR_LIST -28 -16 -4 8 20 32 44 56 68 80 92 104 116 128 140 152 164 /end FIX_AXIS_PAR_LIST /end AXIS_DESCR
/end CHARACTERISTIC
/begin CHARACTERISTIC CT_AFRLeanLimitForColdIdleEnrich "cal comments" CURVE 0x9297 2D_Array_UB 0.0 CM_AFR_8bit 0.0 31.875
 /begin AXIS_DESCR FIX_AXIS NO_INPUT_QUANTITY CM_Equaloutput1 17 -28.0 164.0 MAX_GRAD 0.0 /begin FIX_AXIS_PAR_LIST -28 -16 -4 8 20 32 44 56 68 80 92 104 116 128 140 152 164 /end FIX_AXIS_PAR_LIST /end AXIS_DESCR
/end CHARACTERISTIC
/begin CHARACTERISTIC CT_AFROpenLoopInPEIdle "cal comments" CURVE 0x9609 2D_Array_UB 0.0 CM_AFR_8bit 0.0 31.875
 /begin AXIS_DESCR COM_AXIS NO_INPUT_QUANTITY CM_RPM_0to16384 4 0.0 16383.75 AXIS_PTS_REF CA_EngSpd4Step1 MAX_GRAD 0.0 /end AXIS_DESCR
/end CHARACTERISTIC
/begin CHARACTERISTIC CT_AFRPECoolTempMult "cal comments" CURVE 0x96DC 2D_Array_UB 0.0 CM_Mult0_to_2_ratio 0.0 1.9921875
 /begin AXIS_DESCR FIX_AXIS NO_INPUT_QUANTITY CM_Equaloutput1 17 -28.0 164.0 MAX_GRAD 0.0 /begin FIX_AXIS_PAR_LIST -28 -16 -4 8 20 32 44 56 68 80 92 104 116 128 140 152 164 /end FIX_AXIS_PAR_LIST /end AXIS_DESCR
/end CHARACTERISTIC
/begin CHARACTERISTIC CT_AFRPowerEnrich "cal comments" MAP 0x96F0 3D_Array_UB 0.0 CM_AFR_8bit 0.0 31.875
 /begin AXIS_DESCR COM_AXIS NO_INPUT_QUANTITY CM_Percent_0to200_2 4 0.0 199.9969024658203 AXIS_PTS_REF CA_Percent1 MAX_GRAD 0.0 /end AXIS_DESCR
 /begin AXIS_DESCR COM_AXIS NO_INPUT_QUANTITY CM_RPM_0to16384 17 0.0 16383.75 AXIS_PTS_REF CA_EngSpd17Step1 MAX_GRAD 0.0 /end AXIS_DESCR
/end CHARACTERISTIC
/begin CHARACTERISTIC CT_AFRWarmUpOffsetBaroCompIdle "cal comments" CURVE 0x9539 2D_Array_SB 0.0 CM_AFR_n4to4 -4.0 3.96875
 /begin AXIS_DESCR FIX_AXIS NO_INPUT_QUANTITY CM_Equaloutput1 6 55.0 105.0 MAX_GRAD 0.0 /begin FIX_AXIS_PAR_LIST 55 65 75 85 95 105 /end FIX_AXIS_PAR_LIST /end AXIS_DESCR
/end CHARACTERISTIC
/begin CHARACTERISTIC CT_AFRWarmUpOffsetBaroCompRun "cal comments" CURVE 0x9531 2D_Array_SB 0.0 CM_AFR_n4to4 -4.0 3.96875
 /begin AXIS_DESCR FIX_AXIS NO_INPUT_QUANTITY CM_Equaloutput1 6 55.0 105.0 MAX_GRAD 0.0 /begin FIX_AXIS_PAR_LIST 55 65 75 85 95 105 /end FIX_AXIS_PAR_LIST /end AXIS_DESCR
/end CHARACTERISTIC
/begin CHARACTERISTIC CT_AFRWarmUpOffsetDecayIntervel "cal comments" CURVE 0x975F 2D_Array_UB 0.0 CM_Second_0to8 0.0 7.96875
 /begin AXIS_DESCR FIX_AXIS NO_INPUT_QUANTITY CM_Equaloutput1 17 -28.0 164.0 MAX_GRAD 0.0 /begin FIX_AXIS_PAR_LIST -28 -16 -4 8 20 32 44 56 68 80 92 104 116 128 140 152 164 /end FIX_AXIS_PAR_LIST /end AXIS_DESCR
/end CHARACTERISTIC
/begin CHARACTERISTIC CT_AFRWarmUpOffsetIdle "cal comments" CURVE 0x9774 2D_Array_UB 0.0 CM_AFR_8bit 0.0 31.875
 /begin AXIS_DESCR FIX_AXIS NO_INPUT_QUANTITY CM_Equaloutput1 17 -28.0 164.0 MAX_GRAD 0.0 /begin FIX_AXIS_PAR_LIST -28 -16 -4 8 20 32 44 56 68 80 92 104 116 128 140 152 164 /end FIX_AXIS_PAR_LIST /end AXIS_DESCR
/end CHARACTERISTIC
/begin CHARACTERISTIC CT_AFRWarmUpOffsetRun "cal comments" CURVE 0x9787 2D_Array_UB 0.0 CM_AFR_8bit 0.0 31.875
 /begin AXIS_DESCR FIX_AXIS NO_INPUT_QUANTITY CM_Equaloutput1 17 -28.0 164.0 MAX_GRAD 0.0 /begin FIX_AXIS_PAR_LIST -28 -16 -4 8 20 32 44 56 68 80 92 104 116 128 140 152 164 /end FIX_AXIS_PAR_LIST /end AXIS_DESCR
/end CHARACTERISTIC
/begin CHARACTERISTIC CT_AirFuelRatioBase "cal comments" MAP 0x9542 3D_Array_UB 0.0 CM_AFR_8bit 0.0 31.875
 /begin AXIS_DESCR COM_AXIS NO_INPUT_QUANTITY CM_RPM_0to16384 17 0.0 16383.75 AXIS_PTS_REF CA_EngSpd17Step2 MAX_GRAD 0.0 /end AXIS_DESCR
 /begin AXIS_DESCR COM_AXIS NO_INPUT_QUANTITY CM_kpa_0to256_1 10 0.0 255.99609375 AXIS_PTS_REF CA_MAP10Step1 MAX_GRAD 0.0 /end AXIS_DESCR
/end CHARACTERISTIC
/begin CHARACTERISTIC CT_AirFuelRatioBaseCoolTempMult "cal comments" CURVE 0x97B0 2D_Array_UB 0.0 CM_Mult0_to_2_ratio 0.0 1.9921875
 /begin AXIS_DESCR FIX_AXIS NO_INPUT_QUANTITY CM_Equaloutput1 17 -28.0 164.0 MAX_GRAD 0.0 /begin FIX_AXIS_PAR_LIST -28 -16 -4 8 20 32 44 56 68 80 92 104 116 128 140 152 164 /end FIX_AXIS_PAR_LIST /end AXIS_DESCR
/end CHARACTERISTIC
/begin CHARACTERISTIC CT_AltMAPCalcMult "cal comments" CURVE 0xB54A 2D_Array_UB 0.0 CM_Mult0_to_2_ratio 0.0 1.9921875
 /begin AXIS_DESCR FIX_AXIS NO_INPUT_QUANTITY CM_Equaloutput1 11 55.0 105.0 MAX_GRAD 0.0 /begin FIX_AXIS_PAR_LIST 55 60 65 70 75 80 85 90 95 100 105 /end FIX_AXIS_PAR_LIST /end AXIS_DESCR
/end CHARACTERISTIC
/begin CHARACTERISTIC CT_BaroReadTooth "cal comments" CURVE 0xB572 2D_Array_UB 0.0 CM_Count3 0.0 255.0
 /begin AXIS_DESCR COM_AXIS NO_INPUT_QUANTITY CM_RPM_0to16384 9 0.0 16383.75 AXIS_PTS_REF CA_EngSpd9Step1 MAX_GRAD 0.0 /end AXIS_DESCR
/end CHARACTERISTIC
/begin CHARACTERISTIC C_MapBaroUsed "cal comments" VALUE 0xB57B Scalar_UB 0.0 CM_Boolean4 0.0 1.0 /end CHARACTERISTIC
/begin CHARACTERISTIC CT_BaroUpdtEngRunOfstMain "cal comments" MAP 0xB5AD 3D_Array_UB 0.0 CM_kpa_8bit 0.0 127.5
 /begin AXIS_DESCR FIX_AXIS NO_INPUT_QUANTITY CM_Equaloutput1 9 0.0 100.0 MAX_GRAD 0.0 /begin FIX_AXIS_PAR_LIST 0 12.5 25 37.5 50 62.5 75 87.5 100 /end FIX_AXIS_PAR_LIST /end AXIS_DESCR
 /begin AXIS_DESCR COM_AXIS NO_INPUT_QUANTITY CM_RPM_0to16384 9 0.0 16383.75 AXIS_PTS_REF CA_EngSpd9Step1 MAX_GRAD 0.0 /end AXIS_DESCR
/end CHARACTERISTIC
/begin CHARACTERISTIC CT_BaroUpdtEngRunTPSMaxThresh "cal comments" CURVE 0xB597 2D_Array_UB 0.0 CM_Percent_0to200_3 0.0 199.21875
 /begin AXIS_DESCR COM_AXIS NO_INPUT_QUANTITY CM_RPM_0to16384 17 0.0 16383.75 AXIS_PTS_REF CA_EngSpd17Step1 MAX_GRAD 0.0 /end AXIS_DESCR
/end CHARACTERISTIC
/begin CHARACTERISTIC CT_BaroUpdtEngRunTPSMinThresh "cal comments" CURVE 0xB584 2D_Array_UB 0.0 CM_Percent_0to200_3 0.0 199.21875
 /begin AXIS_DESCR COM_AXIS NO_INPUT_QUANTITY CM_RPM_0to16384 17 0.0 16383.75 AXIS_PTS_REF CA_EngSpd17Step1 MAX_GRAD 0.0 /end AXIS_DESCR
/end CHARACTERISTIC
/begin CHARACTERISTIC CT_CATFactorCLTIATCorr "cal comments" MAP 0x8F97 D_Array_SB 0.0 CM_Ratio_n2to2 -2.0 1.984375
 /begin AXIS_DESCR FIX_AXIS NO_INPUT_QUANTITY CM_Equaloutput1 6 -28.0 92.0 MAX_GRAD 0.0 /begin FIX_AXIS_PAR_LIST -28 -4 20 44 68 92 /end FIX_AXIS_PAR_LIST /end AXIS_DESCR
 /begin AXIS_DESCR FIX_AXIS NO_INPUT_QUANTITY CM_Equaloutput1 9 -28.0 164.0 MAX_GRAD 0.0 /begin FIX_AXIS_PAR_LIST -28 -4 20 44 68 92 116 140 164 /end FIX_AXIS_PAR_LIST /end AXIS_DESCR
/end CHARACTERISTIC
/begin CHARACTERISTIC CT_ChargeAirTempFactorCyl1 "cal comments" MAP 0x8339 D_Array_SB 0.0 CM_Ratio_n2to2 -2.0 1.984375
 /begin AXIS_DESCR FIX_AXIS NO_INPUT_QUANTITY CM_Equaloutput1 9 25.0 105.0 MAX_GRAD 0.0 /begin FIX_AXIS_PAR_LIST 25 35 45 55 65 75 85 95 105 /end FIX_AXIS_PAR_LIST /end AXIS_DESCR
 /begin AXIS_DESCR COM_AXIS NO_INPUT_QUANTITY CM_RPM_0to16384 10 0.0 16383.75 AXIS_PTS_REF CA_EngSpd10Step1 MAX_GRAD 0.0 /end AXIS_DESCR
/end CHARACTERISTIC
/begin CHARACTERISTIC CT_ColdEngFPWMultIdle "cal comments" CURVE 0x94DC 2D_Array_UB 0.0 CM_Mult0_to_2_ratio 0.0 1.9921875
 /begin AXIS_DESCR FIX_AXIS NO_INPUT_QUANTITY CM_Equaloutput1 17 -28.0 164.0 MAX_GRAD 0.0 /begin FIX_AXIS_PAR_LIST -28 -16 -4 8 20 32 44 56 68 80 92 104 116 128 140 152 164 /end FIX_AXIS_PAR_LIST /end AXIS_DESCR
/end CHARACTERISTIC
/begin CHARACTERISTIC CT_ColdEngFPWMultRun "cal comments" CURVE 0x94EF 2D_Array_UB 0.0 CM_Mult0_to_2_ratio 0.0 1.9921875
 /begin AXIS_DESCR FIX_AXIS NO_INPUT_QUANTITY CM_Equaloutput1 17 -28.0 164.0 MAX_GRAD 0.0 /begin FIX_AXIS_PAR_LIST -28 -16 -4 8 20 32 44 56 68 80 92 104 116 128 140 152 164 /end FIX_AXIS_PAR_LIST /end AXIS_DESCR
/end CHARACTERISTIC
/begin CHARACTERISTIC CT_ColdEngFPWMult_NG "cal comments" CURVE 0x9502 2D_Array_UB 0.0 CM_Mult0_to_2_ratio 0.0 1.9921875
 /begin AXIS_DESCR FIX_AXIS NO_INPUT_QUANTITY CM_Equaloutput1 17 -28.0 164.0 MAX_GRAD 0.0 /begin FIX_AXIS_PAR_LIST -28 -16 -4 8 20 32 44 56 68 80 92 104 116 128 140 152 164 /end FIX_AXIS_PAR_LIST /end AXIS_DESCR
/end CHARACTERISTIC
/begin CHARACTERISTIC CT_ColdEngFPWMult_LPG "cal comments" CURVE 0x9515 2D_Array_UB 0.0 CM_Mult0_to_2_ratio 0.0 1.9921875
 /begin AXIS_DESCR FIX_AXIS NO_INPUT_QUANTITY CM_Equaloutput1 17 -28.0 164.0 MAX_GRAD 0.0 /begin FIX_AXIS_PAR_LIST -28 -16 -4 8 20 32 44 56 68 80 92 104 116 128 140 152 164 /end FIX_AXIS_PAR_LIST /end AXIS_DESCR
/end CHARACTERISTIC
/begin CHARACTERISTIC CT_CoolantTemp "cal comments" CURVE 0xB48E 2D_Array_SW 0.0 CM_DegC_N256to256 -256.0 255.9921875
 /begin AXIS_DESCR FIX_AXIS NO_INPUT_QUANTITY CM_Equaloutput1 33 0.0 100.0 MAX_GRAD 0.0
  /begin FIX_AXIS_PAR_LIST 0 3.125 6.25 9.375 12.5 15.625 18.75 21.875 25 28.125 31.25 34.375 37.5 40.625 43.75 46.875 50 53.125 56.25 59.375 62.5 65.625 68.75 71.875 75 78.125 81.25 84.375 87.5 90.625 93.75 96.875 100 /end FIX_AXIS_PAR_LIST
 /end AXIS_DESCR
/end CHARACTERISTIC
/begin CHARACTERISTIC CT_CoolantTempEx "cal comments" CURVE 0x2 2D_Array_SW 0.0 CM_DegC_N256to256 -256.0 255.9921875
 /begin AXIS_DESCR COM_AXIS NO_INPUT_QUANTITY CM_Percent_0to100_1 33 0.0 99.9984130859375 AXIS_PTS_REF CA_PercentStep33 MAX_GRAD 0.0 /end AXIS_DESCR
/end CHARACTERISTIC
/begin CHARACTERISTIC CT_DecEnleanDecayFactorCoolTemp "cal comments" CURVE 0x96A3 2D_Array_UB 0.0 CM_Mult_0to1 0.0 0.99609375
 /begin AXIS_DESCR FIX_AXIS NO_INPUT_QUANTITY CM_Equaloutput1 17 -28.0 164.0 MAX_GRAD 0.0 /begin FIX_AXIS_PAR_LIST -28 -16 -4 8 20 32 44 56 68 80 92 104 116 128 140 152 164 /end FIX_AXIS_PAR_LIST /end AXIS_DESCR
/end CHARACTERISTIC
/begin CHARACTERISTIC CT_DecEnleanDecayFactorEngSpd "cal comments" CURVE 0x93FA 2D_Array_UB 0.0 CM_Mult_0to1_2 0.0 0.99609375
 /begin AXIS_DESCR COM_AXIS NO_INPUT_QUANTITY CM_RPM_0to16384 17 0.0 16383.75 AXIS_PTS_REF CA_EngSpd17Step1 MAX_GRAD 0.0 /end AXIS_DESCR
/end CHARACTERISTIC
/begin CHARACTERISTIC CT_DEDeltaFuelMultBase "cal comments" CURVE 0x9434 2D_Array_UW 0.0 CM_Grams0to8 0.0 7.999755859375
 /begin AXIS_DESCR FIX_AXIS NO_INPUT_QUANTITY CM_Equaloutput1 18 0.0 1.700000092387199e-002 MAX_GRAD 0.0
  /begin FIX_AXIS_PAR_LIST 0 1.e-003 2.e-003 3.e-003 4.e-003 5.e-003 6.e-003 7.e-003 8.e-003 8.999999999999999e-003 1.e-002 1.1e-002 1.2e-002 1.3e-002 1.4e-002 1.5e-002 1.6e-002 1.7e-002 /end FIX_AXIS_PAR_LIST
 /end AXIS_DESCR
/end CHARACTERISTIC
/begin CHARACTERISTIC CT_DEDeltaFuelMultCoolTemp "cal comments" CURVE 0x96C9 2D_Array_UB 0.0 CM_mult_0to4 0.0 3.984375
 /begin AXIS_DESCR FIX_AXIS NO_INPUT_QUANTITY CM_Equaloutput1 17 -28.0 164.0 MAX_GRAD 0.0 /begin FIX_AXIS_PAR_LIST -28 -16 -4 8 20 32 44 56 68 80 92 104 116 128 140 152 164 /end FIX_AXIS_PAR_LIST /end AXIS_DESCR
/end CHARACTERISTIC
/begin CHARACTERISTIC CT_DEDeltaFuelMultSpeedLoad "cal comments" MAP 0x9486 3D_Array_UB 0.0 CM_Grams0to2 0.0 1.9921875
 /begin AXIS_DESCR COM_AXIS NO_INPUT_QUANTITY CM_RPM_0to16384 4 0.0 16383.75 AXIS_PTS_REF CA_EngSpd4Step1 MAX_GRAD 0.0 /end AXIS_DESCR
 /begin AXIS_DESCR FIX_AXIS NO_INPUT_QUANTITY CM_Equaloutput1 10 15.0 105.0 MAX_GRAD 0.0 /begin FIX_AXIS_PAR_LIST 15 25 35 45 55 65 75 85 95 105 /end FIX_AXIS_PAR_LIST /end AXIS_DESCR
/end CHARACTERISTIC
/begin CHARACTERISTIC CT_DefaultTPS "cal comments" CURVE 0xB41A 2D_Array_UW 0.0 CM_Percent_0to200_2 0.0 199.9969024658203
 /begin AXIS_DESCR FIX_AXIS NO_INPUT_QUANTITY CM_Equaloutput1 17 0.0 6400.0 MAX_GRAD 0.0
  /begin FIX_AXIS_PAR_LIST 0 400 800 1200 1600 2000 2400 2800 3200 3600 4000 4400 4800 5200 5600 6000 6400 /end FIX_AXIS_PAR_LIST
 /end AXIS_DESCR
/end CHARACTERISTIC
/begin CHARACTERISTIC CT_DesireEngineSpeed "cal comments" CURVE 0x9C2E 2D_Array_UW 0.0 udf_CM_18586 0.0 16383.75
 /begin AXIS_DESCR FIX_AXIS NO_INPUT_QUANTITY CM_Equaloutput1 5 1.0 5.0 MAX_GRAD 0.0 /begin FIX_AXIS_PAR_LIST 1 2 3 4 5 /end FIX_AXIS_PAR_LIST /end AXIS_DESCR
/end CHARACTERISTIC
/begin CHARACTERISTIC CT_DesireEngSpdLinear1 "cal comments" CURVE 0x9C44 2D_Array_UW 0.0 CM_RPM_0to16384 0.0 16383.75
 /begin AXIS_DESCR COM_AXIS NO_INPUT_QUANTITY CM_Percent_0to200_2 4 0.0 199.9969024658203 AXIS_PTS_REF CA_Percent2 MAX_GRAD 0.0 /end AXIS_DESCR
/end CHARACTERISTIC
/begin CHARACTERISTIC CT_DesireEngSpdLinear2 "cal comments" CURVE 0x9C4E 2D_Array_UW 0.0 CM_RPM_0to16384 0.0 16383.75
 /begin AXIS_DESCR COM_AXIS NO_INPUT_QUANTITY CM_Percent_0to200_2 4 0.0 199.9969024658203 AXIS_PTS_REF CA_Percent2 MAX_GRAD 0.0 /end AXIS_DESCR
/end CHARACTERISTIC
/begin CHARACTERISTIC CT_DsrdEngSpdLinear1_NG "cal comments" CURVE 0x9C58 2D_Array_UW 0.0 CM_RPM_0to16384 0.0 16383.75
 /begin AXIS_DESCR COM_AXIS NO_INPUT_QUANTITY CM_Percent_0to200_2 4 0.0 199.9969024658203 AXIS_PTS_REF CA_Percent2 MAX_GRAD 0.0 /end AXIS_DESCR
/end CHARACTERISTIC
/begin CHARACTERISTIC CT_DsrdEngSpdLinear2_NG "cal comments" CURVE 0x9C62 2D_Array_UW 0.0 CM_RPM_0to16384 0.0 16383.75
 /begin AXIS_DESCR COM_AXIS NO_INPUT_QUANTITY CM_Percent_0to200_2 4 0.0 199.9969024658203 AXIS_PTS_REF CA_Percent2 MAX_GRAD 0.0 /end AXIS_DESCR
/end CHARACTERISTIC
/begin CHARACTERISTIC CT_DsrdEngSpdLinear1_LPG "cal comments" CURVE 0x9C6C 2D_Array_UW 0.0 CM_RPM_0to16384 0.0 16383.75
 /begin AXIS_DESCR COM_AXIS NO_INPUT_QUANTITY CM_Percent_0to200_2 4 0.0 199.9969024658203 AXIS_PTS_REF CA_Percent2 MAX_GRAD 0.0 /end AXIS_DESCR
/end CHARACTERISTIC
/begin CHARACTERISTIC CT_DsrdEngSpdLinear2_LPG "cal comments" CURVE 0x9C76 2D_Array_UW 0.0 CM_RPM_0to16384 0.0 16383.75
 /begin AXIS_DESCR COM_AXIS NO_INPUT_QUANTITY CM_Percent_0to200_2 4 0.0 199.9969024658203 AXIS_PTS_REF CA_Percent2 MAX_GRAD 0.0 /end AXIS_DESCR
/end CHARACTERISTIC
/begin CHARACTERISTIC CT_EstimatedTorque "cal comments" MAP 0x4 udf_RL_19771 0.0 udf_CM_18544 -128.0 127.99609375
 /begin AXIS_DESCR COM_AXIS NO_INPUT_QUANTITY CM_kpa_0to256_1 18 0.0 255.99609375 AXIS_PTS_REF CA_MAP18Step1 MAX_GRAD 0.0 /end AXIS_DESCR
 /begin AXIS_DESCR COM_AXIS NO_INPUT_QUANTITY CM_RPM_0to16384 17 0.0 16383.75 AXIS_PTS_REF CA_EngSpd17Step1 MAX_GRAD 0.0 /end AXIS_DESCR
/end CHARACTERISTIC
/begin CHARACTERISTIC CT_FPWCorrFactorForFPVolt "cal comments" CURVE 0x9331 2D_Array_UB 0.0 CM_Mult0_to_2_ratio 0.0 1.9921875
 /begin AXIS_DESCR FIX_AXIS NO_INPUT_QUANTITY CM_Equaloutput1 9 6.400000095367432 19.20000076293945 MAX_GRAD 0.0 /begin FIX_AXIS_PAR_LIST 6.4 8 9.6 11.2 12.8 14.4 16 17.6 19.2 /end FIX_AXIS_PAR_LIST /end AXIS_DESCR
/end CHARACTERISTIC
/begin CHARACTERISTIC CT_FPWCorrFactorForFPVoltGas "cal comments" CURVE 0x933C 2D_Array_UB 0.0 CM_Mult0_to_2_ratio 0.0 1.9921875
 /begin AXIS_DESCR FIX_AXIS NO_INPUT_QUANTITY CM_Equaloutput1 9 6.400000095367432 19.20000076293945 MAX_GRAD 0.0 /begin FIX_AXIS_PAR_LIST 6.4 8 9.6 11.2 12.8 14.4 16 17.6 19.2 /end FIX_AXIS_PAR_LIST /end AXIS_DESCR
/end CHARACTERISTIC
/begin CHARACTERISTIC CT_FPWCorrFactorForFuelPressure_NG "cal comments" MAP 0x9348 3D_Array_UB 0.0 CM_Mult0_to_4_ratio 0.0 3.984375
 /begin AXIS_DESCR COM_AXIS NO_INPUT_QUANTITY CM_kpa_0to256_1 9 0.0 255.99609375 AXIS_PTS_REF CA_MAP9Step1 MAX_GRAD 0.0 /end AXIS_DESCR
 /begin AXIS_DESCR COM_AXIS NO_INPUT_QUANTITY CM_kpa_n256to256_1 8 -256 255.9921875 AXIS_PTS_REF CA_MAP8Step1 MAX_GRAD 0.0 /end AXIS_DESCR
/end CHARACTERISTIC
/begin CHARACTERISTIC CT_FPWCorrFactorForFuelPressure_LPG "cal comments" MAP 0x9393 3D_Array_UB 0.0 CM_Mult0_to_4_ratio 0.0 3.984375
 /begin AXIS_DESCR COM_AXIS NO_INPUT_QUANTITY CM_kpa_0to256_1 9 0.0 255.99609375 AXIS_PTS_REF CA_MAP9Step1 MAX_GRAD 0.0 /end AXIS_DESCR
 /begin AXIS_DESCR COM_AXIS NO_INPUT_QUANTITY CM_kpa_n256to256_1 8 -256 255.9921875 AXIS_PTS_REF CA_MAP8Step1 MAX_GRAD 0.0 /end AXIS_DESCR
/end CHARACTERISTIC
/begin CHARACTERISTIC CT_FuelCLEnbCoolTempThrsh "cal comments" CURVE 0x984A 2D_Array_SW 0.0 CM_DegC_N256to256 -256.0 255.9921875
 /begin AXIS_DESCR FIX_AXIS NO_INPUT_QUANTITY CM_Equaloutput1 17 -28.0 164.0 MAX_GRAD 0.0 /begin FIX_AXIS_PAR_LIST -28 -16 -4 8 20 32 44 56 68 80 92 104 116 128 140 152 164 /end FIX_AXIS_PAR_LIST /end AXIS_DESCR
/end CHARACTERISTIC
/begin CHARACTERISTIC CT_FuelCLIntDelayO2ErrMult "cal comments" CURVE 0x9904 2D_Array_UB 0.0 CM_Mult_0to1_2 0.0 0.99609375
 /begin AXIS_DESCR FIX_AXIS NO_INPUT_QUANTITY CM_Equaloutput1 6 0.0 347.5 MAX_GRAD 0.0 /begin FIX_AXIS_PAR_LIST 0 69.5 139 208.5 278 347.5 /end FIX_AXIS_PAR_LIST /end AXIS_DESCR
/end CHARACTERISTIC
/begin CHARACTERISTIC CT_FuelCLIntLearningDelay "cal comments" CURVE 0x98FE 2D_Array_UB 0.0 CM_Second_0to4 0.0 3.984375
 /begin AXIS_DESCR COM_AXIS NO_INPUT_QUANTITY CM_RPM_0to16384 4 0.0 16383.75 AXIS_PTS_REF CA_EngSpd4Step1 MAX_GRAD 0.0 /end AXIS_DESCR
/end CHARACTERISTIC
/begin CHARACTERISTIC C_FuelEOICrank "cal comments" VALUE 0x9306 Scalar_UW 0.0 CM_CrankAngle_0to1024 0.0 1023.984375 /end CHARACTERISTIC
/begin CHARACTERISTIC CT_FuelEOIRun "cal comments" CURVE 0x930A 2D_Array_UW 0.0 CM_CrankAngle_0to1024 0.0 1023.984375
 /begin AXIS_DESCR COM_AXIS NO_INPUT_QUANTITY CM_RPM_0to16384 6 0.0 16383.75 AXIS_PTS_REF CA_EngSpd6Step2 MAX_GRAD 0.0 /end AXIS_DESCR
/end CHARACTERISTIC
/begin CHARACTERISTIC CT_FuelEOIRunGas "cal comments" CURVE 0x9318 2D_Array_UW 0.0 CM_CrankAngle_0to1024 0.0 1023.984375
 /begin AXIS_DESCR COM_AXIS NO_INPUT_QUANTITY CM_RPM_0to16384 6 0.0 16383.75 AXIS_PTS_REF CA_EngSpd6Step2 MAX_GRAD 0.0 /end AXIS_DESCR
/end CHARACTERISTIC
/begin CHARACTERISTIC C_FuelEOITrimPulse "cal comments" VALUE 0x9A0A Scalar_UW 0.0 CM_CrankAngle_0to1024 0.0 1023.984375 /end CHARACTERISTIC
/begin CHARACTERISTIC C_TrimPulseBeforeCIDsucceed "cal comments" VALUE 0x9A0C Scalar_UB 0.0 CM_Boolean1 0.0 1.0 /end CHARACTERISTIC
/begin CHARACTERISTIC C_TrimPulseEnbTPSThresh "cal comments" VALUE 0x9A0E Scalar_UW 0.0 CM_Percent_0to200_2 0.0 199.9969024658203 /end CHARACTERISTIC
/begin CHARACTERISTIC CT_FuelO2RichLeanThreshBase "cal comments" MAP 0x987D 3D_Array_UB 0.0 CM_mVolt 0.0 1016.0
 /begin AXIS_DESCR COM_AXIS NO_INPUT_QUANTITY CM_kpa_0to256_1 9 0.0 255.99609375 AXIS_PTS_REF CA_MAP9Step3 MAX_GRAD 0.0 /end AXIS_DESCR
 /begin AXIS_DESCR COM_AXIS NO_INPUT_QUANTITY CM_RPM_0to16384 4 0.0 16383.75 AXIS_PTS_REF CA_EngSpd4Step1 MAX_GRAD 0.0 /end AXIS_DESCR
/end CHARACTERISTIC
/begin CHARACTERISTIC CT_FuelO2RichLeanThreshBase_NG "cal comments" MAP 0x98A4 3D_Array_UB 0.0 CM_mVolt 0.0 1016.0
 /begin AXIS_DESCR COM_AXIS NO_INPUT_QUANTITY CM_kpa_0to256_1 9 0.0 255.99609375 AXIS_PTS_REF CA_MAP9Step3 MAX_GRAD 0.0 /end AXIS_DESCR
 /begin AXIS_DESCR COM_AXIS NO_INPUT_QUANTITY CM_RPM_0to16384 4 0.0 16383.75 AXIS_PTS_REF CA_EngSpd4Step1 MAX_GRAD 0.0 /end AXIS_DESCR
/end CHARACTERISTIC
/begin CHARACTERISTIC CT_FuelO2RichLeanThreshBase_LPG "cal comments" MAP 0x98CB 3D_Array_UB 0.0 CM_mVolt 0.0 1016.0
 /begin AXIS_DESCR COM_AXIS NO_INPUT_QUANTITY CM_kpa_0to256_1 9 0.0 255.99609375 AXIS_PTS_REF CA_MAP9Step3 MAX_GRAD 0.0 /end AXIS_DESCR
 /begin AXIS_DESCR COM_AXIS NO_INPUT_QUANTITY CM_RPM_0to16384 4 0.0 16383.75 AXIS_PTS_REF CA_EngSpd4Step1 MAX_GRAD 0.0 /end AXIS_DESCR
/end CHARACTERISTIC
/begin CHARACTERISTIC CT_FuelPropLeanToRich "cal comments" MAP 0x995E 3D_Array_UB 0.0 CM_Percent_0to100 0.0 99.609375
 /begin AXIS_DESCR COM_AXIS NO_INPUT_QUANTITY CM_kpa_0to256_1 9 0.0 255.99609375 AXIS_PTS_REF CA_MAP9Step3 MAX_GRAD 0.0 /end AXIS_DESCR
 /begin AXIS_DESCR COM_AXIS NO_INPUT_QUANTITY CM_RPM_0to16384 4 0.0 16383.75 AXIS_PTS_REF CA_EngSpd4Step1 MAX_GRAD 0.0 /end AXIS_DESCR
/end CHARACTERISTIC
/begin CHARACTERISTIC CT_FuelPropMinDuration "cal comments" CURVE 0x9986 2D_Array_UB 0.0 CM_Second_0to4 0.0 3.984375
 /begin AXIS_DESCR COM_AXIS NO_INPUT_QUANTITY CM_RPM_0to16384 4 0.0 16383.75 AXIS_PTS_REF CA_EngSpd4Step1 MAX_GRAD 0.0 /end AXIS_DESCR
/end CHARACTERISTIC
/begin CHARACTERISTIC CT_FuelPropO2ErrMult "cal comments" CURVE 0x9918 2D_Array_UW 0.0 CM_FactorRatio 0.0 0.9999847412109375
 /begin AXIS_DESCR FIX_AXIS NO_INPUT_QUANTITY CM_Equaloutput1 6 0.0 347.5 MAX_GRAD 0.0 /begin FIX_AXIS_PAR_LIST 0 69.5 139 208.5 278 347.5 /end FIX_AXIS_PAR_LIST /end AXIS_DESCR
/end CHARACTERISTIC
/begin CHARACTERISTIC CT_FuelPropRichBiasHoldTimeGain "cal comments" CURVE 0x998C 2D_Array_UB 0.0 CM_Mult0_to_2_ratio 0.0 1.9921875
 /begin AXIS_DESCR COM_AXIS NO_INPUT_QUANTITY CM_RPM_0to16384 4 0.0 16383.75 AXIS_PTS_REF CA_EngSpd4Step1 MAX_GRAD 0.0 /end AXIS_DESCR
/end CHARACTERISTIC
/begin CHARACTERISTIC CT_FuelPropRichToLean "cal comments" MAP 0x9937 3D_Array_UB 0.0 CM_Percent_0to100 0.0 99.609375
 /begin AXIS_DESCR COM_AXIS NO_INPUT_QUANTITY CM_kpa_0to256_1 9 0.0 255.99609375 AXIS_PTS_REF CA_MAP9Step3 MAX_GRAD 0.0 /end AXIS_DESCR
 /begin AXIS_DESCR COM_AXIS NO_INPUT_QUANTITY CM_RPM_0to16384 4 0.0 16383.75 AXIS_PTS_REF CA_EngSpd4Step1 MAX_GRAD 0.0 /end AXIS_DESCR
/end CHARACTERISTIC
/begin CHARACTERISTIC CT_FuelPumpDutyCycle "cal comments" CURVE 0x92F4 2D_Array_UB 0.0 CM_Percent_0to100 0.0 99.609375
 /begin AXIS_DESCR FIX_AXIS NO_INPUT_QUANTITY CM_Equaloutput1 17 6.0 18.79999923706055 MAX_GRAD 0.0
  /begin FIX_AXIS_PAR_LIST 6 6.8 7.6 8.4 9.199999999999999 10 10.8 11.6 12.4 13.2 14 14.8 15.6 16.4 17.2 18 18.8 /end FIX_AXIS_PAR_LIST
 /end AXIS_DESCR
/end CHARACTERISTIC
/begin CHARACTERISTIC CT_FuelPumpWorkTimeForPP "cal comments" CURVE 0x9246 2D_Array_UW 0.0 CM_Second_0to512 0.0 511.9921875
 /begin AXIS_DESCR FIX_AXIS NO_INPUT_QUANTITY CM_Equaloutput1 17 -28.0 164.0 MAX_GRAD 0.0 /begin FIX_AXIS_PAR_LIST -28 -16 -4 8 20 32 44 56 68 80 92 104 116 128 140 152 164 /end FIX_AXIS_PAR_LIST /end AXIS_DESCR
/end CHARACTERISTIC
/begin CHARACTERISTIC C_BLM_Enb "cal comments" VALUE 0x97C2 Scalar_UB 0.0 CM_Boolean4 0.0 1.0 /end CHARACTERISTIC
/begin CHARACTERISTIC C_BLM_FCV_Enb "cal comments" VALUE 0x97C3 Scalar_UB 0.0 CM_Boolean4 0.0 1.0 /end CHARACTERISTIC
/begin CHARACTERISTIC C_BLM_CellRst "cal comments" VALUE 0x97C4 Scalar_UB 0.0 CM_Boolean4 0.0 1.0 /end CHARACTERISTIC
/begin CHARACTERISTIC C_BLM_AllRst "cal comments" VALUE 0x97C5 Scalar_UB 0.0 CM_Boolean4 0.0 1.0 /end CHARACTERISTIC
/begin CHARACTERISTIC C_BLM_RstValue "cal comments" VALUE 0x97C6 Scalar_UW 0.0 CM_Ratio_0to2_2 0.0 1.999969482421875 /end CHARACTERISTIC
/begin CHARACTERISTIC C_BLM_CoolTempMin "cal comments" VALUE 0x97DE Scalar_SW 0.0 CM_DegC_N256to256 -256.0 255.9921875 /end CHARACTERISTIC
/begin CHARACTERISTIC C_BLM_CoolTempMax "cal comments" VALUE 0x97E0 Scalar_SW 0.0 CM_DegC_N256to256 -256.0 255.9921875 /end CHARACTERISTIC
/begin CHARACTERISTIC C_BLM_LrnLeanThrsh "cal comments" VALUE 0x97E2 Scalar_SW 0.0 CM_SignedWord_n32768to32768_2 -32768.0 32766.0 /end CHARACTERISTIC
/begin CHARACTERISTIC C_BLM_LrnRichThrsh "cal comments" VALUE 0x97E4 Scalar_SW 0.0 CM_SignedWord_n32768to32768_2 -32768.0 32766.0 /end CHARACTERISTIC
/begin CHARACTERISTIC C_BLM_LrnStep "cal comments" VALUE 0x97E6 Scalar_UW 0.0 CM_Ratio_0to2_2 0.0 1.999969482421875 /end CHARACTERISTIC
/begin CHARACTERISTIC C_BLM_LrnMax "cal comments" VALUE 0x97E8 Scalar_UW 0.0 CM_Ratio_0to2_2 0.0 1.999969482421875 /end CHARACTERISTIC
/begin CHARACTERISTIC C_BLM_LrnMin "cal comments" VALUE 0x97EA Scalar_UW 0.0 CM_Ratio_0to2_2 0.0 1.999969482421875 /end CHARACTERISTIC
/begin CHARACTERISTIC C_BLM_RowDiffMax "cal comments" VALUE 0x9800 Scalar_UW 0.0 CM_Ratio_0to2_2 0.0 1.999969482421875 /end CHARACTERISTIC
/begin CHARACTERISTIC CT_BLM_ColDiffMax_NG "cal comments" CURVE 0x9802 Scalar_UW 0.0 CM_Ratio_0to2_2 0.0 1.999969482421875
 /begin AXIS_DESCR FIX_AXIS NO_INPUT_QUANTITY CM_Equaloutput1 16 0.0 16.0 MAX_GRAD 0.0 /begin FIX_AXIS_PAR_LIST 0 1 2 3 4 5 6 7 8 9 10 11 12 13 14 15 /end FIX_AXIS_PAR_LIST /end AXIS_DESCR
/end CHARACTERISTIC
/begin CHARACTERISTIC CT_BLM_ColDiffMax_LPG "cal comments" CURVE 0x9822 Scalar_UW 0.0 CM_Ratio_0to2_2 0.0 1.999969482421875
 /begin AXIS_DESCR FIX_AXIS NO_INPUT_QUANTITY CM_Equaloutput1 16 0.0 16.0 MAX_GRAD 0.0 /begin FIX_AXIS_PAR_LIST 0 1 2 3 4 5 6 7 8 9 10 11 12 13 14 15 /end FIX_AXIS_PAR_LIST /end AXIS_DESCR
/end CHARACTERISTIC
/begin CHARACTERISTIC C_BLM_AirFlowMin_NG "cal comments" VALUE 0x97C8 Scalar_UW 0.0 CM_GramPerSecond_1 0.0 511.9921875 /end CHARACTERISTIC
/begin CHARACTERISTIC C_BLM_AirFlowMin_LPG "cal comments" VALUE 0x97CA Scalar_UW 0.0 CM_GramPerSecond_1 0.0 511.9921875 /end CHARACTERISTIC
/begin CHARACTERISTIC C_BLM_AirFlowMax "cal comments" VALUE 0x97CC Scalar_UW 0.0 CM_GramPerSecond_1 0.0 511.9921875 /end CHARACTERISTIC
/begin CHARACTERISTIC C_BLM_AirFlowHyst "cal comments" VALUE 0x97CE Scalar_UW 0.0 CM_GramPerSecond_1 0.0 511.9921875 /end CHARACTERISTIC
/begin CHARACTERISTIC C_BLM_AirFlowDelta "cal comments" VALUE 0x97D0 Scalar_UW 0.0 CM_GramPerSecond_1 0.0 511.9921875 /end CHARACTERISTIC
/begin CHARACTERISTIC C_BLM_EngSpeedMin "cal comments" VALUE 0x97D4 Scalar_UW 0.0 CM_RPM_0to16384 0.0 16383.75 /end CHARACTERISTIC
/begin CHARACTERISTIC C_BLM_EngSpeedMax "cal comments" VALUE 0x97D6 Scalar_UW 0.0 CM_RPM_0to16384 0.0 16383.75 /end CHARACTERISTIC
/begin CHARACTERISTIC C_BLM_EngSpeedHyst "cal comments" VALUE 0x97D8 Scalar_UW 0.0 CM_RPM_0to16384 0.0 16383.75 /end CHARACTERISTIC
/begin CHARACTERISTIC C_BLM_EngSpeedDelta "cal comments" VALUE 0x97DA Scalar_UW 0.0 CM_RPM_0to16384 0.0 16383.75 /end CHARACTERISTIC
/begin CHARACTERISTIC C_BLM_AirFlowCoef "cal comments" VALUE 0x97D2 Scalar_UW 0.0 CM_FiltCoef 0.0 0.9999847412109375 /end CHARACTERISTIC
/begin CHARACTERISTIC C_BLM_EngSpeedCoef "cal comments" VALUE 0x97DC Scalar_UW 0.0 CM_FiltCoef 0.0 0.9999847412109375 /end CHARACTERISTIC
/begin CHARACTERISTIC CT_BLM_LrnDelay "cal comments" CURVE 0x97EE Scalar_UW 0.0 CM_Second_0to4096 0.0 4095.9375
 /begin AXIS_DESCR FIX_AXIS NO_INPUT_QUANTITY CM_Equaloutput1 9 0 32 MAX_GRAD 0.0 /begin FIX_AXIS_PAR_LIST 0 4 8 12 16 20 24 28 32 /end FIX_AXIS_PAR_LIST /end AXIS_DESCR
/end CHARACTERISTIC
/begin CHARACTERISTIC CT_IdleAirflowColdOffset "cal comments" CURVE 0x9D0E 2D_Array_UB 0.0 CM_Percent_0to100 0.0 99.609375
 /begin AXIS_DESCR FIX_AXIS NO_INPUT_QUANTITY CM_Equaloutput1 17 -28.0 164.0 MAX_GRAD 0.0 /begin FIX_AXIS_PAR_LIST -28 -16 -4 8 20 32 44 56 68 80 92 104 116 128 140 152 164 /end FIX_AXIS_PAR_LIST /end AXIS_DESCR
/end CHARACTERISTIC
/begin CHARACTERISTIC CT_IdleDerivEngSpdHigh "cal comments" CURVE 0x2 2D_Array_UB 0.0 CM_Percent_0to100 0.0 99.609375
 /begin AXIS_DESCR FIX_AXIS NO_INPUT_QUANTITY CM_Equaloutput1 17 0.0 128.0 MAX_GRAD 0.0 /begin FIX_AXIS_PAR_LIST 0 8 16 24 32 40 48 56 64 72 80 88 96 104 112 120 128 /end FIX_AXIS_PAR_LIST /end AXIS_DESCR
/end CHARACTERISTIC
/begin CHARACTERISTIC CT_IdleDerivEngSpdLow "cal comments" CURVE 0x2 2D_Array_UB 0.0 CM_Percent_0to100 0.0 99.609375
 /begin AXIS_DESCR FIX_AXIS NO_INPUT_QUANTITY CM_Equaloutput1 17 0.0 128.0 MAX_GRAD 0.0 /begin FIX_AXIS_PAR_LIST 0 8 16 24 32 40 48 56 64 72 80 88 96 104 112 120 128 /end FIX_AXIS_PAR_LIST /end AXIS_DESCR
/end CHARACTERISTIC
/begin CHARACTERISTIC C_IdleDesireSpdStartup "cal comments" VALUE 0x9C8A Scalar_UW 0.0 udf_CM_18586 0.0 16383.75 /end CHARACTERISTIC
/begin CHARACTERISTIC CT_IdleIntGainEngSpdHigh "cal comments" CURVE 0x2 2D_Array_UB 0.0 CM_Mult0_to_2_ratio1 0.0 1.9921875
 /begin AXIS_DESCR COM_AXIS NO_INPUT_QUANTITY CM_RPM_0to16384 11 0.0 16383.75 AXIS_PTS_REF CA_EngSpd11Step2 MAX_GRAD 0.0 /end AXIS_DESCR
/end CHARACTERISTIC
/begin CHARACTERISTIC CT_IdleIntGainEngSpdLow "cal comments" CURVE 0x2 2D_Array_UB 0.0 CM_Mult0_to_2_ratio1 0.0 1.9921875
 /begin AXIS_DESCR COM_AXIS NO_INPUT_QUANTITY CM_RPM_0to16384 11 0.0 16383.75 AXIS_PTS_REF CA_EngSpd11Step2 MAX_GRAD 0.0 /end AXIS_DESCR
/end CHARACTERISTIC
/begin CHARACTERISTIC CT_IdlePropEngSpdHigh "cal comments" CURVE 0x2 2D_Array_UB 0.0 CM_Percent_0to100 0.0 99.609375
 /begin AXIS_DESCR COM_AXIS NO_INPUT_QUANTITY CM_RPM_0to16384 17 0.0 16383.75 AXIS_PTS_REF CA_EngSpd17Step4 MAX_GRAD 0.0 /end AXIS_DESCR
/end CHARACTERISTIC
/begin CHARACTERISTIC CT_IdlePropEngSpdLow "cal comments" CURVE 0x2 2D_Array_UB 0.0 CM_Percent_0to100 0.0 99.609375
 /begin AXIS_DESCR COM_AXIS NO_INPUT_QUANTITY CM_RPM_0to16384 17 0.0 16383.75 AXIS_PTS_REF CA_EngSpd17Step4 MAX_GRAD 0.0 /end AXIS_DESCR
/end CHARACTERISTIC
/begin CHARACTERISTIC CT_InjectorOffset "cal comments" CURVE 0x9326 2D_Array_UB 0.0 CM_msec_0to4 0.0 3.984375
 /begin AXIS_DESCR FIX_AXIS NO_INPUT_QUANTITY CM_Equaloutput1 9 6.400000095367432 19.20000076293945 MAX_GRAD 0.0 /begin FIX_AXIS_PAR_LIST 6.4 8 9.6 11.2 12.8 14.4 16 17.6 19.2 /end FIX_AXIS_PAR_LIST /end AXIS_DESCR
/end CHARACTERISTIC
/begin CHARACTERISTIC CT_IntakeAirTemp "cal comments" CURVE 0xB44A 2D_Array_SW 0.0 CM_DegC_N256to256 -256.0 255.9921875
 /begin AXIS_DESCR FIX_AXIS NO_INPUT_QUANTITY CM_Equaloutput1 33 0.0 100.0 MAX_GRAD 0.0
  /begin FIX_AXIS_PAR_LIST 0 3.125 6.25 9.375 12.5 15.625 18.75 21.875 25 28.125 31.25 34.375 37.5 40.625 43.75 46.875 50 53.125 56.25 59.375 62.5 65.625 68.75 71.875 75 78.125 81.25 84.375 87.5 90.625 93.75 96.875 100 /end FIX_AXIS_PAR_LIST
 /end AXIS_DESCR
/end CHARACTERISTIC
/begin CHARACTERISTIC CT_MAPCIDEnableMAPThresh "cal comments" CURVE 0xB4D2 2D_Array_UB 0.0 CM_kpa_8bit 0.0 127.5
 /begin AXIS_DESCR FIX_AXIS NO_INPUT_QUANTITY CM_Equaloutput1 17 0.0 12800.0 MAX_GRAD 0.0
  /begin FIX_AXIS_PAR_LIST 0 800 1600 2400 3200 4000 4800 5600 6400 7200 8000 8800 9600 10400 11200 12000 12800 /end FIX_AXIS_PAR_LIST
 /end AXIS_DESCR
/end CHARACTERISTIC
/begin CHARACTERISTIC CT_MAPDefault "cal comments" CURVE 0xB530 2D_Array_UW 0.0 CM_kpa_0to256_1 0.0 255.99609375
 /begin AXIS_DESCR FIX_AXIS NO_INPUT_QUANTITY CM_Equaloutput1 11 55.0 105.0 MAX_GRAD 0.0 /begin FIX_AXIS_PAR_LIST 55 60 65 70 75 80 85 90 95 100 105 /end FIX_AXIS_PAR_LIST /end AXIS_DESCR
/end CHARACTERISTIC
/begin CHARACTERISTIC CT_MAPEstimateMain "cal comments" MAP 0xB189 3D_Array_UB 0.0 CM_kpa_8bit 0.0 127.5
 /begin AXIS_DESCR COM_AXIS NO_INPUT_QUANTITY CM_RPM_0to16384 17 0.0 16383.75 AXIS_PTS_REF CA_EngSpd17Step2 MAX_GRAD 0.0 /end AXIS_DESCR
 /begin AXIS_DESCR FIX_AXIS NO_INPUT_QUANTITY CM_Equaloutput1 33 0.0 100.0 MAX_GRAD 0.0
  /begin FIX_AXIS_PAR_LIST 0 3.125 6.25 9.375 12.5 15.625 18.75 21.875 25 28.125 31.25 34.375 37.5 40.625 43.75 46.875 50 53.125 56.25 59.375 62.5 65.625 68.75 71.875 75 78.125 81.25 84.375 87.5 90.625 93.75 96.875 100 /end FIX_AXIS_PAR_LIST
 /end AXIS_DESCR
/end CHARACTERISTIC
/begin CHARACTERISTIC CT_MAPReadAngleMain "cal comments" MAP 0xB0E4 3D_Array_UW 0.0 CM_CrankAngle_0to1024 0.0 1023.984375
 /begin AXIS_DESCR COM_AXIS NO_INPUT_QUANTITY CM_kpa_0to256_1 9 0.0 255.99609375 AXIS_PTS_REF CA_MAP9Step1 MAX_GRAD 0.0 /end AXIS_DESCR
 /begin AXIS_DESCR COM_AXIS NO_INPUT_QUANTITY CM_RPM_0to16384 9 0.0 16383.75 AXIS_PTS_REF CA_EngSpd9Step1 MAX_GRAD 0.0 /end AXIS_DESCR
/end CHARACTERISTIC
/begin CHARACTERISTIC CT_O2ErrorCalcOffset "cal comments" CURVE 0x98F6 2D_Array_UB 0.0 CM_mVolt 0.0 1016.0
 /begin AXIS_DESCR COM_AXIS NO_INPUT_QUANTITY CM_RPM_0to16384 4 0.0 16383.75 AXIS_PTS_REF CA_EngSpd4Step1 MAX_GRAD 0.0 /end AXIS_DESCR
/end CHARACTERISTIC
/begin CHARACTERISTIC CT_O2HeaterAccFuelMassThresh "cal comments" CURVE 0x9216 2D_Array_UW 0.0 CM_Grams0to8_1 0.0 7.999755859375
 /begin AXIS_DESCR FIX_AXIS NO_INPUT_QUANTITY CM_Equaloutput1 17 -28.0 164.0 MAX_GRAD 0.0 /begin FIX_AXIS_PAR_LIST -28 -16 -4 8 20 32 44 56 68 80 92 104 116 128 140 152 164 /end FIX_AXIS_PAR_LIST /end AXIS_DESCR
/end CHARACTERISTIC
/begin CHARACTERISTIC CT_O2HeaterDutyCycleMain "cal comments" CURVE 0xB0AA 2D_Array_UW 0.0 CM_Percent_0to200_2 0.0 199.9969024658203
 /begin AXIS_DESCR FIX_AXIS NO_INPUT_QUANTITY CM_Equaloutput1 17 -28.0 164.0 MAX_GRAD 0.0 /begin FIX_AXIS_PAR_LIST -28 -16 -4 8 20 32 44 56 68 80 92 104 116 128 140 152 164 /end FIX_AXIS_PAR_LIST /end AXIS_DESCR
/end CHARACTERISTIC
/begin CHARACTERISTIC CT_O2SignalFiltCoef "cal comments" CURVE 0x9874 2D_Array_UB 0.0 CM_FiltCoef_1 0.0 0.99609375
 /begin AXIS_DESCR COM_AXIS NO_INPUT_QUANTITY CM_RPM_0to16384 4 0.0 16383.75 AXIS_PTS_REF CA_EngSpd4Step1 MAX_GRAD 0.0 /end AXIS_DESCR
/end CHARACTERISTIC
/begin AXIS_PTS CA_TPS11Step "AXIS comments" 0xA07C NO_INPUT_QUANTITY AxisPtsX_UW 0.0 CM_Percent_0to200_2 11 0.0 199.9969024658203 /end AXIS_PTS
/begin AXIS_PTS CA_GENV11Step "AXIS comments" 0x2 NO_INPUT_QUANTITY AxisPtsX_UW 0.0 CM_Volt_0to1024_1 11 0.0 1023.984375 /end AXIS_PTS
/begin AXIS_PTS CA_WPGOV9Step "AXIS comments" 0x2 NO_INPUT_QUANTITY AxisPtsX_UW 0.0 CM_mpa_0to16_1 9 0.0 15.999755859375 /end AXIS_PTS
/begin AXIS_PTS CA_EngSpd10Step1 "AXIS comments" 0x8112 NO_INPUT_QUANTITY AxisPtsX_UW 0.0 CM_RPM_0to16384 10 0.0 16383.75 /end AXIS_PTS
/begin AXIS_PTS CA_EngSpd17Step1 "AXIS comments" 0x8158 NO_INPUT_QUANTITY AxisPtsX_UW 0.0 CM_RPM_0to16384 17 0.0 16383.75 /end AXIS_PTS
/begin AXIS_PTS CA_EngSpd17Step2 "AXIS comments" 0x8232 NO_INPUT_QUANTITY AxisPtsX_UW 0.0 CM_RPM_0to16384 17 0.0 16383.75 /end AXIS_PTS
/begin AXIS_PTS CA_EngSpd17Step4 "AXIS comments" 0x8256 NO_INPUT_QUANTITY AxisPtsX_UW 0.0 CM_RPM_0to16384 17 0.0 16383.75 /end AXIS_PTS
/begin AXIS_PTS CA_EngSpd11Step1 "AXIS comments" 0xAAC6 NO_INPUT_QUANTITY AxisPtsX_UW 0.0 CM_RPM_0to16384 11 0.0 16383.75 /end AXIS_PTS
/begin AXIS_PTS CA_EngSpd11Step2 "AXIS comments" 0x8128 NO_INPUT_QUANTITY AxisPtsX_UW 0.0 CM_RPM_0to16384 11 0.0 16383.75 /end AXIS_PTS
/begin AXIS_PTS CA_EngSpd11Step3 "AXIS comments" 0x8140 NO_INPUT_QUANTITY AxisPtsX_UW 0.0 CM_RPM_0to16384 11 0.0 16383.75 /end AXIS_PTS
/begin AXIS_PTS CA_EngSpd11Step4 "AXIS comments" 0xAADE NO_INPUT_QUANTITY AxisPtsX_UW 0.0 CM_RPM_0to16384 11 0.0 16383.75 /end AXIS_PTS
/begin AXIS_PTS CA_EngSpd4Step1 "AXIS comments" 0x82A0 NO_INPUT_QUANTITY AxisPtsX_UW 0.0 CM_RPM_0to16384 4 0.0 16383.75 /end AXIS_PTS
/begin AXIS_PTS CA_EngSpd6Step2 "AXIS comments" 0x827A NO_INPUT_QUANTITY AxisPtsX_UW 0.0 CM_RPM_0to16384 6 0.0 16383.75 /end AXIS_PTS
/begin AXIS_PTS CA_EngSpd9Step1 "AXIS comments" 0x80FE NO_INPUT_QUANTITY AxisPtsX_UW 0.0 CM_RPM_0to16384 9 0.0 16383.75 /end AXIS_PTS
/begin AXIS_PTS CA_PWRGOV9Step "AXIS comments" 0xC062 NO_INPUT_QUANTITY AxisPtsX_UW 0.0 udf_CM_18705 9 0.0 511.9921875 /end AXIS_PTS
/begin AXIS_PTS CA_AirGramStep17 "AXIS comments" 0x82D6 NO_INPUT_QUANTITY AxisPtsX_UW 0.0 udf_CM_18705 17 0.0 511.9921875 /end AXIS_PTS
/begin AXIS_PTS CA_FuelGramStep17 "AXIS comments" 0xB698 NO_INPUT_QUANTITY AxisPtsX_UW 0.0 udf_CM_16444 17 0.0 15.999755859375 /end AXIS_PTS
/begin AXIS_PTS CA_MAP10Step1 "AXIS comments" 0x81C8 NO_INPUT_QUANTITY AxisPtsX_UW 0.0 CM_kpa_0to256_1 10 0.0 255.99609375 /end AXIS_PTS
/begin AXIS_PTS CA_MAP18Step1 "AXIS comments" 0x81DE NO_INPUT_QUANTITY AxisPtsX_UW 0.0 CM_kpa_0to256_1 18 0.0 255.99609375 /end AXIS_PTS
/begin AXIS_PTS CA_MAP15Step1 "AXIS comments" 0x9084 NO_INPUT_QUANTITY AxisPtsX_UW 0.0 CM_kpa_0to256_1 15 0.0 255.99609375 /end AXIS_PTS
/begin AXIS_PTS CA_MAP8Step1 "AXIS comments" 0x81B6 NO_INPUT_QUANTITY AxisPtsX_SW 0.0 CM_kpa_n256to256_1 8 -256 255.9921875 /end AXIS_PTS
/begin AXIS_PTS CA_MAP8Step2 "AXIS comments" 0xB686 NO_INPUT_QUANTITY AxisPtsX_UW 0.0 CM_kpa_0to256_1 8 0.0 255.99609375 /end AXIS_PTS
/begin AXIS_PTS CA_MAP8Step3 "AXIS comments" 0x81A4 NO_INPUT_QUANTITY AxisPtsX_UW 0.0 CM_kpa_0to256_1 8 0.0 255.99609375 /end AXIS_PTS
/begin AXIS_PTS CA_MAP9Step1 "AXIS comments" 0x817C NO_INPUT_QUANTITY AxisPtsX_UW 0.0 CM_kpa_0to256_1 9 0.0 255.99609375 /end AXIS_PTS
/begin AXIS_PTS CA_MAP9Step3 "AXIS comments" 0x8190 NO_INPUT_QUANTITY AxisPtsX_UW 0.0 CM_kpa_0to256_1 9 0.0 255.99609375 /end AXIS_PTS
/begin AXIS_PTS CA_MAP9Step2 "AXIS comments" 0x8FD0 NO_INPUT_QUANTITY AxisPtsX_UW 0.0 CM_kpa_0to256_1 9 0.0 255.99609375 /end AXIS_PTS
/begin AXIS_PTS CA_Percent1 "AXIS comments" 0x8288 NO_INPUT_QUANTITY AxisPtsX_UW 0.0 CM_Percent_0to200_2 4 0.0 199.9969024658203 /end AXIS_PTS
/begin AXIS_PTS CA_Percent2 "AXIS comments" 0x9C3A NO_INPUT_QUANTITY AxisPtsX_UW 0.0 CM_Percent_0to200_2 4 0.0 199.9969024658203 /end AXIS_PTS
/begin AXIS_PTS CA_PercentStep33 "AXIS comments" 0x2 NO_INPUT_QUANTITY AxisPtsX_UW 0.0 CM_Percent_0to100_1 33 0.0 99.9984130859375 /end AXIS_PTS
/begin AXIS_PTS CA_PercentStep4 "AXIS comments" 0x2 NO_INPUT_QUANTITY AxisPtsX_UW 0.0 CM_Percent_0to100_1 4 0.0 99.9984130859375 /end AXIS_PTS
/begin COMPU_METHOD udf_CM_15262 "Ax + B" RAT_FUNC "%4.4" "ratio" COEFFS 0.0 32768.00013421773 0.0 0.0 0.0 1.0 /end COMPU_METHOD
/begin COMPU_METHOD udf_CM_15471 "Ax + B" RAT_FUNC "%4.0" "None" COEFFS 0 1 0 0 0 1 /end COMPU_METHOD
/begin COMPU_METHOD udf_CM_15478 "Ax + B" RAT_FUNC "%4.0" "None" COEFFS 0 1 0 0 0 1 /end COMPU_METHOD
/begin COMPU_METHOD udf_CM_15492 "Ax + B" RAT_FUNC "%4.4" "volt" COEFFS 0.0 2048.0 0.0 0.0 0.0 1.0 /end COMPU_METHOD
/begin COMPU_METHOD udf_CM_15499 "Ax + B" RAT_FUNC "%4.4" "volt" COEFFS 0.0 2048.0 0.0 0.0 0.0 1.0 /end COMPU_METHOD
/begin COMPU_METHOD udf_CM_15611 "Ax + B" RAT_FUNC "%4.4" "volt" COEFFS 0.0 2048.0 0.0 0.0 0.0 1.0 /end COMPU_METHOD
/begin COMPU_METHOD CM_Boolean1 "" RAT_FUNC "%1.0" "bool" COEFFS 0 1 0 0 0 1 /end COMPU_METHOD
/begin COMPU_METHOD CM_Boolean2 "" RAT_FUNC "%1.0" "boolean" COEFFS 0 1 0 0 0 1 /end COMPU_METHOD
/begin COMPU_METHOD CM_Boolean4 "" RAT_FUNC "%1.0" "None" COEFFS 0 1 0 0 0 1 /end COMPU_METHOD
/begin COMPU_METHOD udf_CM_15681 "Ax + B" RAT_FUNC "%4.0" "Counts" COEFFS 0 1 0 0 0 1 /end COMPU_METHOD
/begin COMPU_METHOD udf_CM_15688 "Ax + B" RAT_FUNC "%4.0" "None" COEFFS 0 1 0 0 0 1 /end COMPU_METHOD
/begin COMPU_METHOD udf_CM_15695 "Ax + B" RAT_FUNC "%4.0" "Counts" COEFFS 0 1 0 0 0 1 /end COMPU_METHOD
/begin COMPU_METHOD udf_CM_15702 "Ax + B" RAT_FUNC "%4.0" "None" COEFFS 0 1 0 0 0 1 /end COMPU_METHOD
/begin COMPU_METHOD udf_CM_15709 "Ax + B" RAT_FUNC "%4.0" "None" COEFFS 0 1 0 0 0 1 /end COMPU_METHOD
/begin COMPU_METHOD CM_VERSION1 "" RAT_FUNC "%10.0" "Date" COEFFS 0 1 0 0 0 1 /end COMPU_METHOD
/begin COMPU_METHOD CM_Count1 "" RAT_FUNC "%3.0" "count" COEFFS 0 1 0 0 0 1 /end COMPU_METHOD
/begin COMPU_METHOD CM_Count2 "" RAT_FUNC "%3.0" "counts" COEFFS 0 1 0 0 0 1 /end COMPU_METHOD
/begin COMPU_METHOD CM_Count3 "" RAT_FUNC "%3.0" "None" COEFFS 0 1 0 0 0 1 /end COMPU_METHOD
/begin COMPU_METHOD CM_Count4 "" RAT_FUNC "%3.0" "steps" COEFFS 0 1 0 0 0 1 /end COMPU_METHOD
/begin COMPU_METHOD udf_CM_15835 "Ax + B" RAT_FUNC "%4.2" "" COEFFS 0.0 128.0 0.0 0.0 0.0 1.0 /end COMPU_METHOD
/begin COMPU_METHOD udf_CM_15842 "Ax + B" RAT_FUNC "%4.2" "" COEFFS 0.0 128.0 0.0 0.0 0.0 1.0 /end COMPU_METHOD
/begin COMPU_METHOD udf_CM_15849 "Ax + B" RAT_FUNC "%4.0" "" COEFFS 0 1 0 0 0 1 /end COMPU_METHOD
/begin COMPU_METHOD udf_CM_15898 "Ax + B" RAT_FUNC "%4.0" "" COEFFS 0 1 0 0 0 1 /end COMPU_METHOD
/begin COMPU_METHOD udf_CM_15933 "Ax + B" RAT_FUNC "%4.0" "" COEFFS 0 1 0 0 0 1 /end COMPU_METHOD
/begin COMPU_METHOD CM_EOI "" TAB_VERB "%10.4" "" COMPU_TAB_REF CM_EOI_TAB /end COMPU_METHOD
/begin COMPU_METHOD CM_GPIO "" TAB_VERB "%10.4" "" COMPU_TAB_REF CM_GPIO_TAB /end COMPU_METHOD
/begin COMPU_METHOD CM_GPIO_EX "" TAB_VERB "%10.4" "" COMPU_TAB_REF CM_GPIO_EX_TAB /end COMPU_METHOD
/begin COMPU_METHOD CM_FUNC "" TAB_VERB "%10.4" "" COMPU_TAB_REF CM_FUNC_TAB /end COMPU_METHOD
/begin COMPU_METHOD CM_FUEL_TYPE "" TAB_VERB "%10.4" "" COMPU_TAB_REF CM_FUEL_TYPE_TAB /end COMPU_METHOD
/begin COMPU_METHOD udf_CM_16066 "Ax + B" RAT_FUNC "%4.4" "rpm" COEFFS 0.0 4.0 0.0 0.0 0.0 1.0 /end COMPU_METHOD
/begin COMPU_METHOD udf_CM_16276 "Ax + B" RAT_FUNC "%4.0" "boolean" COEFFS 0 1 0 0 0 1 /end COMPU_METHOD
/begin COMPU_METHOD udf_CM_16444 "Ax + B" RAT_FUNC "%4.4" "grm" COEFFS 0.0 4096.0 0.0 0.0 0.0 1.0 /end COMPU_METHOD
/begin COMPU_METHOD udf_CM_16542 "Ax + B" RAT_FUNC "%4.0" "None" COEFFS 0 1 0 0 0 1 /end COMPU_METHOD
/begin COMPU_METHOD CM_Mult0_to_2_ratio "" RAT_FUNC "%5.4" "ratio" COEFFS 0.0 128.0 0.0 0.0 0.0 1.0 /end COMPU_METHOD
/begin COMPU_METHOD CM_Mult0_to_2_ratio1 "" RAT_FUNC "%5.4" "ratio/512rpm" COEFFS 0.0 128.0 0.0 0.0 0.0 1.0 /end COMPU_METHOD
/begin COMPU_METHOD CM_Mult0_to_4_ratio "" RAT_FUNC "%5.4" "ratio" COEFFS 0.0 64.0 0.0 0.0 0.0 1.0 /end COMPU_METHOD
/begin COMPU_METHOD CM_Equaloutput1 "Default N=E compu method" RAT_FUNC "%10.4" "" COEFFS 0 1 0 0 0 1 /end COMPU_METHOD
/begin COMPU_METHOD CM_Boolean6 "Default N=E compu method" RAT_FUNC "%10.4" "Boolean" COEFFS 0 1 0 0 0 1 /end COMPU_METHOD
/begin COMPU_METHOD CM_Enum_0to4 "" RAT_FUNC "%1.0" "enum" COEFFS 0 1 0 0 0 1 /end COMPU_METHOD
/begin COMPU_METHOD CM_AFR_8bit "" RAT_FUNC "%4.2" "afr" COEFFS 0.0 8.0 0.0 0.0 0.0 1.0 /end COMPU_METHOD
/begin COMPU_METHOD CM_AFR_n4to4 "" RAT_FUNC "%4.3" "afr" COEFFS 0.0 32.0 0.0 0.0 0.0 1.0 /end COMPU_METHOD
/begin COMPU_METHOD CM_Angle_8bit "" RAT_FUNC "%3.1" "angle" COEFFS 0.0 2.0 0.0 0.0 0.0 1.0 /end COMPU_METHOD
/begin COMPU_METHOD CM_Grams0to2 "" RAT_FUNC "%6.5" "gms" COEFFS 0.0 128.0 0.0 0.0 0.0 1.0 /end COMPU_METHOD
/begin COMPU_METHOD CM_Grams0to8 "" RAT_FUNC "%6.5" "gms" COEFFS 0.0 8192.000033554432 0.0 0.0 0.0 1.0 /end COMPU_METHOD
/begin COMPU_METHOD CM_Grams0to8_1 "" RAT_FUNC "%6.5" "grams" COEFFS 0.0 8192.000033554432 0.0 0.0 0.0 1.0 /end COMPU_METHOD
/begin COMPU_METHOD CM_FiltCoef "" RAT_FUNC "%7.6" "coef" COEFFS 0.0 65536.00026843546 0.0 0.0 0.0 1.0 /end COMPU_METHOD
/begin COMPU_METHOD CM_FactorRatio "" RAT_FUNC "%7.6" "ratio" COEFFS 0.0 65536.00026843546 0.0 0.0 0.0 1.0 /end COMPU_METHOD
/begin COMPU_METHOD CM_GramPerSecond "" RAT_FUNC "%7.5" "grams/sec" COEFFS 0.0 4096.0 0.0 0.0 0.0 1.0 /end COMPU_METHOD
/begin COMPU_METHOD CM_GramPerSecond_1 "" RAT_FUNC "%7.5" "grams/sec" COEFFS 0.0 128.0 0.0 0.0 0.0 1.0 /end COMPU_METHOD
/begin COMPU_METHOD udf_CM_18376 "" RAT_FUNC "%7.5" "ratio" COEFFS 0.0 4096.0 0.0 0.0 0.0 1.0 /end COMPU_METHOD
/begin COMPU_METHOD CM_kpa_8bit "" RAT_FUNC "%4.1" "kpa" COEFFS 0.0 2.0 0.0 0.0 0.0 1.0 /end COMPU_METHOD
/begin COMPU_METHOD CM_kpa_0_256_8bit "" RAT_FUNC "%4.1" "kpa" COEFFS 0.0 1.0 0.0 0.0 0.0 1.0 /end COMPU_METHOD
/begin COMPU_METHOD CM_mVolt "" RAT_FUNC "%4.0" "millivolt" COEFFS 0.0 0.25 0.0 0.0 0.0 1.0 /end COMPU_METHOD
/begin COMPU_METHOD CM_mVolt_1 "" RAT_FUNC "%7.3" "millivolt" COEFFS 0.0 64.0 0.0 0.0 0.0 1.0 /end COMPU_METHOD
/begin COMPU_METHOD CM_Ratio_0to2_1 "" RAT_FUNC "%6.5" "msec/count" COEFFS 0.0 32768.00013421773 0.0 0.0 0.0 1.0 /end COMPU_METHOD
/begin COMPU_METHOD CM_Ratio_0to2_2 "" RAT_FUNC "%6.5" "ratio" COEFFS 0.0 32768.00013421773 0.0 0.0 0.0 1.0 /end COMPU_METHOD
/begin COMPU_METHOD CM_Seconds_1 "" RAT_FUNC "%7.3" "sec" COEFFS 0.0 32.0 0.0 0.0 0.0 1.0 /end COMPU_METHOD
/begin COMPU_METHOD CM_Percent_N200to200 "" RAT_FUNC "%7.4" "percent" COEFFS 0.0 163.8400167772177 0.0 0.0 0.0 1.0 /end COMPU_METHOD
/begin COMPU_METHOD CM_SparkAngle_N256to256 "" RAT_FUNC "%7.4" "angle" COEFFS 0.0 128.0 0.0 0.0 0.0 1.0 /end COMPU_METHOD
/begin COMPU_METHOD CM_DegC_N256to256 "" RAT_FUNC "%7.4" "degC" COEFFS 0.0 128.0 0.0 0.0 0.0 1.0 /end COMPU_METHOD
/begin COMPU_METHOD CM_FiltCoef_1 "" RAT_FUNC "%5.4" "coef" COEFFS 0.0 256.0 0.0 0.0 0.0 1.0 /end COMPU_METHOD
/begin COMPU_METHOD CM_Mult_0to1 "" RAT_FUNC "%5.4" "not_specified" COEFFS 0.0 256.0 0.0 0.0 0.0 1.0 /end COMPU_METHOD
/begin COMPU_METHOD CM_Mult_0to1_2 "" RAT_FUNC "%5.4" "ratio" COEFFS 0.0 256.0 0.0 0.0 0.0 1.0 /end COMPU_METHOD
/begin COMPU_METHOD CM_Percent_0to200 "" RAT_FUNC "%8.5" "percent/count" COEFFS 0.0 327.6800000536871 0.0 0.0 0.0 1.0 /end COMPU_METHOD
/begin COMPU_METHOD CM_Percent_0to100 "" RAT_FUNC "%5.3" "percent" COEFFS 0.0 2.56 0.0 0.0 0.0 1.0 /end COMPU_METHOD
/begin COMPU_METHOD CM_Percent_N100to100 "" RAT_FUNC "%5.3" "percent" COEFFS 0.0 1.28 0.0 0.0 0.0 1.0 /end COMPU_METHOD
/begin COMPU_METHOD CM_Percent_0to100_1 "" RAT_FUNC "%6.4" "percent" COEFFS 0.0 655.3603892316423 0.0 0.0 0.0 1.0 /end COMPU_METHOD
/begin COMPU_METHOD CM_Percent_0to200_1 "" RAT_FUNC "%7.4" "" COEFFS 0.0 327.6800872415464 0.0 0.0 0.0 1.0 /end COMPU_METHOD
/begin COMPU_METHOD CM_Percent_0to200_2 "" RAT_FUNC "%7.4" "percent" COEFFS 0.0 327.6800872415464 0.0 0.0 0.0 1.0 /end COMPU_METHOD
/begin COMPU_METHOD CM_Percent_0to200_3 "" RAT_FUNC "%6.3" "percent" COEFFS 0.0 1.28 0.0 0.0 0.0 1.0 /end COMPU_METHOD
/begin COMPU_METHOD CM_Ratio_0to8 "" RAT_FUNC "%6.5" "ratio" COEFFS 0.0 8192.0 0.0 0.0 0.0 1.0 /end COMPU_METHOD
/begin COMPU_METHOD CM_Ratio_n256to256 "" RAT_FUNC "%7.4" "amps" COEFFS 0.0 128.0 0.0 0.0 0.0 1.0 /end COMPU_METHOD
/begin COMPU_METHOD CM_Ratio_n128to128 "" RAT_FUNC "%7.4" "kpa" COEFFS 0.0 256.0 0.0 0.0 0.0 1.0 /end COMPU_METHOD
/begin COMPU_METHOD CM_kpa_n512to512 "" RAT_FUNC "%7.4" "kpa" COEFFS 0.0 64.0 0.0 0.0 0.0 1.0 /end COMPU_METHOD
/begin COMPU_METHOD CM_Ratio_n8to8 "" RAT_FUNC "%7.4" "mpa" COEFFS 0.0 4096.0 0.0 0.0 0.0 1.0 /end COMPU_METHOD
/begin COMPU_METHOD udf_CM_18544 "" RAT_FUNC "%7.4" "NM" COEFFS 0.0 256.0 0.0 0.0 0.0 1.0 /end COMPU_METHOD
/begin COMPU_METHOD CM_Ratio_n2to2 "" RAT_FUNC "%4.3" "ratio" COEFFS 0.0 64.0 0.0 0.0 0.0 1.0 /end COMPU_METHOD
/begin COMPU_METHOD CM_RPM_n8192to8192 "" RAT_FUNC "%6.2" "rpm" COEFFS 0.0 4.0 0.0 0.0 0.0 1.0 /end COMPU_METHOD
/begin COMPU_METHOD CM_RPM_0to16384_1 "" RAT_FUNC "%7.2" "" COEFFS 0.0 4.0 0.0 0.0 0.0 1.0 /end COMPU_METHOD
/begin COMPU_METHOD CM_Hz_0to16384 "" RAT_FUNC "%7.2" "hertz" COEFFS 0.0 4.0 0.0 0.0 0.0 1.0 /end COMPU_METHOD
/begin COMPU_METHOD CM_RPM_0to16384 "" RAT_FUNC "%7.2" "rpm" COEFFS 0.0 4.0 0.0 0.0 0.0 1.0 /end COMPU_METHOD
/begin COMPU_METHOD udf_CM_18586 "" RAT_FUNC "%7.2" "RPM" COEFFS 0.0 4.0 0.0 0.0 0.0 1.0 /end COMPU_METHOD
/begin COMPU_METHOD CM_amp_0to512_1 "" RAT_FUNC "%7.4" "amp" COEFFS 0.0 128.0 0.0 0.0 0.0 1.0 /end COMPU_METHOD
/begin COMPU_METHOD CM_kpa_0to512_1 "" RAT_FUNC "%7.4" "kpa" COEFFS 0.0 128.0 0.0 0.0 0.0 1.0 /end COMPU_METHOD
/begin COMPU_METHOD CM_kpa_0to1024_1 "" RAT_FUNC "%7.4" "kpa" COEFFS 0.0 64.0 0.0 0.0 0.0 1.0 /end COMPU_METHOD
/begin COMPU_METHOD CM_kpa_0to2048_1 "" RAT_FUNC "%7.4" "kpa" COEFFS 0.0 32.0 0.0 0.0 0.0 1.0 /end COMPU_METHOD
/begin COMPU_METHOD CM_kpa_n256to256_1 "" RAT_FUNC "%7.4" "kpa" COEFFS 0.0 128.0 0.0 0.0 0.0 1.0 /end COMPU_METHOD
/begin COMPU_METHOD CM_kpa_0to256_1 "" RAT_FUNC "%7.4" "kpa" COEFFS 0.0 256.0 0.0 0.0 0.0 1.0 /end COMPU_METHOD
/begin COMPU_METHOD CM_mpa_0to16_1 "" RAT_FUNC "%7.4" "mpa" COEFFS 0.0 4096.0 0.0 0.0 0.0 1.0 /end COMPU_METHOD
/begin COMPU_METHOD CM_CrankAngle_0to1024 "" RAT_FUNC "%7.3" "angle" COEFFS 0.0 64.0 0.0 0.0 0.0 1.0 /end COMPU_METHOD
/begin COMPU_METHOD CM_milliliter_0to1024 "" RAT_FUNC "%7.3" "milliliter" COEFFS 0.0 64.0 0.0 0.0 0.0 1.0 /end COMPU_METHOD
/begin COMPU_METHOD CM_msec_0to1024 "" RAT_FUNC "%7.3" "msec" COEFFS 0.0 64.0 0.0 0.0 0.0 1.0 /end COMPU_METHOD
/begin COMPU_METHOD CM_Second_0to1024 "" RAT_FUNC "%7.3" "sec" COEFFS 0.0 64.0 0.0 0.0 0.0 1.0 /end COMPU_METHOD
/begin COMPU_METHOD CM_Second_0to8192 "" RAT_FUNC "%7.3" "sec" COEFFS 0.0 8.0 0.0 0.0 0.0 1.0 /end COMPU_METHOD
/begin COMPU_METHOD CM_SignedWord_n32768to32768_2 "" RAT_FUNC "%5.0" "counts" COEFFS 0 1 0 0 0 1 /end COMPU_METHOD
/begin COMPU_METHOD CM_AFR_0to32 "" RAT_FUNC "%6.4" "afr" COEFFS 0.0 2048.001048576537 0.0 0.0 0.0 1.0 /end COMPU_METHOD
/begin COMPU_METHOD CM_Volt_0to32_1 "" RAT_FUNC "%6.4" "volt" COEFFS 0.0 2048.001048576537 0.0 0.0 0.0 1.0 /end COMPU_METHOD
/begin COMPU_METHOD CM_Volt_0to1024_1 "" RAT_FUNC "%6.4" "volt" COEFFS 0.0 64.0 0.0 0.0 0.0 1.0 /end COMPU_METHOD
/begin COMPU_METHOD CM_Second_0to4096 "" RAT_FUNC "%7.3" "sec" COEFFS 0.0 16.0 0.0 0.0 0.0 1.0 /end COMPU_METHOD
/begin COMPU_METHOD CM_KPH_0to512 "" RAT_FUNC "%7.4" "kph" COEFFS 0.0 128.0 0.0 0.0 0.0 1.0 /end COMPU_METHOD
/begin COMPU_METHOD udf_CM_18705 "" RAT_FUNC "%7.4" "grams" COEFFS 0.0 128.0 0.0 0.0 0.0 1.0 /end COMPU_METHOD
/begin COMPU_METHOD CM_Second_0to512 "" RAT_FUNC "%7.4" "sec" COEFFS 0.0 128.0 0.0 0.0 0.0 1.0 /end COMPU_METHOD
/begin COMPU_METHOD udf_CM_18726 "Ax + B" RAT_FUNC "%4.4" "percent" COEFFS 0.0 327.6800000536871 0.0 0.0 0.0 1.0 /end COMPU_METHOD
/begin COMPU_METHOD CM_Count_0to65535 "" RAT_FUNC "%5.0" "count" COEFFS 0 1 0 0 0 1 /end COMPU_METHOD
/begin COMPU_METHOD CM_Count_0to65535_1 "" RAT_FUNC "%5.0" "counts" COEFFS 0 1 0 0 0 1 /end COMPU_METHOD
/begin COMPU_METHOD CM_Second_0to65535 "" RAT_FUNC "%5.0" "sec" COEFFS 0 1 0 0 0 1 /end COMPU_METHOD
/begin COMPU_METHOD CM_msec_0to4 "" RAT_FUNC "%4.3" "msec" COEFFS 0.0 64.0 0.0 0.0 0.0 1.0 /end COMPU_METHOD
/begin COMPU_METHOD CM_mult_0to4 "" RAT_FUNC "%4.3" "not_specified" COEFFS 0.0 64.0 0.0 0.0 0.0 1.0 /end COMPU_METHOD
/begin COMPU_METHOD CM_Second_0to4 "" RAT_FUNC "%4.3" "sec" COEFFS 0.0 64.0 0.0 0.0 0.0 1.0 /end COMPU_METHOD
/begin COMPU_METHOD CM_Mult_0to8 "" RAT_FUNC "%4.3" "ratio" COEFFS 0.0 32.0 0.0 0.0 0.0 1.0 /end COMPU_METHOD
/begin COMPU_METHOD CM_Second_0to8 "" RAT_FUNC "%4.3" "sec" COEFFS 0.0 32.0 0.0 0.0 0.0 1.0 /end COMPU_METHOD
/begin COMPU_VTAB CM_EOI_TAB "" TAB_VERB 4 0 "Cyl1" 1 "Cyl2" 2 "Cyl3" 3 "Cyl4" /end COMPU_VTAB
/begin COMPU_VTAB CM_GPIO_TAB "" TAB_VERB 6 0 "PA" 1 "PB" 2 "PC" 3 "PD" 4 "PE" 5 "PI" /end COMPU_VTAB
/begin COMPU_VTAB CM_GPIO_EX_TAB "" TAB_VERB 9 0 "PA" 1 "PB" 2 "PC" 3 "PD" 4 "PE" 5 "PF" 6 "PG" 7 "PH" 8 "PI" /end COMPU_VTAB
/begin COMPU_VTAB CM_FUNC_TAB "" TAB_VERB 104 0 " " 1 "DO_IDL_DIR" 2 "DO_IDL_STEP" 3 "DO_IDL_EN" 4 "DO_IAC_DIR" 5 "DO_IAC_STEP" 6 "DO_IAC_EN" 7 "DO_FCV_DIR" 8 "DO_FCV_STEP" 9 "DO_FCV_EN" 10 "DO_DM1_DIR" 11 "DO_DM1_EN" 12 "DO_DM2_DIR" 13 "DO_DM2_EN" 14 "DO_TACH" 15 "DO_NG_SHUT" 16 "DO_LPG_SHUT" 17 "DO_NG_LPG_SHT" 18 "DO_JET_TWO" 19 "DO_JET_SEL" 20 "DO_OIL_L" 21 "DO_SLEEP" 22 "DO_LED_MIL" 23 "DO_LED_RUN" 24 "DO_KNK_INT" 25 "DO_FBPV" 26 "DO_SR_CP" 27 "DO_SR_PL" 28 "DO_485EN" 29 "DO_TEST_TOG1" 30 "DO_TEST_TOG2" 31 "DO_TEST_NO" 32 "DO_TEST_NC" 33 "DI_GEAR_N" 34 "DI_DIFF_LCK" 35 "DI_REV_GEAR" 36 "DI_PWR_ADD" 37 "DI_STRT" 38 "DI_STOP" 39 "DI_FPP_FB" 40 "DI_OP" 41 "DI_IDLE" 42 "DI_HDL_GR_L" 43 "DI_WTR_CLN" 44 "DI_STRT_STP" 45 "DI_MULF_SEL" 46 "DI_U_HILL" 47 "DI_NG_SEL" 48 "DI_LPG_SEL" 49 "DI_SR_Q" 50 "DI_INJ1_2_SL" 51 "DI_INJ1_2_SH" 52 "DI_INJ1_3_SL" 53 "DI_INJ1_3_SH" 54 "DI_INJ2_2_SL" 55 "DI_INJ2_2_SH" 56 "DI_INJ2_3_SL" 57 "DI_INJ2_3_SH" 58 "AI_CLT1" 59 "AI_CLT2" 60 "AI_CLT3" 61 "AI_CLT4" 62 "AI_CLT5" 63 "AI_CLT6" 64 "AI_TPS1" 65 "AI_TPS2" 66 "AI_BAT" 67 "AI_IAT" 68 "AI_MAP" 69 "AI_O2_1" 70 "AI_O2_2" 71 "AI_RO2_1" 72 "AI_RO2_2" 73 "AI_G_RPM" 74 "AI_WP_I" 75 "AI_WP_O" 76 "AI_FCVPS" 77 "AI_BSTP" 78 "AI_FP" 79 "AI_GEN_VLT1" 80 "AI_HDLPS" 81 "AI_GEN_CUR" 82 "AI_WPP_CUR" 83 "AI_CUR_AC" 84 "AI_MULF_SEL" 85 "AI_OP" 86 "PI_CO" 87 "PI_STRT" 88 "PI_STOP" 89 "PI_U_HILL" 90 "PI_G_RPM" 91 "PI_VEH_SPD" 92 "PO_TEST" 93 "PO_O2H_1" 94 "PO_RO2H_1" 95 "PO_FPP" 96 "PO_CCP" 97 "PO_GV" 98 "PO_ETCM1" 99 "PO_ETCM2" 100 "PO_SMTR" 101 "PO_BSTC" 102 "PO_WPP" 103 "PO_GENV" /end COMPU_VTAB
/begin COMPU_VTAB CM_FUEL_TYPE_TAB "" TAB_VERB 3 0 "Gasoline" 1 "NG" 2 "LPG" /end COMPU_VTAB
/begin RECORD_LAYOUT 2D_Array_SB FNC_VALUES 1 SBYTE COLUMN_DIR DIRECT ALIGNMENT_WORD 1 ALIGNMENT_LONG 2 /end RECORD_LAYOUT
/begin RECORD_LAYOUT 2D_Array_SW FNC_VALUES 1 SWORD COLUMN_DIR DIRECT ALIGNMENT_WORD 1 ALIGNMENT_LONG 2 /end RECORD_LAYOUT
/begin RECORD_LAYOUT 2D_Array_UB FNC_VALUES 1 UBYTE COLUMN_DIR DIRECT ALIGNMENT_WORD 1 ALIGNMENT_LONG 2 /end RECORD_LAYOUT
/begin RECORD_LAYOUT 2D_Array_UW FNC_VALUES 1 UWORD COLUMN_DIR DIRECT ALIGNMENT_WORD 1 ALIGNMENT_LONG 2 /end RECORD_LAYOUT
/begin RECORD_LAYOUT D_Array_SB FNC_VALUES 1 SBYTE COLUMN_DIR DIRECT ALIGNMENT_WORD 1 ALIGNMENT_LONG 2 /end RECORD_LAYOUT
/begin RECORD_LAYOUT udf_RL_19771 FNC_VALUES 1 SWORD COLUMN_DIR DIRECT ALIGNMENT_WORD 1 ALIGNMENT_LONG 2 /end RECORD_LAYOUT
/begin RECORD_LAYOUT 3D_Array_UB FNC_VALUES 1 UBYTE COLUMN_DIR DIRECT ALIGNMENT_WORD 1 ALIGNMENT_LONG 2 /end RECORD_LAYOUT
/begin RECORD_LAYOUT 3D_Array_UW FNC_VALUES 1 UWORD COLUMN_DIR DIRECT ALIGNMENT_WORD 1 ALIGNMENT_LONG 2 /end RECORD_LAYOUT
/begin RECORD_LAYOUT AxisPtsX_UW AXIS_PTS_X 1 UWORD INDEX_INCR DIRECT ALIGNMENT_WORD 1 ALIGNMENT_LONG 2 /end RECORD_LAYOUT
/begin RECORD_LAYOUT AxisPtsX_SW AXIS_PTS_X 1 SWORD INDEX_INCR DIRECT ALIGNMENT_WORD 1 ALIGNMENT_LONG 2 /end RECORD_LAYOUT
/begin RECORD_LAYOUT Scalar_SW FNC_VALUES 1 SWORD COLUMN_DIR DIRECT ALIGNMENT_WORD 1 ALIGNMENT_LONG 2 /end RECORD_LAYOUT
/begin RECORD_LAYOUT Scalar_UB FNC_VALUES 1 UBYTE COLUMN_DIR DIRECT ALIGNMENT_WORD 1 ALIGNMENT_LONG 2 /end RECORD_LAYOUT
/begin RECORD_LAYOUT Scalar_UW FNC_VALUES 1 UWORD COLUMN_DIR DIRECT ALIGNMENT_WORD 1 ALIGNMENT_LONG 2 /end RECORD_LAYOUT
/begin RECORD_LAYOUT ValueBlock_UW FNC_VALUES 1 UWORD COLUMN_DIR DIRECT ALIGNMENT_WORD 1 ALIGNMENT_LONG 2 /end RECORD_LAYOUT
/begin RECORD_LAYOUT Scalar_UL FNC_VALUES 1 ULONG COLUMN_DIR DIRECT ALIGNMENT_WORD 1 ALIGNMENT_LONG 2 /end RECORD_LAYOUT
/end MODULE
/end PROJECT
