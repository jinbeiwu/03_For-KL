ASAP2_VERSION 1 40
/begin PROJECT RS19_Prod ""
/begin HEADER "" VERSION "" /end HEADER
/begin MODULE RS19_Prod ""
/begin MOD_COMMON "" BYTE_ORDER MSB_FIRST ALIGNMENT_BYTE 1 ALIGNMENT_WORD 1 ALIGNMENT_LONG 2 ALIGNMENT_FLOAT32_IEEE 4 ALIGNMENT_FLOAT64_IEEE 8 /end MOD_COMMON
/begin CHARACTERISTIC D_IntakeAirTempShortHiDiagRunTimeThrsh "cal comments" VALUE 0xBBDA Scalar_UW 0.0 CM_Count_0to65535_1 0.0 65535.0 /end CHARACTERISTIC
/begin CHARACTERISTIC D_IntakeAirTempShortHighFailTimeThrsh "cal comments" VALUE 0xBBDC Scalar_UW 0.0 CM_Count_0to65535_1 0.0 65535.0 /end CHARACTERISTIC
/begin CHARACTERISTIC D_IntakeAirTempShortHighPassTimeThrsh "cal comments" VALUE 0xBBDE Scalar_UW 0.0 CM_Count_0to65535_3 0.0 65535.0 /end CHARACTERISTIC
/begin CHARACTERISTIC D_IntakeAirTempShortLightEnb "cal comments" VALUE 0xBBE9 Scalar_UB 0.0 CM_Boolean6 0.0 255.0 /end CHARACTERISTIC
/begin CHARACTERISTIC D_IntakeAirTempShortLoDiagRunTimeThrsh "cal comments" VALUE 0xBBD8 Scalar_UW 0.0 CM_Count_0to65535_1 0.0 65535.0 /end CHARACTERISTIC
/begin CHARACTERISTIC D_IntakeAirTempShortLowFailTimeThrsh "cal comments" VALUE 0xBBE0 Scalar_UW 0.0 CM_Count_0to65535_1 0.0 65535.0 /end CHARACTERISTIC
/begin CHARACTERISTIC D_IntakeAirTempShortLowPassTimeThrsh "cal comments" VALUE 0xBBE2 Scalar_UW 0.0 CM_Count_0to65535_1 0.0 65535.0 /end CHARACTERISTIC
/begin CHARACTERISTIC D_IntakeAirTempShortRangeThreshHi "cal comments" VALUE 0xBBE4 Scalar_UW 0.0 CM_Percent_0to100_1 0.0 99.9984130859375 /end CHARACTERISTIC
/begin CHARACTERISTIC D_IntakeAirTempShortRangeThreshLo "cal comments" VALUE 0xBBE6 Scalar_UW 0.0 CM_Percent_0to100_1 0.0 99.9984130859375 /end CHARACTERISTIC
/begin CHARACTERISTIC D_ACSShortHighFailTimeThrsh "cal comments" VALUE 0xBBEA Scalar_UW 0.0 CM_Count_0to65535_1 0.0 65535.0 /end CHARACTERISTIC
/begin CHARACTERISTIC D_ACSShortHighPassTimeThrsh "cal comments" VALUE 0xBBEC Scalar_UW 0.0 CM_Count_0to65535_1 0.0 65535.0 /end CHARACTERISTIC
/begin CHARACTERISTIC D_ACSShortLowFailTimeThrsh "cal comments" VALUE 0xBBEE Scalar_UW 0.0 CM_Count_0to65535_1 0.0 65535.0 /end CHARACTERISTIC
/begin CHARACTERISTIC D_ACSShortLowPassTimeThrsh "cal comments" VALUE 0xBBF0 Scalar_UW 0.0 CM_Count_0to65535_1 0.0 65535.0 /end CHARACTERISTIC
/begin CHARACTERISTIC D_ACSShortRangeThreshHi "cal comments" VALUE 0xBBF2 Scalar_UW 0.0 CM_Percent_0to100_1 0.0 99.9984130859375 /end CHARACTERISTIC
/begin CHARACTERISTIC D_ACSShortRangeThreshLo "cal comments" VALUE 0xBBF4 Scalar_UW 0.0 CM_Percent_0to100_1 0.0 99.9984130859375 /end CHARACTERISTIC
/begin CHARACTERISTIC D_ACSShortEnb "cal comments" VALUE 0xBBF6 Scalar_UB 0.0 CM_Boolean6 0.0 255.0 /end CHARACTERISTIC
/begin CHARACTERISTIC D_ACSShortLightEnb "cal comments" VALUE 0xBBF7 Scalar_UB 0.0 CM_Boolean6 0.0 255.0 /end CHARACTERISTIC
/begin CHARACTERISTIC D_WPSShortHighFailTimeThrsh "cal comments" VALUE 0xBBF8 Scalar_UW 0.0 CM_Count_0to65535_1 0.0 65535.0 /end CHARACTERISTIC
/begin CHARACTERISTIC D_WPSShortHighPassTimeThrsh "cal comments" VALUE 0xBBFA Scalar_UW 0.0 CM_Count_0to65535_1 0.0 65535.0 /end CHARACTERISTIC
/begin CHARACTERISTIC D_WPSShortLowFailTimeThrsh "cal comments" VALUE 0xBBFC Scalar_UW 0.0 CM_Count_0to65535_1 0.0 65535.0 /end CHARACTERISTIC
/begin CHARACTERISTIC D_WPSShortLowPassTimeThrsh "cal comments" VALUE 0xBBFE Scalar_UW 0.0 CM_Count_0to65535_1 0.0 65535.0 /end CHARACTERISTIC
/begin CHARACTERISTIC D_WPSShortRangeThreshHi "cal comments" VALUE 0xBC00 Scalar_UW 0.0 CM_Percent_0to100_1 0.0 99.9984130859375 /end CHARACTERISTIC
/begin CHARACTERISTIC D_WPSShortRangeThreshLo "cal comments" VALUE 0xBC02 Scalar_UW 0.0 CM_Percent_0to100_1 0.0 99.9984130859375 /end CHARACTERISTIC
/begin CHARACTERISTIC D_WPSShortEnb "cal comments" VALUE 0xBC04 Scalar_UB 0.0 CM_Boolean6 0.0 255.0 /end CHARACTERISTIC
/begin CHARACTERISTIC D_WPSShortLightEnb "cal comments" VALUE 0xBC05 Scalar_UB 0.0 CM_Boolean6 0.0 255.0 /end CHARACTERISTIC
/begin CHARACTERISTIC D_MAPShortEnb "cal comments" VALUE 0xBC70 Scalar_UB 0.0 CM_Boolean6 0.0 255.0 /end CHARACTERISTIC
/begin CHARACTERISTIC D_MAPShortHiDiagFailThrsh "cal comments" VALUE 0xBC6E Scalar_UW 0.0 CM_Percent_0to100_1 0.0 99.9984130859375 /end CHARACTERISTIC
/begin CHARACTERISTIC D_MAPShortHiEngSpdThrsh "cal comments" VALUE 0xBC50 Scalar_UW 0.0 CM_RPM_0to16384 0.0 16383.75 /end CHARACTERISTIC
/begin CHARACTERISTIC D_MAPShortHighFailTimeThrsh "cal comments" VALUE 0xBC48 Scalar_UW 0.0 CM_Count_0to65535_2 0.0 65535.0 /end CHARACTERISTIC
/begin CHARACTERISTIC D_MAPShortHighPassTimeThrsh "cal comments" VALUE 0xBC4A Scalar_UW 0.0 CM_Count_0to65535_2 0.0 65535.0 /end CHARACTERISTIC
/begin CHARACTERISTIC D_MAPShortHiSpdHiTPSThrsh "cal comments" VALUE 0xBC42 Scalar_UW 0.0 CM_Percent_0to200_2 0.0 199.9969024658203 /end CHARACTERISTIC
/begin CHARACTERISTIC D_MAPShortHiSpdLoTPSThrsh "cal comments" VALUE 0xBC40 Scalar_UW 0.0 CM_Percent_0to200_2 0.0 199.9969024658203 /end CHARACTERISTIC
/begin CHARACTERISTIC D_MAPShortLightEnb "cal comments" VALUE 0xBC71 Scalar_UB 0.0 CM_Boolean6 0.0 255.0 /end CHARACTERISTIC
/begin CHARACTERISTIC D_MAPShortLoDiagFailThrsh "cal comments" VALUE 0xBC6C Scalar_UW 0.0 CM_Percent_0to100_1 0.0 99.9984130859375 /end CHARACTERISTIC
/begin CHARACTERISTIC D_MAPShortLoEngSpdThrsh "cal comments" VALUE 0xBC52 Scalar_UW 0.0 CM_RPM_0to16384 0.0 16383.75 /end CHARACTERISTIC
/begin CHARACTERISTIC D_MAPShortLoIgnVoltThrshHi "cal comments" VALUE 0xBC56 Scalar_UW 0.0 CM_Volt_0to32_1 0.0 31.99900627136231 /end CHARACTERISTIC
/begin CHARACTERISTIC D_MAPShortLoIgnVoltThrshLo "cal comments" VALUE 0xBC54 Scalar_UW 0.0 CM_Volt_0to32_1 0.0 31.99900627136231 /end CHARACTERISTIC
/begin CHARACTERISTIC D_MAPShortLoSpdHiTPSThrsh "cal comments" VALUE 0xBC44 Scalar_UW 0.0 CM_Percent_0to200_2 0.0 199.9969024658203 /end CHARACTERISTIC
/begin CHARACTERISTIC D_MAPShortLoSpdLoTPSThrsh "cal comments" VALUE 0xBC46 Scalar_UW 0.0 CM_Percent_0to200_2 0.0 199.9969024658203 /end CHARACTERISTIC
/begin CHARACTERISTIC D_MAPShortLowFailTimeThrsh "cal comments" VALUE 0xBC4C Scalar_UW 0.0 CM_Count_0to65535_2 0.0 65535.0 /end CHARACTERISTIC
/begin CHARACTERISTIC D_MAPShortLowPassTimeThrsh "cal comments" VALUE 0xBC4E Scalar_UW 0.0 CM_Count_0to65535_2 0.0 65535.0 /end CHARACTERISTIC
/begin CHARACTERISTIC D_BSTPShortEnb "cal comments" VALUE 0xBC36 Scalar_UB 0.0 CM_Boolean6 0.0 255.0 /end CHARACTERISTIC
/begin CHARACTERISTIC D_BSTPShortHiDiagFailThrsh "cal comments" VALUE 0xBC34 Scalar_UW 0.0 CM_Percent_0to100_1 0.0 99.9984130859375 /end CHARACTERISTIC
/begin CHARACTERISTIC D_BSTPShortHiEngSpdThrsh "cal comments" VALUE 0xBC16 Scalar_UW 0.0 CM_RPM_0to16384 0.0 16383.75 /end CHARACTERISTIC
/begin CHARACTERISTIC D_BSTPShortHighFailTimeThrsh "cal comments" VALUE 0xBC0E Scalar_UW 0.0 CM_Count_0to65535_2 0.0 65535.0 /end CHARACTERISTIC
/begin CHARACTERISTIC D_BSTPShortHighPassTimeThrsh "cal comments" VALUE 0xBC10 Scalar_UW 0.0 CM_Count_0to65535_2 0.0 65535.0 /end CHARACTERISTIC
/begin CHARACTERISTIC D_BSTPShortHiSpdHiTPSThrsh "cal comments" VALUE 0xBC08 Scalar_UW 0.0 CM_Percent_0to200_2 0.0 199.9969024658203 /end CHARACTERISTIC
/begin CHARACTERISTIC D_BSTPShortHiSpdLoTPSThrsh "cal comments" VALUE 0xBC06 Scalar_UW 0.0 CM_Percent_0to200_2 0.0 199.9969024658203 /end CHARACTERISTIC
/begin CHARACTERISTIC D_BSTPShortLightEnb "cal comments" VALUE 0xBC37 Scalar_UB 0.0 CM_Boolean6 0.0 255.0 /end CHARACTERISTIC
/begin CHARACTERISTIC D_BSTPShortLoDiagFailThrsh "cal comments" VALUE 0xBC32 Scalar_UW 0.0 CM_Percent_0to100_1 0.0 99.9984130859375 /end CHARACTERISTIC
/begin CHARACTERISTIC D_BSTPShortLoEngSpdThrsh "cal comments" VALUE 0xBC18 Scalar_UW 0.0 CM_RPM_0to16384 0.0 16383.75 /end CHARACTERISTIC
/begin CHARACTERISTIC D_BSTPShortLoIgnVoltThrshHi "cal comments" VALUE 0xBC1C Scalar_UW 0.0 CM_Volt_0to32_1 0.0 31.99900627136231 /end CHARACTERISTIC
/begin CHARACTERISTIC D_BSTPShortLoIgnVoltThrshLo "cal comments" VALUE 0xBC1A Scalar_UW 0.0 CM_Volt_0to32_1 0.0 31.99900627136231 /end CHARACTERISTIC
/begin CHARACTERISTIC D_BSTPShortLoSpdHiTPSThrsh "cal comments" VALUE 0xBC0A Scalar_UW 0.0 CM_Percent_0to200_2 0.0 199.9969024658203 /end CHARACTERISTIC
/begin CHARACTERISTIC D_BSTPShortLoSpdLoTPSThrsh "cal comments" VALUE 0xBC0C Scalar_UW 0.0 CM_Percent_0to200_2 0.0 199.9969024658203 /end CHARACTERISTIC
/begin CHARACTERISTIC D_BSTPShortLowFailTimeThrsh "cal comments" VALUE 0xBC12 Scalar_UW 0.0 CM_Count_0to65535_2 0.0 65535.0 /end CHARACTERISTIC
/begin CHARACTERISTIC D_BSTPShortLowPassTimeThrsh "cal comments" VALUE 0xBC14 Scalar_UW 0.0 CM_Count_0to65535_2 0.0 65535.0 /end CHARACTERISTIC
/begin CHARACTERISTIC D_O21ShortDiagCoolTempThrsh "cal comments" VALUE 0xBB90 Scalar_SW 0.0 CM_DegC_N256to256 -256.0 255.9921875 /end CHARACTERISTIC
/begin CHARACTERISTIC D_O21ShortDiagEnableDelay "cal comments" VALUE 0xBB92 Scalar_UW 0.0 CM_Second_0to65535 0.0 65535.0 /end CHARACTERISTIC
/begin CHARACTERISTIC D_O21ShortDiagIGNVoltThrsh "cal comments" VALUE 0xBB8E Scalar_UW 0.0 CM_Volt_0to32_1 0.0 31.99900627136231 /end CHARACTERISTIC
/begin CHARACTERISTIC D_O21ShortDiagPassTimeThrsh "cal comments" VALUE 0xBB9C Scalar_UW 0.0 CM_Count_0to65535_1 0.0 65535.0 /end CHARACTERISTIC
/begin CHARACTERISTIC D_O21ShortDiagSingalFiltCoef "cal comments" VALUE 0xBB8C Scalar_UW 0.0 CM_FiltCoef 0.0 0.9999847412109375 /end CHARACTERISTIC
/begin CHARACTERISTIC D_O21ShortEnb "cal comments" VALUE 0xBB9E Scalar_UB 0.0 CM_Boolean6 0.0 255.0 /end CHARACTERISTIC
/begin CHARACTERISTIC D_O21ShortHighFailTimeThrsh "cal comments" VALUE 0xBB9A Scalar_UW 0.0 CM_Count_0to65535_1 0.0 65535.0 /end CHARACTERISTIC
/begin CHARACTERISTIC D_O21ShortLightEnb "cal comments" VALUE 0xBB9F Scalar_UB 0.0 CM_Boolean6 0.0 255.0 /end CHARACTERISTIC
/begin CHARACTERISTIC D_O21ShortLowFailTimeThrsh "cal comments" VALUE 0xBB98 Scalar_UW 0.0 CM_Count_0to65535_1 0.0 65535.0 /end CHARACTERISTIC
/begin CHARACTERISTIC D_O21ShortRangeThreshHi "cal comments" VALUE 0xBB96 Scalar_UW 0.0 CM_mVolt_2 0.0 1023.96875 /end CHARACTERISTIC
/begin CHARACTERISTIC D_O21ShortRangeThreshLo "cal comments" VALUE 0xBB94 Scalar_UW 0.0 CM_mVolt_2 0.0 1023.96875 /end CHARACTERISTIC
/begin CHARACTERISTIC D_O2HeaterShortEnb "cal comments" VALUE 0xBBCA Scalar_UB 0.0 CM_Boolean6 0.0 255.0 /end CHARACTERISTIC
/begin CHARACTERISTIC D_O2HeaterShortFailThresh "cal comments" VALUE 0xBC95 Scalar_UB 0.0 CM_Count1 0.0 255.0 /end CHARACTERISTIC
/begin CHARACTERISTIC D_O2HeaterShortLightEnb "cal comments" VALUE 0xBBCB Scalar_UB 0.0 CM_Boolean6 0.0 255.0 /end CHARACTERISTIC
/begin CHARACTERISTIC D_O2HeaterShortPassThresh "cal comments" VALUE 0xBC96 Scalar_UB 0.0 CM_Count1 0.0 255.0 /end CHARACTERISTIC
/begin CHARACTERISTIC D_OutputDiagEnableDelay "cal comments" VALUE 0xBC82 Scalar_UB 0.0 CM_Second_0to64 0.0 63.75 /end CHARACTERISTIC
/begin CHARACTERISTIC D_SoftwareErrorEnb "cal comments" VALUE 0xBCAA Scalar_UB 0.0 CM_Boolean6 0.0 255.0 /end CHARACTERISTIC
/begin CHARACTERISTIC D_SoftwareErrorFailTimeThrsh "cal comments" VALUE 0xBCA6 Scalar_UW 0.0 CM_Count_0to65535_2 0.0 65535.0 /end CHARACTERISTIC
/begin CHARACTERISTIC D_SoftwareErrorLightEnb "cal comments" VALUE 0xBCAB Scalar_UB 0.0 CM_Boolean6 0.0 255.0 /end CHARACTERISTIC
/begin CHARACTERISTIC D_SoftwareErrorPassTimeThrsh "cal comments" VALUE 0xBCA8 Scalar_UW 0.0 CM_Count_0to65535_2 0.0 65535.0 /end CHARACTERISTIC
/begin CHARACTERISTIC D_FPFeedbackInputEnb "cal comments" VALUE 0xBBBC Scalar_UB 0.0 CM_Boolean6 0.0 255.0 /end CHARACTERISTIC
/begin CHARACTERISTIC D_FPFeedbackLightEnb "cal comments" VALUE 0xBBBD Scalar_UB 0.0 CM_Count3 0.0 255.0 /end CHARACTERISTIC
/begin CHARACTERISTIC D_FPFeedbackShortFailThresh "cal comments" VALUE 0xBBBA Scalar_UB 0.0 CM_Count3 0.0 255.0 /end CHARACTERISTIC
/begin CHARACTERISTIC D_FPFeedbackShortPassThresh "cal comments" VALUE 0xBBBB Scalar_UB 0.0 CM_Count3 0.0 255.0 /end CHARACTERISTIC
/begin CHARACTERISTIC D_OilPressureInputEnb "cal comments" VALUE 0xBC75 Scalar_UB 0.0 CM_Boolean6 0.0 255.0 /end CHARACTERISTIC
/begin CHARACTERISTIC D_OilPressureLightEnb "cal comments" VALUE 0xBC76 Scalar_UB 0.0 CM_Count3 0.0 255.0 /end CHARACTERISTIC
/begin CHARACTERISTIC D_OilPressureShortFailThresh "cal comments" VALUE 0xBC73 Scalar_UB 0.0 CM_Count3 0.0 255.0 /end CHARACTERISTIC
/begin CHARACTERISTIC D_OilPressureShortPassThresh "cal comments" VALUE 0xBC74 Scalar_UB 0.0 CM_Count3 0.0 255.0 /end CHARACTERISTIC
/begin CHARACTERISTIC D_OilPressureShortDetectDelay "cal comments" VALUE 0xBC72 Scalar_UB 0.0 CM_Count3 0.0 255.0 /end CHARACTERISTIC
/begin CHARACTERISTIC D_OilSWLowActive "cal comments" VALUE 0xBC77 Scalar_UB 0.0 CM_Boolean6 0.0 255.0 /end CHARACTERISTIC
/begin CHARACTERISTIC D_OilSWAnalogused "cal comments" VALUE 0xBC78 Scalar_UB 0.0 CM_Boolean6 0.0 255.0 /end CHARACTERISTIC
/begin CHARACTERISTIC D_OilSWShortRangeThreshLo "cal comments" VALUE 0xBC7A Scalar_UW 0.0 CM_Percent_0to100_1 0.0 99.9984130859375 /end CHARACTERISTIC
/begin CHARACTERISTIC D_OilSWShortRangeThreshHi "cal comments" VALUE 0xBC7C Scalar_UW 0.0 CM_Percent_0to100_1 0.0 99.9984130859375 /end CHARACTERISTIC
/begin CHARACTERISTIC D_SpkCoilShortFailThresh "cal comments" CURVE 0xBC83 2D_Array_UB 0.0 CM_Count1 0.0 255.0
 /begin AXIS_DESCR FIX_AXIS NO_INPUT_QUANTITY CM_EOI 4 0.0 4.0 MAX_GRAD 0.0 /begin FIX_AXIS_PAR_LIST 0 1 2 3 /end FIX_AXIS_PAR_LIST /end AXIS_DESCR
/end CHARACTERISTIC
/begin CHARACTERISTIC D_SpkCoilShortPassThresh "cal comments" CURVE 0xBC87 2D_Array_UB 0.0 CM_Count1 0.0 255.0
 /begin AXIS_DESCR FIX_AXIS NO_INPUT_QUANTITY CM_EOI 4 0.0 4.0 MAX_GRAD 0.0 /begin FIX_AXIS_PAR_LIST 0 1 2 3 /end FIX_AXIS_PAR_LIST /end AXIS_DESCR
/end CHARACTERISTIC
/begin CHARACTERISTIC D_TPSMotorControlEnb "cal comments" VALUE 0xBBCC Scalar_UB 0.0 CM_Boolean6 0.0 255.0 /end CHARACTERISTIC
/begin CHARACTERISTIC D_TPSMotorControlLightEnb "cal comments" VALUE 0xBBCD Scalar_UB 0.0 CM_Boolean6 0.0 255.0 /end CHARACTERISTIC
/begin CHARACTERISTIC D_TPSMotorDiagFailTimeThresh "cal comments" VALUE 0xBBCE Scalar_UW 0.0 CM_Count_0to65535_1 0.0 65535.0 /end CHARACTERISTIC
/begin CHARACTERISTIC D_TPSMotorDiagPassTimeThresh "cal comments" VALUE 0xBBD0 Scalar_UW 0.0 CM_Count_0to65535_1 0.0 65535.0 /end CHARACTERISTIC
/begin CHARACTERISTIC D_TPSMotorDiagTPSErrThresh "cal comments" VALUE 0xBBD6 Scalar_UW 0.0 CM_Percent_0to200_2 0.0 199.9969024658203 /end CHARACTERISTIC
/begin CHARACTERISTIC D_TPSMotorDynErrThrDecayStep "cal comments" VALUE 0xBBD4 Scalar_UW 0.0 CM_Percent_0to200_2 0.0 199.9969024658203 /end CHARACTERISTIC
/begin CHARACTERISTIC D_TPSMotorDynErrThrshGain "cal comments" VALUE 0xBBD2 Scalar_UW 0.0 udf_CM_18376 0.0 15.999755859375 /end CHARACTERISTIC
/begin CHARACTERISTIC D_FCVMotorControlEnb "cal comments" VALUE 0xBBBE Scalar_UB 0.0 CM_Boolean6 0.0 255.0 /end CHARACTERISTIC
/begin CHARACTERISTIC D_FCVMotorControlLightEnb "cal comments" VALUE 0xBBBF Scalar_UB 0.0 CM_Boolean6 0.0 255.0 /end CHARACTERISTIC
/begin CHARACTERISTIC D_FCVMotorDiagFailTimeThresh "cal comments" VALUE 0xBBC0 Scalar_UW 0.0 CM_Count_0to65535_1 0.0 65535.0 /end CHARACTERISTIC
/begin CHARACTERISTIC D_FCVMotorDiagPassTimeThresh "cal comments" VALUE 0xBBC2 Scalar_UW 0.0 CM_Count_0to65535_1 0.0 65535.0 /end CHARACTERISTIC
/begin CHARACTERISTIC D_FCVMotorDiagFCVPSErrThresh "cal comments" VALUE 0xBBC8 Scalar_UW 0.0 CM_Percent_0to200_2 0.0 199.9969024658203 /end CHARACTERISTIC
/begin CHARACTERISTIC D_FCVMotorDynErrThrDecayStep "cal comments" VALUE 0xBBC6 Scalar_UW 0.0 CM_Percent_0to200_2 0.0 199.9969024658203 /end CHARACTERISTIC
/begin CHARACTERISTIC D_FCVMotorDynErrThrshGain "cal comments" VALUE 0xBBC4 Scalar_UW 0.0 udf_CM_18376 0.0 15.999755859375 /end CHARACTERISTIC
/begin CHARACTERISTIC D_SWLOnMinDuration "cal comments" VALUE 0xBB5A Scalar_UB 0.0 CM_Seconds 0.0 127.5 /end CHARACTERISTIC
/begin CHARACTERISTIC D_IGNOffInitDDMS "cal comments" VALUE 0xBB5B Scalar_UB 0.0 CM_Boolean1 0.0 1.0 /end CHARACTERISTIC
/begin CHARACTERISTIC D_TPSShortDiagPassTimeThrsh "cal comments" VALUE 0xBCB2 Scalar_UW 0.0 CM_Count_0to65535_2 0.0 65535.0 /end CHARACTERISTIC
/begin CHARACTERISTIC D_TPSShortEnb "cal comments" VALUE 0xBCB8 Scalar_UB 0.0 CM_Boolean6 0.0 255.0 /end CHARACTERISTIC
/begin CHARACTERISTIC D_TPSShortHighFailTimeThrsh "cal comments" VALUE 0xBCAE Scalar_UW 0.0 CM_Count_0to65535_2 0.0 65535.0 /end CHARACTERISTIC
/begin CHARACTERISTIC D_TPSShortLightEnb "cal comments" VALUE 0xBCB9 Scalar_UB 0.0 CM_Boolean6 0.0 255.0 /end CHARACTERISTIC
/begin CHARACTERISTIC D_TPSShortLowFailTimeThrsh "cal comments" VALUE 0xBCB0 Scalar_UW 0.0 CM_Count_0to65535_2 0.0 65535.0 /end CHARACTERISTIC
/begin CHARACTERISTIC D_TPSShortRangeThreshHi "cal comments" VALUE 0xBCB6 Scalar_UW 0.0 CM_Percent_0to100_1 0.0 99.9984130859375 /end CHARACTERISTIC
/begin CHARACTERISTIC D_TPSShortRangeThreshLo "cal comments" VALUE 0xBCB4 Scalar_UW 0.0 CM_Percent_0to100_1 0.0 99.9984130859375 /end CHARACTERISTIC
/begin CHARACTERISTIC DT_MAPShortHiRunTimeThrsh "cal comments" CURVE 0xBC5A 2D_Array_UW 0.0 CM_Count_0to65535_2 0.0 65535.0
 /begin AXIS_DESCR FIX_AXIS NO_INPUT_QUANTITY CM_Equaloutput1 9 -40.0 40.0 MAX_GRAD 0.0 /begin FIX_AXIS_PAR_LIST -40 -30 -20 -10 0 10 20 30 40 /end FIX_AXIS_PAR_LIST /end AXIS_DESCR
/end CHARACTERISTIC
/begin MEASUREMENT AFRRamped "var comments" UWORD udf_CM_15464 0 0.0 0.0 31.99951171875 ECU_ADDRESS 0x40002098 /end MEASUREMENT
/begin MEASUREMENT AFRBase "var comments" UWORD udf_CM_15422 0 0.0 0.0 31.99951171875 ECU_ADDRESS 0x40002162 /end MEASUREMENT
/begin MEASUREMENT AFRCrankToRun "var comments" UBYTE udf_CM_15436 0 0.0 0.0 255.0 ECU_ADDRESS 0x40002094 /end MEASUREMENT
/begin MEASUREMENT AFRWarmUpEnb "var comments" UBYTE udf_CM_15513 0 0.0 0.0 255.0 ECU_ADDRESS 0x400020A2 /end MEASUREMENT
/begin MEASUREMENT AFRWarmUp "var comments" UWORD udf_CM_15506 0 0.0 0.0 31.99951171875 ECU_ADDRESS 0x400020A0 /end MEASUREMENT
/begin MEASUREMENT AFRWarmUpIdle "var comments" UWORD udf_CM_15520 0 0.0 0.0 31.99951171875 ECU_ADDRESS 0x4000209C /end MEASUREMENT
/begin MEASUREMENT AFRWarmUpRun "var comments" UWORD udf_CM_15527 0 0.0 0.0 31.99951171875 ECU_ADDRESS 0x4000209E /end MEASUREMENT
/begin MEASUREMENT AFRCrank "var comments" UWORD udf_CM_15429 0 0.0 0.0 31.99951171875 ECU_ADDRESS 0x4000215C /end MEASUREMENT
/begin MEASUREMENT AFRFinal "var comments" UWORD udf_CM_15450 0 0.0 0.0 31.99951171875 ECU_ADDRESS 0x400020A6 /end MEASUREMENT
/begin MEASUREMENT AFRPE "var comments" UWORD udf_CM_15457 0 0.0 0.0 31.99951171875 ECU_ADDRESS 0x400020A8 /end MEASUREMENT
/begin MEASUREMENT AFRTarget "var comments" UWORD udf_CM_15485 0 0.0 0.0 31.99951171875 ECU_ADDRESS 0x40002096 /end MEASUREMENT
/begin MEASUREMENT AirFlowCyl1 "var comments" UWORD udf_CM_15534 0 0.0 0.0 511.9921875 DISPLAY_IDENTIFIER AirFlowCyl[0] ECU_ADDRESS 0x40002008 /end MEASUREMENT
/begin MEASUREMENT AirFlowCyl2 "var comments" UWORD udf_CM_15541 0 0.0 0.0 511.9921875 DISPLAY_IDENTIFIER AirFlowCyl[1] ECU_ADDRESS 0x4000200A /end MEASUREMENT
/begin MEASUREMENT AFRVolt1 "var comments" UWORD udf_CM_15492 0 0.0 0.0 31.99951171875 DISPLAY_IDENTIFIER AFRVolt[0] ECU_ADDRESS 0x4000236A /end MEASUREMENT
/begin MEASUREMENT AFRVolt2 "var comments" UWORD udf_CM_15499 0 0.0 0.0 31.99951171875 DISPLAY_IDENTIFIER AFRVolt[1] ECU_ADDRESS 0x4000236C /end MEASUREMENT
/begin MEASUREMENT ClTSHDiagEnb "var comments" UBYTE udf_CM_15674 0 0.0 0.0 255.0 ECU_ADDRESS 0x400025A3 /end MEASUREMENT
/begin MEASUREMENT ClTSHFailCount "var comments" UWORD udf_CM_15681 0 0.0 0.0 65535.0 ECU_ADDRESS 0x400025B2 /end MEASUREMENT
/begin MEASUREMENT ClTSHFailMet "var comments" UBYTE udf_CM_15688 0 0.0 0.0 255.0 ECU_ADDRESS 0x400025A7 /end MEASUREMENT
/begin MEASUREMENT ClTSHPassCount "var comments" UWORD udf_CM_15695 0 0.0 0.0 65535.0 ECU_ADDRESS 0x400025B4 /end MEASUREMENT
/begin MEASUREMENT ClTSHTestFail "var comments" UBYTE udf_CM_15702 0 0.0 0.0 255.0 ECU_ADDRESS 0x400025AC /end MEASUREMENT
/begin MEASUREMENT ClTSLDiagEnb "var comments" UBYTE udf_CM_15709 0 0.0 0.0 255.0 ECU_ADDRESS 0x400025A2 /end MEASUREMENT
/begin MEASUREMENT ClTSLFailCount "var comments" UWORD udf_CM_15716 0 0.0 0.0 65535.0 ECU_ADDRESS 0x400025AE /end MEASUREMENT
/begin MEASUREMENT ClTSLFailMet "var comments" UBYTE udf_CM_15723 0 0.0 0.0 255.0 ECU_ADDRESS 0x400025A6 /end MEASUREMENT
/begin MEASUREMENT ClTSLPassCount "var comments" UWORD udf_CM_15730 0 0.0 0.0 65535.0 ECU_ADDRESS 0x400025B0 /end MEASUREMENT
/begin MEASUREMENT ClTSLTestFail "var comments" UBYTE udf_CM_15737 0 0.0 0.0 255.0 ECU_ADDRESS 0x400025AB /end MEASUREMENT
/begin MEASUREMENT ClTOHDiagEnb "var comments" UBYTE udf_CM_15709 0 0.0 0.0 255.0 ECU_ADDRESS 0x400025A4 /end MEASUREMENT
/begin MEASUREMENT ClTOHFailCount "var comments" UWORD udf_CM_15716 0 0.0 0.0 65535.0 ECU_ADDRESS 0x400025B6 /end MEASUREMENT
/begin MEASUREMENT ClTOHFailMet "var comments" UBYTE udf_CM_15723 0 0.0 0.0 255.0 ECU_ADDRESS 0x400025A0 /end MEASUREMENT
/begin MEASUREMENT ClTOHPassCount "var comments" UWORD udf_CM_15730 0 0.0 0.0 65535.0 ECU_ADDRESS 0x400025B8 /end MEASUREMENT
/begin MEASUREMENT ClTOHTestFail "var comments" UBYTE udf_CM_15737 0 0.0 0.0 255.0 ECU_ADDRESS 0x400025AD /end MEASUREMENT
/begin MEASUREMENT CoilASHFailMet "var comments" UBYTE udf_CM_18040 0 0.0 0.0 255.0 DISPLAY_IDENTIFIER SpkCoil_ShortHiFailCriteriaMet[0] ECU_ADDRESS 0x400026C8 /end MEASUREMENT
/begin MEASUREMENT CoilASLFailMet "var comments" UBYTE udf_CM_18047 0 0.0 0.0 255.0 DISPLAY_IDENTIFIER SpkCoil_ShortLoFailCriteriaMet[0] ECU_ADDRESS 0x400026CC /end MEASUREMENT
/begin MEASUREMENT CoilAShrtTestComp "var comments" UBYTE udf_CM_18061 0 0.0 0.0 255.0 DISPLAY_IDENTIFIER SpkCoil_ShortTestComplete[0] ECU_ADDRESS 0x400026B0 /end MEASUREMENT
/begin MEASUREMENT CoilAShrtDiagEnb "var comments" UBYTE udf_CM_18019 0 0.0 0.0 255.0 DISPLAY_IDENTIFIER SpkCoil_ShortEnblCriteriaMet[0] ECU_ADDRESS 0x400026A8 /end MEASUREMENT
/begin MEASUREMENT CoilAShrtTestFail "var comments" UBYTE udf_CM_18068 0 0.0 0.0 255.0 DISPLAY_IDENTIFIER SpkCoil_ShortTestFailed[0] ECU_ADDRESS 0x400026B4 /end MEASUREMENT
/begin MEASUREMENT CoilAShrtFailCount "var comments" UWORD udf_CM_18026 0 0.0 0.0 65535.0 DISPLAY_IDENTIFIER SpkCoil_ShortFailCntr[0] ECU_ADDRESS 0x400026B8 /end MEASUREMENT
/begin MEASUREMENT CoilAShrtFailMet "var comments" UBYTE udf_CM_18033 0 0.0 0.0 255.0 DISPLAY_IDENTIFIER SpkCoil_ShortFailCriteriaMet[0] ECU_ADDRESS 0x400026AC /end MEASUREMENT
/begin MEASUREMENT CoilAShrtPassCount "var comments" UWORD udf_CM_18054 0 0.0 0.0 65535.0 DISPLAY_IDENTIFIER SpkCoil_ShortSampleCntr[0] ECU_ADDRESS 0x400026C0 /end MEASUREMENT
/begin MEASUREMENT CoilBSHFailMet "var comments" UBYTE udf_CM_18040 0 0.0 0.0 255.0 DISPLAY_IDENTIFIER SpkCoil_ShortHiFailCriteriaMet[1] ECU_ADDRESS 0x400026C9 /end MEASUREMENT
/begin MEASUREMENT CoilBSLFailMet "var comments" UBYTE udf_CM_18047 0 0.0 0.0 255.0 DISPLAY_IDENTIFIER SpkCoil_ShortLoFailCriteriaMet[1] ECU_ADDRESS 0x400026CD /end MEASUREMENT
/begin MEASUREMENT CoilBShrtTestComp "var comments" UBYTE udf_CM_18061 0 0.0 0.0 255.0 DISPLAY_IDENTIFIER SpkCoil_ShortTestComplete[1] ECU_ADDRESS 0x400026B1 /end MEASUREMENT
/begin MEASUREMENT CoilBShrtDiagEnb "var comments" UBYTE udf_CM_18019 0 0.0 0.0 255.0 DISPLAY_IDENTIFIER SpkCoil_ShortEnblCriteriaMet[1] ECU_ADDRESS 0x400026A9 /end MEASUREMENT
/begin MEASUREMENT CoilBShrtTestFail "var comments" UBYTE udf_CM_18068 0 0.0 0.0 255.0 DISPLAY_IDENTIFIER SpkCoil_ShortTestFailed[1] ECU_ADDRESS 0x400026B5 /end MEASUREMENT
/begin MEASUREMENT CoilBShrtFailCount "var comments" UWORD udf_CM_18026 0 0.0 0.0 65535.0 DISPLAY_IDENTIFIER SpkCoil_ShortFailCntr[1] ECU_ADDRESS 0x400026BA /end MEASUREMENT
/begin MEASUREMENT CoilBShrtFailMet "var comments" UBYTE udf_CM_18033 0 0.0 0.0 255.0 DISPLAY_IDENTIFIER SpkCoil_ShortFailCriteriaMet[1] ECU_ADDRESS 0x400026AD /end MEASUREMENT
/begin MEASUREMENT CoilBShrtPassCount "var comments" UWORD udf_CM_18054 0 0.0 0.0 65535.0 DISPLAY_IDENTIFIER SpkCoil_ShortSampleCntr[1] ECU_ADDRESS 0x400026C2 /end MEASUREMENT
/begin MEASUREMENT CoilCSHFailMet "var comments" UBYTE udf_CM_18040 0 0.0 0.0 255.0 DISPLAY_IDENTIFIER SpkCoil_ShortHiFailCriteriaMet[2] ECU_ADDRESS 0x400026CA /end MEASUREMENT
/begin MEASUREMENT CoilCSLFailMet "var comments" UBYTE udf_CM_18047 0 0.0 0.0 255.0 DISPLAY_IDENTIFIER SpkCoil_ShortLoFailCriteriaMet[2] ECU_ADDRESS 0x400026CE /end MEASUREMENT
/begin MEASUREMENT CoilCShrtTestComp "var comments" UBYTE udf_CM_18061 0 0.0 0.0 255.0 DISPLAY_IDENTIFIER SpkCoil_ShortTestComplete[2] ECU_ADDRESS 0x400026B2 /end MEASUREMENT
/begin MEASUREMENT CoilCShrtDiagEnb "var comments" UBYTE udf_CM_18019 0 0.0 0.0 255.0 DISPLAY_IDENTIFIER SpkCoil_ShortEnblCriteriaMet[2] ECU_ADDRESS 0x400026AA /end MEASUREMENT
/begin MEASUREMENT CoilCShrtTestFail "var comments" UBYTE udf_CM_18068 0 0.0 0.0 255.0 DISPLAY_IDENTIFIER SpkCoil_ShortTestFailed[2] ECU_ADDRESS 0x400026B6 /end MEASUREMENT
/begin MEASUREMENT CoilCShrtFailCount "var comments" UWORD udf_CM_18026 0 0.0 0.0 65535.0 DISPLAY_IDENTIFIER SpkCoil_ShortFailCntr[2] ECU_ADDRESS 0x400026BC /end MEASUREMENT
/begin MEASUREMENT CoilCShrtFailMet "var comments" UBYTE udf_CM_18033 0 0.0 0.0 255.0 DISPLAY_IDENTIFIER SpkCoil_ShortFailCriteriaMet[2] ECU_ADDRESS 0x400026AE /end MEASUREMENT
/begin MEASUREMENT CoilCShrtPassCount "var comments" UWORD udf_CM_18054 0 0.0 0.0 65535.0 DISPLAY_IDENTIFIER SpkCoil_ShortSampleCntr[2] ECU_ADDRESS 0x400026C4 /end MEASUREMENT
/begin MEASUREMENT CoilDSHFailMet "var comments" UBYTE udf_CM_18040 0 0.0 0.0 255.0 DISPLAY_IDENTIFIER SpkCoil_ShortHiFailCriteriaMet[3] ECU_ADDRESS 0x400026CB /end MEASUREMENT
/begin MEASUREMENT CoilDSLFailMet "var comments" UBYTE udf_CM_18047 0 0.0 0.0 255.0 DISPLAY_IDENTIFIER SpkCoil_ShortLoFailCriteriaMet[3] ECU_ADDRESS 0x400026CF /end MEASUREMENT
/begin MEASUREMENT CoilDShrtTestComp "var comments" UBYTE udf_CM_18061 0 0.0 0.0 255.0 DISPLAY_IDENTIFIER SpkCoil_ShortTestComplete[3] ECU_ADDRESS 0x400026B3 /end MEASUREMENT
/begin MEASUREMENT CoilDShrtDiagEnb "var comments" UBYTE udf_CM_18019 0 0.0 0.0 255.0 DISPLAY_IDENTIFIER SpkCoil_ShortEnblCriteriaMet[3] ECU_ADDRESS 0x400026AB /end MEASUREMENT
/begin MEASUREMENT CoilDShrtTestFail "var comments" UBYTE udf_CM_18068 0 0.0 0.0 255.0 DISPLAY_IDENTIFIER SpkCoil_ShortTestFailed[3] ECU_ADDRESS 0x400026B7 /end MEASUREMENT
/begin MEASUREMENT CoilDShrtFailCount "var comments" UWORD udf_CM_18026 0 0.0 0.0 65535.0 DISPLAY_IDENTIFIER SpkCoil_ShortFailCntr[3] ECU_ADDRESS 0x400026BE /end MEASUREMENT
/begin MEASUREMENT CoilDShrtFailMet "var comments" UBYTE udf_CM_18033 0 0.0 0.0 255.0 DISPLAY_IDENTIFIER SpkCoil_ShortFailCriteriaMet[3] ECU_ADDRESS 0x400026AF /end MEASUREMENT
/begin MEASUREMENT CoilDShrtPassCount "var comments" UWORD udf_CM_18054 0 0.0 0.0 65535.0 DISPLAY_IDENTIFIER SpkCoil_ShortSampleCntr[3] ECU_ADDRESS 0x400026C6 /end MEASUREMENT
/begin MEASUREMENT CrkDiagTmrEnb "var comments" UBYTE udf_CM_15849 0 0.0 0.0 255.0 DISPLAY_IDENTIFIER CrkDiag_7p8TimerEnbl[0] ECU_ADDRESS 0x400025E2 /end MEASUREMENT
/begin MEASUREMENT CrkNoSigDiagEnb "var comments" UBYTE udf_CM_15905 0 0.0 0.0 255.0 ECU_ADDRESS 0x400025EE /end MEASUREMENT
/begin MEASUREMENT CrkNoSigFailMet "var comments" UBYTE udf_CM_15912 0 0.0 0.0 255.0 ECU_ADDRESS 0x400025DE /end MEASUREMENT
/begin MEASUREMENT CrkDiagTmr1 "var comments" UWORD udf_CM_15842 0 0.0 0.0 511.9921875 DISPLAY_IDENTIFIER CrkDiag_7p8TimerArray[1] ECU_ADDRESS 0x400025E6 /end MEASUREMENT
/begin MEASUREMENT CrkNoSigTestFail "var comments" UBYTE udf_CM_15926 0 0.0 0.0 255.0 ECU_ADDRESS 0x400025EC /end MEASUREMENT
/begin MEASUREMENT CrkNoSigTestComp "var comments" UBYTE udf_CM_15919 0 0.0 0.0 255.0 ECU_ADDRESS 0x400025EA /end MEASUREMENT
/begin MEASUREMENT CrkDiagTmr0 "var comments" UWORD udf_CM_15835 0 0.0 0.0 511.9921875 DISPLAY_IDENTIFIER CrkDiag_7p8TimerArray[0] ECU_ADDRESS 0x400025E4 /end MEASUREMENT
/begin MEASUREMENT CrkNoSigTestReported "var comments" UBYTE udf_CM_15933 0 0.0 0.0 255.0 ECU_ADDRESS 0x400025DF /end MEASUREMENT
/begin MEASUREMENT CrkNoisyDiagEnb "var comments" UBYTE udf_CM_15856 0 0.0 0.0 255.0 ECU_ADDRESS 0x400025E9 /end MEASUREMENT
/begin MEASUREMENT CrkNoisyFailCnt "var comments" UWORD udf_CM_15863 0 0.0 0.0 65535.0 ECU_ADDRESS 0x400025F4 /end MEASUREMENT
/begin MEASUREMENT CrkNoisyFailMet "var comments" UBYTE udf_CM_15870 0 0.0 0.0 255.0 ECU_ADDRESS 0x400025EF /end MEASUREMENT
/begin MEASUREMENT CrkNoisyPassCnt "var comments" UWORD udf_CM_15877 0 0.0 0.0 65535.0 ECU_ADDRESS 0x400025F2 /end MEASUREMENT
/begin MEASUREMENT CrkNoisyTestComp "var comments" UBYTE udf_CM_15884 0 0.0 0.0 255.0 ECU_ADDRESS 0x400025E8 /end MEASUREMENT
/begin MEASUREMENT CrkNoisyTestFail "var comments" UBYTE udf_CM_15891 0 0.0 0.0 255.0 ECU_ADDRESS 0x400025ED /end MEASUREMENT
/begin MEASUREMENT CrkNoisyTestReported "var comments" UBYTE udf_CM_15898 0 0.0 0.0 255.0 ECU_ADDRESS 0x400025E0 /end MEASUREMENT
/begin MEASUREMENT IgnVoltAtKeyOn "var comments" UWORD udf_CM_16920 0 0.0 0.0 31.99951171875 ECU_ADDRESS 0x400025F6 /end MEASUREMENT
/begin MEASUREMENT CrankToRunMet "var comments" UBYTE udf_CM_15821 0 0.0 0.0 255.0 ECU_ADDRESS 0x400023A1 /end MEASUREMENT
/begin MEASUREMENT CrankToStallMet "var comments" UBYTE udf_CM_15828 0 0.0 0.0 255.0 ECU_ADDRESS 0x400023A2 /end MEASUREMENT
/begin MEASUREMENT MAPCIDEnb "var comments" UBYTE udf_CM_17095 0 0.0 0.0 255.0 ECU_ADDRESS 0x40002385 /end MEASUREMENT
/begin MEASUREMENT DesireTPS "var comments" UWORD udf_CM_15989 0 0.0 0.0 199.9969482421875 ECU_ADDRESS 0x400024EA /end MEASUREMENT
/begin MEASUREMENT DiagWarningLamp "var comments" UBYTE udf_CM_16010 0 0.0 0.0 1.0 ECU_ADDRESS 0x4000255C /end MEASUREMENT
/begin MEASUREMENT DsrdSpdStep "var comments" UWORD udf_CM_16787 0 0.0 0.0 16383.75 DISPLAY_IDENTIFIER IdlDsrdEngSpdStep ECU_ADDRESS 0x40002212 /end MEASUREMENT
/begin MEASUREMENT DsrdSpdTarget "var comments" UWORD udf_CM_16794 0 0.0 0.0 16383.75 DISPLAY_IDENTIFIER IdlDsrdEngSpdTarget ECU_ADDRESS 0x4000220C /end MEASUREMENT
/begin MEASUREMENT DsrdThrFlow "var comments" UWORD udf_CM_15982 0 0.0 0.0 511.9921875 ECU_ADDRESS 0x40002500 /end MEASUREMENT
/begin MEASUREMENT DesireTPSOld "var comments" UWORD udf_CM_15996 0 0.0 0.0 199.9969482421875 ECU_ADDRESS 0x40002502 /end MEASUREMENT
/begin MEASUREMENT EngSpdAvg "var comments" UWORD udf_CM_16066 0 0.0 0.0 16383.75 DISPLAY_IDENTIFIER EngineSpeed_Avg ECU_ADDRESS 0x40002474 /end MEASUREMENT
/begin MEASUREMENT EngSpdOld0 "var comments" UWORD udf_CM_16073 0 0.0 0.0 16383.75 DISPLAY_IDENTIFIER EngineSpeed_AvgOld[0] ECU_ADDRESS 0x40002450 /end MEASUREMENT
/begin MEASUREMENT EngSpdOld1 "var comments" UWORD udf_CM_16122 0 0.0 0.0 16383.75 DISPLAY_IDENTIFIER EngineSpeed_AvgOld[1] ECU_ADDRESS 0x40002452 /end MEASUREMENT
/begin MEASUREMENT EngSpdOld10 "var comments" UWORD udf_CM_16080 0 0.0 0.0 16383.75 DISPLAY_IDENTIFIER EngineSpeed_AvgOld[10] ECU_ADDRESS 0x40002464 /end MEASUREMENT
/begin MEASUREMENT EngSpdOld11 "var comments" UWORD udf_CM_16087 0 0.0 0.0 16383.75 DISPLAY_IDENTIFIER EngineSpeed_AvgOld[11] ECU_ADDRESS 0x40002466 /end MEASUREMENT
/begin MEASUREMENT EngSpdOld12 "var comments" UWORD udf_CM_16094 0 0.0 0.0 16383.75 DISPLAY_IDENTIFIER EngineSpeed_AvgOld[12] ECU_ADDRESS 0x40002468 /end MEASUREMENT
/begin MEASUREMENT EngSpdOld13 "var comments" UWORD udf_CM_16101 0 0.0 0.0 16383.75 DISPLAY_IDENTIFIER EngineSpeed_AvgOld[13] ECU_ADDRESS 0x4000246A /end MEASUREMENT
/begin MEASUREMENT EngSpdOld14 "var comments" UWORD udf_CM_16108 0 0.0 0.0 16383.75 DISPLAY_IDENTIFIER EngineSpeed_AvgOld[14] ECU_ADDRESS 0x4000246C /end MEASUREMENT
/begin MEASUREMENT EngSpdOld15 "var comments" UWORD udf_CM_16115 0 0.0 0.0 16383.75 DISPLAY_IDENTIFIER EngineSpeed_AvgOld[15] ECU_ADDRESS 0x4000246E /end MEASUREMENT
/begin MEASUREMENT EngSpdOld2 "var comments" UWORD udf_CM_16129 0 0.0 0.0 16383.75 DISPLAY_IDENTIFIER EngineSpeed_AvgOld[2] ECU_ADDRESS 0x40002454 /end MEASUREMENT
/begin MEASUREMENT EngSpdOld3 "var comments" UWORD udf_CM_16136 0 0.0 0.0 16383.75 DISPLAY_IDENTIFIER EngineSpeed_AvgOld[3] ECU_ADDRESS 0x40002456 /end MEASUREMENT
/begin MEASUREMENT EngSpdOld4 "var comments" UWORD udf_CM_16143 0 0.0 0.0 16383.75 DISPLAY_IDENTIFIER EngineSpeed_AvgOld[4] ECU_ADDRESS 0x40002458 /end MEASUREMENT
/begin MEASUREMENT EngSpdOld5 "var comments" UWORD udf_CM_16150 0 0.0 0.0 16383.75 DISPLAY_IDENTIFIER EngineSpeed_AvgOld[5] ECU_ADDRESS 0x4000245A /end MEASUREMENT
/begin MEASUREMENT EngSpdOld6 "var comments" UWORD udf_CM_16157 0 0.0 0.0 16383.75 DISPLAY_IDENTIFIER EngineSpeed_AvgOld[6] ECU_ADDRESS 0x4000245C /end MEASUREMENT
/begin MEASUREMENT EngSpdOld7 "var comments" UWORD udf_CM_16164 0 0.0 0.0 16383.75 DISPLAY_IDENTIFIER EngineSpeed_AvgOld[7] ECU_ADDRESS 0x4000245E /end MEASUREMENT
/begin MEASUREMENT EngSpdOld8 "var comments" UWORD udf_CM_16171 0 0.0 0.0 16383.75 DISPLAY_IDENTIFIER EngineSpeed_AvgOld[8] ECU_ADDRESS 0x40002460 /end MEASUREMENT
/begin MEASUREMENT EngSpdOld9 "var comments" UWORD udf_CM_16178 0 0.0 0.0 16383.75 DISPLAY_IDENTIFIER EngineSpeed_AvgOld[9] ECU_ADDRESS 0x40002462 /end MEASUREMENT
/begin MEASUREMENT MultFuelType "var comments" UBYTE udf_CM_16193 0 0.0 0.0 255.0 ECU_ADDRESS 0x400024DA /end MEASUREMENT
/begin MEASUREMENT MultFuelSeq "var comments" UBYTE udf_CM_18012 0 0.0 0.0 255.0 ECU_ADDRESS 0x400024DB /end MEASUREMENT
/begin MEASUREMENT EngineState "var comments" UBYTE udf_CM_16192 0 0.0 0.0 255.0 ECU_ADDRESS 0x4000239E /end MEASUREMENT
/begin MEASUREMENT EngTorque "var comments" SWORD udf_CM_16059 0 0.0 -128.0 127.99609375 DISPLAY_IDENTIFIER EngineFlywheelTorq ECU_ADDRESS 0x40002092 /end MEASUREMENT
/begin MEASUREMENT EngineTuning "var comments" UBYTE udf_CM_16199 0 0.0 0.0 255.0 ECU_ADDRESS 0x400023AC /end MEASUREMENT
/begin MEASUREMENT O2SHTestFail "var comments" UBYTE udf_CM_17508 0 0.0 0.0 255.0 ECU_ADDRESS 0x400025D3 /end MEASUREMENT
/begin MEASUREMENT O2ShrtDiagEnb "var comments" UBYTE udf_CM_17494 0 0.0 0.0 255.0 ECU_ADDRESS 0x400025D0 /end MEASUREMENT
/begin MEASUREMENT O2SHFailMet "var comments" UBYTE udf_CM_17487 0 0.0 0.0 255.0 ECU_ADDRESS 0x400025D6 /end MEASUREMENT
/begin MEASUREMENT O2SHFailCount "var comments" UWORD udf_CM_17480 0 0.0 0.0 65535.0 ECU_ADDRESS 0x400025D8 /end MEASUREMENT
/begin MEASUREMENT O2SLFailMet "var comments" UBYTE udf_CM_17522 0 0.0 0.0 255.0 ECU_ADDRESS 0x400025D5 /end MEASUREMENT
/begin MEASUREMENT O2SLFailCount "var comments" UWORD udf_CM_17515 0 0.0 0.0 65535.0 ECU_ADDRESS 0x400025DA /end MEASUREMENT
/begin MEASUREMENT O2SLTestFail "var comments" UBYTE udf_CM_17529 0 0.0 0.0 255.0 ECU_ADDRESS 0x400025D2 /end MEASUREMENT
/begin MEASUREMENT O2ShrtPassCount "var comments" UWORD udf_CM_17501 0 0.0 0.0 65535.0 ECU_ADDRESS 0x400025DC /end MEASUREMENT
/begin MEASUREMENT BaseFPWCyl1 "var comments" UWORD udf_CM_15597 0 0.0 0.0 1023.984375 DISPLAY_IDENTIFIER BaseFPWCyl ECU_ADDRESS 0x4000207C /end MEASUREMENT
/begin MEASUREMENT BaseFuelMassCyl1 "var comments" UWORD udf_CM_15604 0 0.0 0.0 0.9999849796295166 DISPLAY_IDENTIFIER BaseFuelMassCyl ECU_ADDRESS 0x40002086 /end MEASUREMENT
/begin MEASUREMENT BaseFMPrevCyl1 "var comments" UWORD udf_CM_15590 0 0.0 0.0 0.9999849796295166 DISPLAY_IDENTIFIER BaseFMPrevCyl ECU_ADDRESS 0x40002090 /end MEASUREMENT
/begin MEASUREMENT FPWClCorrCyl1 "var comments" UWORD udf_CM_16409 0 0.0 0.0 1023.984375 DISPLAY_IDENTIFIER FPWClCorrCyl[0] ECU_ADDRESS 0x4000207E /end MEASUREMENT
/begin MEASUREMENT FPWClCorrCyl2 "var comments" UWORD udf_CM_16416 0 0.0 0.0 1023.984375 DISPLAY_IDENTIFIER FPWClCorrCyl[1] ECU_ADDRESS 0x40002080 /end MEASUREMENT
/begin MEASUREMENT ChrgAirTmpCyl1 "var comments" SWORD udf_CM_15646 0 0.0 -256.0 255.9921875 DISPLAY_IDENTIFIER ChrgAirTmpCyl ECU_ADDRESS 0x40002014 /end MEASUREMENT
/begin MEASUREMENT FuelCLTermCyl1 "var comments" SWORD udf_CM_16437 0 0.0 -4.0 3.9998779296875 DISPLAY_IDENTIFIER FuelCLTermCyl ECU_ADDRESS 0x40002182 /end MEASUREMENT
/begin MEASUREMENT FuelCLEnbCyl1 "var comments" UBYTE udf_CM_16423 0 0.0 0.0 255.0 DISPLAY_IDENTIFIER FuelCLEnbCyl ECU_ADDRESS 0x40002191 /end MEASUREMENT
/begin MEASUREMENT FuelINTCyl1 "var comments" SWORD udf_CM_16500 0 0.0 -32768.0 32767.0 DISPLAY_IDENTIFIER FuelINTCyl ECU_ADDRESS 0x4000218E /end MEASUREMENT
/begin MEASUREMENT FuelINTDlyCyl1 "var comments" UWORD udf_CM_16507 0 0.0 0.0 1023.984375 DISPLAY_IDENTIFIER FuelINTDlyCyl ECU_ADDRESS 0x400021A2 /end MEASUREMENT
/begin MEASUREMENT FPropMinDurEnb "var comments" UBYTE udf_CM_16395 0 0.0 0.0 255.0 ECU_ADDRESS 0x4000219C /end MEASUREMENT
/begin MEASUREMENT FRichBiasHold1 "var comments" SWORD udf_CM_17067 0 0.0 -32.0 31.9990234375 DISPLAY_IDENTIFIER INTRatioCyl ECU_ADDRESS 0x4000217E /end MEASUREMENT
/begin MEASUREMENT RawO2RLThresh "var comments" UWORD udf_CM_17648 0 0.0 0.0 1023.984375 ECU_ADDRESS 0x4000218C /end MEASUREMENT
/begin MEASUREMENT FPropLoLoadCond "var comments" UBYTE udf_CM_19230 0 0.0 0.0 255.0 DISPLAY_IDENTIFIER VbFUEL_PropTerm_LowLoad ECU_ADDRESS 0x4000219B /end MEASUREMENT
/begin MEASUREMENT FPropAddFuelCyl1 "var comments" UBYTE udf_CM_16381 0 0.0 0.0 255.0 DISPLAY_IDENTIFIER FPropAddFuelCyl[0] ECU_ADDRESS 0x400021A8 /end MEASUREMENT
/begin MEASUREMENT FuelINTRstCyl1 "var comments" UBYTE udf_CM_16521 0 0.0 0.0 255.0 DISPLAY_IDENTIFIER FuelINTRstCyl ECU_ADDRESS 0x40002186 /end MEASUREMENT
/begin MEASUREMENT FuelINTDlyPass1 "var comments" UBYTE udf_CM_16514 0 0.0 0.0 255.0 DISPLAY_IDENTIFIER FuelINTDlyPass ECU_ADDRESS 0x4000219D /end MEASUREMENT
/begin MEASUREMENT INTRatioCyl1 "var comments" UWORD udf_CM_19048 0 0.0 0.0 1.999969005584717 DISPLAY_IDENTIFIER VaFUEL_ClosedLoop_Mult ECU_ADDRESS 0x40002180 /end MEASUREMENT
/begin MEASUREMENT FPropRichHold1 "var comments" UBYTE udf_CM_16402 0 0.0 0.0 255.0 DISPLAY_IDENTIFIER FPropRichHold ECU_ADDRESS 0x4000218A /end MEASUREMENT
/begin MEASUREMENT FuelPropCyl1 "var comments" UWORD udf_CM_16535 0 0.0 0.0 199.9969482421875 DISPLAY_IDENTIFIER FuelPropCyl ECU_ADDRESS 0x40002194 /end MEASUREMENT
/begin MEASUREMENT FuelCLRstCyl1 "var comments" UBYTE udf_CM_16430 0 0.0 0.0 255.0 DISPLAY_IDENTIFIER FuelCLRstCyl ECU_ADDRESS 0x40002197 /end MEASUREMENT
/begin MEASUREMENT CATFactorCyl1 "var comments" SWORD udf_CM_15639 0 0.0 -1.998847961425781 1.998787045478821 DISPLAY_IDENTIFIER CATFactorCyl ECU_ADDRESS 0x40002012 /end MEASUREMENT
/begin MEASUREMENT FuelEOI "var comments" UWORD udf_CM_16465 0 0.0 0.0 1023.984375 ECU_ADDRESS 0x4000211E /end MEASUREMENT
/begin MEASUREMENT FuelEOITarget "var comments" UWORD udf_CM_16472 0 0.0 0.0 1023.984375 ECU_ADDRESS 0x4000212A /end MEASUREMENT
/begin MEASUREMENT FuelEOITrim "var comments" UWORD udf_CM_16479 0 0.0 0.0 1023.984375 ECU_ADDRESS 0x40002130 /end MEASUREMENT
/begin MEASUREMENT O2HeaterOutputEnable "var comments" UBYTE udf_CM_17452 0 0.0 0.0 255.0 ECU_ADDRESS 0x4000206F /end MEASUREMENT
/begin MEASUREMENT FuelInj1Enb "var comments" UBYTE udf_CM_16486 0 0.0 0.0 255.0 DISPLAY_IDENTIFIER FuelInjEnb[0] ECU_ADDRESS 0x4000212C /end MEASUREMENT
/begin MEASUREMENT FuelInj2Enb "var comments" UBYTE udf_CM_16493 0 0.0 0.0 255.0 DISPLAY_IDENTIFIER FuelInjEnb[1] ECU_ADDRESS 0x4000212D /end MEASUREMENT
/begin MEASUREMENT InjectorOffset "var comments" UWORD udf_CM_17046 0 0.0 0.0 1023.984375 ECU_ADDRESS 0x40002134 /end MEASUREMENT
/begin MEASUREMENT FO21Filt "var comments" UWORD udf_CM_16325 0 0.0 0.0 1023.984375 DISPLAY_IDENTIFIER FO2Filt ECU_ADDRESS 0x400021A0 /end MEASUREMENT
/begin MEASUREMENT FO21Ready "var comments" UBYTE udf_CM_16339 0 0.0 0.0 255.0 DISPLAY_IDENTIFIER FO2Ready ECU_ADDRESS 0x40002196 /end MEASUREMENT
/begin MEASUREMENT FO21RichOld "var comments" UBYTE udf_CM_16311 0 0.0 0.0 1.0 ECU_ADDRESS 0x40002188 /end MEASUREMENT
/begin MEASUREMENT FO21FiltRich "var comments" UBYTE udf_CM_16332 0 0.0 0.0 1.0 DISPLAY_IDENTIFIER FO2FiltRich ECU_ADDRESS 0x40002187 /end MEASUREMENT
/begin MEASUREMENT FO21Rich "var comments" UBYTE udf_CM_16346 0 0.0 0.0 1.0 DISPLAY_IDENTIFIER FO2Rich ECU_ADDRESS 0x40002190 /end MEASUREMENT
/begin MEASUREMENT FO2RLThresh "var comments" UWORD udf_CM_16360 0 0.0 0.0 1023.984375 ECU_ADDRESS 0x40002192 /end MEASUREMENT
/begin MEASUREMENT FO21RLChange "var comments" UBYTE udf_CM_16353 0 0.0 0.0 255.0 DISPLAY_IDENTIFIER FO2RLChange ECU_ADDRESS 0x4000219A /end MEASUREMENT
/begin MEASUREMENT O2HeaterEnb "var comments" UBYTE udf_CM_17445 0 0.0 0.0 255.0 DISPLAY_IDENTIFIER O2HeaterEnable ECU_ADDRESS 0x4000206E /end MEASUREMENT
/begin MEASUREMENT ExtPEModeEnb "var comments" UBYTE udf_CM_16269 0 0.0 0.0 255.0 ECU_ADDRESS 0x400020A3 /end MEASUREMENT
/begin MEASUREMENT FuelPumpEnb "var comments" UBYTE udf_CM_16605 0 0.0 0.0 255.0 ECU_ADDRESS 0x4000213B /end MEASUREMENT
/begin MEASUREMENT PowerEnrich "var comments" UBYTE udf_CM_17613 0 0.0 0.0 255.0 ECU_ADDRESS 0x40002136 /end MEASUREMENT
/begin MEASUREMENT FPumpSHFailMet "var comments" UBYTE udf_CM_16563 0 0.0 0.0 255.0 DISPLAY_IDENTIFIER FuelPump_ShortHiFailCriteriaMet ECU_ADDRESS 0x400026D7 /end MEASUREMENT
/begin MEASUREMENT FPumpSLFailMet "var comments" UBYTE udf_CM_16570 0 0.0 0.0 255.0 DISPLAY_IDENTIFIER FuelPump_ShortLoFailCriteriaMet ECU_ADDRESS 0x400026D9 /end MEASUREMENT
/begin MEASUREMENT FPumpShrtTestComp "var comments" UBYTE udf_CM_16584 0 0.0 0.0 255.0 DISPLAY_IDENTIFIER FuelPump_ShortTestComplete ECU_ADDRESS 0x400026D6 /end MEASUREMENT
/begin MEASUREMENT FPumpShrtDiagEnb "var comments" UBYTE udf_CM_16542 0 0.0 0.0 255.0 DISPLAY_IDENTIFIER FuelPump_ShortEnblCriteriaMet ECU_ADDRESS 0x400026D4 /end MEASUREMENT
/begin MEASUREMENT FPumpShrtTestFail "var comments" UBYTE udf_CM_16591 0 0.0 0.0 255.0 DISPLAY_IDENTIFIER FuelPump_ShortTestFailed ECU_ADDRESS 0x400026D8 /end MEASUREMENT
/begin MEASUREMENT FPumpShrtFailCount "var comments" UWORD udf_CM_16549 0 0.0 0.0 65535.0 DISPLAY_IDENTIFIER FuelPump_ShortFailCntr ECU_ADDRESS 0x400026DA /end MEASUREMENT
/begin MEASUREMENT FPumpShrtFailMet "var comments" UBYTE udf_CM_16556 0 0.0 0.0 255.0 DISPLAY_IDENTIFIER FuelPump_ShortFailCriteriaMet ECU_ADDRESS 0x400026D5 /end MEASUREMENT
/begin MEASUREMENT FPumpShrtPassCount "var comments" UWORD udf_CM_16577 0 0.0 0.0 65535.0 DISPLAY_IDENTIFIER FuelPump_ShortSampleCntr ECU_ADDRESS 0x400026DC /end MEASUREMENT
/begin MEASUREMENT FuelPumpRunEnb "var comments" UBYTE udf_CM_16619 0 0.0 0.0 255.0 ECU_ADDRESS 0x40002139 /end MEASUREMENT
/begin MEASUREMENT FuelPumpDC "var comments" UWORD udf_CM_16598 0 0.0 0.0 199.9969482421875 ECU_ADDRESS 0x4000213C /end MEASUREMENT
/begin MEASUREMENT FuelPumpPPDsrd "var comments" UBYTE udf_CM_19244 0 0.0 0.0 255.0 DISPLAY_IDENTIFIER VbFUEL_PumpPrimeForPP_Dsrd ECU_ADDRESS 0x40002143 /end MEASUREMENT
/begin MEASUREMENT FuelPumpPrmEnb "var comments" UBYTE udf_CM_16612 0 0.0 0.0 255.0 ECU_ADDRESS 0x40002138 /end MEASUREMENT
/begin MEASUREMENT FuelVoltCorr "var comments" UWORD udf_CM_16626 0 0.0 0.0 1.999969005584717 ECU_ADDRESS 0x40002132 /end MEASUREMENT
/begin MEASUREMENT FinalFPWCyl1 "var comments" UWORD udf_CM_16283 0 0.0 0.0 1023.984375 DISPLAY_IDENTIFIER FinalFPWCyl[0] ECU_ADDRESS 0x40002122 /end MEASUREMENT
/begin MEASUREMENT FinalFPWCyl2 "var comments" UWORD udf_CM_16290 0 0.0 0.0 1023.984375 DISPLAY_IDENTIFIER FinalFPWCyl[1] ECU_ADDRESS 0x40002124 /end MEASUREMENT
/begin MEASUREMENT FinalFPWCyl3 "var comments" UWORD udf_CM_16290 0 0.0 0.0 1023.984375 DISPLAY_IDENTIFIER FinalFPWCyl[2] ECU_ADDRESS 0x40002126 /end MEASUREMENT
/begin MEASUREMENT FinalFPWCyl4 "var comments" UWORD udf_CM_16290 0 0.0 0.0 1023.984375 DISPLAY_IDENTIFIER FinalFPWCyl[3] ECU_ADDRESS 0x40002128 /end MEASUREMENT
/begin MEASUREMENT O2HtAccFuelMassPrevious "var comments" UWORD udf_CM_17466 0 0.0 0.0 7.9998779296875 ECU_ADDRESS 0x40002072 /end MEASUREMENT
/begin MEASUREMENT O2HtAccFuelMass "var comments" UWORD udf_CM_17459 0 0.0 0.0 7.9998779296875 ECU_ADDRESS 0x40002070 /end MEASUREMENT
/begin MEASUREMENT O2HeaterDC "var comments" UWORD udf_CM_17438 0 0.0 0.0 199.9969482421875 DISPLAY_IDENTIFIER O2HeaterDutyCycle ECU_ADDRESS 0x400023B0 /end MEASUREMENT
/begin MEASUREMENT O2HtAccFuelMassThresh "var comments" UWORD udf_CM_17473 0 0.0 0.0 7.9998779296875 ECU_ADDRESS 0x40002074 /end MEASUREMENT
/begin MEASUREMENT AEDecayFactor "var comments" UWORD udf_CM_15261 0 0.0 0.0 0.9999849796295166 ECU_ADDRESS 0x4000214C /end MEASUREMENT
/begin MEASUREMENT AECancelled "var comments" UBYTE udf_CM_15254 0 0.0 0.0 255.0 ECU_ADDRESS 0x40002152 /end MEASUREMENT
/begin MEASUREMENT AEFuelCyl1 "var comments" UWORD udf_CM_15268 0 0.0 0.0 7.9998779296875 DISPLAY_IDENTIFIER AEFuelCyl ECU_ADDRESS 0x40002144 /end MEASUREMENT
/begin MEASUREMENT AccEnrich "var comments" UBYTE udf_CM_15240 0 0.0 0.0 255.0 ECU_ADDRESS 0x40002150 /end MEASUREMENT
/begin MEASUREMENT DEDecayFactor "var comments" UWORD udf_CM_15961 0 0.0 0.0 0.9999849796295166 ECU_ADDRESS 0x4000214E /end MEASUREMENT
/begin MEASUREMENT DEFuelCyl1 "var comments" UWORD udf_CM_15968 0 0.0 0.0 7.9998779296875 DISPLAY_IDENTIFIER DEFuelCyl ECU_ADDRESS 0x40002146 /end MEASUREMENT
/begin MEASUREMENT DECancelled "var comments" UBYTE udf_CM_15947 0 0.0 0.0 255.0 ECU_ADDRESS 0x40002153 /end MEASUREMENT
/begin MEASUREMENT DecEnlean "var comments" UBYTE udf_CM_15954 0 0.0 0.0 255.0 ECU_ADDRESS 0x40002151 /end MEASUREMENT
/begin MEASUREMENT DeltaFuelCyl1 "var comments" UWORD udf_CM_15975 0 0.0 0.0 0.9999849796295166 DISPLAY_IDENTIFIER DeltaFuelCyl ECU_ADDRESS 0x4000214A /end MEASUREMENT
/begin MEASUREMENT TranFuelDltCyl1 "var comments" SWORD udf_CM_18908 0 0.0 -8.0 7.999755859375 DISPLAY_IDENTIFIER TranFuelDltCyl ECU_ADDRESS 0x40002148 /end MEASUREMENT
/begin MEASUREMENT FuelCutOff "var comments" UBYTE udf_CM_16451 0 0.0 0.0 255.0 ECU_ADDRESS 0x400020B6 /end MEASUREMENT
/begin MEASUREMENT SparkCutOff "var comments" UBYTE udf_CM_16451 0 0.0 0.0 255.0 ECU_ADDRESS 0x400020B7 /end MEASUREMENT
/begin MEASUREMENT VbFUEL_ClearFloodEnbl "var comments" UBYTE udf_CM_15723 0 0.0 0.0 255.0 ECU_ADDRESS 0x0 /end MEASUREMENT
/begin MEASUREMENT VfFUEL_TPS_DFCOThrsh "var comments" UWORD udf_CM_16871 0 0.0 0.0 199.9969482421875 ECU_ADDRESS 0x0 /end MEASUREMENT
/begin MEASUREMENT VbFUEL_DFCO_CritMet "var comments" UBYTE udf_CM_15723 0 0.0 0.0 255.0 ECU_ADDRESS 0x400020B8 /end MEASUREMENT
/begin MEASUREMENT VbFUEL_DFCO_Enabled "var comments" UBYTE udf_CM_15723 0 0.0 0.0 255.0 ECU_ADDRESS 0x400020B9 /end MEASUREMENT
/begin MEASUREMENT VbFUEL_DFCO_ExitEnbl "var comments" UBYTE udf_CM_15723 0 0.0 0.0 255.0 ECU_ADDRESS 0x400020BA /end MEASUREMENT
/begin MEASUREMENT VbFUEL_DFCO_RampOutEn "var comments" UBYTE udf_CM_15723 0 0.0 0.0 255.0 ECU_ADDRESS 0x400020BB /end MEASUREMENT
/begin MEASUREMENT VbFUEL_DFCO_Spark_CritMet "var comments" UBYTE udf_CM_15723 0 0.0 0.0 255.0 ECU_ADDRESS 0x400020BC /end MEASUREMENT
/begin MEASUREMENT VbFUEL_DFCO_Spark_Enabled "var comments" UBYTE udf_CM_15723 0 0.0 0.0 255.0 ECU_ADDRESS 0x400020BD /end MEASUREMENT
/begin MEASUREMENT VbFUEL_EM_DFCODisable "var comments" UBYTE udf_CM_15723 0 0.0 0.0 255.0 ECU_ADDRESS 0x400020B2 /end MEASUREMENT
/begin MEASUREMENT VfFUEL_MAP_DFCOThrsh "var comments" UWORD udf_CM_15401 0 0.0 0.0 255.99609375 ECU_ADDRESS 0x400020AE /end MEASUREMENT
/begin MEASUREMENT VfFUEL_r_DFCO_RampoutFact "var comments" UWORD udf_CM_16626 0 0.0 0.0 1.999969005584717 ECU_ADDRESS 0x400020BE /end MEASUREMENT
/begin MEASUREMENT VfFUEL_t_DFCOExit_Fuel "var comments" UWORD udf_CM_16283 0 0.0 0.0 1023.984375 ECU_ADDRESS 0x400020C0 /end MEASUREMENT
/begin MEASUREMENT FuelConsump "var comments" UWORD udf_CM_16444 0 0.0 0.0 15.999755859375 DISPLAY_IDENTIFIER FuelConsumptionRate ECU_ADDRESS 0x4000208E /end MEASUREMENT
/begin MEASUREMENT InjectorFlow "var comments" UWORD udf_CM_16444 0 0.0 0.0 15.999755859375 ECU_ADDRESS 0x400024DC /end MEASUREMENT
/begin MEASUREMENT FuelDlvMode "var comments" UBYTE udf_CM_16458 0 0.0 0.0 255.0 ECU_ADDRESS 0x40002120 /end MEASUREMENT
/begin MEASUREMENT VECyl1 "var comments" UWORD udf_CM_19398 0 0.0 0.0 199.9969482421875 DISPLAY_IDENTIFIER VECyl[0] ECU_ADDRESS 0x40002016 /end MEASUREMENT
/begin MEASUREMENT VECyl2 "var comments" UWORD udf_CM_19398 0 0.0 0.0 199.9969482421875 DISPLAY_IDENTIFIER VECyl[1] ECU_ADDRESS 0x40002018 /end MEASUREMENT
/begin MEASUREMENT VECyl3 "var comments" UWORD udf_CM_19398 0 0.0 0.0 199.9969482421875 DISPLAY_IDENTIFIER VECyl[2] ECU_ADDRESS 0x4000201A /end MEASUREMENT
/begin MEASUREMENT VECyl4 "var comments" UWORD udf_CM_19398 0 0.0 0.0 199.9969482421875 DISPLAY_IDENTIFIER VECyl[3] ECU_ADDRESS 0x4000201C /end MEASUREMENT
/begin MEASUREMENT AirPerCyl1 "var comments" UWORD udf_CM_15548 0 0.0 0.0 3.99993896484375 DISPLAY_IDENTIFIER AirPerCyl[0] ECU_ADDRESS 0x40002000 /end MEASUREMENT
/begin MEASUREMENT AirPerCyl2 "var comments" UWORD udf_CM_15555 0 0.0 0.0 3.99993896484375 DISPLAY_IDENTIFIER AirPerCyl[1] ECU_ADDRESS 0x40002002 /end MEASUREMENT
/begin MEASUREMENT IDLEMoveDirct "var comments" UBYTE udf_CM_16668 0 0.0 0.0 2.0 ECU_ADDRESS 0x400024E8 /end MEASUREMENT
/begin MEASUREMENT IDLEMode "var comments" UBYTE udf_CM_16640 0 0.0 0.0 255.0 ECU_ADDRESS 0x400021FD /end MEASUREMENT
/begin MEASUREMENT IDLEMotorState "var comments" UBYTE udf_CM_16661 0 0.0 0.0 3.0 ECU_ADDRESS 0x400024EE /end MEASUREMENT
/begin MEASUREMENT ActIDLEPosition "var comments" UBYTE udf_CM_15247 0 0.0 0.0 255.0 ECU_ADDRESS 0x400024EC /end MEASUREMENT
/begin MEASUREMENT IdlDerivTerm "var comments" SWORD udf_CM_16773 0 0.0 -200.0 199.993896484375 ECU_ADDRESS 0x400021DE /end MEASUREMENT
/begin MEASUREMENT IdlDsrdSpdStOfst "var comments" UWORD udf_CM_16801 0 0.0 0.0 16383.75 ECU_ADDRESS 0x40002218 /end MEASUREMENT
/begin MEASUREMENT IdlEngSpdHigh "var comments" UBYTE udf_CM_16850 0 0.0 0.0 255.0 ECU_ADDRESS 0x40002216 /end MEASUREMENT
/begin MEASUREMENT IdlINTDelta "var comments" UWORD udf_CM_16864 0 0.0 0.0 199.9969482421875 ECU_ADDRESS 0x400021D6 /end MEASUREMENT
/begin MEASUREMENT IdlINTTerm "var comments" UWORD udf_CM_16871 0 0.0 0.0 199.9969482421875 ECU_ADDRESS 0x400021D2 /end MEASUREMENT
/begin MEASUREMENT NrmIdlDlyTmr "var comments" UWORD udf_CM_17368 0 0.0 0.0 1023.984375 ECU_ADDRESS 0x4000220E /end MEASUREMENT
/begin MEASUREMENT IdlPropTerm "var comments" SWORD udf_CM_16885 0 0.0 -200.0 199.993896484375 ECU_ADDRESS 0x400021DC /end MEASUREMENT
/begin MEASUREMENT IdlDsrdEngSpd "var comments" UWORD udf_CM_16780 0 0.0 0.0 16383.75 ECU_ADDRESS 0x40002210 /end MEASUREMENT
/begin MEASUREMENT IdlEngSpdError "var comments" UWORD udf_CM_16843 0 0.0 0.0 16383.75 ECU_ADDRESS 0x40002214 /end MEASUREMENT
/begin MEASUREMENT IACVResetInProg "var comments" UBYTE udf_CM_16682 0 0.0 0.0 255.0 ECU_ADDRESS 0x40002288 /end MEASUREMENT
/begin MEASUREMENT DsrdIACV_MtrPstn "var comments" UBYTE udf_CM_15247 0 0.0 0.0 255.0 ECU_ADDRESS 0x40002514 /end MEASUREMENT
/begin MEASUREMENT IACVResetCmplt "var comments" UBYTE udf_CM_16675 0 0.0 0.0 255.0 ECU_ADDRESS 0x4000228E /end MEASUREMENT
/begin MEASUREMENT IACVMotorLost "var comments" UBYTE udf_CM_16647 0 0.0 0.0 255.0 ECU_ADDRESS 0x4000228B /end MEASUREMENT
/begin MEASUREMENT IACVMotorReset "var comments" UBYTE udf_CM_16654 0 0.0 0.0 255.0 ECU_ADDRESS 0x4000228A /end MEASUREMENT
/begin MEASUREMENT IACVOLFlow "var comments" UWORD udf_CM_16808 0 0.0 0.0 199.9969482421875 ECU_ADDRESS 0x40002276 /end MEASUREMENT
/begin MEASUREMENT IACVCLFlow "var comments" UWORD udf_CM_16808 0 0.0 0.0 199.9969482421875 ECU_ADDRESS 0x40002230 /end MEASUREMENT
/begin MEASUREMENT IACVFlow "var comments" UWORD udf_CM_16808 0 0.0 0.0 199.9969482421875 ECU_ADDRESS 0x40002238 /end MEASUREMENT
/begin MEASUREMENT IACVFlowCoolOffset "var comments" UWORD udf_CM_16808 0 0.0 0.0 199.9969482421875 ECU_ADDRESS 0x4000226A /end MEASUREMENT
/begin MEASUREMENT IACVFlowCoolOffsetMax "var comments" UWORD udf_CM_16808 0 0.0 0.0 199.9969482421875 ECU_ADDRESS 0x4000226C /end MEASUREMENT
/begin MEASUREMENT IACVFlowCrankOffset "var comments" UWORD udf_CM_16808 0 0.0 0.0 199.9969482421875 ECU_ADDRESS 0x40002268 /end MEASUREMENT
/begin MEASUREMENT IACVFlowTFOffset "var comments" UWORD udf_CM_16808 0 0.0 0.0 199.9969482421875 ECU_ADDRESS 0x40002278 /end MEASUREMENT
/begin MEASUREMENT IACVFlowBattOffset "var comments" UWORD udf_CM_16808 0 0.0 0.0 199.9969482421875 ECU_ADDRESS 0x4000226E /end MEASUREMENT
/begin MEASUREMENT IACVFlowDsrdTF "var comments" UWORD udf_CM_16808 0 0.0 0.0 199.9969482421875 ECU_ADDRESS 0x4000227A /end MEASUREMENT
/begin MEASUREMENT IACVFlowCoolFactor "var comments" UWORD udf_CM_15261 0 0.0 0.0 0.9999849796295166 ECU_ADDRESS 0x40002274 /end MEASUREMENT
/begin MEASUREMENT IACVFlowCoolantDecayTime "var comments" UWORD udf_CM_16507 0 0.0 0.0 1023.984375 ECU_ADDRESS 0x40002270 /end MEASUREMENT
/begin MEASUREMENT IACVAlternatorLoadStat "var comments" UBYTE udf_CM_16423 0 0.0 0.0 255.0 ECU_ADDRESS 0x40002272 /end MEASUREMENT
/begin MEASUREMENT IACVCLCondMet "var comments" UBYTE udf_CM_16857 0 0.0 0.0 255.0 ECU_ADDRESS 0x40002261 /end MEASUREMENT
/begin MEASUREMENT IACVMode "var comments" UBYTE udf_CM_16640 0 0.0 0.0 255.0 ECU_ADDRESS 0x40002260 /end MEASUREMENT
/begin MEASUREMENT ActIACVPosition "var comments" UBYTE udf_CM_15247 0 0.0 0.0 255.0 ECU_ADDRESS 0x40002507 /end MEASUREMENT
/begin MEASUREMENT IACVMoveDirct "var comments" UBYTE udf_CM_16668 0 0.0 0.0 2.0 ECU_ADDRESS 0x40002506 /end MEASUREMENT
/begin MEASUREMENT IACVMotorState "var comments" UBYTE udf_CM_16661 0 0.0 0.0 3.0 ECU_ADDRESS 0x4000250B /end MEASUREMENT
/begin MEASUREMENT IACVDerivTerm "var comments" SWORD udf_CM_16773 0 0.0 -200.0 199.993896484375 ECU_ADDRESS 0x4000222C /end MEASUREMENT
/begin MEASUREMENT IACVDsrdSpdStOfst "var comments" UWORD udf_CM_16801 0 0.0 0.0 16383.75 ECU_ADDRESS 0x4000227C /end MEASUREMENT
/begin MEASUREMENT IACVEngSpdHigh "var comments" UBYTE udf_CM_16850 0 0.0 0.0 255.0 ECU_ADDRESS 0x40002281 /end MEASUREMENT
/begin MEASUREMENT IACVINTDelta "var comments" UWORD udf_CM_16864 0 0.0 0.0 199.9969482421875 ECU_ADDRESS 0x40002222 /end MEASUREMENT
/begin MEASUREMENT IACVINTTerm "var comments" UWORD udf_CM_16871 0 0.0 0.0 199.9969482421875 ECU_ADDRESS 0x4000221E /end MEASUREMENT
/begin MEASUREMENT NrmIACVDlyTmr "var comments" UWORD udf_CM_17368 0 0.0 0.0 1023.984375 ECU_ADDRESS 0x40002262 /end MEASUREMENT
/begin MEASUREMENT IACVPropTerm "var comments" SWORD udf_CM_16885 0 0.0 -200.0 199.993896484375 ECU_ADDRESS 0x4000222E /end MEASUREMENT
/begin MEASUREMENT IACVDsrdEngSpd "var comments" UWORD udf_CM_16780 0 0.0 0.0 16383.75 ECU_ADDRESS 0x40002282 /end MEASUREMENT
/begin MEASUREMENT IACVEngSpdError "var comments" UWORD udf_CM_16843 0 0.0 0.0 16383.75 ECU_ADDRESS 0x40002286 /end MEASUREMENT
/begin MEASUREMENT BSTPDsrd "var comments" UWORD udf_CM_15562 0 0.0 0.0 255.99609375 ECU_ADDRESS 0x40002050 /end MEASUREMENT
/begin MEASUREMENT BSTPCommand "var comments" UWORD udf_CM_15562 0 0.0 0.0 255.99609375 ECU_ADDRESS 0x4000205C /end MEASUREMENT
/begin MEASUREMENT BSTPError "var comments" UWORD udf_CM_15562 0 0.0 0.0 255.99609375 ECU_ADDRESS 0x4000204E /end MEASUREMENT
/begin MEASUREMENT BSTPCntrCL "var comments" UWORD udf_CM_15562 0 0.0 0.0 255.99609375 ECU_ADDRESS 0x4000205A /end MEASUREMENT
/begin MEASUREMENT BSTPErrorHigh "var comments" UBYTE udf_CM_16850 0 0.0 0.0 255.0 ECU_ADDRESS 0x4000204A /end MEASUREMENT
/begin MEASUREMENT BSTPINTTerm "var comments" UWORD udf_CM_16871 0 0.0 0.0 199.9969482421875 ECU_ADDRESS 0x4000204C /end MEASUREMENT
/begin MEASUREMENT BSTPPropTerm "var comments" SWORD udf_CM_16885 0 0.0 -200.0 199.993896484375 ECU_ADDRESS 0x40002054 /end MEASUREMENT
/begin MEASUREMENT BSTPCntrCLTerm "var comments" UWORD udf_CM_16808 0 0.0 0.0 199.9969482421875 ECU_ADDRESS 0x40002052 /end MEASUREMENT
/begin MEASUREMENT BSTPINTDelta "var comments" UWORD udf_CM_16864 0 0.0 0.0 199.9969482421875 ECU_ADDRESS 0x40002056 /end MEASUREMENT
/begin MEASUREMENT BSTPActual "var comments" UWORD udf_CM_17291 0 0.0 0.0 255.99609375 ECU_ADDRESS 0x40002556 /end MEASUREMENT
/begin MEASUREMENT BSTPUnfilt "var comments" UWORD udf_CM_17291 0 0.0 0.0 255.99609375 ECU_ADDRESS 0x40002558 /end MEASUREMENT
/begin MEASUREMENT BSTCDutyCycle "var comments" UWORD udf_CM_18726 0 0.0 0.0 199.9969482421875 ECU_ADDRESS 0x40002554 /end MEASUREMENT
/begin MEASUREMENT BSTPMode "var comments" UBYTE udf_CM_16640 0 0.0 0.0 255.0 ECU_ADDRESS 0x40002065 /end MEASUREMENT
/begin MEASUREMENT BSTPCondMet "var comments" UBYTE udf_CM_16815 0 0.0 0.0 255.0 ECU_ADDRESS 0x40002064 /end MEASUREMENT
/begin MEASUREMENT ACCurrent "var comments" UWORD udf_CM_18005 0 0.0 0.0 99.99847412109375 ECU_ADDRESS 0x400024D4 /end MEASUREMENT
/begin MEASUREMENT ACLoadMet "var comments" UBYTE udf_CM_17214 0 0.0 0.0 255.0 ECU_ADDRESS 0x400024D6 /end MEASUREMENT
/begin MEASUREMENT GenDCCurrent "var comments" UWORD udf_CM_17294 0 0.0 0.0 255.99609375 ECU_ADDRESS 0x400024D2 /end MEASUREMENT
/begin MEASUREMENT IATSHTestFail "var comments" UBYTE udf_CM_16724 0 0.0 0.0 255.0 ECU_ADDRESS 0x40002629 /end MEASUREMENT
/begin MEASUREMENT IATSHDiagEnb "var comments" UBYTE udf_CM_16696 0 0.0 0.0 255.0 ECU_ADDRESS 0x40002633 /end MEASUREMENT
/begin MEASUREMENT IATSHFailCount "var comments" UWORD udf_CM_16703 0 0.0 0.0 65535.0 ECU_ADDRESS 0x4000262E /end MEASUREMENT
/begin MEASUREMENT IATSHFailMet "var comments" UBYTE udf_CM_16710 0 0.0 0.0 255.0 ECU_ADDRESS 0x40002625 /end MEASUREMENT
/begin MEASUREMENT IATSHPassCount "var comments" UWORD udf_CM_16717 0 0.0 0.0 65535.0 ECU_ADDRESS 0x40002630 /end MEASUREMENT
/begin MEASUREMENT IATSLDiagEnb "var comments" UBYTE udf_CM_16731 0 0.0 0.0 255.0 ECU_ADDRESS 0x40002632 /end MEASUREMENT
/begin MEASUREMENT IATSLFailCount "var comments" UWORD udf_CM_16738 0 0.0 0.0 65535.0 ECU_ADDRESS 0x4000262A /end MEASUREMENT
/begin MEASUREMENT IATSLFailMet "var comments" UBYTE udf_CM_16745 0 0.0 0.0 255.0 ECU_ADDRESS 0x40002624 /end MEASUREMENT
/begin MEASUREMENT IATSLPassCount "var comments" UWORD udf_CM_16752 0 0.0 0.0 65535.0 ECU_ADDRESS 0x4000262C /end MEASUREMENT
/begin MEASUREMENT IATSLTestFail "var comments" UBYTE udf_CM_16759 0 0.0 0.0 255.0 ECU_ADDRESS 0x40002628 /end MEASUREMENT
/begin MEASUREMENT ACSSLFailMet "var comments" UBYTE udf_CM_16710 0 0.0 0.0 255.0 ECU_ADDRESS 0x40002757 /end MEASUREMENT
/begin MEASUREMENT ACSSHFailMet "var comments" UBYTE udf_CM_16710 0 0.0 0.0 255.0 ECU_ADDRESS 0x40002760 /end MEASUREMENT
/begin MEASUREMENT ACSSLTestFail "var comments" UBYTE udf_CM_16759 0 0.0 0.0 255.0 ECU_ADDRESS 0x40002755 /end MEASUREMENT
/begin MEASUREMENT ACSSHTestFail "var comments" UBYTE udf_CM_16759 0 0.0 0.0 255.0 ECU_ADDRESS 0x40002756 /end MEASUREMENT
/begin MEASUREMENT ACSSLFailCount "var comments" UWORD udf_CM_16717 0 0.0 0.0 65535.0 ECU_ADDRESS 0x40002758 /end MEASUREMENT
/begin MEASUREMENT ACSSLPassCount "var comments" UWORD udf_CM_16717 0 0.0 0.0 65535.0 ECU_ADDRESS 0x4000275A /end MEASUREMENT
/begin MEASUREMENT ACSSHFailCount "var comments" UWORD udf_CM_16717 0 0.0 0.0 65535.0 ECU_ADDRESS 0x4000275C /end MEASUREMENT
/begin MEASUREMENT ACSSHPassCount "var comments" UWORD udf_CM_16717 0 0.0 0.0 65535.0 ECU_ADDRESS 0x4000275E /end MEASUREMENT
/begin MEASUREMENT ACSShrtDiagEnb "var comments" UBYTE udf_CM_16731 0 0.0 0.0 255.0 ECU_ADDRESS 0x40002754 /end MEASUREMENT
/begin MEASUREMENT WPSSLFailMet "var comments" UBYTE udf_CM_16710 0 0.0 0.0 255.0 ECU_ADDRESS 0x4000276E /end MEASUREMENT
/begin MEASUREMENT WPSSHFailMet "var comments" UBYTE udf_CM_16710 0 0.0 0.0 255.0 ECU_ADDRESS 0x4000276F /end MEASUREMENT
/begin MEASUREMENT WPSSLTestFail "var comments" UBYTE udf_CM_16759 0 0.0 0.0 255.0 ECU_ADDRESS 0x40002764 /end MEASUREMENT
/begin MEASUREMENT WPSSHTestFail "var comments" UBYTE udf_CM_16759 0 0.0 0.0 255.0 ECU_ADDRESS 0x40002765 /end MEASUREMENT
/begin MEASUREMENT WPSSLFailCount "var comments" UWORD udf_CM_16717 0 0.0 0.0 65535.0 ECU_ADDRESS 0x40002766 /end MEASUREMENT
/begin MEASUREMENT WPSSLPassCount "var comments" UWORD udf_CM_16717 0 0.0 0.0 65535.0 ECU_ADDRESS 0x40002768 /end MEASUREMENT
/begin MEASUREMENT WPSSHFailCount "var comments" UWORD udf_CM_16717 0 0.0 0.0 65535.0 ECU_ADDRESS 0x4000276A /end MEASUREMENT
/begin MEASUREMENT WPSSHPassCount "var comments" UWORD udf_CM_16717 0 0.0 0.0 65535.0 ECU_ADDRESS 0x4000276C /end MEASUREMENT
/begin MEASUREMENT WPSShrtHDiagEnb "var comments" UBYTE udf_CM_16731 0 0.0 0.0 255.0 ECU_ADDRESS 0x40002770 /end MEASUREMENT
/begin MEASUREMENT WPSShrtLDiagEnb "var comments" UBYTE udf_CM_16731 0 0.0 0.0 255.0 ECU_ADDRESS 0x40002771 /end MEASUREMENT
/begin MEASUREMENT VbCCPS_CCPEnable "var comments" UBYTE udf_CM_16857 0 0.0 0.0 255.0 ECU_ADDRESS 0x0 /end MEASUREMENT
/begin MEASUREMENT VfCCPS_Pct_CCPDutyCycle "var comments" UWORD udf_CM_16808 0 0.0 0.0 199.9969482421875 ECU_ADDRESS 0x0 /end MEASUREMENT
/begin MEASUREMENT IdleFlow "var comments" UWORD udf_CM_16836 0 0.0 0.0 199.9969482421875 ECU_ADDRESS 0x400021E4 /end MEASUREMENT
/begin MEASUREMENT IdleCLFlow "var comments" UWORD udf_CM_16808 0 0.0 0.0 199.9969482421875 ECU_ADDRESS 0x400021E0 /end MEASUREMENT
/begin MEASUREMENT IDLECondMet "var comments" UBYTE udf_CM_16815 0 0.0 0.0 255.0 ECU_ADDRESS 0x400021E2 /end MEASUREMENT
/begin MEASUREMENT IdleSwitch "var comments" UBYTE udf_CM_16857 0 0.0 0.0 255.0 ECU_ADDRESS 0x400021F8 /end MEASUREMENT
/begin MEASUREMENT FL_UpHillFlag "var comments" UBYTE udf_CM_16857 0 0.0 0.0 255.0 ECU_ADDRESS 0x0 /end MEASUREMENT
/begin MEASUREMENT InjCy1SHFailMet "var comments" UBYTE udf_CM_16955 0 0.0 0.0 255.0 DISPLAY_IDENTIFIER InjCy_ShortHiFailCriteriaMet[0] ECU_ADDRESS 0x4000270C /end MEASUREMENT
/begin MEASUREMENT InjCy1SLFailMet "var comments" UBYTE udf_CM_16962 0 0.0 0.0 255.0 DISPLAY_IDENTIFIER InjCy_ShortLoFailCriteriaMet[0] ECU_ADDRESS 0x40002710 /end MEASUREMENT
/begin MEASUREMENT InjCy1ShrtTestComp "var comments" UBYTE udf_CM_16976 0 0.0 0.0 255.0 DISPLAY_IDENTIFIER InjCy_ShortTestComplete[0] ECU_ADDRESS 0x400026F4 /end MEASUREMENT
/begin MEASUREMENT InjCy1ShrtTestFail "var comments" UBYTE udf_CM_16983 0 0.0 0.0 255.0 DISPLAY_IDENTIFIER InjCy_ShortTestFailed[0] ECU_ADDRESS 0x400026F8 /end MEASUREMENT
/begin MEASUREMENT InjCy1ShrtFailCount "var comments" UWORD udf_CM_16941 0 0.0 0.0 65535.0 DISPLAY_IDENTIFIER InjCy_ShortFailCntr[0] ECU_ADDRESS 0x400026FC /end MEASUREMENT
/begin MEASUREMENT InjCy1ShrtFailMet "var comments" UBYTE udf_CM_16948 0 0.0 0.0 255.0 DISPLAY_IDENTIFIER InjCy_ShortFailCriteriaMet[0] ECU_ADDRESS 0x400026F0 /end MEASUREMENT
/begin MEASUREMENT InjCy1ShrtPassCount "var comments" UWORD udf_CM_16969 0 0.0 0.0 65535.0 DISPLAY_IDENTIFIER InjCy_ShortSampleCntr[0] ECU_ADDRESS 0x40002704 /end MEASUREMENT
/begin MEASUREMENT InjCy2SHFailMet "var comments" UBYTE udf_CM_16955 0 0.0 0.0 255.0 DISPLAY_IDENTIFIER InjCy_ShortHiFailCriteriaMet[1] ECU_ADDRESS 0x4000270D /end MEASUREMENT
/begin MEASUREMENT InjCy2SLFailMet "var comments" UBYTE udf_CM_16962 0 0.0 0.0 255.0 DISPLAY_IDENTIFIER InjCy_ShortLoFailCriteriaMet[1] ECU_ADDRESS 0x40002711 /end MEASUREMENT
/begin MEASUREMENT InjCy2ShrtTestComp "var comments" UBYTE udf_CM_16976 0 0.0 0.0 255.0 DISPLAY_IDENTIFIER InjCy_ShortTestComplete[1] ECU_ADDRESS 0x400026F5 /end MEASUREMENT
/begin MEASUREMENT InjCy2ShrtTestFail "var comments" UBYTE udf_CM_16983 0 0.0 0.0 255.0 DISPLAY_IDENTIFIER InjCy_ShortTestFailed[1] ECU_ADDRESS 0x400026F9 /end MEASUREMENT
/begin MEASUREMENT InjCy2ShrtFailCount "var comments" UWORD udf_CM_16941 0 0.0 0.0 65535.0 DISPLAY_IDENTIFIER InjCy_ShortFailCntr[1] ECU_ADDRESS 0x400026FE /end MEASUREMENT
/begin MEASUREMENT InjCy2ShrtFailMet "var comments" UBYTE udf_CM_16948 0 0.0 0.0 255.0 DISPLAY_IDENTIFIER InjCy_ShortFailCriteriaMet[1] ECU_ADDRESS 0x400026F1 /end MEASUREMENT
/begin MEASUREMENT InjCy2ShrtPassCount "var comments" UWORD udf_CM_16969 0 0.0 0.0 65535.0 DISPLAY_IDENTIFIER InjCy_ShortSampleCntr[1] ECU_ADDRESS 0x40002706 /end MEASUREMENT
/begin MEASUREMENT InjCy3SHFailMet "var comments" UBYTE udf_CM_16955 0 0.0 0.0 255.0 DISPLAY_IDENTIFIER InjCy_ShortHiFailCriteriaMet[2] ECU_ADDRESS 0x4000270E /end MEASUREMENT
/begin MEASUREMENT InjCy3SLFailMet "var comments" UBYTE udf_CM_16962 0 0.0 0.0 255.0 DISPLAY_IDENTIFIER InjCy_ShortLoFailCriteriaMet[2] ECU_ADDRESS 0x40002712 /end MEASUREMENT
/begin MEASUREMENT InjCy3ShrtTestComp "var comments" UBYTE udf_CM_16976 0 0.0 0.0 255.0 DISPLAY_IDENTIFIER InjCy_ShortTestComplete[2] ECU_ADDRESS 0x400026F6 /end MEASUREMENT
/begin MEASUREMENT InjCy3ShrtTestFail "var comments" UBYTE udf_CM_16983 0 0.0 0.0 255.0 DISPLAY_IDENTIFIER InjCy_ShortTestFailed[2] ECU_ADDRESS 0x400026FA /end MEASUREMENT
/begin MEASUREMENT InjCy3ShrtFailCount "var comments" UWORD udf_CM_16941 0 0.0 0.0 65535.0 DISPLAY_IDENTIFIER InjCy_ShortFailCntr[2] ECU_ADDRESS 0x40002700 /end MEASUREMENT
/begin MEASUREMENT InjCy3ShrtFailMet "var comments" UBYTE udf_CM_16948 0 0.0 0.0 255.0 DISPLAY_IDENTIFIER InjCy_ShortFailCriteriaMet[2] ECU_ADDRESS 0x400026F2 /end MEASUREMENT
/begin MEASUREMENT InjCy3ShrtPassCount "var comments" UWORD udf_CM_16969 0 0.0 0.0 65535.0 DISPLAY_IDENTIFIER InjCy_ShortSampleCntr[2] ECU_ADDRESS 0x40002708 /end MEASUREMENT
/begin MEASUREMENT InjCy4SHFailMet "var comments" UBYTE udf_CM_16955 0 0.0 0.0 255.0 DISPLAY_IDENTIFIER InjCy_ShortHiFailCriteriaMet[3] ECU_ADDRESS 0x4000270F /end MEASUREMENT
/begin MEASUREMENT InjCy4SLFailMet "var comments" UBYTE udf_CM_16962 0 0.0 0.0 255.0 DISPLAY_IDENTIFIER InjCy_ShortLoFailCriteriaMet[3] ECU_ADDRESS 0x40002713 /end MEASUREMENT
/begin MEASUREMENT InjCy4ShrtTestComp "var comments" UBYTE udf_CM_16976 0 0.0 0.0 255.0 DISPLAY_IDENTIFIER InjCy_ShortTestComplete[3] ECU_ADDRESS 0x400026F7 /end MEASUREMENT
/begin MEASUREMENT InjCy4ShrtTestFail "var comments" UBYTE udf_CM_16983 0 0.0 0.0 255.0 DISPLAY_IDENTIFIER InjCy_ShortTestFailed[3] ECU_ADDRESS 0x400026FB /end MEASUREMENT
/begin MEASUREMENT InjCy4ShrtFailCount "var comments" UWORD udf_CM_16941 0 0.0 0.0 65535.0 DISPLAY_IDENTIFIER InjCy_ShortFailCntr[3] ECU_ADDRESS 0x40002702 /end MEASUREMENT
/begin MEASUREMENT InjCy4ShrtFailMet "var comments" UBYTE udf_CM_16948 0 0.0 0.0 255.0 DISPLAY_IDENTIFIER InjCy_ShortFailCriteriaMet[3] ECU_ADDRESS 0x400026F3 /end MEASUREMENT
/begin MEASUREMENT InjCy4ShrtPassCount "var comments" UWORD udf_CM_16969 0 0.0 0.0 65535.0 DISPLAY_IDENTIFIER InjCy_ShortSampleCntr[3] ECU_ADDRESS 0x4000270A /end MEASUREMENT
/begin MEASUREMENT OSWPFilt "var comments" UWORD udf_CM_18005 0 0.0 0.0 99.99847412109375 ECU_ADDRESS 0x400024E0 /end MEASUREMENT
/begin MEASUREMENT WPRawSignal "var comments" UWORD udf_CM_18005 0 0.0 0.0 99.99847412109375 ECU_ADDRESS 0x40002548 /end MEASUREMENT
/begin MEASUREMENT PCodeActive "var comments" UWORD udf_CM_17592 0 0.0 0.0 65535.0 ECU_ADDRESS 0x4000256E /end MEASUREMENT
/begin MEASUREMENT MAPSHDiagEnb "var comments" UBYTE udf_CM_17214 0 0.0 0.0 255.0 ECU_ADDRESS 0x4000263A /end MEASUREMENT
/begin MEASUREMENT MAPSHFailCount "var comments" UWORD udf_CM_17221 0 0.0 0.0 65535.0 ECU_ADDRESS 0x40002644 /end MEASUREMENT
/begin MEASUREMENT MAPSHFailMet "var comments" UBYTE udf_CM_17228 0 0.0 0.0 255.0 ECU_ADDRESS 0x40002649 /end MEASUREMENT
/begin MEASUREMENT MAPSHPassCount "var comments" UWORD udf_CM_17242 0 0.0 0.0 65535.0 ECU_ADDRESS 0x40002646 /end MEASUREMENT
/begin MEASUREMENT MAPSHTestFail "var comments" UBYTE udf_CM_17249 0 0.0 0.0 255.0 ECU_ADDRESS 0x4000263F /end MEASUREMENT
/begin MEASUREMENT MAPSLDiagEnb "var comments" UBYTE udf_CM_17256 0 0.0 0.0 255.0 ECU_ADDRESS 0x4000263B /end MEASUREMENT
/begin MEASUREMENT MAPSLFailCount "var comments" UWORD udf_CM_17263 0 0.0 0.0 65535.0 ECU_ADDRESS 0x40002640 /end MEASUREMENT
/begin MEASUREMENT MAPSLFailMet "var comments" UBYTE udf_CM_17270 0 0.0 0.0 255.0 ECU_ADDRESS 0x40002648 /end MEASUREMENT
/begin MEASUREMENT MAPSLPassCount "var comments" UWORD udf_CM_17277 0 0.0 0.0 65535.0 ECU_ADDRESS 0x40002642 /end MEASUREMENT
/begin MEASUREMENT MAPSLTestFail "var comments" UBYTE udf_CM_17284 0 0.0 0.0 255.0 ECU_ADDRESS 0x4000263E /end MEASUREMENT
/begin MEASUREMENT BSTPSHDiagEnb "var comments" UBYTE udf_CM_17214 0 0.0 0.0 255.0 ECU_ADDRESS 0x40002778 /end MEASUREMENT
/begin MEASUREMENT BSTPSHFailCount "var comments" UWORD udf_CM_17221 0 0.0 0.0 65535.0 ECU_ADDRESS 0x40002786 /end MEASUREMENT
/begin MEASUREMENT BSTPSHFailMet "var comments" UBYTE udf_CM_17228 0 0.0 0.0 255.0 ECU_ADDRESS 0x4000277B /end MEASUREMENT
/begin MEASUREMENT BSTPSHPassCount "var comments" UWORD udf_CM_17242 0 0.0 0.0 65535.0 ECU_ADDRESS 0x40002788 /end MEASUREMENT
/begin MEASUREMENT BSTPSHTestFail "var comments" UBYTE udf_CM_17249 0 0.0 0.0 255.0 ECU_ADDRESS 0x40002781 /end MEASUREMENT
/begin MEASUREMENT BSTPSLDiagEnb "var comments" UBYTE udf_CM_17256 0 0.0 0.0 255.0 ECU_ADDRESS 0x40002776 /end MEASUREMENT
/begin MEASUREMENT BSTPSLFailCount "var comments" UWORD udf_CM_17263 0 0.0 0.0 65535.0 ECU_ADDRESS 0x40002782 /end MEASUREMENT
/begin MEASUREMENT BSTPSLFailMet "var comments" UBYTE udf_CM_17270 0 0.0 0.0 255.0 ECU_ADDRESS 0x40002779 /end MEASUREMENT
/begin MEASUREMENT BSTPSLPassCount "var comments" UWORD udf_CM_17277 0 0.0 0.0 65535.0 ECU_ADDRESS 0x40002784 /end MEASUREMENT
/begin MEASUREMENT BSTPSLTestFail "var comments" UBYTE udf_CM_17284 0 0.0 0.0 255.0 ECU_ADDRESS 0x40002780 /end MEASUREMENT
/begin MEASUREMENT MtrMovDlyCnt "var comments" UBYTE udf_CM_18166 0 0.0 0.0 255.0 DISPLAY_IDENTIFIER IDLE_Motor_StartMoveDelayCount ECU_ADDRESS 0x400024E9 /end MEASUREMENT
/begin MEASUREMENT MtrPauseCnt "var comments" UBYTE udf_CM_18159 0 0.0 0.0 255.0 DISPLAY_IDENTIFIER IDLE_Motor_PauseDelayCount ECU_ADDRESS 0x400024F4 /end MEASUREMENT
/begin MEASUREMENT MtrStartSteps "var comments" UBYTE udf_CM_18173 0 0.0 0.0 255.0 DISPLAY_IDENTIFIER IDLE_Motor_StartMoveSteps ECU_ADDRESS 0x400024ED /end MEASUREMENT
/begin MEASUREMENT O2HtSHFailMet "var comments" UBYTE udf_CM_17403 0 0.0 0.0 255.0 DISPLAY_IDENTIFIER O2Heater_ShortHiFailCriteriaMet ECU_ADDRESS 0x400026E3 /end MEASUREMENT
/begin MEASUREMENT O2HtSLFailMet "var comments" UBYTE udf_CM_17410 0 0.0 0.0 255.0 DISPLAY_IDENTIFIER O2Heater_ShortLoFailCriteriaMet ECU_ADDRESS 0x400026E5 /end MEASUREMENT
/begin MEASUREMENT O2HtShrtTestComp "var comments" UBYTE udf_CM_17424 0 0.0 0.0 255.0 DISPLAY_IDENTIFIER O2Heater_ShortTestComplete ECU_ADDRESS 0x400026E2 /end MEASUREMENT
/begin MEASUREMENT O2HtShrtDiagEnb "var comments" UBYTE udf_CM_17382 0 0.0 0.0 255.0 DISPLAY_IDENTIFIER O2Heater_ShortEnblCriteriaMet ECU_ADDRESS 0x400026E0 /end MEASUREMENT
/begin MEASUREMENT O2HtShrtTestFail "var comments" UBYTE udf_CM_17431 0 0.0 0.0 255.0 DISPLAY_IDENTIFIER O2Heater_ShortTestFailed ECU_ADDRESS 0x400026E4 /end MEASUREMENT
/begin MEASUREMENT O2HtShrtFailCount "var comments" UWORD udf_CM_17389 0 0.0 0.0 65535.0 DISPLAY_IDENTIFIER O2Heater_ShortFailCntr ECU_ADDRESS 0x400026E6 /end MEASUREMENT
/begin MEASUREMENT O2HtShrtFailMet "var comments" UBYTE udf_CM_17396 0 0.0 0.0 255.0 DISPLAY_IDENTIFIER O2Heater_ShortFailCriteriaMet ECU_ADDRESS 0x400026E1 /end MEASUREMENT
/begin MEASUREMENT O2HtShrtPassCount "var comments" UWORD udf_CM_17417 0 0.0 0.0 65535.0 DISPLAY_IDENTIFIER O2Heater_ShortSampleCntr ECU_ADDRESS 0x400026E8 /end MEASUREMENT
/begin MEASUREMENT DCMSHFailMet "var comments" UBYTE udf_CM_17403 0 0.0 0.0 255.0 DISPLAY_IDENTIFIER DCM_ShortHiFailCriteriaMet ECU_ADDRESS 0x4000269F /end MEASUREMENT
/begin MEASUREMENT DCMSLFailMet "var comments" UBYTE udf_CM_17410 0 0.0 0.0 255.0 DISPLAY_IDENTIFIER DCM_ShortLoFailCriteriaMet ECU_ADDRESS 0x400026A1 /end MEASUREMENT
/begin MEASUREMENT DCMShrtTestComp "var comments" UBYTE udf_CM_17424 0 0.0 0.0 255.0 DISPLAY_IDENTIFIER DCM_ShortTestComplete ECU_ADDRESS 0x4000269E /end MEASUREMENT
/begin MEASUREMENT DCMShrtDiagEnb "var comments" UBYTE udf_CM_17382 0 0.0 0.0 255.0 DISPLAY_IDENTIFIER DCM_ShortEnblCriteriaMet ECU_ADDRESS 0x4000269C /end MEASUREMENT
/begin MEASUREMENT DCMShrtTestFail "var comments" UBYTE udf_CM_17431 0 0.0 0.0 255.0 DISPLAY_IDENTIFIER DCM_ShortTestFailed ECU_ADDRESS 0x400026A0 /end MEASUREMENT
/begin MEASUREMENT DCMShrtFailCount "var comments" UWORD udf_CM_17389 0 0.0 0.0 65535.0 DISPLAY_IDENTIFIER DCM_ShortFailCntr ECU_ADDRESS 0x400026A2 /end MEASUREMENT
/begin MEASUREMENT DCMShrtFailMet "var comments" UBYTE udf_CM_17396 0 0.0 0.0 255.0 DISPLAY_IDENTIFIER DCM_ShortFailCriteriaMet ECU_ADDRESS 0x4000269D /end MEASUREMENT
/begin MEASUREMENT DCMShrtPassCount "var comments" UWORD udf_CM_17417 0 0.0 0.0 65535.0 DISPLAY_IDENTIFIER DCM_ShortSampleCntr ECU_ADDRESS 0x400026A4 /end MEASUREMENT
/begin MEASUREMENT TACHSHFailMet "var comments" UBYTE udf_CM_17403 0 0.0 0.0 255.0 DISPLAY_IDENTIFIER TACH_ShortHiFailCriteriaMet ECU_ADDRESS 0x4000271B /end MEASUREMENT
/begin MEASUREMENT TACHSLFailMet "var comments" UBYTE udf_CM_17410 0 0.0 0.0 255.0 DISPLAY_IDENTIFIER TACH_ShortLoFailCriteriaMet ECU_ADDRESS 0x4000271D /end MEASUREMENT
/begin MEASUREMENT TACHShrtTestComp "var comments" UBYTE udf_CM_17424 0 0.0 0.0 255.0 DISPLAY_IDENTIFIER TACH_ShortTestComplete ECU_ADDRESS 0x4000271A /end MEASUREMENT
/begin MEASUREMENT TACHShrtDiagEnb "var comments" UBYTE udf_CM_17382 0 0.0 0.0 255.0 DISPLAY_IDENTIFIER TACH_ShortEnblCriteriaMet ECU_ADDRESS 0x40002718 /end MEASUREMENT
/begin MEASUREMENT TACHShrtTestFail "var comments" UBYTE udf_CM_17431 0 0.0 0.0 255.0 DISPLAY_IDENTIFIER TACH_ShortTestFailed ECU_ADDRESS 0x4000271C /end MEASUREMENT
/begin MEASUREMENT TACHShrtFailCount "var comments" UWORD udf_CM_17389 0 0.0 0.0 65535.0 DISPLAY_IDENTIFIER TACH_ShortFailCntr ECU_ADDRESS 0x4000271E /end MEASUREMENT
/begin MEASUREMENT TACHShrtFailMet "var comments" UBYTE udf_CM_17396 0 0.0 0.0 255.0 DISPLAY_IDENTIFIER TACH_ShortFailCriteriaMet ECU_ADDRESS 0x40002719 /end MEASUREMENT
/begin MEASUREMENT TACHShrtPassCount "var comments" UWORD udf_CM_17417 0 0.0 0.0 65535.0 DISPLAY_IDENTIFIER TACH_ShortSampleCntr ECU_ADDRESS 0x40002720 /end MEASUREMENT
/begin MEASUREMENT CCPSHFailMet "var comments" UBYTE udf_CM_17403 0 0.0 0.0 255.0 DISPLAY_IDENTIFIER CCP_ShortHiFailCriteriaMet ECU_ADDRESS 0x40002693 /end MEASUREMENT
/begin MEASUREMENT CCPSLFailMet "var comments" UBYTE udf_CM_17410 0 0.0 0.0 255.0 DISPLAY_IDENTIFIER CCP_ShortLoFailCriteriaMet ECU_ADDRESS 0x40002695 /end MEASUREMENT
/begin MEASUREMENT CCPShrtTestComp "var comments" UBYTE udf_CM_17424 0 0.0 0.0 255.0 DISPLAY_IDENTIFIER CCP_ShortTestComplete ECU_ADDRESS 0x40002692 /end MEASUREMENT
/begin MEASUREMENT CCPShrtDiagEnb "var comments" UBYTE udf_CM_17382 0 0.0 0.0 255.0 DISPLAY_IDENTIFIER CCP_ShortEnblCriteriaMet ECU_ADDRESS 0x40002690 /end MEASUREMENT
/begin MEASUREMENT CCPShrtTestFail "var comments" UBYTE udf_CM_17431 0 0.0 0.0 255.0 DISPLAY_IDENTIFIER CCP_ShortTestFailed ECU_ADDRESS 0x40002694 /end MEASUREMENT
/begin MEASUREMENT CCPShrtFailCount "var comments" UWORD udf_CM_17389 0 0.0 0.0 65535.0 DISPLAY_IDENTIFIER CCP_ShortFailCntr ECU_ADDRESS 0x40002696 /end MEASUREMENT
/begin MEASUREMENT CCPShrtFailMet "var comments" UBYTE udf_CM_17396 0 0.0 0.0 255.0 DISPLAY_IDENTIFIER CCP_ShortFailCriteriaMet ECU_ADDRESS 0x40002691 /end MEASUREMENT
/begin MEASUREMENT CCPShrtPassCount "var comments" UWORD udf_CM_17417 0 0.0 0.0 65535.0 DISPLAY_IDENTIFIER CCP_ShortSampleCntr ECU_ADDRESS 0x40002698 /end MEASUREMENT
/begin MEASUREMENT OutDiagComEnbKO "var comments" UBYTE udf_CM_17557 0 0.0 0.0 255.0 DISPLAY_IDENTIFIER OutPutDiag_CommKeyOnEnbMet ECU_ADDRESS 0x4000265A /end MEASUREMENT
/begin MEASUREMENT OutDiagComEnbRun "var comments" UBYTE udf_CM_17564 0 0.0 0.0 255.0 DISPLAY_IDENTIFIER OutPutDiag_CommRunEnbMet ECU_ADDRESS 0x4000265B /end MEASUREMENT
/begin MEASUREMENT KeyonToCrankMet "var comments" UBYTE udf_CM_17074 0 0.0 0.0 255.0 ECU_ADDRESS 0x400023A4 /end MEASUREMENT
/begin MEASUREMENT PowerDownDelay "var comments" UBYTE udf_CM_17606 0 0.0 0.0 255.0 ECU_ADDRESS 0x400023A0 /end MEASUREMENT
/begin MEASUREMENT PPCrtMet "var comments" UBYTE udf_CM_17627 0 0.0 0.0 255.0 ECU_ADDRESS 0x4000213E /end MEASUREMENT
/begin MEASUREMENT PPComplete "var comments" UBYTE udf_CM_17620 0 0.0 0.0 255.0 ECU_ADDRESS 0x4000213F /end MEASUREMENT
/begin MEASUREMENT PPDisable "var comments" UBYTE udf_CM_17634 0 0.0 0.0 255.0 ECU_ADDRESS 0x40000108 /end MEASUREMENT
/begin MEASUREMENT PrimePulseWidth "var comments" UWORD udf_CM_17641 0 0.0 0.0 1023.984375 ECU_ADDRESS 0x40002140 /end MEASUREMENT
/begin MEASUREMENT RefPeriodHiRes "var comments" ULONG udf_CM_17662 0 0.0 0.0 4294967.295 DISPLAY_IDENTIFIER RefPeriod_HiRes ECU_ADDRESS 0x40002480 /end MEASUREMENT
/begin MEASUREMENT RefPeriodHiResAvg "var comments" ULONG udf_CM_17669 0 0.0 0.0 4294967.295 DISPLAY_IDENTIFIER RefPeriod_HiResAvg ECU_ADDRESS 0x40002488 /end MEASUREMENT
/begin MEASUREMENT RunToCrankMet "var comments" UBYTE udf_CM_17697 0 0.0 0.0 255.0 ECU_ADDRESS 0x400023A3 /end MEASUREMENT
/begin MEASUREMENT RunCylCount "var comments" UBYTE udf_CM_19377 0 0.0 0.0 255.0 DISPLAY_IDENTIFIER VcVIOS_RunCylCount ECU_ADDRESS 0x400023A7 /end MEASUREMENT
/begin MEASUREMENT RunModeCount "var comments" UBYTE udf_CM_19384 0 0.0 0.0 255.0 DISPLAY_IDENTIFIER VcVIOS_RunModeCount ECU_ADDRESS 0x400023A8 /end MEASUREMENT
/begin MEASUREMENT RunTime "var comments" UWORD udf_CM_17683 0 0.0 0.0 65535.0 ECU_ADDRESS 0x40000092 /end MEASUREMENT
/begin MEASUREMENT RunTimeTotal "var comments" ULONG udf_CM_17663 0 0.0 0.0 4294967.295 ECU_ADDRESS 0x40000094 /end MEASUREMENT
/begin MEASUREMENT ETCM_TPSHi2Dsr "var comments" UBYTE udf_CM_16353 0 0.0 0.0 255.0 ECU_ADDRESS 0x400022C0 /end MEASUREMENT
/begin MEASUREMENT ETCM_TPSHi2Ref "var comments" UBYTE udf_CM_16353 0 0.0 0.0 255.0 ECU_ADDRESS 0x400022C1 /end MEASUREMENT
/begin MEASUREMENT ETCM_TPSDltState "var comments" UBYTE udf_CM_16353 0 0.0 0.0 255.0 ECU_ADDRESS 0x400022BA /end MEASUREMENT
/begin MEASUREMENT ETCM_UnpwrdRefLearned "var comments" UBYTE udf_CM_16353 0 0.0 0.0 255.0 ECU_ADDRESS 0x400022C6 /end MEASUREMENT
/begin MEASUREMENT ETCM_ThrotMtrDir "var comments" UBYTE udf_CM_16353 0 0.0 0.0 255.0 ECU_ADDRESS 0x400022BB /end MEASUREMENT
/begin MEASUREMENT ETCM_DutyLimited "var comments" UBYTE udf_CM_16353 0 0.0 0.0 255.0 ECU_ADDRESS 0x400022BC /end MEASUREMENT
/begin MEASUREMENT ETCM_UnpwrdRefThrotPstn "var comments" UWORD udf_CM_18726 0 0.0 0.0 199.9969482421875 ECU_ADDRESS 0x400022C8 /end MEASUREMENT
/begin MEASUREMENT ETCM_UnlimitedDutyCycle "var comments" UWORD udf_CM_18726 0 0.0 0.0 199.9969482421875 ECU_ADDRESS 0x400022D8 /end MEASUREMENT
/begin MEASUREMENT ETCM_LimitedDutyCycle "var comments" UWORD udf_CM_18726 0 0.0 0.0 199.9969482421875 ECU_ADDRESS 0x400022B8 /end MEASUREMENT
/begin MEASUREMENT ETCM_INTDelta "var comments" UWORD udf_CM_18726 0 0.0 0.0 199.9969482421875 ECU_ADDRESS 0x400022DA /end MEASUREMENT
/begin MEASUREMENT ETCM_TPSErr2Dsr "var comments" UWORD udf_CM_18726 0 0.0 0.0 199.9969482421875 ECU_ADDRESS 0x400022C2 /end MEASUREMENT
/begin MEASUREMENT ETCM_TPSErr2Ref "var comments" UWORD udf_CM_18726 0 0.0 0.0 199.9969482421875 ECU_ADDRESS 0x400022D2 /end MEASUREMENT
/begin MEASUREMENT ETCM_TPSDltErr "var comments" UWORD udf_CM_18726 0 0.0 0.0 199.9969482421875 ECU_ADDRESS 0x400022DC /end MEASUREMENT
/begin MEASUREMENT ETCM_CompositeTerm "var comments" SWORD udf_CM_16773 0 0.0 -200.0 199.993896484375 ECU_ADDRESS 0x400022D6 /end MEASUREMENT
/begin MEASUREMENT ETCM_SprTerm "var comments" SWORD udf_CM_16773 0 0.0 -200.0 199.993896484375 ECU_ADDRESS 0x400022CC /end MEASUREMENT
/begin MEASUREMENT ETCM_FriTerm "var comments" SWORD udf_CM_16773 0 0.0 -200.0 199.993896484375 ECU_ADDRESS 0x400022CA /end MEASUREMENT
/begin MEASUREMENT ETCM_INTTerm "var comments" SWORD udf_CM_16773 0 0.0 -200.0 199.993896484375 ECU_ADDRESS 0x400022BE /end MEASUREMENT
/begin MEASUREMENT ETCM_DerivTerm "var comments" SWORD udf_CM_16773 0 0.0 -200.0 199.993896484375 ECU_ADDRESS 0x400022CE /end MEASUREMENT
/begin MEASUREMENT ETCM_PropTerm "var comments" SWORD udf_CM_16773 0 0.0 -200.0 199.993896484375 ECU_ADDRESS 0x400022D0 /end MEASUREMENT
/begin MEASUREMENT MotorCoilTempFilt "var comments" SWORD udf_CM_15758 0 0.0 -256.0 255.9921875 ECU_ADDRESS 0x40002552 /end MEASUREMENT
/begin MEASUREMENT GENV1Filt "var comments" UWORD udf_CM_16928 0 0.0 0.0 1023.984375 ECU_ADDRESS 0x0 /end MEASUREMENT
/begin MEASUREMENT GENV2Filt "var comments" UWORD udf_CM_16928 0 0.0 0.0 1023.984375 ECU_ADDRESS 0x0 /end MEASUREMENT
/begin MEASUREMENT GENV3Filt "var comments" UWORD udf_CM_16928 0 0.0 0.0 1023.984375 ECU_ADDRESS 0x0 /end MEASUREMENT
/begin MEASUREMENT GENV_VOLTErr2Dsr "var comments" UWORD udf_CM_16928 0 0.0 0.0 1023.984375 ECU_ADDRESS 0x0 /end MEASUREMENT
/begin MEASUREMENT GENV_VOLTHi2Dsr "var comments" UBYTE udf_CM_16353 0 0.0 0.0 255.0 ECU_ADDRESS 0x0 /end MEASUREMENT
/begin MEASUREMENT GENV_CompositeTerm "var comments" SWORD udf_CM_16773 0 0.0 -200.0 199.993896484375 ECU_ADDRESS 0x0 /end MEASUREMENT
/begin MEASUREMENT GENV_INTTerm "var comments" SWORD udf_CM_16773 0 0.0 -200.0 199.993896484375 ECU_ADDRESS 0x0 /end MEASUREMENT
/begin MEASUREMENT GENV_PropTerm "var comments" SWORD udf_CM_16773 0 0.0 -200.0 199.993896484375 ECU_ADDRESS 0x0 /end MEASUREMENT
/begin MEASUREMENT GENV_INTDelta "var comments" UWORD udf_CM_18726 0 0.0 0.0 199.9969482421875 ECU_ADDRESS 0x0 /end MEASUREMENT
/begin MEASUREMENT SABaseRun "var comments" SWORD udf_CM_17711 0 0.0 -256.0 255.9921875 ECU_ADDRESS 0x4000232A /end MEASUREMENT
/begin MEASUREMENT SACrank "var comments" SWORD udf_CM_17718 0 0.0 -256.0 255.9921875 ECU_ADDRESS 0x40002358 /end MEASUREMENT
/begin MEASUREMENT SAFinalCyl1 "var comments" SWORD udf_CM_17725 0 0.0 -256.0 255.9921875 DISPLAY_IDENTIFIER SAFinalCyl[0] ECU_ADDRESS 0x40002314 /end MEASUREMENT
/begin MEASUREMENT SAFinalDlvCyl1 "var comments" SWORD udf_CM_17739 0 0.0 -256.0 255.9921875 DISPLAY_IDENTIFIER SAFinalDlvCyl[0] ECU_ADDRESS 0x4000231C /end MEASUREMENT
/begin MEASUREMENT SAFinalCyl2 "var comments" SWORD udf_CM_17732 0 0.0 -256.0 255.9921875 DISPLAY_IDENTIFIER SAFinalCyl[1] ECU_ADDRESS 0x40002316 /end MEASUREMENT
/begin MEASUREMENT SAFinalDlvCyl2 "var comments" SWORD udf_CM_17746 0 0.0 -256.0 255.9921875 DISPLAY_IDENTIFIER SAFinalDlvCyl[1] ECU_ADDRESS 0x4000231E /end MEASUREMENT
/begin MEASUREMENT SAGlobal "var comments" SWORD udf_CM_17767 0 0.0 -256.0 255.9921875 ECU_ADDRESS 0x40002334 /end MEASUREMENT
/begin MEASUREMENT SAPE "var comments" SWORD udf_CM_17781 0 0.0 -256.0 255.9921875 ECU_ADDRESS 0x40002352 /end MEASUREMENT
/begin MEASUREMENT SpdCntlDervEnb "var comments" UBYTE udf_CM_16822 0 0.0 0.0 255.0 DISPLAY_IDENTIFIER IdleDerivative_CalcEnable ECU_ADDRESS 0x400021DB /end MEASUREMENT
/begin MEASUREMENT SpdCntlDervLoopCnt "var comments" UBYTE udf_CM_16829 0 0.0 0.0 255.0 DISPLAY_IDENTIFIER IdleDerivative_LoopCounter ECU_ADDRESS 0x400021DA /end MEASUREMENT
/begin MEASUREMENT OPSWSTComp "var comments" UBYTE udf_CM_17816 0 0.0 0.0 255.0 ECU_ADDRESS 0x4000264E /end MEASUREMENT
/begin MEASUREMENT OPSWSTEnb "var comments" UBYTE udf_CM_17494 0 0.0 0.0 255.0 DISPLAY_IDENTIFIER OPSWSTEnbMet ECU_ADDRESS 0x40002657 /end MEASUREMENT
/begin MEASUREMENT OPSWSTFail "var comments" UBYTE udf_CM_17508 0 0.0 0.0 255.0 ECU_ADDRESS 0x4000264F /end MEASUREMENT
/begin MEASUREMENT OPSWSTFC "var comments" UWORD udf_CM_17515 0 0.0 0.0 65535.0 ECU_ADDRESS 0x40002652 /end MEASUREMENT
/begin MEASUREMENT OPSWSTFMet "var comments" UBYTE udf_CM_17522 0 0.0 0.0 255.0 ECU_ADDRESS 0x40002656 /end MEASUREMENT
/begin MEASUREMENT OPSWSTPC "var comments" UWORD udf_CM_17501 0 0.0 0.0 65535.0 ECU_ADDRESS 0x40002654 /end MEASUREMENT
/begin MEASUREMENT OPSWSTEnbMetDC "var comments" UWORD udf_CM_17501 0 0.0 0.0 65535.0 ECU_ADDRESS 0x40002650 /end MEASUREMENT
/begin MEASUREMENT FPFBNCTComp "var comments" UBYTE udf_CM_17816 0 0.0 0.0 255.0 ECU_ADDRESS 0x4000260A /end MEASUREMENT
/begin MEASUREMENT FPFBNCTEnb "var comments" UBYTE udf_CM_17494 0 0.0 0.0 255.0 DISPLAY_IDENTIFIER FPFBNCTEnbMet ECU_ADDRESS 0x40002608 /end MEASUREMENT
/begin MEASUREMENT FPFBNCTFail "var comments" UBYTE udf_CM_17508 0 0.0 0.0 255.0 ECU_ADDRESS 0x4000260B /end MEASUREMENT
/begin MEASUREMENT FPFBNCTFC "var comments" UWORD udf_CM_17515 0 0.0 0.0 65535.0 ECU_ADDRESS 0x4000260C /end MEASUREMENT
/begin MEASUREMENT FPFBNCTFMet "var comments" UBYTE udf_CM_17522 0 0.0 0.0 255.0 ECU_ADDRESS 0x40002609 /end MEASUREMENT
/begin MEASUREMENT FPFBNCTPC "var comments" UWORD udf_CM_17501 0 0.0 0.0 65535.0 ECU_ADDRESS 0x4000260E /end MEASUREMENT
/begin MEASUREMENT ShutDownCmplt "var comments" UBYTE udf_CM_17963 0 0.0 0.0 255.0 ECU_ADDRESS 0x400023A6 /end MEASUREMENT
/begin MEASUREMENT IdleMetPrev "var comments" UBYTE udf_CM_17837 0 0.0 0.0 255.0 DISPLAY_IDENTIFIER SbIDLE_IdleCondsMet_Prev ECU_ADDRESS 0x40002337 /end MEASUREMENT
/begin MEASUREMENT TPSCntrDTestComp "var comments" UBYTE udf_CM_18215 0 0.0 0.0 255.0 ECU_ADDRESS 0x40002616 /end MEASUREMENT
/begin MEASUREMENT TPSErrorDynThresh "var comments" UWORD udf_CM_18180 0 0.0 0.0 199.9969482421875 ECU_ADDRESS 0x40002614 /end MEASUREMENT
/begin MEASUREMENT TPSCntrDDiagEnb "var comments" UBYTE udf_CM_18187 0 0.0 0.0 255.0 ECU_ADDRESS 0x40002612 /end MEASUREMENT
/begin MEASUREMENT TPSCntrErrorThresh "var comments" UWORD udf_CM_18236 0 0.0 0.0 199.9969482421875 ECU_ADDRESS 0x4000261C /end MEASUREMENT
/begin MEASUREMENT TPSCntrDTestFail "var comments" UBYTE udf_CM_18222 0 0.0 0.0 255.0 ECU_ADDRESS 0x40002617 /end MEASUREMENT
/begin MEASUREMENT TPSCntrDFailCount "var comments" UWORD udf_CM_18194 0 0.0 0.0 65535.0 ECU_ADDRESS 0x4000261A /end MEASUREMENT
/begin MEASUREMENT TPSCntrDFailMet "var comments" UBYTE udf_CM_18201 0 0.0 0.0 255.0 ECU_ADDRESS 0x40002613 /end MEASUREMENT
/begin MEASUREMENT TPSCntrDPassCount "var comments" UWORD udf_CM_18208 0 0.0 0.0 65535.0 ECU_ADDRESS 0x40002618 /end MEASUREMENT
/begin MEASUREMENT TPSCntrError "var comments" UWORD udf_CM_18229 0 0.0 0.0 199.9969482421875 ECU_ADDRESS 0x40002620 /end MEASUREMENT
/begin MEASUREMENT FCVPSCntrDTestComp "var comments" UBYTE udf_CM_18215 0 0.0 0.0 255.0 ECU_ADDRESS 0x400025FC /end MEASUREMENT
/begin MEASUREMENT FCVPSErrorDynThresh "var comments" UWORD udf_CM_18180 0 0.0 0.0 199.9969482421875 ECU_ADDRESS 0x400025FA /end MEASUREMENT
/begin MEASUREMENT FCVPSCntrDDiagEnb "var comments" UBYTE udf_CM_18187 0 0.0 0.0 255.0 ECU_ADDRESS 0x400025F8 /end MEASUREMENT
/begin MEASUREMENT FCVPSCntrErrorThresh "var comments" UWORD udf_CM_18236 0 0.0 0.0 199.9969482421875 ECU_ADDRESS 0x40002602 /end MEASUREMENT
/begin MEASUREMENT FCVPSCntrDTestFail "var comments" UBYTE udf_CM_18222 0 0.0 0.0 255.0 ECU_ADDRESS 0x400025FD /end MEASUREMENT
/begin MEASUREMENT FCVPSCntrDFailCount "var comments" UWORD udf_CM_18194 0 0.0 0.0 65535.0 ECU_ADDRESS 0x40002600 /end MEASUREMENT
/begin MEASUREMENT FCVPSCntrDFailMet "var comments" UBYTE udf_CM_18201 0 0.0 0.0 255.0 ECU_ADDRESS 0x400025F9 /end MEASUREMENT
/begin MEASUREMENT FCVPSCntrDPassCount "var comments" UWORD udf_CM_18208 0 0.0 0.0 65535.0 ECU_ADDRESS 0x400025FE /end MEASUREMENT
/begin MEASUREMENT FCVPSCntrError "var comments" UWORD udf_CM_18229 0 0.0 0.0 199.9969482421875 ECU_ADDRESS 0x40002606 /end MEASUREMENT
/begin MEASUREMENT SpdCntlLvl "var comments" UBYTE udf_CM_18012 0 0.0 0.0 255.0 DISPLAY_IDENTIFIER SpeedControlLvl ECU_ADDRESS 0x400021FC /end MEASUREMENT
/begin MEASUREMENT SparkDwell "var comments" UWORD udf_CM_17991 0 0.0 0.0 1023.984375 ECU_ADDRESS 0x400022E8 /end MEASUREMENT
/begin MEASUREMENT SparkMode "var comments" UBYTE udf_CM_17998 0 0.0 0.0 255.0 ECU_ADDRESS 0x40002324 /end MEASUREMENT
/begin MEASUREMENT StallToCrankMet "var comments" UBYTE udf_CM_18138 0 0.0 0.0 255.0 ECU_ADDRESS 0x400023A5 /end MEASUREMENT
/begin MEASUREMENT ThrFlowAtTPSMax "var comments" UWORD udf_CM_18677 0 0.0 0.0 511.9921875 ECU_ADDRESS 0x400024FC /end MEASUREMENT
/begin MEASUREMENT ThrFlowAtTPSMin "var comments" UWORD udf_CM_18684 0 0.0 0.0 511.9921875 ECU_ADDRESS 0x400024F0 /end MEASUREMENT
/begin MEASUREMENT TPSMinimum "var comments" UWORD udf_CM_18810 0 0.0 0.0 199.9969482421875 ECU_ADDRESS 0x400024FE /end MEASUREMENT
/begin MEASUREMENT TPSMinLnCNT "var comments" UBYTE udf_CM_18824 0 0.0 0.0 255.0 ECU_ADDRESS 0x400024F5 /end MEASUREMENT
/begin MEASUREMENT TPSMinLrned "var comments" UBYTE udf_CM_18817 0 0.0 0.0 255.0 ECU_ADDRESS 0x400024F7 /end MEASUREMENT
/begin MEASUREMENT DsrdFuelFlow "var comments" UWORD udf_CM_15982 0 0.0 0.0 511.9921875 ECU_ADDRESS 0x40002520 /end MEASUREMENT
/begin MEASUREMENT FCVPSMinimum "var comments" UWORD udf_CM_18810 0 0.0 0.0 199.9969482421875 ECU_ADDRESS 0x40002536 /end MEASUREMENT
/begin MEASUREMENT FCVPSMinLnCNT "var comments" UBYTE udf_CM_18824 0 0.0 0.0 255.0 ECU_ADDRESS 0x4000252A /end MEASUREMENT
/begin MEASUREMENT FCVPSMinLrned "var comments" UBYTE udf_CM_18817 0 0.0 0.0 255.0 ECU_ADDRESS 0x4000252F /end MEASUREMENT
/begin MEASUREMENT DesireFCVPS "var comments" UWORD udf_CM_15989 0 0.0 0.0 199.9969482421875 ECU_ADDRESS 0x40002526 /end MEASUREMENT
/begin MEASUREMENT FCVMotorState "var comments" UBYTE udf_CM_16661 0 0.0 0.0 3.0 ECU_ADDRESS 0x4000252C /end MEASUREMENT
/begin MEASUREMENT ActFCVPosition "var comments" UBYTE udf_CM_15247 0 0.0 0.0 255.0 ECU_ADDRESS 0x40002525 /end MEASUREMENT
/begin MEASUREMENT FCVMoveDirct "var comments" UBYTE udf_CM_16668 0 0.0 0.0 2.0 ECU_ADDRESS 0x40002524 /end MEASUREMENT
/begin MEASUREMENT FCVPS "var comments" UWORD udf_CM_18726 0 0.0 0.0 199.9969482421875 ECU_ADDRESS 0x4000253C /end MEASUREMENT
/begin MEASUREMENT FCVPSRawSignal "var comments" UWORD udf_CM_18838 0 0.0 0.0 65535.0 ECU_ADDRESS 0x4000253A /end MEASUREMENT
/begin MEASUREMENT FCVPSDelta "var comments" UWORD udf_CM_18733 0 0.0 0.0 199.9969482421875 ECU_ADDRESS 0x40002542 /end MEASUREMENT
/begin MEASUREMENT TPSShrtDiagEnb "var comments" UBYTE udf_CM_18859 0 0.0 0.0 255.0 ECU_ADDRESS 0x40002738 /end MEASUREMENT
/begin MEASUREMENT TPSSHFailCount "var comments" UWORD udf_CM_18845 0 0.0 0.0 65535.0 ECU_ADDRESS 0x40002740 /end MEASUREMENT
/begin MEASUREMENT TPSSHFailMet "var comments" UBYTE udf_CM_18852 0 0.0 0.0 255.0 ECU_ADDRESS 0x40002737 /end MEASUREMENT
/begin MEASUREMENT TPSSHTestFail "var comments" UBYTE udf_CM_18873 0 0.0 0.0 255.0 ECU_ADDRESS 0x4000273B /end MEASUREMENT
/begin MEASUREMENT TPSSLFailCount "var comments" UWORD udf_CM_18880 0 0.0 0.0 65535.0 ECU_ADDRESS 0x4000273E /end MEASUREMENT
/begin MEASUREMENT TPSSLFailMet "var comments" UBYTE udf_CM_18887 0 0.0 0.0 255.0 ECU_ADDRESS 0x40002736 /end MEASUREMENT
/begin MEASUREMENT TPSSLTestFail "var comments" UBYTE udf_CM_18894 0 0.0 0.0 255.0 ECU_ADDRESS 0x4000273A /end MEASUREMENT
/begin MEASUREMENT TPSShrtPassCount "var comments" UWORD udf_CM_18866 0 0.0 0.0 65535.0 ECU_ADDRESS 0x4000273C /end MEASUREMENT
/begin MEASUREMENT AFCCell1 "var comments" UWORD udf_CM_15275 0 0.0 0.0 1.999969005584717 DISPLAY_IDENTIFIER AFCCell[0] ECU_ADDRESS 0x4000009E /end MEASUREMENT
/begin MEASUREMENT AFCCell2 "var comments" UWORD udf_CM_15324 0 0.0 0.0 1.999969005584717 DISPLAY_IDENTIFIER AFCCell[1] ECU_ADDRESS 0x400000A0 /end MEASUREMENT
/begin MEASUREMENT AFCCell11 "var comments" UWORD udf_CM_15282 0 0.0 0.0 1.999969005584717 DISPLAY_IDENTIFIER AFCCell[10] ECU_ADDRESS 0x400000B2 /end MEASUREMENT
/begin MEASUREMENT AFCCell12 "var comments" UWORD udf_CM_15289 0 0.0 0.0 1.999969005584717 DISPLAY_IDENTIFIER AFCCell[11] ECU_ADDRESS 0x400000B4 /end MEASUREMENT
/begin MEASUREMENT AFCCell13 "var comments" UWORD udf_CM_15296 0 0.0 0.0 1.999969005584717 DISPLAY_IDENTIFIER AFCCell[12] ECU_ADDRESS 0x400000B6 /end MEASUREMENT
/begin MEASUREMENT AFCCell14 "var comments" UWORD udf_CM_15303 0 0.0 0.0 1.999969005584717 DISPLAY_IDENTIFIER AFCCell[13] ECU_ADDRESS 0x400000B8 /end MEASUREMENT
/begin MEASUREMENT AFCCell15 "var comments" UWORD udf_CM_15310 0 0.0 0.0 1.999969005584717 DISPLAY_IDENTIFIER AFCCell[14] ECU_ADDRESS 0x400000BA /end MEASUREMENT
/begin MEASUREMENT AFCCell16 "var comments" UWORD udf_CM_15317 0 0.0 0.0 1.999969005584717 DISPLAY_IDENTIFIER AFCCell[15] ECU_ADDRESS 0x400000BC /end MEASUREMENT
/begin MEASUREMENT AFCCell3 "var comments" UWORD udf_CM_15331 0 0.0 0.0 1.999969005584717 DISPLAY_IDENTIFIER AFCCell[2] ECU_ADDRESS 0x400000A2 /end MEASUREMENT
/begin MEASUREMENT AFCCell4 "var comments" UWORD udf_CM_15338 0 0.0 0.0 1.999969005584717 DISPLAY_IDENTIFIER AFCCell[3] ECU_ADDRESS 0x400000A4 /end MEASUREMENT
/begin MEASUREMENT AFCCell5 "var comments" UWORD udf_CM_15345 0 0.0 0.0 1.999969005584717 DISPLAY_IDENTIFIER AFCCell[4] ECU_ADDRESS 0x400000A6 /end MEASUREMENT
/begin MEASUREMENT AFCCell6 "var comments" UWORD udf_CM_15352 0 0.0 0.0 1.999969005584717 DISPLAY_IDENTIFIER AFCCell[5] ECU_ADDRESS 0x400000A8 /end MEASUREMENT
/begin MEASUREMENT AFCCell7 "var comments" UWORD udf_CM_15359 0 0.0 0.0 1.999969005584717 DISPLAY_IDENTIFIER AFCCell[6] ECU_ADDRESS 0x400000AA /end MEASUREMENT
/begin MEASUREMENT AFCCell8 "var comments" UWORD udf_CM_15366 0 0.0 0.0 1.999969005584717 DISPLAY_IDENTIFIER AFCCell[7] ECU_ADDRESS 0x400000AC /end MEASUREMENT
/begin MEASUREMENT AFCCell9 "var comments" UWORD udf_CM_15373 0 0.0 0.0 1.999969005584717 DISPLAY_IDENTIFIER AFCCell[8] ECU_ADDRESS 0x400000AE /end MEASUREMENT
/begin MEASUREMENT AFCCell10 "var comments" UWORD udf_CM_15380 0 0.0 0.0 1.999969005584717 DISPLAY_IDENTIFIER AFCCell[9] ECU_ADDRESS 0x400000B0 /end MEASUREMENT
/begin MEASUREMENT AFCCellNum "var comments" UBYTE udf_CM_15387 0 0.0 0.0 255.0 ECU_ADDRESS 0x4000235C /end MEASUREMENT
/begin MEASUREMENT AFCFiltExpMAPMult "var comments" UWORD udf_CM_15394 0 0.0 0.0 1.999969005584717 ECU_ADDRESS 0x4000235E /end MEASUREMENT
/begin MEASUREMENT AFCFiltMAP "var comments" UWORD udf_CM_15401 0 0.0 0.0 255.99609375 ECU_ADDRESS 0x40002364 /end MEASUREMENT
/begin MEASUREMENT AFCLMet "var comments" UBYTE udf_CM_15408 0 0.0 0.0 255.0 ECU_ADDRESS 0x40002362 /end MEASUREMENT
/begin MEASUREMENT AFCMult "var comments" UWORD udf_CM_15415 0 0.0 0.0 1.999969005584717 ECU_ADDRESS 0x40002360 /end MEASUREMENT
/begin MEASUREMENT AFRRawSig1 "var comments" UWORD udf_CM_15471 0 0.0 0.0 65535.0 DISPLAY_IDENTIFIER AFRRawSig[0] ECU_ADDRESS 0x40002366 /end MEASUREMENT
/begin MEASUREMENT AFRRawSig2 "var comments" UWORD udf_CM_15478 0 0.0 0.0 65535.0 DISPLAY_IDENTIFIER AFRRawSig[1] ECU_ADDRESS 0x40002368 /end MEASUREMENT
/begin MEASUREMENT Baro "var comments" UWORD udf_CM_15562 0 0.0 0.0 255.99609375 ECU_ADDRESS 0x40000090 /end MEASUREMENT
/begin MEASUREMENT BaroReadCrtMet "var comments" UBYTE udf_CM_15576 0 0.0 0.0 255.0 ECU_ADDRESS 0x40002379 /end MEASUREMENT
/begin MEASUREMENT BaroOffset "var comments" UWORD udf_CM_15569 0 0.0 0.0 255.99609375 ECU_ADDRESS 0x40002376 /end MEASUREMENT
/begin MEASUREMENT BaroReadTthNum "var comments" UWORD udf_CM_15583 0 0.0 0.0 65535.0 ECU_ADDRESS 0x4000237C /end MEASUREMENT
/begin MEASUREMENT FinalPulseWidth1 "var comments" UWORD udf_CM_16304 0 0.0 0.0 1023.984375 DISPLAY_IDENTIFIER FinalPulseWidth[0] ECU_ADDRESS 0x4000243E /end MEASUREMENT
/begin MEASUREMENT FinalPulseWidth2 "var comments" UWORD udf_CM_16297 0 0.0 0.0 1023.984375 DISPLAY_IDENTIFIER FinalPulseWidth[1] ECU_ADDRESS 0x40002440 /end MEASUREMENT
/begin MEASUREMENT CoolTemp "var comments" SWORD udf_CM_15751 0 0.0 -256.0 255.9921875 ECU_ADDRESS 0x4000238E /end MEASUREMENT
/begin MEASUREMENT CoolTempFilt "var comments" SWORD udf_CM_15758 0 0.0 -256.0 255.9921875 ECU_ADDRESS 0x40002390 /end MEASUREMENT
/begin MEASUREMENT ClTStartup "var comments" SWORD udf_CM_15744 0 0.0 -256.0 255.9921875 ECU_ADDRESS 0x40002392 /end MEASUREMENT
/begin MEASUREMENT CoolTemp2 "var comments" SWORD udf_CM_15751 0 0.0 -256.0 255.9921875 ECU_ADDRESS 0x40002396 /end MEASUREMENT
/begin MEASUREMENT CoolTemp2Filt "var comments" SWORD udf_CM_15758 0 0.0 -256.0 255.9921875 ECU_ADDRESS 0x40002398 /end MEASUREMENT
/begin MEASUREMENT ClT2Startup "var comments" SWORD udf_CM_15744 0 0.0 -256.0 255.9921875 ECU_ADDRESS 0x4000239A /end MEASUREMENT
/begin MEASUREMENT CIDFailCount "var comments" UWORD udf_CM_15653 0 0.0 0.0 65535.0 ECU_ADDRESS 0x40002382 /end MEASUREMENT
/begin MEASUREMENT CIDSucceed "var comments" UBYTE udf_CM_15667 0 0.0 0.0 255.0 ECU_ADDRESS 0x4000237E /end MEASUREMENT
/begin MEASUREMENT SeqPhase_Cyl1 "var comments" UWORD udf_CM_15667 0 0.0 0.0 65535.0 DISPLAY_IDENTIFIER CylPhase[0] ECU_ADDRESS 0x40001BC0 /end MEASUREMENT
/begin MEASUREMENT SeqPhase_Cyl2 "var comments" UWORD udf_CM_15667 0 0.0 0.0 65535.0 DISPLAY_IDENTIFIER CylPhase[1] ECU_ADDRESS 0x40001BC2 /end MEASUREMENT
/begin MEASUREMENT SeqPhase_Cyl3 "var comments" UWORD udf_CM_15667 0 0.0 0.0 65535.0 DISPLAY_IDENTIFIER CylPhase[2] ECU_ADDRESS 0x40001BC4 /end MEASUREMENT
/begin MEASUREMENT SeqPhase_Cyl4 "var comments" UWORD udf_CM_15667 0 0.0 0.0 65535.0 DISPLAY_IDENTIFIER CylPhase[3] ECU_ADDRESS 0x40001BC6 /end MEASUREMENT
/begin MEASUREMENT MAP_EVENT_TOOTH "var comments" UBYTE udf_CM_15667 0 0.0 0.0 255.0 ECU_ADDRESS 0x40001C80 /end MEASUREMENT
/begin MEASUREMENT Map_Event_Tooth_Count "var comments" UBYTE udf_CM_15667 0 0.0 0.0 255.0 ECU_ADDRESS 0x40001C81 /end MEASUREMENT
/begin MEASUREMENT BdcTooth "var comments" UBYTE udf_CM_15667 0 0.0 0.0 255.0 DISPLAY_IDENTIFIER BDC_TOOTH[0] ECU_ADDRESS 0x40001638 /end MEASUREMENT
/begin MEASUREMENT SyncTooth "var comments" UBYTE udf_CM_15667 0 0.0 0.0 255.0 DISPLAY_IDENTIFIER SYNCHRONIZATION_EVENT_TOOTH ECU_ADDRESS 0x40001B95 /end MEASUREMENT
/begin MEASUREMENT Ref1Tooth_Cyl1 "var comments" UBYTE udf_CM_15667 0 0.0 0.0 255.0 DISPLAY_IDENTIFIER REFERENCE_EVENT1_TOOTH[0] ECU_ADDRESS 0x40001B91 /end MEASUREMENT
/begin MEASUREMENT Ref1Tooth_Cyl2 "var comments" UBYTE udf_CM_15667 0 0.0 0.0 255.0 DISPLAY_IDENTIFIER REFERENCE_EVENT1_TOOTH[1] ECU_ADDRESS 0x40001B92 /end MEASUREMENT
/begin MEASUREMENT Ref1Tooth_Cyl3 "var comments" UBYTE udf_CM_15667 0 0.0 0.0 255.0 DISPLAY_IDENTIFIER REFERENCE_EVENT1_TOOTH[2] ECU_ADDRESS 0x40001B93 /end MEASUREMENT
/begin MEASUREMENT Ref1Tooth_Cyl4 "var comments" UBYTE udf_CM_15667 0 0.0 0.0 255.0 DISPLAY_IDENTIFIER REFERENCE_EVENT1_TOOTH[3] ECU_ADDRESS 0x40001B94 /end MEASUREMENT
/begin MEASUREMENT Ref2Tooth_Cyl1 "var comments" UBYTE udf_CM_15667 0 0.0 0.0 255.0 DISPLAY_IDENTIFIER REFERENCE_EVENT2_TOOTH[0] ECU_ADDRESS 0x40001BA0 /end MEASUREMENT
/begin MEASUREMENT Ref2Tooth_Cyl2 "var comments" UBYTE udf_CM_15667 0 0.0 0.0 255.0 DISPLAY_IDENTIFIER REFERENCE_EVENT2_TOOTH[1] ECU_ADDRESS 0x40001BA1 /end MEASUREMENT
/begin MEASUREMENT Ref2Tooth_Cyl3 "var comments" UBYTE udf_CM_15667 0 0.0 0.0 255.0 DISPLAY_IDENTIFIER REFERENCE_EVENT2_TOOTH[2] ECU_ADDRESS 0x40001BA2 /end MEASUREMENT
/begin MEASUREMENT Ref2Tooth_Cyl4 "var comments" UBYTE udf_CM_15667 0 0.0 0.0 255.0 DISPLAY_IDENTIFIER REFERENCE_EVENT2_TOOTH[3] ECU_ADDRESS 0x40001BA3 /end MEASUREMENT
/begin MEASUREMENT FuelTooth_Cyl1 "var comments" UBYTE udf_CM_15667 0 0.0 0.0 255.0 DISPLAY_IDENTIFIER FUEL_EVENT_TOOTH[0] ECU_ADDRESS 0x40001C4C /end MEASUREMENT
/begin MEASUREMENT FuelTooth_Cyl2 "var comments" UBYTE udf_CM_15667 0 0.0 0.0 255.0 DISPLAY_IDENTIFIER FUEL_EVENT_TOOTH[1] ECU_ADDRESS 0x40001C4D /end MEASUREMENT
/begin MEASUREMENT FuelTooth_Cyl3 "var comments" UBYTE udf_CM_15667 0 0.0 0.0 255.0 DISPLAY_IDENTIFIER FUEL_EVENT_TOOTH[2] ECU_ADDRESS 0x40001C4E /end MEASUREMENT
/begin MEASUREMENT FuelTooth_Cyl4 "var comments" UBYTE udf_CM_15667 0 0.0 0.0 255.0 DISPLAY_IDENTIFIER FUEL_EVENT_TOOTH[3] ECU_ADDRESS 0x40001C4F /end MEASUREMENT
/begin MEASUREMENT TrimTooth_Cyl1 "var comments" UBYTE udf_CM_15667 0 0.0 0.0 255.0 DISPLAY_IDENTIFIER TRIM_EVENT_TOOTH[0] ECU_ADDRESS 0x40001C50 /end MEASUREMENT
/begin MEASUREMENT TrimTooth_Cyl2 "var comments" UBYTE udf_CM_15667 0 0.0 0.0 255.0 DISPLAY_IDENTIFIER TRIM_EVENT_TOOTH[1] ECU_ADDRESS 0x40001C51 /end MEASUREMENT
/begin MEASUREMENT TrimTooth_Cyl3 "var comments" UBYTE udf_CM_15667 0 0.0 0.0 255.0 DISPLAY_IDENTIFIER TRIM_EVENT_TOOTH[2] ECU_ADDRESS 0x40001C52 /end MEASUREMENT
/begin MEASUREMENT TrimTooth_Cyl4 "var comments" UBYTE udf_CM_15667 0 0.0 0.0 255.0 DISPLAY_IDENTIFIER TRIM_EVENT_TOOTH[3] ECU_ADDRESS 0x40001C53 /end MEASUREMENT
/begin MEASUREMENT TrimCutOffTooth_Cyl1 "var comments" UBYTE udf_CM_15667 0 0.0 0.0 255.0 DISPLAY_IDENTIFIER TRIM_CUT_OFF_EVENT_TOOTH[0] ECU_ADDRESS 0x40001C54 /end MEASUREMENT
/begin MEASUREMENT TrimCutOffTooth_Cyl2 "var comments" UBYTE udf_CM_15667 0 0.0 0.0 255.0 DISPLAY_IDENTIFIER TRIM_CUT_OFF_EVENT_TOOTH[1] ECU_ADDRESS 0x40001C55 /end MEASUREMENT
/begin MEASUREMENT TrimCutOffTooth_Cyl3 "var comments" UBYTE udf_CM_15667 0 0.0 0.0 255.0 DISPLAY_IDENTIFIER TRIM_CUT_OFF_EVENT_TOOTH[2] ECU_ADDRESS 0x40001C56 /end MEASUREMENT
/begin MEASUREMENT TrimCutOffTooth_Cyl4 "var comments" UBYTE udf_CM_15667 0 0.0 0.0 255.0 DISPLAY_IDENTIFIER TRIM_CUT_OFF_EVENT_TOOTH[3] ECU_ADDRESS 0x40001C57 /end MEASUREMENT
/begin MEASUREMENT ToothPeriod "var comments" UWORD udf_CM_15660 0 0.0 0.0 65535.0 ECU_ADDRESS 0x40001B98 /end MEASUREMENT
/begin MEASUREMENT ToothDuration "var comments" UWORD udf_CM_15660 0 0.0 0.0 65535.0 ECU_ADDRESS 0x40001B9A /end MEASUREMENT
/begin MEASUREMENT SeqSparkEnb "var comments" UBYTE udf_CM_17921 0 0.0 0.0 255.0 ECU_ADDRESS 0x4000237F /end MEASUREMENT
/begin MEASUREMENT CIDSuccCount "var comments" UWORD udf_CM_15660 0 0.0 0.0 65535.0 ECU_ADDRESS 0x40002380 /end MEASUREMENT
/begin MEASUREMENT MAPExpAltCmpd "var comments" UWORD udf_CM_17123 0 0.0 0.0 255.99609375 ECU_ADDRESS 0x400023DA /end MEASUREMENT
/begin MEASUREMENT IntakeAirTemp "var comments" SWORD udf_CM_17053 0 0.0 -256.0 255.9921875 ECU_ADDRESS 0x400023B2 /end MEASUREMENT
/begin MEASUREMENT IATDfltUsed "var comments" UBYTE udf_CM_16689 0 0.0 0.0 255.0 ECU_ADDRESS 0x400023B8 /end MEASUREMENT
/begin MEASUREMENT IntkAirTempFilt "var comments" SWORD udf_CM_17060 0 0.0 -256.0 255.9921875 ECU_ADDRESS 0x400023B4 /end MEASUREMENT
/begin MEASUREMENT IATStartup "var comments" SWORD udf_CM_16766 0 0.0 -256.0 255.9921875 ECU_ADDRESS 0x400023B6 /end MEASUREMENT
/begin MEASUREMENT IGNVolt "var comments" UWORD udf_CM_16913 0 0.0 0.0 31.99951171875 ECU_ADDRESS 0x400023BA /end MEASUREMENT
/begin MEASUREMENT IGNVoltFilt "var comments" UWORD udf_CM_16927 0 0.0 0.0 31.99951171875 ECU_ADDRESS 0x400023BC /end MEASUREMENT
/begin MEASUREMENT IGNOff "var comments" UBYTE udf_CM_16892 0 0.0 0.0 255.0 ECU_ADDRESS 0x400023C1 /end MEASUREMENT
/begin MEASUREMENT BattVoltKeyOff "var comments" UWORD udf_CM_15611 0 0.0 0.0 31.99951171875 DISPLAY_IDENTIFIER BattVoltStepMotorDrive ECU_ADDRESS 0x400023C8 /end MEASUREMENT
/begin MEASUREMENT IGNRawSignal "var comments" UWORD udf_CM_16899 0 0.0 0.0 65535.0 ECU_ADDRESS 0x400023BE /end MEASUREMENT
/begin MEASUREMENT IGNState "var comments" UBYTE udf_CM_16906 0 0.0 0.0 255.0 ECU_ADDRESS 0x400023C0 /end MEASUREMENT
/begin MEASUREMENT SystVoltPassCount "var comments" UWORD udf_CM_18299 0 0.0 0.0 65535.0 ECU_ADDRESS 0x4000274C /end MEASUREMENT
/begin MEASUREMENT SystVoltDiagEnb "var comments" UBYTE udf_CM_18250 0 0.0 0.0 255.0 ECU_ADDRESS 0x40002746 /end MEASUREMENT
/begin MEASUREMENT SystVoltHFailMet "var comments" UBYTE udf_CM_18264 0 0.0 0.0 255.0 ECU_ADDRESS 0x40002751 /end MEASUREMENT
/begin MEASUREMENT SystVoltHFailCount "var comments" UWORD udf_CM_18257 0 0.0 0.0 65535.0 ECU_ADDRESS 0x4000274A /end MEASUREMENT
/begin MEASUREMENT SystVoltHTestFail "var comments" UBYTE udf_CM_18271 0 0.0 0.0 255.0 ECU_ADDRESS 0x40002749 /end MEASUREMENT
/begin MEASUREMENT SystVoltLFailMet "var comments" UBYTE udf_CM_18285 0 0.0 0.0 255.0 ECU_ADDRESS 0x40002750 /end MEASUREMENT
/begin MEASUREMENT SystVoltLFailCount "var comments" UWORD udf_CM_18278 0 0.0 0.0 65535.0 ECU_ADDRESS 0x4000274E /end MEASUREMENT
/begin MEASUREMENT SystVoltLTestFail "var comments" UBYTE udf_CM_18292 0 0.0 0.0 255.0 ECU_ADDRESS 0x40002748 /end MEASUREMENT
/begin MEASUREMENT GENVPassCount "var comments" UWORD udf_CM_18299 0 0.0 0.0 65535.0 ECU_ADDRESS 0x0 /end MEASUREMENT
/begin MEASUREMENT GENVDiagEnb "var comments" UBYTE udf_CM_18250 0 0.0 0.0 255.0 ECU_ADDRESS 0x0 /end MEASUREMENT
/begin MEASUREMENT GENVHFailMet "var comments" UBYTE udf_CM_18264 0 0.0 0.0 255.0 ECU_ADDRESS 0x0 /end MEASUREMENT
/begin MEASUREMENT GENVHFailCount "var comments" UWORD udf_CM_18257 0 0.0 0.0 65535.0 ECU_ADDRESS 0x0 /end MEASUREMENT
/begin MEASUREMENT GENVHTestFail "var comments" UBYTE udf_CM_18271 0 0.0 0.0 255.0 ECU_ADDRESS 0x0 /end MEASUREMENT
/begin MEASUREMENT GENVLFailMet "var comments" UBYTE udf_CM_18285 0 0.0 0.0 255.0 ECU_ADDRESS 0x0 /end MEASUREMENT
/begin MEASUREMENT GENVLFailCount "var comments" UWORD udf_CM_18278 0 0.0 0.0 65535.0 ECU_ADDRESS 0x0 /end MEASUREMENT
/begin MEASUREMENT GENVLTestFail "var comments" UBYTE udf_CM_18292 0 0.0 0.0 255.0 ECU_ADDRESS 0x0 /end MEASUREMENT
/begin MEASUREMENT MAPActual "var comments" UWORD udf_CM_17081 0 0.0 0.0 255.99609375 ECU_ADDRESS 0x400023E0 /end MEASUREMENT
/begin MEASUREMENT MAPAltComp "var comments" UWORD udf_CM_17088 0 0.0 0.0 255.99609375 ECU_ADDRESS 0x400023CE /end MEASUREMENT
/begin MEASUREMENT MAPDfltUsed "var comments" UBYTE udf_CM_17102 0 0.0 0.0 255.0 ECU_ADDRESS 0x4000236E /end MEASUREMENT
/begin MEASUREMENT MAPEstCorr "var comments" UWORD udf_CM_17109 0 0.0 0.0 255.99609375 ECU_ADDRESS 0x400023FC /end MEASUREMENT
/begin MEASUREMENT MAPEstimated "var comments" UWORD udf_CM_17116 0 0.0 0.0 255.99609375 ECU_ADDRESS 0x400023EE /end MEASUREMENT
/begin MEASUREMENT MAPExpected "var comments" UWORD udf_CM_17137 0 0.0 0.0 255.99609375 ECU_ADDRESS 0x400023E2 /end MEASUREMENT
/begin MEASUREMENT MAPExpDiff "var comments" UWORD udf_CM_17130 0 0.0 0.0 255.99609375 ECU_ADDRESS 0x400023FE /end MEASUREMENT
/begin MEASUREMENT MAPExpIncrs "var comments" UBYTE udf_CM_17144 0 0.0 0.0 255.0 ECU_ADDRESS 0x400023D0 /end MEASUREMENT
/begin MEASUREMENT MAPExpPrev "var comments" UWORD udf_CM_17151 0 0.0 0.0 255.99609375 ECU_ADDRESS 0x400023EC /end MEASUREMENT
/begin MEASUREMENT VACExpected "var comments" UWORD udf_CM_19027 0 0.0 0.0 255.99609375 ECU_ADDRESS 0x400023D2 /end MEASUREMENT
/begin MEASUREMENT MAPFiltLow "var comments" UWORD udf_CM_17165 0 0.0 0.0 255.99609375 ECU_ADDRESS 0x400023E6 /end MEASUREMENT
/begin MEASUREMENT MAPFiltLowAvg "var comments" UWORD udf_CM_17172 0 0.0 0.0 255.99609375 ECU_ADDRESS 0x400023E8 /end MEASUREMENT
/begin MEASUREMENT MAPFiltLowDlt "var comments" UWORD udf_CM_17179 0 0.0 0.0 255.99609375 ECU_ADDRESS 0x400023D4 /end MEASUREMENT
/begin MEASUREMENT MAPFiltLowPrv "var comments" UWORD udf_CM_17186 0 0.0 0.0 255.99609375 ECU_ADDRESS 0x400023F8 /end MEASUREMENT
/begin MEASUREMENT VACActual "var comments" UWORD udf_CM_19020 0 0.0 0.0 255.99609375 ECU_ADDRESS 0x400023F6 /end MEASUREMENT
/begin MEASUREMENT BaroNorminal "var comments" UWORD udf_CM_19503 0 0.0 0.0 255.99609375 DISPLAY_IDENTIFIER VfVIOS_p_NominalBaro ECU_ADDRESS 0x400023F2 /end MEASUREMENT
/begin MEASUREMENT MAPReadAngle "var comments" UWORD udf_CM_17193 0 0.0 0.0 1023.984375 ECU_ADDRESS 0x400023EA /end MEASUREMENT
/begin MEASUREMENT MAPReadCmplt "var comments" UBYTE udf_CM_17207 0 0.0 0.0 255.0 ECU_ADDRESS 0x400023D8 /end MEASUREMENT
/begin MEASUREMENT MAPReadAngleDel "var comments" UWORD udf_CM_17200 0 0.0 0.0 1023.984375 ECU_ADDRESS 0x400023E4 /end MEASUREMENT
/begin MEASUREMENT MAPReadErr "var comments" UBYTE udf_CM_19335 0 0.0 0.0 255.0 DISPLAY_IDENTIFIER VbVIOS_MAPReadError ECU_ADDRESS 0x400023D7 /end MEASUREMENT
/begin MEASUREMENT MAPShorted "var comments" UBYTE udf_CM_17235 0 0.0 0.0 255.0 ECU_ADDRESS 0x400023CA /end MEASUREMENT
/begin MEASUREMENT MAPUnfilt "var comments" UWORD udf_CM_17291 0 0.0 0.0 255.99609375 ECU_ADDRESS 0x400023F0 /end MEASUREMENT
/begin MEASUREMENT FuelPressure "var comments" UWORD udf_CM_17293 0 0.0 0.0 511.9921875 ECU_ADDRESS 0x4000254E /end MEASUREMENT
/begin MEASUREMENT WPFilt "var comments" UWORD udf_CM_17292 0 0.0 0.0 15.999755859375 ECU_ADDRESS 0x4000254A /end MEASUREMENT
/begin MEASUREMENT O2Volt "var comments" UWORD udf_CM_17536 0 0.0 0.0 1023.984375 ECU_ADDRESS 0x40002430 /end MEASUREMENT
/begin MEASUREMENT O2VoltPrev "var comments" UWORD udf_CM_17543 0 0.0 0.0 1023.984375 ECU_ADDRESS 0x40002432 /end MEASUREMENT
/begin MEASUREMENT FuelMode "var comments" UBYTE udf_CM_16528 0 0.0 0.0 255.0 ECU_ADDRESS 0x40002439 /end MEASUREMENT
/begin MEASUREMENT RefPeriod "var comments" UWORD udf_CM_17655 0 0.0 0.0 1023.984375 ECU_ADDRESS 0x40002492 /end MEASUREMENT
/begin MEASUREMENT RefPulseSeen "var comments" UBYTE udf_CM_17676 0 0.0 0.0 255.0 ECU_ADDRESS 0x40002486 /end MEASUREMENT
/begin MEASUREMENT IACV_RefToothCount "var comments" UWORD udf_CM_19370 0 0.0 0.0 65535.0 ECU_ADDRESS 0x40002406 /end MEASUREMENT
/begin MEASUREMENT FCV_RefToothCount "var comments" UWORD udf_CM_19370 0 0.0 0.0 65535.0 ECU_ADDRESS 0x40002404 /end MEASUREMENT
/begin MEASUREMENT MAPExpRealUsed "var comments" UBYTE udf_CM_17158 0 0.0 0.0 255.0 ECU_ADDRESS 0x400023DE /end MEASUREMENT
/begin MEASUREMENT EngineSpeed "var comments" UWORD udf_CM_16185 0 0.0 0.0 16383.75 ECU_ADDRESS 0x40002484 /end MEASUREMENT
/begin MEASUREMENT EngSpdDelta "var comments" UWORD udf_CM_16206 0 0.0 0.0 16383.75 ECU_ADDRESS 0x4000244E /end MEASUREMENT
/begin MEASUREMENT EngSpdErrF2UF "var comments" UWORD udf_CM_16213 0 0.0 0.0 16383.75 ECU_ADDRESS 0x4000244A /end MEASUREMENT
/begin MEASUREMENT EngSpdFilt "var comments" UWORD udf_CM_16220 0 0.0 0.0 16383.75 ECU_ADDRESS 0x40002448 /end MEASUREMENT
/begin MEASUREMENT EngSpdIncrs "var comments" UBYTE udf_CM_16227 0 0.0 0.0 255.0 ECU_ADDRESS 0x4000244C /end MEASUREMENT
/begin MEASUREMENT EngSpdState "var comments" UBYTE udf_CM_16234 0 0.0 0.0 255.0 ECU_ADDRESS 0x40002491 /end MEASUREMENT
/begin MEASUREMENT RunModeTran "var comments" UBYTE udf_CM_19412 0 0.0 0.0 255.0 DISPLAY_IDENTIFIER VeVIOS_RunModeTran ECU_ADDRESS 0x4000239F /end MEASUREMENT
/begin MEASUREMENT SprkDlvMode "var comments" UBYTE udf_CM_18131 0 0.0 0.0 255.0 ECU_ADDRESS 0x40002384 /end MEASUREMENT
/begin MEASUREMENT VSS_DUTY "var comments" UWORD udf_CM_18726 0 0.0 0.0 199.9969482421875 DISPLAY_IDENTIFIER FI_Current_Duty[0] ECU_ADDRESS 0x400009E8 /end MEASUREMENT
/begin MEASUREMENT DIAG_DUTY "var comments" UWORD udf_CM_18726 0 0.0 0.0 199.9969482421875 DISPLAY_IDENTIFIER FI_Current_Duty[1] ECU_ADDRESS 0x400009EA /end MEASUREMENT
/begin MEASUREMENT DCEN_DUTY "var comments" UWORD udf_CM_18726 0 0.0 0.0 199.9969482421875 DISPLAY_IDENTIFIER FI_Current_Duty[2] ECU_ADDRESS 0x400009EC /end MEASUREMENT
/begin MEASUREMENT TPS "var comments" UWORD udf_CM_18726 0 0.0 0.0 199.9969482421875 ECU_ADDRESS 0x400024AE /end MEASUREMENT
/begin MEASUREMENT TPSChanged "var comments" UBYTE udf_CM_18796 0 0.0 0.0 255.0 DISPLAY_IDENTIFIER TPSIncreaseFlag ECU_ADDRESS 0x400024AC /end MEASUREMENT
/begin MEASUREMENT TPSDelta "var comments" UWORD udf_CM_18733 0 0.0 0.0 199.9969482421875 ECU_ADDRESS 0x400024C0 /end MEASUREMENT
/begin MEASUREMENT TPSIACCompstd "var comments" UWORD udf_CM_18789 0 0.0 0.0 199.9969482421875 ECU_ADDRESS 0x400023F4 /end MEASUREMENT
/begin MEASUREMENT TPSPrev "var comments" UWORD udf_CM_18831 0 0.0 0.0 199.9969482421875 ECU_ADDRESS 0x400024B8 /end MEASUREMENT
/begin MEASUREMENT TPSRawSignal "var comments" UWORD udf_CM_18838 0 0.0 0.0 65535.0 ECU_ADDRESS 0x400024B0 /end MEASUREMENT
/begin MEASUREMENT TPSDiffAE "var comments" SWORD udf_CM_18747 0 0.0 -200.0 199.993896484375 ECU_ADDRESS 0x400024C2 /end MEASUREMENT
/begin MEASUREMENT TPSFiltAE "var comments" UWORD udf_CM_18775 0 0.0 0.0 199.9969482421875 ECU_ADDRESS 0x400024B2 /end MEASUREMENT
/begin MEASUREMENT TPSDiffF2UF "var comments" SWORD udf_CM_18761 0 0.0 -200.0 199.993896484375 ECU_ADDRESS 0x400024BC /end MEASUREMENT
/begin MEASUREMENT TPSDiffDE "var comments" SWORD udf_CM_18754 0 0.0 -200.0 199.993896484375 ECU_ADDRESS 0x400024C4 /end MEASUREMENT
/begin MEASUREMENT TPSDfltUsed "var comments" UBYTE udf_CM_18740 0 0.0 0.0 255.0 ECU_ADDRESS 0x400024B6 /end MEASUREMENT
/begin MEASUREMENT TPSFiltDE "var comments" UWORD udf_CM_18782 0 0.0 0.0 199.9969482421875 ECU_ADDRESS 0x400024B4 /end MEASUREMENT
/begin MEASUREMENT TPSFilt "var comments" UWORD udf_CM_18768 0 0.0 0.0 199.9969482421875 ECU_ADDRESS 0x400024BA /end MEASUREMENT
/begin MEASUREMENT TPSIncrs "var comments" UBYTE udf_CM_18803 0 0.0 0.0 255.0 ECU_ADDRESS 0x400024B7 /end MEASUREMENT
/begin MEASUREMENT TPSZero "var comments" UWORD udf_CM_18901 0 0.0 0.0 199.9969482421875 ECU_ADDRESS 0x4000009C /end MEASUREMENT
/begin COMPU_METHOD udf_CM_15240 "Ax + B" RAT_FUNC "%4.4" "boolean" COEFFS 0 1 0 0 0 1 /end COMPU_METHOD
/begin COMPU_METHOD udf_CM_15247 "Ax + B" RAT_FUNC "%4.0" "counts" COEFFS 0 1 0 0 0 1 /end COMPU_METHOD
/begin COMPU_METHOD udf_CM_15254 "Ax + B" RAT_FUNC "%4.0" "boolean" COEFFS 0 1 0 0 0 1 /end COMPU_METHOD
/begin COMPU_METHOD udf_CM_15261 "Ax + B" RAT_FUNC "%4.4" "ratio" COEFFS 0.0 65536.00026843546 0.0 0.0 0.0 1.0 /end COMPU_METHOD
/begin COMPU_METHOD udf_CM_15268 "Ax + B" RAT_FUNC "%4.4" "gm" COEFFS 0.0 8192.000033554432 0.0 0.0 0.0 1.0 /end COMPU_METHOD
/begin COMPU_METHOD udf_CM_15275 "Ax + B" RAT_FUNC "%4.4" "ratio" COEFFS 0.0 32768.00013421773 0.0 0.0 0.0 1.0 /end COMPU_METHOD
/begin COMPU_METHOD udf_CM_15282 "Ax + B" RAT_FUNC "%4.4" "ratio" COEFFS 0.0 32768.00013421773 0.0 0.0 0.0 1.0 /end COMPU_METHOD
/begin COMPU_METHOD udf_CM_15289 "Ax + B" RAT_FUNC "%4.4" "ratio" COEFFS 0.0 32768.00013421773 0.0 0.0 0.0 1.0 /end COMPU_METHOD
/begin COMPU_METHOD udf_CM_15296 "Ax + B" RAT_FUNC "%4.4" "ratio" COEFFS 0.0 32768.00013421773 0.0 0.0 0.0 1.0 /end COMPU_METHOD
/begin COMPU_METHOD udf_CM_15303 "Ax + B" RAT_FUNC "%4.4" "ratio" COEFFS 0.0 32768.00013421773 0.0 0.0 0.0 1.0 /end COMPU_METHOD
/begin COMPU_METHOD udf_CM_15310 "Ax + B" RAT_FUNC "%4.4" "ratio" COEFFS 0.0 32768.00013421773 0.0 0.0 0.0 1.0 /end COMPU_METHOD
/begin COMPU_METHOD udf_CM_15317 "Ax + B" RAT_FUNC "%4.4" "ratio" COEFFS 0.0 32768.00013421773 0.0 0.0 0.0 1.0 /end COMPU_METHOD
/begin COMPU_METHOD udf_CM_15324 "Ax + B" RAT_FUNC "%4.4" "ratio" COEFFS 0.0 32768.00013421773 0.0 0.0 0.0 1.0 /end COMPU_METHOD
/begin COMPU_METHOD udf_CM_15331 "Ax + B" RAT_FUNC "%4.4" "ratio" COEFFS 0.0 32768.00013421773 0.0 0.0 0.0 1.0 /end COMPU_METHOD
/begin COMPU_METHOD udf_CM_15338 "Ax + B" RAT_FUNC "%4.4" "ratio" COEFFS 0.0 32768.00013421773 0.0 0.0 0.0 1.0 /end COMPU_METHOD
/begin COMPU_METHOD udf_CM_15345 "Ax + B" RAT_FUNC "%4.4" "ratio" COEFFS 0.0 32768.00013421773 0.0 0.0 0.0 1.0 /end COMPU_METHOD
/begin COMPU_METHOD udf_CM_15352 "Ax + B" RAT_FUNC "%4.4" "ratio" COEFFS 0.0 32768.00013421773 0.0 0.0 0.0 1.0 /end COMPU_METHOD
/begin COMPU_METHOD udf_CM_15359 "Ax + B" RAT_FUNC "%4.4" "ratio" COEFFS 0.0 32768.00013421773 0.0 0.0 0.0 1.0 /end COMPU_METHOD
/begin COMPU_METHOD udf_CM_15366 "Ax + B" RAT_FUNC "%4.4" "ratio" COEFFS 0.0 32768.00013421773 0.0 0.0 0.0 1.0 /end COMPU_METHOD
/begin COMPU_METHOD udf_CM_15373 "Ax + B" RAT_FUNC "%4.4" "ratio" COEFFS 0.0 32768.00013421773 0.0 0.0 0.0 1.0 /end COMPU_METHOD
/begin COMPU_METHOD udf_CM_15380 "Ax + B" RAT_FUNC "%4.4" "ratio" COEFFS 0.0 32768.00013421773 0.0 0.0 0.0 1.0 /end COMPU_METHOD
/begin COMPU_METHOD udf_CM_15387 "Ax + B" RAT_FUNC "%4.0" "count" COEFFS 0 1 0 0 0 1 /end COMPU_METHOD
/begin COMPU_METHOD udf_CM_15394 "Ax + B" RAT_FUNC "%4.4" "ratio" COEFFS 0.0 32768.00013421773 0.0 0.0 0.0 1.0 /end COMPU_METHOD
/begin COMPU_METHOD udf_CM_15401 "Ax + B" RAT_FUNC "%4.4" "kpa" COEFFS 0.0 256.0 0.0 0.0 0.0 1.0 /end COMPU_METHOD
/begin COMPU_METHOD udf_CM_15408 "Ax + B" RAT_FUNC "%4.0" "boolean" COEFFS 0 1 0 0 0 1 /end COMPU_METHOD
/begin COMPU_METHOD udf_CM_15415 "Ax + B" RAT_FUNC "%4.4" "ratio" COEFFS 0.0 32768.00013421773 0.0 0.0 0.0 1.0 /end COMPU_METHOD
/begin COMPU_METHOD udf_CM_15422 "Ax + B" RAT_FUNC "%4.4" "ratio" COEFFS 0.0 2048.0 0.0 0.0 0.0 1.0 /end COMPU_METHOD
/begin COMPU_METHOD udf_CM_15429 "Ax + B" RAT_FUNC "%4.4" "ratio" COEFFS 0.0 2048.0 0.0 0.0 0.0 1.0 /end COMPU_METHOD
/begin COMPU_METHOD udf_CM_15436 "Ax + B" RAT_FUNC "%4.0" "boolean" COEFFS 0 1 0 0 0 1 /end COMPU_METHOD
/begin COMPU_METHOD udf_CM_15450 "Ax + B" RAT_FUNC "%4.4" "ratio" COEFFS 0.0 2048.0 0.0 0.0 0.0 1.0 /end COMPU_METHOD
/begin COMPU_METHOD udf_CM_15457 "Ax + B" RAT_FUNC "%4.4" "ratio" COEFFS 0.0 2048.0 0.0 0.0 0.0 1.0 /end COMPU_METHOD
/begin COMPU_METHOD udf_CM_15464 "Ax + B" RAT_FUNC "%4.4" "ratio" COEFFS 0.0 2048.0 0.0 0.0 0.0 1.0 /end COMPU_METHOD
/begin COMPU_METHOD udf_CM_15471 "Ax + B" RAT_FUNC "%4.0" "None" COEFFS 0 1 0 0 0 1 /end COMPU_METHOD
/begin COMPU_METHOD udf_CM_15478 "Ax + B" RAT_FUNC "%4.0" "None" COEFFS 0 1 0 0 0 1 /end COMPU_METHOD
/begin COMPU_METHOD udf_CM_15485 "Ax + B" RAT_FUNC "%4.4" "ratio" COEFFS 0.0 2048.0 0.0 0.0 0.0 1.0 /end COMPU_METHOD
/begin COMPU_METHOD udf_CM_15492 "Ax + B" RAT_FUNC "%4.4" "volt" COEFFS 0.0 2048.0 0.0 0.0 0.0 1.0 /end COMPU_METHOD
/begin COMPU_METHOD udf_CM_15499 "Ax + B" RAT_FUNC "%4.4" "volt" COEFFS 0.0 2048.0 0.0 0.0 0.0 1.0 /end COMPU_METHOD
/begin COMPU_METHOD udf_CM_15506 "Ax + B" RAT_FUNC "%4.4" "ratio" COEFFS 0.0 2048.0 0.0 0.0 0.0 1.0 /end COMPU_METHOD
/begin COMPU_METHOD udf_CM_15513 "Ax + B" RAT_FUNC "%4.0" "boolean" COEFFS 0 1 0 0 0 1 /end COMPU_METHOD
/begin COMPU_METHOD udf_CM_15520 "Ax + B" RAT_FUNC "%4.4" "ratio" COEFFS 0.0 2048.0 0.0 0.0 0.0 1.0 /end COMPU_METHOD
/begin COMPU_METHOD udf_CM_15527 "Ax + B" RAT_FUNC "%4.4" "ratio" COEFFS 0.0 2048.0 0.0 0.0 0.0 1.0 /end COMPU_METHOD
/begin COMPU_METHOD udf_CM_15534 "Ax + B" RAT_FUNC "%4.4" "gm/sec" COEFFS 0.0 128.0 0.0 0.0 0.0 1.0 /end COMPU_METHOD
/begin COMPU_METHOD udf_CM_15541 "Ax + B" RAT_FUNC "%4.4" "gm/sec" COEFFS 0.0 128.0 0.0 0.0 0.0 1.0 /end COMPU_METHOD
/begin COMPU_METHOD udf_CM_15548 "Ax + B" RAT_FUNC "%4.4" "grams" COEFFS 0.0 16384.00006710886 0.0 0.0 0.0 1.0 /end COMPU_METHOD
/begin COMPU_METHOD udf_CM_15555 "Ax + B" RAT_FUNC "%4.4" "grams" COEFFS 0.0 16384.00006710886 0.0 0.0 0.0 1.0 /end COMPU_METHOD
/begin COMPU_METHOD udf_CM_15562 "Ax + B" RAT_FUNC "%4.4" "kpa" COEFFS 0.0 256.0 0.0 0.0 0.0 1.0 /end COMPU_METHOD
/begin COMPU_METHOD udf_CM_15569 "Ax + B" RAT_FUNC "%4.4" "kpa" COEFFS 0.0 256.0 0.0 0.0 0.0 1.0 /end COMPU_METHOD
/begin COMPU_METHOD udf_CM_15576 "Ax + B" RAT_FUNC "%4.0" "boolean" COEFFS 0 1 0 0 0 1 /end COMPU_METHOD
/begin COMPU_METHOD udf_CM_15583 "Ax + B" RAT_FUNC "%4.0" "None" COEFFS 0 1 0 0 0 1 /end COMPU_METHOD
/begin COMPU_METHOD udf_CM_15590 "Ax + B" RAT_FUNC "%4.4" "gm" COEFFS 0.0 65536.00026843546 0.0 0.0 0.0 1.0 /end COMPU_METHOD
/begin COMPU_METHOD udf_CM_15597 "Ax + B" RAT_FUNC "%4.4" "msec" COEFFS 0.0 64.0 0.0 0.0 0.0 1.0 /end COMPU_METHOD
/begin COMPU_METHOD udf_CM_15604 "Ax + B" RAT_FUNC "%4.4" "gm" COEFFS 0.0 65536.00026843546 0.0 0.0 0.0 1.0 /end COMPU_METHOD
/begin COMPU_METHOD udf_CM_15611 "Ax + B" RAT_FUNC "%4.4" "volt" COEFFS 0.0 2048.0 0.0 0.0 0.0 1.0 /end COMPU_METHOD
/begin COMPU_METHOD CM_Boolean1 "" RAT_FUNC "%1.0" "bool" COEFFS 0 1 0 0 0 1 /end COMPU_METHOD
/begin COMPU_METHOD udf_CM_15639 "Ax + B" RAT_FUNC "%4.4" "ratio" COEFFS 0.0 16393.44262295082 0.0 0.0 0.0 1.0 /end COMPU_METHOD
/begin COMPU_METHOD udf_CM_15646 "Ax + B" RAT_FUNC "%4.4" "degC" COEFFS 0.0 128.0 0.0 0.0 0.0 1.0 /end COMPU_METHOD
/begin COMPU_METHOD udf_CM_15653 "Ax + B" RAT_FUNC "%4.0" "counts" COEFFS 0 1 0 0 0 1 /end COMPU_METHOD
/begin COMPU_METHOD udf_CM_15660 "Ax + B" RAT_FUNC "%4.0" "counts" COEFFS 0 1 0 0 0 1 /end COMPU_METHOD
/begin COMPU_METHOD udf_CM_15667 "Ax + B" RAT_FUNC "%4.0" "None" COEFFS 0 1 0 0 0 1 /end COMPU_METHOD
/begin COMPU_METHOD udf_CM_15674 "Ax + B" RAT_FUNC "%4.0" "None" COEFFS 0 1 0 0 0 1 /end COMPU_METHOD
/begin COMPU_METHOD udf_CM_15681 "Ax + B" RAT_FUNC "%4.0" "Counts" COEFFS 0 1 0 0 0 1 /end COMPU_METHOD
/begin COMPU_METHOD udf_CM_15688 "Ax + B" RAT_FUNC "%4.0" "None" COEFFS 0 1 0 0 0 1 /end COMPU_METHOD
/begin COMPU_METHOD udf_CM_15695 "Ax + B" RAT_FUNC "%4.0" "Counts" COEFFS 0 1 0 0 0 1 /end COMPU_METHOD
/begin COMPU_METHOD udf_CM_15702 "Ax + B" RAT_FUNC "%4.0" "None" COEFFS 0 1 0 0 0 1 /end COMPU_METHOD
/begin COMPU_METHOD udf_CM_15709 "Ax + B" RAT_FUNC "%4.0" "None" COEFFS 0 1 0 0 0 1 /end COMPU_METHOD
/begin COMPU_METHOD udf_CM_15716 "Ax + B" RAT_FUNC "%4.0" "Counts" COEFFS 0 1 0 0 0 1 /end COMPU_METHOD
/begin COMPU_METHOD udf_CM_15723 "Ax + B" RAT_FUNC "%4.0" "None" COEFFS 0 1 0 0 0 1 /end COMPU_METHOD
/begin COMPU_METHOD udf_CM_15730 "Ax + B" RAT_FUNC "%4.0" "Counts" COEFFS 0 1 0 0 0 1 /end COMPU_METHOD
/begin COMPU_METHOD udf_CM_15737 "Ax + B" RAT_FUNC "%4.0" "None" COEFFS 0 1 0 0 0 1 /end COMPU_METHOD
/begin COMPU_METHOD udf_CM_15744 "Ax + B" RAT_FUNC "%4.4" "degC" COEFFS 0.0 128.0 0.0 0.0 0.0 1.0 /end COMPU_METHOD
/begin COMPU_METHOD udf_CM_15751 "Ax + B" RAT_FUNC "%4.4" "degC" COEFFS 0.0 128.0 0.0 0.0 0.0 1.0 /end COMPU_METHOD
/begin COMPU_METHOD udf_CM_15758 "Ax + B" RAT_FUNC "%4.4" "degC" COEFFS 0.0 128.0 0.0 0.0 0.0 1.0 /end COMPU_METHOD
/begin COMPU_METHOD CM_Count1 "" RAT_FUNC "%3.0" "count" COEFFS 0 1 0 0 0 1 /end COMPU_METHOD
/begin COMPU_METHOD CM_Count3 "" RAT_FUNC "%3.0" "None" COEFFS 0 1 0 0 0 1 /end COMPU_METHOD
/begin COMPU_METHOD udf_CM_15821 "Ax + B" RAT_FUNC "%4.0" "None" COEFFS 0 1 0 0 0 1 /end COMPU_METHOD
/begin COMPU_METHOD udf_CM_15828 "Ax + B" RAT_FUNC "%4.0" "None" COEFFS 0 1 0 0 0 1 /end COMPU_METHOD
/begin COMPU_METHOD udf_CM_15835 "Ax + B" RAT_FUNC "%4.2" "" COEFFS 0.0 128.0 0.0 0.0 0.0 1.0 /end COMPU_METHOD
/begin COMPU_METHOD udf_CM_15842 "Ax + B" RAT_FUNC "%4.2" "" COEFFS 0.0 128.0 0.0 0.0 0.0 1.0 /end COMPU_METHOD
/begin COMPU_METHOD udf_CM_15849 "Ax + B" RAT_FUNC "%4.0" "" COEFFS 0 1 0 0 0 1 /end COMPU_METHOD
/begin COMPU_METHOD udf_CM_15856 "Ax + B" RAT_FUNC "%4.0" "" COEFFS 0 1 0 0 0 1 /end COMPU_METHOD
/begin COMPU_METHOD udf_CM_15863 "Ax + B" RAT_FUNC "%4.0" "" COEFFS 0 1 0 0 0 1 /end COMPU_METHOD
/begin COMPU_METHOD udf_CM_15870 "Ax + B" RAT_FUNC "%4.0" "" COEFFS 0 1 0 0 0 1 /end COMPU_METHOD
/begin COMPU_METHOD udf_CM_15877 "Ax + B" RAT_FUNC "%4.0" "" COEFFS 0 1 0 0 0 1 /end COMPU_METHOD
/begin COMPU_METHOD udf_CM_15884 "Ax + B" RAT_FUNC "%4.0" "" COEFFS 0 1 0 0 0 1 /end COMPU_METHOD
/begin COMPU_METHOD udf_CM_15891 "Ax + B" RAT_FUNC "%4.0" "" COEFFS 0 1 0 0 0 1 /end COMPU_METHOD
/begin COMPU_METHOD udf_CM_15898 "Ax + B" RAT_FUNC "%4.0" "" COEFFS 0 1 0 0 0 1 /end COMPU_METHOD
/begin COMPU_METHOD udf_CM_15905 "Ax + B" RAT_FUNC "%4.0" "" COEFFS 0 1 0 0 0 1 /end COMPU_METHOD
/begin COMPU_METHOD udf_CM_15912 "Ax + B" RAT_FUNC "%4.0" "" COEFFS 0 1 0 0 0 1 /end COMPU_METHOD
/begin COMPU_METHOD udf_CM_15919 "Ax + B" RAT_FUNC "%4.0" "" COEFFS 0 1 0 0 0 1 /end COMPU_METHOD
/begin COMPU_METHOD udf_CM_15926 "Ax + B" RAT_FUNC "%4.0" "" COEFFS 0 1 0 0 0 1 /end COMPU_METHOD
/begin COMPU_METHOD udf_CM_15933 "Ax + B" RAT_FUNC "%4.0" "" COEFFS 0 1 0 0 0 1 /end COMPU_METHOD
/begin COMPU_METHOD CM_EOI "" TAB_VERB "%10.4" "" COMPU_TAB_REF CM_EOI_TAB /end COMPU_METHOD
/begin COMPU_METHOD udf_CM_15947 "Ax + B" RAT_FUNC "%4.0" "boolean" COEFFS 0 1 0 0 0 1 /end COMPU_METHOD
/begin COMPU_METHOD udf_CM_15954 "Ax + B" RAT_FUNC "%4.4" "boolean" COEFFS 0 1 0 0 0 1 /end COMPU_METHOD
/begin COMPU_METHOD udf_CM_15961 "Ax + B" RAT_FUNC "%4.4" "ratio" COEFFS 0.0 65536.00026843546 0.0 0.0 0.0 1.0 /end COMPU_METHOD
/begin COMPU_METHOD udf_CM_15968 "Ax + B" RAT_FUNC "%4.4" "gm" COEFFS 0.0 8192.000033554432 0.0 0.0 0.0 1.0 /end COMPU_METHOD
/begin COMPU_METHOD udf_CM_15975 "Ax + B" RAT_FUNC "%4.4" "gm" COEFFS 0.0 65536.00026843546 0.0 0.0 0.0 1.0 /end COMPU_METHOD
/begin COMPU_METHOD udf_CM_15982 "Ax + B" RAT_FUNC "%4.4" "Gram" COEFFS 0.0 128.0 0.0 0.0 0.0 1.0 /end COMPU_METHOD
/begin COMPU_METHOD udf_CM_15989 "Ax + B" RAT_FUNC "%4.4" "percent" COEFFS 0.0 327.6800000536871 0.0 0.0 0.0 1.0 /end COMPU_METHOD
/begin COMPU_METHOD udf_CM_15996 "Ax + B" RAT_FUNC "%4.0" "percent" COEFFS 0.0 327.6800000536871 0.0 0.0 0.0 1.0 /end COMPU_METHOD
/begin COMPU_METHOD udf_CM_16010 "" TAB_VERB "%10.4" "" COMPU_TAB_REF udf_CV_19704 /end COMPU_METHOD
/begin COMPU_METHOD udf_CM_16059 "Ax + B" RAT_FUNC "%4.4" "NM" COEFFS 0.0 256.0 0.0 0.0 0.0 1.0 /end COMPU_METHOD
/begin COMPU_METHOD udf_CM_16066 "Ax + B" RAT_FUNC "%4.4" "rpm" COEFFS 0.0 4.0 0.0 0.0 0.0 1.0 /end COMPU_METHOD
/begin COMPU_METHOD udf_CM_16073 "Ax + B" RAT_FUNC "%4.4" "rpm" COEFFS 0.0 4.0 0.0 0.0 0.0 1.0 /end COMPU_METHOD
/begin COMPU_METHOD udf_CM_16080 "Ax + B" RAT_FUNC "%4.4" "rpm" COEFFS 0.0 4.0 0.0 0.0 0.0 1.0 /end COMPU_METHOD
/begin COMPU_METHOD udf_CM_16087 "Ax + B" RAT_FUNC "%4.4" "rpm" COEFFS 0.0 4.0 0.0 0.0 0.0 1.0 /end COMPU_METHOD
/begin COMPU_METHOD udf_CM_16094 "Ax + B" RAT_FUNC "%4.4" "rpm" COEFFS 0.0 4.0 0.0 0.0 0.0 1.0 /end COMPU_METHOD
/begin COMPU_METHOD udf_CM_16101 "Ax + B" RAT_FUNC "%4.4" "rpm" COEFFS 0.0 4.0 0.0 0.0 0.0 1.0 /end COMPU_METHOD
/begin COMPU_METHOD udf_CM_16108 "Ax + B" RAT_FUNC "%4.4" "rpm" COEFFS 0.0 4.0 0.0 0.0 0.0 1.0 /end COMPU_METHOD
/begin COMPU_METHOD udf_CM_16115 "Ax + B" RAT_FUNC "%4.4" "rpm" COEFFS 0.0 4.0 0.0 0.0 0.0 1.0 /end COMPU_METHOD
/begin COMPU_METHOD udf_CM_16122 "Ax + B" RAT_FUNC "%4.4" "rpm" COEFFS 0.0 4.0 0.0 0.0 0.0 1.0 /end COMPU_METHOD
/begin COMPU_METHOD udf_CM_16129 "Ax + B" RAT_FUNC "%4.4" "rpm" COEFFS 0.0 4.0 0.0 0.0 0.0 1.0 /end COMPU_METHOD
/begin COMPU_METHOD udf_CM_16136 "Ax + B" RAT_FUNC "%4.4" "rpm" COEFFS 0.0 4.0 0.0 0.0 0.0 1.0 /end COMPU_METHOD
/begin COMPU_METHOD udf_CM_16143 "Ax + B" RAT_FUNC "%4.4" "rpm" COEFFS 0.0 4.0 0.0 0.0 0.0 1.0 /end COMPU_METHOD
/begin COMPU_METHOD udf_CM_16150 "Ax + B" RAT_FUNC "%4.4" "rpm" COEFFS 0.0 4.0 0.0 0.0 0.0 1.0 /end COMPU_METHOD
/begin COMPU_METHOD udf_CM_16157 "Ax + B" RAT_FUNC "%4.4" "rpm" COEFFS 0.0 4.0 0.0 0.0 0.0 1.0 /end COMPU_METHOD
/begin COMPU_METHOD udf_CM_16164 "Ax + B" RAT_FUNC "%4.4" "rpm" COEFFS 0.0 4.0 0.0 0.0 0.0 1.0 /end COMPU_METHOD
/begin COMPU_METHOD udf_CM_16171 "Ax + B" RAT_FUNC "%4.4" "rpm" COEFFS 0.0 4.0 0.0 0.0 0.0 1.0 /end COMPU_METHOD
/begin COMPU_METHOD udf_CM_16178 "Ax + B" RAT_FUNC "%4.4" "rpm" COEFFS 0.0 4.0 0.0 0.0 0.0 1.0 /end COMPU_METHOD
/begin COMPU_METHOD udf_CM_16185 "Ax + B" RAT_FUNC "%4.4" "rpm" COEFFS 0.0 4.0 0.0 0.0 0.0 1.0 /end COMPU_METHOD
/begin COMPU_METHOD udf_CM_16192 "" TAB_VERB "%10.4" "" COMPU_TAB_REF udf_CV_19710 /end COMPU_METHOD
/begin COMPU_METHOD udf_CM_16193 "" TAB_VERB "%10.4" "" COMPU_TAB_REF udf_CV_19711 /end COMPU_METHOD
/begin COMPU_METHOD udf_CM_16199 "Ax + B" RAT_FUNC "%4.0" "None" COEFFS 0 1 0 0 0 1 /end COMPU_METHOD
/begin COMPU_METHOD udf_CM_16206 "Ax + B" RAT_FUNC "%4.4" "rpm" COEFFS 0.0 4.0 0.0 0.0 0.0 1.0 /end COMPU_METHOD
/begin COMPU_METHOD udf_CM_16213 "Ax + B" RAT_FUNC "%4.4" "rpm" COEFFS 0.0 4.0 0.0 0.0 0.0 1.0 /end COMPU_METHOD
/begin COMPU_METHOD udf_CM_16220 "Ax + B" RAT_FUNC "%4.4" "rpm" COEFFS 0.0 4.0 0.0 0.0 0.0 1.0 /end COMPU_METHOD
/begin COMPU_METHOD udf_CM_16227 "Ax + B" RAT_FUNC "%4.0" "none" COEFFS 0 1 0 0 0 1 /end COMPU_METHOD
/begin COMPU_METHOD udf_CM_16234 "Ax + B" RAT_FUNC "%4.0" "boolean" COEFFS 0 1 0 0 0 1 /end COMPU_METHOD
/begin COMPU_METHOD udf_CM_16269 "Ax + B" RAT_FUNC "%4.0" "boolean" COEFFS 0 1 0 0 0 1 /end COMPU_METHOD
/begin COMPU_METHOD udf_CM_16283 "Ax + B" RAT_FUNC "%4.4" "msec" COEFFS 0.0 64.0 0.0 0.0 0.0 1.0 /end COMPU_METHOD
/begin COMPU_METHOD udf_CM_16290 "Ax + B" RAT_FUNC "%4.4" "msec" COEFFS 0.0 64.0 0.0 0.0 0.0 1.0 /end COMPU_METHOD
/begin COMPU_METHOD udf_CM_16297 "Ax + B" RAT_FUNC "%4.4" "msec" COEFFS 0.0 64.0 0.0 0.0 0.0 1.0 /end COMPU_METHOD
/begin COMPU_METHOD udf_CM_16304 "Ax + B" RAT_FUNC "%4.4" "msec" COEFFS 0.0 64.0 0.0 0.0 0.0 1.0 /end COMPU_METHOD
/begin COMPU_METHOD udf_CM_16311 "" TAB_VERB "%10.4" "" COMPU_TAB_REF udf_CV_19716 /end COMPU_METHOD
/begin COMPU_METHOD udf_CM_16325 "Ax + B" RAT_FUNC "%4.4" "millivolt" COEFFS 0.0 64.0 0.0 0.0 0.0 1.0 /end COMPU_METHOD
/begin COMPU_METHOD udf_CM_16332 "" TAB_VERB "%10.4" "" COMPU_TAB_REF udf_CV_19722 /end COMPU_METHOD
/begin COMPU_METHOD udf_CM_16339 "Ax + B" RAT_FUNC "%4.0" "boolean" COEFFS 0 1 0 0 0 1 /end COMPU_METHOD
/begin COMPU_METHOD udf_CM_16346 "" TAB_VERB "%10.4" "" COMPU_TAB_REF udf_CV_19728 /end COMPU_METHOD
/begin COMPU_METHOD udf_CM_16353 "Ax + B" RAT_FUNC "%4.0" "boolean" COEFFS 0 1 0 0 0 1 /end COMPU_METHOD
/begin COMPU_METHOD udf_CM_16360 "Ax + B" RAT_FUNC "%4.4" "millivolt" COEFFS 0.0 64.0 0.0 0.0 0.0 1.0 /end COMPU_METHOD
/begin COMPU_METHOD udf_CM_16381 "Ax + B" RAT_FUNC "%4.0" "boolean" COEFFS 0 1 0 0 0 1 /end COMPU_METHOD
/begin COMPU_METHOD udf_CM_16395 "Ax + B" RAT_FUNC "%4.0" "boolean" COEFFS 0 1 0 0 0 1 /end COMPU_METHOD
/begin COMPU_METHOD udf_CM_16402 "Ax + B" RAT_FUNC "%4.0" "boolean" COEFFS 0 1 0 0 0 1 /end COMPU_METHOD
/begin COMPU_METHOD udf_CM_16409 "Ax + B" RAT_FUNC "%4.4" "msec" COEFFS 0.0 64.0 0.0 0.0 0.0 1.0 /end COMPU_METHOD
/begin COMPU_METHOD udf_CM_16416 "Ax + B" RAT_FUNC "%4.4" "msec" COEFFS 0.0 64.0 0.0 0.0 0.0 1.0 /end COMPU_METHOD
/begin COMPU_METHOD udf_CM_16423 "Ax + B" RAT_FUNC "%4.0" "boolean" COEFFS 0 1 0 0 0 1 /end COMPU_METHOD
/begin COMPU_METHOD udf_CM_16430 "Ax + B" RAT_FUNC "%4.0" "boolean" COEFFS 0 1 0 0 0 1 /end COMPU_METHOD
/begin COMPU_METHOD udf_CM_16437 "Ax + B" RAT_FUNC "%4.4" "msec" COEFFS 0.0 8192.000033554432 0.0 0.0 0.0 1.0 /end COMPU_METHOD
/begin COMPU_METHOD udf_CM_16444 "Ax + B" RAT_FUNC "%4.4" "grm" COEFFS 0.0 4096.0 0.0 0.0 0.0 1.0 /end COMPU_METHOD
/begin COMPU_METHOD udf_CM_16451 "Ax + B" RAT_FUNC "%4.0" "boolean" COEFFS 0 1 0 0 0 1 /end COMPU_METHOD
/begin COMPU_METHOD udf_CM_16458 "Ax + B" RAT_FUNC "%4.0" "None" COEFFS 0 1 0 0 0 1 /end COMPU_METHOD
/begin COMPU_METHOD udf_CM_16465 "Ax + B" RAT_FUNC "%4.4" "angle" COEFFS 0.0 64.0 0.0 0.0 0.0 1.0 /end COMPU_METHOD
/begin COMPU_METHOD udf_CM_16472 "Ax + B" RAT_FUNC "%4.4" "angle" COEFFS 0.0 64.0 0.0 0.0 0.0 1.0 /end COMPU_METHOD
/begin COMPU_METHOD udf_CM_16479 "Ax + B" RAT_FUNC "%4.4" "angle" COEFFS 0.0 64.0 0.0 0.0 0.0 1.0 /end COMPU_METHOD
/begin COMPU_METHOD udf_CM_16486 "Ax + B" RAT_FUNC "%4.0" "boolean" COEFFS 0 1 0 0 0 1 /end COMPU_METHOD
/begin COMPU_METHOD udf_CM_16493 "Ax + B" RAT_FUNC "%4.0" "boolean" COEFFS 0 1 0 0 0 1 /end COMPU_METHOD
/begin COMPU_METHOD udf_CM_16500 "Ax + B" RAT_FUNC "%4.4" "counts" COEFFS 0 1 0 0 0 1 /end COMPU_METHOD
/begin COMPU_METHOD udf_CM_16507 "Ax + B" RAT_FUNC "%4.4" "msec" COEFFS 0.0 64.0 0.0 0.0 0.0 1.0 /end COMPU_METHOD
/begin COMPU_METHOD udf_CM_16514 "Ax + B" RAT_FUNC "%4.0" "boolean" COEFFS 0 1 0 0 0 1 /end COMPU_METHOD
/begin COMPU_METHOD udf_CM_16521 "Ax + B" RAT_FUNC "%4.0" "boolean" COEFFS 0 1 0 0 0 1 /end COMPU_METHOD
/begin COMPU_METHOD udf_CM_16528 "Ax + B" RAT_FUNC "%4.0" "None" COEFFS 0 1 0 0 0 1 /end COMPU_METHOD
/begin COMPU_METHOD udf_CM_16535 "Ax + B" RAT_FUNC "%4.4" "percent" COEFFS 0.0 327.6800000536871 0.0 0.0 0.0 1.0 /end COMPU_METHOD
/begin COMPU_METHOD udf_CM_16542 "Ax + B" RAT_FUNC "%4.0" "None" COEFFS 0 1 0 0 0 1 /end COMPU_METHOD
/begin COMPU_METHOD udf_CM_16549 "Ax + B" RAT_FUNC "%4.0" "Counts" COEFFS 0 1 0 0 0 1 /end COMPU_METHOD
/begin COMPU_METHOD udf_CM_16556 "Ax + B" RAT_FUNC "%4.0" "None" COEFFS 0 1 0 0 0 1 /end COMPU_METHOD
/begin COMPU_METHOD udf_CM_16563 "Ax + B" RAT_FUNC "%4.0" "None" COEFFS 0 1 0 0 0 1 /end COMPU_METHOD
/begin COMPU_METHOD udf_CM_16570 "Ax + B" RAT_FUNC "%4.0" "None" COEFFS 0 1 0 0 0 1 /end COMPU_METHOD
/begin COMPU_METHOD udf_CM_16577 "Ax + B" RAT_FUNC "%4.0" "Counts" COEFFS 0 1 0 0 0 1 /end COMPU_METHOD
/begin COMPU_METHOD udf_CM_16584 "Ax + B" RAT_FUNC "%4.0" "None" COEFFS 0 1 0 0 0 1 /end COMPU_METHOD
/begin COMPU_METHOD udf_CM_16591 "Ax + B" RAT_FUNC "%4.0" "None" COEFFS 0 1 0 0 0 1 /end COMPU_METHOD
/begin COMPU_METHOD udf_CM_16598 "Ax + B" RAT_FUNC "%4.4" "percent" COEFFS 0.0 327.6800000536871 0.0 0.0 0.0 1.0 /end COMPU_METHOD
/begin COMPU_METHOD udf_CM_16605 "Ax + B" RAT_FUNC "%4.0" "None" COEFFS 0 1 0 0 0 1 /end COMPU_METHOD
/begin COMPU_METHOD udf_CM_16612 "Ax + B" RAT_FUNC "%4.0" "None" COEFFS 0 1 0 0 0 1 /end COMPU_METHOD
/begin COMPU_METHOD udf_CM_16619 "Ax + B" RAT_FUNC "%4.0" "None" COEFFS 0 1 0 0 0 1 /end COMPU_METHOD
/begin COMPU_METHOD udf_CM_16626 "Ax + B" RAT_FUNC "%4.4" "ratio" COEFFS 0.0 32768.00013421773 0.0 0.0 0.0 1.0 /end COMPU_METHOD
/begin COMPU_METHOD udf_CM_16640 "Ax + B" RAT_FUNC "%4.0" "IAC_Mode" COEFFS 0 1 0 0 0 1 /end COMPU_METHOD
/begin COMPU_METHOD udf_CM_16647 "Ax + B" RAT_FUNC "%4.0" "boolean" COEFFS 0 1 0 0 0 1 /end COMPU_METHOD
/begin COMPU_METHOD udf_CM_16654 "Ax + B" RAT_FUNC "%4.0" "boolean" COEFFS 0 1 0 0 0 1 /end COMPU_METHOD
/begin COMPU_METHOD udf_CM_16661 "" TAB_VERB "%10.4" "" COMPU_TAB_REF udf_CV_19734 /end COMPU_METHOD
/begin COMPU_METHOD udf_CM_16668 "" TAB_VERB "%10.4" "" COMPU_TAB_REF udf_CV_19740 /end COMPU_METHOD
/begin COMPU_METHOD udf_CM_16675 "Ax + B" RAT_FUNC "%4.0" "boolean" COEFFS 0 1 0 0 0 1 /end COMPU_METHOD
/begin COMPU_METHOD udf_CM_16682 "Ax + B" RAT_FUNC "%4.0" "boolean" COEFFS 0 1 0 0 0 1 /end COMPU_METHOD
/begin COMPU_METHOD udf_CM_16689 "Ax + B" RAT_FUNC "%4.0" "boolean" COEFFS 0 1 0 0 0 1 /end COMPU_METHOD
/begin COMPU_METHOD udf_CM_16696 "Ax + B" RAT_FUNC "%4.0" "None" COEFFS 0 1 0 0 0 1 /end COMPU_METHOD
/begin COMPU_METHOD udf_CM_16703 "Ax + B" RAT_FUNC "%4.0" "Counts" COEFFS 0 1 0 0 0 1 /end COMPU_METHOD
/begin COMPU_METHOD udf_CM_16710 "Ax + B" RAT_FUNC "%4.0" "None" COEFFS 0 1 0 0 0 1 /end COMPU_METHOD
/begin COMPU_METHOD udf_CM_16717 "Ax + B" RAT_FUNC "%4.0" "Counts" COEFFS 0 1 0 0 0 1 /end COMPU_METHOD
/begin COMPU_METHOD udf_CM_16724 "Ax + B" RAT_FUNC "%4.0" "None" COEFFS 0 1 0 0 0 1 /end COMPU_METHOD
/begin COMPU_METHOD udf_CM_16731 "Ax + B" RAT_FUNC "%4.0" "None" COEFFS 0 1 0 0 0 1 /end COMPU_METHOD
/begin COMPU_METHOD udf_CM_16738 "Ax + B" RAT_FUNC "%4.0" "Counts" COEFFS 0 1 0 0 0 1 /end COMPU_METHOD
/begin COMPU_METHOD udf_CM_16745 "Ax + B" RAT_FUNC "%4.0" "None" COEFFS 0 1 0 0 0 1 /end COMPU_METHOD
/begin COMPU_METHOD udf_CM_16752 "Ax + B" RAT_FUNC "%4.0" "Counts" COEFFS 0 1 0 0 0 1 /end COMPU_METHOD
/begin COMPU_METHOD udf_CM_16759 "Ax + B" RAT_FUNC "%4.0" "None" COEFFS 0 1 0 0 0 1 /end COMPU_METHOD
/begin COMPU_METHOD udf_CM_16766 "Ax + B" RAT_FUNC "%4.4" "degC" COEFFS 0.0 128.0 0.0 0.0 0.0 1.0 /end COMPU_METHOD
/begin COMPU_METHOD udf_CM_16773 "Ax + B" RAT_FUNC "%4.4" "percent" COEFFS 0.0 163.84 0.0 0.0 0.0 1.0 /end COMPU_METHOD
/begin COMPU_METHOD udf_CM_16780 "Ax + B" RAT_FUNC "%4.4" "rpm" COEFFS 0.0 4.0 0.0 0.0 0.0 1.0 /end COMPU_METHOD
/begin COMPU_METHOD udf_CM_16787 "Ax + B" RAT_FUNC "%4.4" "rpm" COEFFS 0.0 4.0 0.0 0.0 0.0 1.0 /end COMPU_METHOD
/begin COMPU_METHOD udf_CM_16794 "Ax + B" RAT_FUNC "%4.4" "rpm" COEFFS 0.0 4.0 0.0 0.0 0.0 1.0 /end COMPU_METHOD
/begin COMPU_METHOD udf_CM_16801 "Ax + B" RAT_FUNC "%4.4" "rpm" COEFFS 0.0 4.0 0.0 0.0 0.0 1.0 /end COMPU_METHOD
/begin COMPU_METHOD udf_CM_16808 "Ax + B" RAT_FUNC "%4.4" "percent" COEFFS 0.0 327.6800000536871 0.0 0.0 0.0 1.0 /end COMPU_METHOD
/begin COMPU_METHOD udf_CM_16815 "Ax + B" RAT_FUNC "%4.0" "boolean" COEFFS 0 1 0 0 0 1 /end COMPU_METHOD
/begin COMPU_METHOD udf_CM_16822 "Ax + B" RAT_FUNC "%4.0" "boolean" COEFFS 0 1 0 0 0 1 /end COMPU_METHOD
/begin COMPU_METHOD udf_CM_16829 "Ax + B" RAT_FUNC "%4.0" "count" COEFFS 0 1 0 0 0 1 /end COMPU_METHOD
/begin COMPU_METHOD udf_CM_16836 "Ax + B" RAT_FUNC "%4.4" "percent" COEFFS 0.0 327.6800000536871 0.0 0.0 0.0 1.0 /end COMPU_METHOD
/begin COMPU_METHOD udf_CM_16843 "Ax + B" RAT_FUNC "%4.4" "rpm" COEFFS 0.0 4.0 0.0 0.0 0.0 1.0 /end COMPU_METHOD
/begin COMPU_METHOD udf_CM_16850 "Ax + B" RAT_FUNC "%4.0" "boolean" COEFFS 0 1 0 0 0 1 /end COMPU_METHOD
/begin COMPU_METHOD udf_CM_16857 "Ax + B" RAT_FUNC "%4.0" "boolean" COEFFS 0 1 0 0 0 1 /end COMPU_METHOD
/begin COMPU_METHOD udf_CM_16864 "Ax + B" RAT_FUNC "%4.4" "percent" COEFFS 0.0 327.6800000536871 0.0 0.0 0.0 1.0 /end COMPU_METHOD
/begin COMPU_METHOD udf_CM_16871 "Ax + B" RAT_FUNC "%4.4" "percent" COEFFS 0.0 327.6800000536871 0.0 0.0 0.0 1.0 /end COMPU_METHOD
/begin COMPU_METHOD udf_CM_16885 "Ax + B" RAT_FUNC "%4.4" "percent" COEFFS 0.0 163.84 0.0 0.0 0.0 1.0 /end COMPU_METHOD
/begin COMPU_METHOD udf_CM_16892 "Ax + B" RAT_FUNC "%4.0" "boolean" COEFFS 0 1 0 0 0 1 /end COMPU_METHOD
/begin COMPU_METHOD udf_CM_16899 "Ax + B" RAT_FUNC "%4.4" "counts" COEFFS 0 1 0 0 0 1 /end COMPU_METHOD
/begin COMPU_METHOD udf_CM_16906 "Ax + B" RAT_FUNC "%4.0" "boolean" COEFFS 0 1 0 0 0 1 /end COMPU_METHOD
/begin COMPU_METHOD udf_CM_16913 "Ax + B" RAT_FUNC "%4.4" "volt" COEFFS 0.0 2048.0 0.0 0.0 0.0 1.0 /end COMPU_METHOD
/begin COMPU_METHOD udf_CM_16920 "Ax + B" RAT_FUNC "%4.1" "" COEFFS 0.0 2048.0 0.0 0.0 0.0 1.0 /end COMPU_METHOD
/begin COMPU_METHOD udf_CM_16927 "Ax + B" RAT_FUNC "%4.4" "volt" COEFFS 0.0 2048.0 0.0 0.0 0.0 1.0 /end COMPU_METHOD
/begin COMPU_METHOD udf_CM_16928 "Ax + B" RAT_FUNC "%4.4" "volt" COEFFS 0.0 64.0 0.0 0.0 0.0 1.0 /end COMPU_METHOD
/begin COMPU_METHOD udf_CM_16941 "Ax + B" RAT_FUNC "%4.0" "Counts" COEFFS 0 1 0 0 0 1 /end COMPU_METHOD
/begin COMPU_METHOD udf_CM_16948 "Ax + B" RAT_FUNC "%4.0" "None" COEFFS 0 1 0 0 0 1 /end COMPU_METHOD
/begin COMPU_METHOD udf_CM_16955 "Ax + B" RAT_FUNC "%4.0" "None" COEFFS 0 1 0 0 0 1 /end COMPU_METHOD
/begin COMPU_METHOD udf_CM_16962 "Ax + B" RAT_FUNC "%4.0" "None" COEFFS 0 1 0 0 0 1 /end COMPU_METHOD
/begin COMPU_METHOD udf_CM_16969 "Ax + B" RAT_FUNC "%4.0" "Counts" COEFFS 0 1 0 0 0 1 /end COMPU_METHOD
/begin COMPU_METHOD udf_CM_16976 "Ax + B" RAT_FUNC "%4.0" "None" COEFFS 0 1 0 0 0 1 /end COMPU_METHOD
/begin COMPU_METHOD udf_CM_16983 "Ax + B" RAT_FUNC "%4.0" "None" COEFFS 0 1 0 0 0 1 /end COMPU_METHOD
/begin COMPU_METHOD udf_CM_17046 "Ax + B" RAT_FUNC "%4.4" "msec" COEFFS 0.0 64.0 0.0 0.0 0.0 1.0 /end COMPU_METHOD
/begin COMPU_METHOD udf_CM_17053 "Ax + B" RAT_FUNC "%4.4" "degC" COEFFS 0.0 128.0 0.0 0.0 0.0 1.0 /end COMPU_METHOD
/begin COMPU_METHOD udf_CM_17060 "Ax + B" RAT_FUNC "%4.4" "degC" COEFFS 0.0 128.0 0.0 0.0 0.0 1.0 /end COMPU_METHOD
/begin COMPU_METHOD udf_CM_17067 "Ax + B" RAT_FUNC "%4.4" "ratio" COEFFS 0.0 1024.0 0.0 0.0 0.0 1.0 /end COMPU_METHOD
/begin COMPU_METHOD udf_CM_17074 "Ax + B" RAT_FUNC "%4.0" "None" COEFFS 0 1 0 0 0 1 /end COMPU_METHOD
/begin COMPU_METHOD udf_CM_17081 "Ax + B" RAT_FUNC "%4.4" "kpa" COEFFS 0.0 256.0 0.0 0.0 0.0 1.0 /end COMPU_METHOD
/begin COMPU_METHOD udf_CM_17088 "Ax + B" RAT_FUNC "%4.4" "kpa" COEFFS 0.0 256.0 0.0 0.0 0.0 1.0 /end COMPU_METHOD
/begin COMPU_METHOD udf_CM_17095 "Ax + B" RAT_FUNC "%4.0" "None" COEFFS 0 1 0 0 0 1 /end COMPU_METHOD
/begin COMPU_METHOD udf_CM_17102 "Ax + B" RAT_FUNC "%4.0" "boolean" COEFFS 0 1 0 0 0 1 /end COMPU_METHOD
/begin COMPU_METHOD udf_CM_17109 "Ax + B" RAT_FUNC "%4.4" "kpa" COEFFS 0.0 256.0 0.0 0.0 0.0 1.0 /end COMPU_METHOD
/begin COMPU_METHOD udf_CM_17116 "Ax + B" RAT_FUNC "%4.4" "kpa" COEFFS 0.0 256.0 0.0 0.0 0.0 1.0 /end COMPU_METHOD
/begin COMPU_METHOD udf_CM_17123 "Ax + B" RAT_FUNC "%4.4" "kpa" COEFFS 0.0 256.0 0.0 0.0 0.0 1.0 /end COMPU_METHOD
/begin COMPU_METHOD udf_CM_17130 "Ax + B" RAT_FUNC "%4.4" "kpa" COEFFS 0.0 256.0 0.0 0.0 0.0 1.0 /end COMPU_METHOD
/begin COMPU_METHOD udf_CM_17137 "Ax + B" RAT_FUNC "%4.4" "kpa" COEFFS 0.0 256.0 0.0 0.0 0.0 1.0 /end COMPU_METHOD
/begin COMPU_METHOD udf_CM_17144 "Ax + B" RAT_FUNC "%4.0" "boolean" COEFFS 0 1 0 0 0 1 /end COMPU_METHOD
/begin COMPU_METHOD udf_CM_17151 "Ax + B" RAT_FUNC "%4.4" "kpa" COEFFS 0.0 256.0 0.0 0.0 0.0 1.0 /end COMPU_METHOD
/begin COMPU_METHOD udf_CM_17158 "Ax + B" RAT_FUNC "%4.0" "boolean" COEFFS 0 1 0 0 0 1 /end COMPU_METHOD
/begin COMPU_METHOD udf_CM_17165 "Ax + B" RAT_FUNC "%4.4" "kpa" COEFFS 0.0 256.0 0.0 0.0 0.0 1.0 /end COMPU_METHOD
/begin COMPU_METHOD udf_CM_17172 "Ax + B" RAT_FUNC "%4.4" "kpa" COEFFS 0.0 256.0 0.0 0.0 0.0 1.0 /end COMPU_METHOD
/begin COMPU_METHOD udf_CM_17179 "Ax + B" RAT_FUNC "%4.4" "kpa" COEFFS 0.0 256.0 0.0 0.0 0.0 1.0 /end COMPU_METHOD
/begin COMPU_METHOD udf_CM_17186 "Ax + B" RAT_FUNC "%4.4" "kpa" COEFFS 0.0 256.0 0.0 0.0 0.0 1.0 /end COMPU_METHOD
/begin COMPU_METHOD udf_CM_17193 "Ax + B" RAT_FUNC "%4.4" "angle" COEFFS 0.0 64.0 0.0 0.0 0.0 1.0 /end COMPU_METHOD
/begin COMPU_METHOD udf_CM_17200 "Ax + B" RAT_FUNC "%4.4" "angle" COEFFS 0.0 64.0 0.0 0.0 0.0 1.0 /end COMPU_METHOD
/begin COMPU_METHOD udf_CM_17207 "Ax + B" RAT_FUNC "%4.0" "boolean" COEFFS 0 1 0 0 0 1 /end COMPU_METHOD
/begin COMPU_METHOD udf_CM_17214 "Ax + B" RAT_FUNC "%4.0" "None" COEFFS 0 1 0 0 0 1 /end COMPU_METHOD
/begin COMPU_METHOD udf_CM_17221 "Ax + B" RAT_FUNC "%4.0" "Counts" COEFFS 0 1 0 0 0 1 /end COMPU_METHOD
/begin COMPU_METHOD udf_CM_17228 "Ax + B" RAT_FUNC "%4.0" "None" COEFFS 0 1 0 0 0 1 /end COMPU_METHOD
/begin COMPU_METHOD udf_CM_17235 "Ax + B" RAT_FUNC "%4.0" "boolean" COEFFS 0 1 0 0 0 1 /end COMPU_METHOD
/begin COMPU_METHOD udf_CM_17242 "Ax + B" RAT_FUNC "%4.0" "Counts" COEFFS 0 1 0 0 0 1 /end COMPU_METHOD
/begin COMPU_METHOD udf_CM_17249 "Ax + B" RAT_FUNC "%4.0" "None" COEFFS 0 1 0 0 0 1 /end COMPU_METHOD
/begin COMPU_METHOD udf_CM_17256 "Ax + B" RAT_FUNC "%4.0" "None" COEFFS 0 1 0 0 0 1 /end COMPU_METHOD
/begin COMPU_METHOD udf_CM_17263 "Ax + B" RAT_FUNC "%4.0" "Counts" COEFFS 0 1 0 0 0 1 /end COMPU_METHOD
/begin COMPU_METHOD udf_CM_17270 "Ax + B" RAT_FUNC "%4.0" "None" COEFFS 0 1 0 0 0 1 /end COMPU_METHOD
/begin COMPU_METHOD udf_CM_17277 "Ax + B" RAT_FUNC "%4.0" "Counts" COEFFS 0 1 0 0 0 1 /end COMPU_METHOD
/begin COMPU_METHOD udf_CM_17284 "Ax + B" RAT_FUNC "%4.0" "None" COEFFS 0 1 0 0 0 1 /end COMPU_METHOD
/begin COMPU_METHOD udf_CM_17291 "Ax + B" RAT_FUNC "%4.4" "kpa" COEFFS 0.0 256.0 0.0 0.0 0.0 1.0 /end COMPU_METHOD
/begin COMPU_METHOD udf_CM_17292 "Ax + B" RAT_FUNC "%4.4" "mpa" COEFFS 0.0 4096.0 0.0 0.0 0.0 1.0 /end COMPU_METHOD
/begin COMPU_METHOD udf_CM_17293 "Ax + B" RAT_FUNC "%4.4" "kpa" COEFFS 0.0 128.0 0.0 0.0 0.0 1.0 /end COMPU_METHOD
/begin COMPU_METHOD udf_CM_17294 "Ax + B" RAT_FUNC "%4.4" "amps" COEFFS 0.0 128.0 0.0 0.0 0.0 1.0 /end COMPU_METHOD
/begin COMPU_METHOD CM_Equaloutput1 "Default N=E compu method" RAT_FUNC "%10.4" "" COEFFS 0 1 0 0 0 1 /end COMPU_METHOD
/begin COMPU_METHOD CM_Boolean6 "Default N=E compu method" RAT_FUNC "%10.4" "Boolean" COEFFS 0 1 0 0 0 1 /end COMPU_METHOD
/begin COMPU_METHOD udf_CM_17368 "Ax + B" RAT_FUNC "%4.4" "msec" COEFFS 0.0 64.0 0.0 0.0 0.0 1.0 /end COMPU_METHOD
/begin COMPU_METHOD udf_CM_17382 "Ax + B" RAT_FUNC "%4.0" "None" COEFFS 0 1 0 0 0 1 /end COMPU_METHOD
/begin COMPU_METHOD udf_CM_17389 "Ax + B" RAT_FUNC "%4.0" "Counts" COEFFS 0 1 0 0 0 1 /end COMPU_METHOD
/begin COMPU_METHOD udf_CM_17396 "Ax + B" RAT_FUNC "%4.0" "None" COEFFS 0 1 0 0 0 1 /end COMPU_METHOD
/begin COMPU_METHOD udf_CM_17403 "Ax + B" RAT_FUNC "%4.0" "None" COEFFS 0 1 0 0 0 1 /end COMPU_METHOD
/begin COMPU_METHOD udf_CM_17410 "Ax + B" RAT_FUNC "%4.0" "None" COEFFS 0 1 0 0 0 1 /end COMPU_METHOD
/begin COMPU_METHOD udf_CM_17417 "Ax + B" RAT_FUNC "%4.0" "Counts" COEFFS 0 1 0 0 0 1 /end COMPU_METHOD
/begin COMPU_METHOD udf_CM_17424 "Ax + B" RAT_FUNC "%4.0" "None" COEFFS 0 1 0 0 0 1 /end COMPU_METHOD
/begin COMPU_METHOD udf_CM_17431 "Ax + B" RAT_FUNC "%4.0" "None" COEFFS 0 1 0 0 0 1 /end COMPU_METHOD
/begin COMPU_METHOD udf_CM_17438 "Ax + B" RAT_FUNC "%4.4" "percent" COEFFS 0.0 327.6800000536871 0.0 0.0 0.0 1.0 /end COMPU_METHOD
/begin COMPU_METHOD udf_CM_17445 "Ax + B" RAT_FUNC "%4.0" "boolean" COEFFS 0 1 0 0 0 1 /end COMPU_METHOD
/begin COMPU_METHOD udf_CM_17452 "Ax + B" RAT_FUNC "%4.0" "boolean" COEFFS 0 1 0 0 0 1 /end COMPU_METHOD
/begin COMPU_METHOD udf_CM_17459 "Ax + B" RAT_FUNC "%4.4" "grams" COEFFS 0.0 8192.000033554432 0.0 0.0 0.0 1.0 /end COMPU_METHOD
/begin COMPU_METHOD udf_CM_17466 "Ax + B" RAT_FUNC "%4.4" "grams" COEFFS 0.0 8192.000033554432 0.0 0.0 0.0 1.0 /end COMPU_METHOD
/begin COMPU_METHOD udf_CM_17473 "Ax + B" RAT_FUNC "%4.4" "grams" COEFFS 0.0 8192.000033554432 0.0 0.0 0.0 1.0 /end COMPU_METHOD
/begin COMPU_METHOD udf_CM_17480 "Ax + B" RAT_FUNC "%4.0" "counts" COEFFS 0 1 0 0 0 1 /end COMPU_METHOD
/begin COMPU_METHOD udf_CM_17487 "Ax + B" RAT_FUNC "%4.0" "None" COEFFS 0 1 0 0 0 1 /end COMPU_METHOD
/begin COMPU_METHOD udf_CM_17494 "Ax + B" RAT_FUNC "%4.0" "None" COEFFS 0 1 0 0 0 1 /end COMPU_METHOD
/begin COMPU_METHOD udf_CM_17501 "Ax + B" RAT_FUNC "%4.0" "counts" COEFFS 0 1 0 0 0 1 /end COMPU_METHOD
/begin COMPU_METHOD udf_CM_17508 "Ax + B" RAT_FUNC "%4.0" "None" COEFFS 0 1 0 0 0 1 /end COMPU_METHOD
/begin COMPU_METHOD udf_CM_17515 "Ax + B" RAT_FUNC "%4.0" "counts" COEFFS 0 1 0 0 0 1 /end COMPU_METHOD
/begin COMPU_METHOD udf_CM_17522 "Ax + B" RAT_FUNC "%4.0" "None" COEFFS 0 1 0 0 0 1 /end COMPU_METHOD
/begin COMPU_METHOD udf_CM_17529 "Ax + B" RAT_FUNC "%4.0" "None" COEFFS 0 1 0 0 0 1 /end COMPU_METHOD
/begin COMPU_METHOD udf_CM_17536 "Ax + B" RAT_FUNC "%4.4" "millivolt" COEFFS 0.0 64.0 0.0 0.0 0.0 1.0 /end COMPU_METHOD
/begin COMPU_METHOD udf_CM_17543 "Ax + B" RAT_FUNC "%4.4" "millivolt" COEFFS 0.0 64.0 0.0 0.0 0.0 1.0 /end COMPU_METHOD
/begin COMPU_METHOD udf_CM_17557 "Ax + B" RAT_FUNC "%4.0" "None" COEFFS 0 1 0 0 0 1 /end COMPU_METHOD
/begin COMPU_METHOD udf_CM_17564 "Ax + B" RAT_FUNC "%4.0" "None" COEFFS 0 1 0 0 0 1 /end COMPU_METHOD
/begin COMPU_METHOD udf_CM_17592 "Ax + B" RAT_FUNC "%4.0" "" COEFFS 0 1 0 0 0 1 /end COMPU_METHOD
/begin COMPU_METHOD udf_CM_17606 "Ax + B" RAT_FUNC "%4.0" "None" COEFFS 0 1 0 0 0 1 /end COMPU_METHOD
/begin COMPU_METHOD udf_CM_17613 "Ax + B" RAT_FUNC "%4.0" "boolean" COEFFS 0 1 0 0 0 1 /end COMPU_METHOD
/begin COMPU_METHOD udf_CM_17620 "Ax + B" RAT_FUNC "%4.0" "None" COEFFS 0 1 0 0 0 1 /end COMPU_METHOD
/begin COMPU_METHOD udf_CM_17627 "Ax + B" RAT_FUNC "%4.0" "None" COEFFS 0 1 0 0 0 1 /end COMPU_METHOD
/begin COMPU_METHOD udf_CM_17634 "Ax + B" RAT_FUNC "%4.0" "None" COEFFS 0 1 0 0 0 1 /end COMPU_METHOD
/begin COMPU_METHOD udf_CM_17641 "Ax + B" RAT_FUNC "%4.4" "msec" COEFFS 0.0 64.0 0.0 0.0 0.0 1.0 /end COMPU_METHOD
/begin COMPU_METHOD udf_CM_17648 "Ax + B" RAT_FUNC "%4.4" "millivolt" COEFFS 0.0 64.0 0.0 0.0 0.0 1.0 /end COMPU_METHOD
/begin COMPU_METHOD udf_CM_17655 "Ax + B" RAT_FUNC "%4.4" "msec" COEFFS 0.0 64.0 0.0 0.0 0.0 1.0 /end COMPU_METHOD
/begin COMPU_METHOD udf_CM_17662 "Ax + B" RAT_FUNC "%4.4" "msec" COEFFS 0.0 1000.0 0.0 0.0 0.0 1.0 /end COMPU_METHOD
/begin COMPU_METHOD udf_CM_17663 "Ax + B" RAT_FUNC "%4.4" "sec" COEFFS 0.0 60.0 0.0 0.0 0.0 1.0 /end COMPU_METHOD
/begin COMPU_METHOD udf_CM_17669 "Ax + B" RAT_FUNC "%4.4" "msec" COEFFS 0.0 1000.0 0.0 0.0 0.0 1.0 /end COMPU_METHOD
/begin COMPU_METHOD udf_CM_17676 "Ax + B" RAT_FUNC "%4.0" "boolean" COEFFS 0 1 0 0 0 1 /end COMPU_METHOD
/begin COMPU_METHOD udf_CM_17683 "Ax + B" RAT_FUNC "%4.0" "None" COEFFS 0 1 0 0 0 1 /end COMPU_METHOD
/begin COMPU_METHOD udf_CM_17697 "Ax + B" RAT_FUNC "%4.0" "None" COEFFS 0 1 0 0 0 1 /end COMPU_METHOD
/begin COMPU_METHOD udf_CM_17711 "Ax + B" RAT_FUNC "%4.4" "angle" COEFFS 0.0 128.0 0.0 0.0 0.0 1.0 /end COMPU_METHOD
/begin COMPU_METHOD udf_CM_17718 "Ax + B" RAT_FUNC "%4.4" "angle" COEFFS 0.0 128.0 0.0 0.0 0.0 1.0 /end COMPU_METHOD
/begin COMPU_METHOD udf_CM_17725 "Ax + B" RAT_FUNC "%4.4" "angle" COEFFS 0.0 128.0 0.0 0.0 0.0 1.0 /end COMPU_METHOD
/begin COMPU_METHOD udf_CM_17732 "Ax + B" RAT_FUNC "%4.4" "angle" COEFFS 0.0 128.0 0.0 0.0 0.0 1.0 /end COMPU_METHOD
/begin COMPU_METHOD udf_CM_17739 "Ax + B" RAT_FUNC "%4.4" "angle" COEFFS 0.0 128.0 0.0 0.0 0.0 1.0 /end COMPU_METHOD
/begin COMPU_METHOD udf_CM_17746 "Ax + B" RAT_FUNC "%4.4" "angle" COEFFS 0.0 128.0 0.0 0.0 0.0 1.0 /end COMPU_METHOD
/begin COMPU_METHOD udf_CM_17767 "Ax + B" RAT_FUNC "%4.4" "angle" COEFFS 0.0 128.0 0.0 0.0 0.0 1.0 /end COMPU_METHOD
/begin COMPU_METHOD udf_CM_17781 "Ax + B" RAT_FUNC "%4.4" "angle" COEFFS 0.0 128.0 0.0 0.0 0.0 1.0 /end COMPU_METHOD
/begin COMPU_METHOD udf_CM_17816 "Ax + B" RAT_FUNC "%4.0" "None" COEFFS 0 1 0 0 0 1 /end COMPU_METHOD
/begin COMPU_METHOD udf_CM_17837 "Ax + B" RAT_FUNC "%4.4" "none" COEFFS 0 1 0 0 0 1 /end COMPU_METHOD
/begin COMPU_METHOD udf_CM_17921 "Ax + B" RAT_FUNC "%4.0" "boolean" COEFFS 0 1 0 0 0 1 /end COMPU_METHOD
/begin COMPU_METHOD udf_CM_17963 "Ax + B" RAT_FUNC "%4.0" "None" COEFFS 0 1 0 0 0 1 /end COMPU_METHOD
/begin COMPU_METHOD udf_CM_17991 "Ax + B" RAT_FUNC "%4.4" "msec" COEFFS 0.0 64.0 0.0 0.0 0.0 1.0 /end COMPU_METHOD
/begin COMPU_METHOD udf_CM_17998 "Ax + B" RAT_FUNC "%4.0" "None" COEFFS 0 1 0 0 0 1 /end COMPU_METHOD
/begin COMPU_METHOD udf_CM_18005 "Ax + B" RAT_FUNC "%4.4" "percent" COEFFS 0.0 655.3600001073743 0.0 0.0 0.0 1.0 /end COMPU_METHOD
/begin COMPU_METHOD udf_CM_18012 "Ax + B" RAT_FUNC "%4.0" "count" COEFFS 0 1 0 0 0 1 /end COMPU_METHOD
/begin COMPU_METHOD udf_CM_18019 "Ax + B" RAT_FUNC "%4.0" "None" COEFFS 0 1 0 0 0 1 /end COMPU_METHOD
/begin COMPU_METHOD udf_CM_18026 "Ax + B" RAT_FUNC "%4.0" "Counts" COEFFS 0 1 0 0 0 1 /end COMPU_METHOD
/begin COMPU_METHOD udf_CM_18033 "Ax + B" RAT_FUNC "%4.0" "None" COEFFS 0 1 0 0 0 1 /end COMPU_METHOD
/begin COMPU_METHOD udf_CM_18040 "Ax + B" RAT_FUNC "%4.0" "None" COEFFS 0 1 0 0 0 1 /end COMPU_METHOD
/begin COMPU_METHOD udf_CM_18047 "Ax + B" RAT_FUNC "%4.0" "None" COEFFS 0 1 0 0 0 1 /end COMPU_METHOD
/begin COMPU_METHOD udf_CM_18054 "Ax + B" RAT_FUNC "%4.0" "Counts" COEFFS 0 1 0 0 0 1 /end COMPU_METHOD
/begin COMPU_METHOD udf_CM_18061 "Ax + B" RAT_FUNC "%4.0" "None" COEFFS 0 1 0 0 0 1 /end COMPU_METHOD
/begin COMPU_METHOD udf_CM_18068 "Ax + B" RAT_FUNC "%4.0" "None" COEFFS 0 1 0 0 0 1 /end COMPU_METHOD
/begin COMPU_METHOD udf_CM_18075 "Ax + B" RAT_FUNC "%4.0" "None" COEFFS 0 1 0 0 0 1 /end COMPU_METHOD
/begin COMPU_METHOD udf_CM_18082 "Ax + B" RAT_FUNC "%4.0" "Counts" COEFFS 0 1 0 0 0 1 /end COMPU_METHOD
/begin COMPU_METHOD udf_CM_18089 "Ax + B" RAT_FUNC "%4.0" "None" COEFFS 0 1 0 0 0 1 /end COMPU_METHOD
/begin COMPU_METHOD udf_CM_18096 "Ax + B" RAT_FUNC "%4.0" "None" COEFFS 0 1 0 0 0 1 /end COMPU_METHOD
/begin COMPU_METHOD udf_CM_18103 "Ax + B" RAT_FUNC "%4.0" "None" COEFFS 0 1 0 0 0 1 /end COMPU_METHOD
/begin COMPU_METHOD udf_CM_18110 "Ax + B" RAT_FUNC "%4.0" "Counts" COEFFS 0 1 0 0 0 1 /end COMPU_METHOD
/begin COMPU_METHOD udf_CM_18117 "Ax + B" RAT_FUNC "%4.0" "None" COEFFS 0 1 0 0 0 1 /end COMPU_METHOD
/begin COMPU_METHOD udf_CM_18124 "Ax + B" RAT_FUNC "%4.0" "None" COEFFS 0 1 0 0 0 1 /end COMPU_METHOD
/begin COMPU_METHOD udf_CM_18131 "Ax + B" RAT_FUNC "%4.0" "None" COEFFS 0 1 0 0 0 1 /end COMPU_METHOD
/begin COMPU_METHOD udf_CM_18138 "Ax + B" RAT_FUNC "%4.0" "None" COEFFS 0 1 0 0 0 1 /end COMPU_METHOD
/begin COMPU_METHOD udf_CM_18159 "Ax + B" RAT_FUNC "%4.0" "counts" COEFFS 0 1 0 0 0 1 /end COMPU_METHOD
/begin COMPU_METHOD udf_CM_18166 "Ax + B" RAT_FUNC "%4.0" "counts" COEFFS 0 1 0 0 0 1 /end COMPU_METHOD
/begin COMPU_METHOD udf_CM_18173 "Ax + B" RAT_FUNC "%4.0" "counts" COEFFS 0 1 0 0 0 1 /end COMPU_METHOD
/begin COMPU_METHOD udf_CM_18180 "Ax + B" RAT_FUNC "%4.4" "percent" COEFFS 0.0 327.6800000536871 0.0 0.0 0.0 1.0 /end COMPU_METHOD
/begin COMPU_METHOD udf_CM_18187 "Ax + B" RAT_FUNC "%4.0" "None" COEFFS 0 1 0 0 0 1 /end COMPU_METHOD
/begin COMPU_METHOD udf_CM_18194 "Ax + B" RAT_FUNC "%4.0" "Counts" COEFFS 0 1 0 0 0 1 /end COMPU_METHOD
/begin COMPU_METHOD udf_CM_18201 "Ax + B" RAT_FUNC "%4.0" "None" COEFFS 0 1 0 0 0 1 /end COMPU_METHOD
/begin COMPU_METHOD udf_CM_18208 "Ax + B" RAT_FUNC "%4.0" "Counts" COEFFS 0 1 0 0 0 1 /end COMPU_METHOD
/begin COMPU_METHOD udf_CM_18215 "Ax + B" RAT_FUNC "%4.0" "None" COEFFS 0 1 0 0 0 1 /end COMPU_METHOD
/begin COMPU_METHOD udf_CM_18222 "Ax + B" RAT_FUNC "%4.0" "None" COEFFS 0 1 0 0 0 1 /end COMPU_METHOD
/begin COMPU_METHOD udf_CM_18229 "Ax + B" RAT_FUNC "%4.4" "percent" COEFFS 0.0 327.6800000536871 0.0 0.0 0.0 1.0 /end COMPU_METHOD
/begin COMPU_METHOD udf_CM_18236 "Ax + B" RAT_FUNC "%4.4" "percent" COEFFS 0.0 327.6800000536871 0.0 0.0 0.0 1.0 /end COMPU_METHOD
/begin COMPU_METHOD udf_CM_18250 "Ax + B" RAT_FUNC "%4.0" "None" COEFFS 0 1 0 0 0 1 /end COMPU_METHOD
/begin COMPU_METHOD udf_CM_18257 "Ax + B" RAT_FUNC "%4.0" "Counts" COEFFS 0 1 0 0 0 1 /end COMPU_METHOD
/begin COMPU_METHOD udf_CM_18264 "Ax + B" RAT_FUNC "%4.0" "None" COEFFS 0 1 0 0 0 1 /end COMPU_METHOD
/begin COMPU_METHOD udf_CM_18271 "Ax + B" RAT_FUNC "%4.0" "None" COEFFS 0 1 0 0 0 1 /end COMPU_METHOD
/begin COMPU_METHOD udf_CM_18278 "Ax + B" RAT_FUNC "%4.0" "Counts" COEFFS 0 1 0 0 0 1 /end COMPU_METHOD
/begin COMPU_METHOD udf_CM_18285 "Ax + B" RAT_FUNC "%4.0" "None" COEFFS 0 1 0 0 0 1 /end COMPU_METHOD
/begin COMPU_METHOD udf_CM_18292 "Ax + B" RAT_FUNC "%4.0" "None" COEFFS 0 1 0 0 0 1 /end COMPU_METHOD
/begin COMPU_METHOD udf_CM_18299 "Ax + B" RAT_FUNC "%4.0" "Couints" COEFFS 0 1 0 0 0 1 /end COMPU_METHOD
/begin COMPU_METHOD CM_EnumFaultType "" RAT_FUNC "%1.0" "enum" COEFFS 0 1 0 0 0 1 /end COMPU_METHOD
/begin COMPU_METHOD CM_FiltCoef "" RAT_FUNC "%7.6" "coef" COEFFS 0.0 65536.00026843546 0.0 0.0 0.0 1.0 /end COMPU_METHOD
/begin COMPU_METHOD udf_CM_18376 "" RAT_FUNC "%7.5" "ratio" COEFFS 0.0 4096.0 0.0 0.0 0.0 1.0 /end COMPU_METHOD
/begin COMPU_METHOD CM_Seconds "" RAT_FUNC "%4.1" "seconds" COEFFS 0.0 2.0 0.0 0.0 0.0 1.0 /end COMPU_METHOD
/begin COMPU_METHOD CM_mVolt_2 "" RAT_FUNC "%7.3" "mvolt" COEFFS 0.0 64.0 0.0 0.0 0.0 1.0 /end COMPU_METHOD
/begin COMPU_METHOD CM_DegC_N256to256 "" RAT_FUNC "%7.4" "degC" COEFFS 0.0 128.0 0.0 0.0 0.0 1.0 /end COMPU_METHOD
/begin COMPU_METHOD CM_Percent_0to100_1 "" RAT_FUNC "%6.4" "percent" COEFFS 0.0 655.3603892316423 0.0 0.0 0.0 1.0 /end COMPU_METHOD
/begin COMPU_METHOD CM_Percent_0to200_2 "" RAT_FUNC "%7.4" "percent" COEFFS 0.0 327.6800872415464 0.0 0.0 0.0 1.0 /end COMPU_METHOD
/begin COMPU_METHOD CM_Ratio_0to4 "" RAT_FUNC "%6.5" "ratio" COEFFS 0.0 16384.00006710886 0.0 0.0 0.0 1.0 /end COMPU_METHOD
/begin COMPU_METHOD CM_RPM_0to16384 "" RAT_FUNC "%7.2" "rpm" COEFFS 0.0 4.0 0.0 0.0 0.0 1.0 /end COMPU_METHOD
/begin COMPU_METHOD CM_Second_0to64 "" RAT_FUNC "%4.2" "milliseconds" COEFFS 0.0 4.0 0.0 0.0 0.0 1.0 /end COMPU_METHOD
/begin COMPU_METHOD CM_CrankAngle_0to1024_1 "" RAT_FUNC "%7.3" "" COEFFS 0.0 64.0 0.0 0.0 0.0 1.0 /end COMPU_METHOD
/begin COMPU_METHOD CM_Volt_0to32_1 "" RAT_FUNC "%6.4" "volt" COEFFS 0.0 2048.001048576537 0.0 0.0 0.0 1.0 /end COMPU_METHOD
/begin COMPU_METHOD udf_CM_18677 "Ax + B" RAT_FUNC "%4.4" "Gram" COEFFS 0.0 128.0 0.0 0.0 0.0 1.0 /end COMPU_METHOD
/begin COMPU_METHOD udf_CM_18684 "Ax + B" RAT_FUNC "%4.4" "Gram" COEFFS 0.0 128.0 0.0 0.0 0.0 1.0 /end COMPU_METHOD
/begin COMPU_METHOD udf_CM_18726 "Ax + B" RAT_FUNC "%4.4" "percent" COEFFS 0.0 327.6800000536871 0.0 0.0 0.0 1.0 /end COMPU_METHOD
/begin COMPU_METHOD udf_CM_18733 "Ax + B" RAT_FUNC "%4.4" "percent" COEFFS 0.0 327.6800000536871 0.0 0.0 0.0 1.0 /end COMPU_METHOD
/begin COMPU_METHOD udf_CM_18740 "Ax + B" RAT_FUNC "%4.0" "boolean" COEFFS 0 1 0 0 0 1 /end COMPU_METHOD
/begin COMPU_METHOD udf_CM_18747 "Ax + B" RAT_FUNC "%4.4" "percent" COEFFS 0.0 163.84 0.0 0.0 0.0 1.0 /end COMPU_METHOD
/begin COMPU_METHOD udf_CM_18754 "Ax + B" RAT_FUNC "%4.4" "percent" COEFFS 0.0 163.84 0.0 0.0 0.0 1.0 /end COMPU_METHOD
/begin COMPU_METHOD udf_CM_18761 "Ax + B" RAT_FUNC "%4.4" "percent" COEFFS 0.0 163.84 0.0 0.0 0.0 1.0 /end COMPU_METHOD
/begin COMPU_METHOD udf_CM_18768 "Ax + B" RAT_FUNC "%4.4" "percent" COEFFS 0.0 327.6800000536871 0.0 0.0 0.0 1.0 /end COMPU_METHOD
/begin COMPU_METHOD udf_CM_18775 "Ax + B" RAT_FUNC "%4.4" "percent" COEFFS 0.0 327.6800000536871 0.0 0.0 0.0 1.0 /end COMPU_METHOD
/begin COMPU_METHOD udf_CM_18782 "Ax + B" RAT_FUNC "%4.4" "percent" COEFFS 0.0 327.6800000536871 0.0 0.0 0.0 1.0 /end COMPU_METHOD
/begin COMPU_METHOD udf_CM_18789 "Ax + B" RAT_FUNC "%4.4" "percent" COEFFS 0.0 327.6800000536871 0.0 0.0 0.0 1.0 /end COMPU_METHOD
/begin COMPU_METHOD udf_CM_18796 "Ax + B" RAT_FUNC "%4.0" "boolean" COEFFS 0 1 0 0 0 1 /end COMPU_METHOD
/begin COMPU_METHOD udf_CM_18803 "Ax + B" RAT_FUNC "%4.0" "none" COEFFS 0 1 0 0 0 1 /end COMPU_METHOD
/begin COMPU_METHOD udf_CM_18810 "Ax + B" RAT_FUNC "%4.4" "percent" COEFFS 0.0 327.6800000536871 0.0 0.0 0.0 1.0 /end COMPU_METHOD
/begin COMPU_METHOD udf_CM_18817 "Ax + B" RAT_FUNC "%4.0" "boolean" COEFFS 0 1 0 0 0 1 /end COMPU_METHOD
/begin COMPU_METHOD udf_CM_18824 "Ax + B" RAT_FUNC "%4.0" "counts" COEFFS 0 1 0 0 0 1 /end COMPU_METHOD
/begin COMPU_METHOD udf_CM_18831 "Ax + B" RAT_FUNC "%4.4" "percent" COEFFS 0.0 327.6800000536871 0.0 0.0 0.0 1.0 /end COMPU_METHOD
/begin COMPU_METHOD udf_CM_18838 "Ax + B" RAT_FUNC "%4.0" "None" COEFFS 0 1 0 0 0 1 /end COMPU_METHOD
/begin COMPU_METHOD udf_CM_18845 "Ax + B" RAT_FUNC "%4.0" "Counts" COEFFS 0 1 0 0 0 1 /end COMPU_METHOD
/begin COMPU_METHOD udf_CM_18852 "Ax + B" RAT_FUNC "%4.0" "None" COEFFS 0 1 0 0 0 1 /end COMPU_METHOD
/begin COMPU_METHOD udf_CM_18859 "Ax + B" RAT_FUNC "%4.0" "None" COEFFS 0 1 0 0 0 1 /end COMPU_METHOD
/begin COMPU_METHOD udf_CM_18866 "Ax + B" RAT_FUNC "%4.0" "Counts" COEFFS 0 1 0 0 0 1 /end COMPU_METHOD
/begin COMPU_METHOD udf_CM_18873 "Ax + B" RAT_FUNC "%4.0" "None" COEFFS 0 1 0 0 0 1 /end COMPU_METHOD
/begin COMPU_METHOD udf_CM_18880 "Ax + B" RAT_FUNC "%4.0" "Counts" COEFFS 0 1 0 0 0 1 /end COMPU_METHOD
/begin COMPU_METHOD udf_CM_18887 "Ax + B" RAT_FUNC "%4.0" "None" COEFFS 0 1 0 0 0 1 /end COMPU_METHOD
/begin COMPU_METHOD udf_CM_18894 "Ax + B" RAT_FUNC "%4.0" "None" COEFFS 0 1 0 0 0 1 /end COMPU_METHOD
/begin COMPU_METHOD udf_CM_18901 "Ax + B" RAT_FUNC "%4.4" "percent" COEFFS 0.0 327.6800000536871 0.0 0.0 0.0 1.0 /end COMPU_METHOD
/begin COMPU_METHOD udf_CM_18908 "Ax + B" RAT_FUNC "%4.4" "gm" COEFFS 0.0 4096.0 0.0 0.0 0.0 1.0 /end COMPU_METHOD
/begin COMPU_METHOD CM_Count_0to65535_1 "" RAT_FUNC "%5.0" "counts" COEFFS 0 1 0 0 0 1 /end COMPU_METHOD
/begin COMPU_METHOD CM_Count_0to65535_2 "" RAT_FUNC "%5.0" "None" COEFFS 0 1 0 0 0 1 /end COMPU_METHOD
/begin COMPU_METHOD CM_Count_0to65535_3 "" RAT_FUNC "%5.0" "percent" COEFFS 0 1 0 0 0 1 /end COMPU_METHOD
/begin COMPU_METHOD CM_Second_0to65535 "" RAT_FUNC "%5.0" "sec" COEFFS 0 1 0 0 0 1 /end COMPU_METHOD
/begin COMPU_METHOD udf_CM_19006 "" RAT_FUNC "%4.3" "second" COEFFS 0.0 32.0 0.0 0.0 0.0 1.0 /end COMPU_METHOD
/begin COMPU_METHOD udf_CM_19020 "Ax + B" RAT_FUNC "%4.4" "kpa" COEFFS 0.0 256.0 0.0 0.0 0.0 1.0 /end COMPU_METHOD
/begin COMPU_METHOD udf_CM_19027 "Ax + B" RAT_FUNC "%4.4" "kpa" COEFFS 0.0 256.0 0.0 0.0 0.0 1.0 /end COMPU_METHOD
/begin COMPU_METHOD udf_CM_19048 "Ax + B" RAT_FUNC "%4.4" "ratio" COEFFS 0.0 32768.00013421773 0.0 0.0 0.0 1.0 /end COMPU_METHOD
/begin COMPU_METHOD udf_CM_19174 "Ax + B" RAT_FUNC "%4.4" "msec" COEFFS 0.0 16.0 0.0 0.0 0.0 1.0 /end COMPU_METHOD
/begin COMPU_METHOD udf_CM_19230 "Ax + B" RAT_FUNC "%4.0" "boolean" COEFFS 0 1 0 0 0 1 /end COMPU_METHOD
/begin COMPU_METHOD udf_CM_19244 "Ax + B" RAT_FUNC "%4.0" "None" COEFFS 0 1 0 0 0 1 /end COMPU_METHOD
/begin COMPU_METHOD udf_CM_19335 "Ax + B" RAT_FUNC "%4.0" "boolean" COEFFS 0 1 0 0 0 1 /end COMPU_METHOD
/begin COMPU_METHOD udf_CM_19370 "Ax + B" RAT_FUNC "%4.0" "count" COEFFS 0 1 0 0 0 1 /end COMPU_METHOD
/begin COMPU_METHOD udf_CM_19377 "Ax + B" RAT_FUNC "%4.0" "Counts" COEFFS 0 1 0 0 0 1 /end COMPU_METHOD
/begin COMPU_METHOD udf_CM_19384 "Ax + B" RAT_FUNC "%4.0" "None" COEFFS 0 1 0 0 0 1 /end COMPU_METHOD
/begin COMPU_METHOD udf_CM_19398 "Ax + B" RAT_FUNC "%4.4" "percent" COEFFS 0.0 327.6800000536871 0.0 0.0 0.0 1.0 /end COMPU_METHOD
/begin COMPU_METHOD udf_CM_19412 "Ax + B" RAT_FUNC "%4.0" "None" COEFFS 0 1 0 0 0 1 /end COMPU_METHOD
/begin COMPU_METHOD udf_CM_19503 "Ax + B" RAT_FUNC "%4.4" "kpa" COEFFS 0.0 256.0 0.0 0.0 0.0 1.0 /end COMPU_METHOD
/begin COMPU_VTAB CM_EOI_TAB "" TAB_VERB 4 0 "Cyl1" 1 "Cyl2" 2 "Cyl3" 3 "Cyl4" /end COMPU_VTAB
/begin COMPU_TAB DFLT_LIN_TAB "" TAB_INTP 1 1 1.0 /end COMPU_TAB
/begin COMPU_VTAB udf_CV_19704 "" TAB_VERB 2 0 "OFF" 1 "ON" /end COMPU_VTAB
/begin COMPU_VTAB udf_CV_19710 "" TAB_VERB 7 0 "0_EngineOff" 1 "1_KeyOn" 2 "2_Cranking" 3 "3_Run" 4 "4_Stall" 5 "5_ShutDownDelay" 6 "6_ShutDown" /end COMPU_VTAB
/begin COMPU_VTAB udf_CV_19711 "" TAB_VERB 3 0 "0_Petrol" 1 "1_NG" 2 "2_LPG" /end COMPU_VTAB
/begin COMPU_VTAB udf_CV_19716 "" TAB_VERB 2 0 "LEAN" 1 "RICH" /end COMPU_VTAB
/begin COMPU_VTAB udf_CV_19722 "" TAB_VERB 2 0 "LEAN" 1 "RICH" /end COMPU_VTAB
/begin COMPU_VTAB udf_CV_19728 "" TAB_VERB 2 0 "LEAN" 1 "RICH" /end COMPU_VTAB
/begin COMPU_VTAB udf_CV_19734 "" TAB_VERB 4 0 "NotMovingSt" 1 "ThrottleCloseSt" 2 "PauseSt" 3 "ThrottleOpenSt" /end COMPU_VTAB
/begin COMPU_VTAB udf_CV_19740 "" TAB_VERB 3 0 "ThrottleStable" 1 "ThrottleOpen" 2 "ThrottleClose" /end COMPU_VTAB
/begin RECORD_LAYOUT 2D_Array_UB FNC_VALUES 1 UBYTE COLUMN_DIR DIRECT ALIGNMENT_WORD 1 ALIGNMENT_LONG 2 /end RECORD_LAYOUT
/begin RECORD_LAYOUT 2D_Array_UW FNC_VALUES 1 UWORD COLUMN_DIR DIRECT ALIGNMENT_WORD 1 ALIGNMENT_LONG 2 /end RECORD_LAYOUT
/begin RECORD_LAYOUT Scalar_SW FNC_VALUES 1 SWORD COLUMN_DIR DIRECT ALIGNMENT_WORD 1 ALIGNMENT_LONG 2 /end RECORD_LAYOUT
/begin RECORD_LAYOUT Scalar_UB FNC_VALUES 1 UBYTE COLUMN_DIR DIRECT ALIGNMENT_WORD 1 ALIGNMENT_LONG 2 /end RECORD_LAYOUT
/begin RECORD_LAYOUT Scalar_UW FNC_VALUES 1 UWORD COLUMN_DIR DIRECT ALIGNMENT_WORD 1 ALIGNMENT_LONG 2 /end RECORD_LAYOUT
/end MODULE
/end PROJECT
