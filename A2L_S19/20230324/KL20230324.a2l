ASAP2_VERSION 1 40
/begin PROJECT RS19_Prod ""
/begin HEADER "" VERSION "" /end HEADER
/begin MODULE RS19_Prod ""
/begin MOD_PAR "SAILOR" CPU_TYPE "SPC560P"
 /begin MEMORY_SEGMENT Code "External Flash Calibration Space" DATA FLASH INTERN 0x8000 0x5000 -1 -1 -1 -1 -1 /end MEMORY_SEGMENT
 /begin MEMORY_SEGMENT Code "External Flash unuse Space" CODE FLASH INTERN 0xD000 0x0000 -1 -1 -1 -1 -1 /end MEMORY_SEGMENT
 /begin MEMORY_SEGMENT Code "External Flash Code Space" CODE FLASH INTERN 0xD000 0x33000 -1 -1 -1 -1 -1 /end MEMORY_SEGMENT
 /begin MEMORY_SEGMENT Ram "External Ram BSS Space" VARIABLES RAM EXTERN 0x40000000 0x4800 -1 -1 -1 -1 -1 /end MEMORY_SEGMENT
 /begin MEMORY_SEGMENT Data "External RAM Calibration Space" DATA RAM EXTERN 0x40004800 0x5000 -1 -1 -1 -1 -1 /end MEMORY_SEGMENT
 /begin MEMORY_SEGMENT Ram "External Ram Stack Space" VARIABLES RAM EXTERN 0x40009800 0x800 -1 -1 -1 -1 -1 /end MEMORY_SEGMENT
/end MOD_PAR
/begin MOD_COMMON "" BYTE_ORDER MSB_FIRST ALIGNMENT_BYTE 1 ALIGNMENT_WORD 1 ALIGNMENT_LONG 2 ALIGNMENT_FLOAT32_IEEE 4 ALIGNMENT_FLOAT64_IEEE 8 /end MOD_COMMON
/begin IF_DATA ASAP1B_CCP
 /begin SOURCE "Cyl Event" 103 1
  /begin QP_BLOB 0 LENGTH 0x14 CAN_ID_FIXED 0x7D5 RASTER 0 REDUCTION_ALLOWED FIRST_PID 0x00 /end QP_BLOB
  DISPLAY_IDENTIFIER DAQ0 /end SOURCE
 /begin SOURCE "7.82ms" 1 782
  /begin QP_BLOB 1 LENGTH 0x14 CAN_ID_FIXED 0x7D6 RASTER 10 REDUCTION_ALLOWED FIRST_PID 0x14 /end QP_BLOB
  DISPLAY_IDENTIFIER DAQ1 /end SOURCE
 /begin SOURCE "15.6ms" 1 1562
  /begin QP_BLOB 2 LENGTH 0x14 CAN_ID_FIXED 0x7D7 RASTER 11 REDUCTION_ALLOWED FIRST_PID 0x28 /end QP_BLOB
  DISPLAY_IDENTIFIER DAQ2 /end SOURCE
 /begin SOURCE "125ms" 3 125
  /begin QP_BLOB 3 LENGTH 0x3A CAN_ID_FIXED 0x7D8 RASTER 25 REDUCTION_ALLOWED FIRST_PID 0x3C /end QP_BLOB
  DISPLAY_IDENTIFIER DAQ3 /end SOURCE
 /begin TP_BLOB 0x201 0x202 0x7D0 0x7D4 0x0 0x1 DAQ_MODE 1 CONSISTENCY 1 ADDRESS_EXTENSION 0
  /begin DEFINED_PAGES 1 "Working page" 0x0 0x40004800 0x5000 RAM RAM_INIT_BY_ECU DEFAULT /end DEFINED_PAGES
  /begin DEFINED_PAGES 2 "Reference page" 0x0 0x8000 0x5000 FLASH DEFAULT /end DEFINED_PAGES
  OPTIONAL_CMD 0xC OPTIONAL_CMD 0xD OPTIONAL_CMD 0xE OPTIONAL_CMD 0x11 OPTIONAL_CMD 0x19 BAUDRATE 500000 SAMPLE_POINT 70 SAMPLE_RATE 1 BTL_CYCLES 16 SJW 2 SYNC_EDGE 0 /begin CHECKSUM_PARAM 0x8001 20480 CHECKSUM_CALCULATION ACTIVE_PAGE /end CHECKSUM_PARAM RESUME_SUPPORTED /end TP_BLOB
 /begin SEED_KEY "" /end SEED_KEY
 /begin RASTER "Cyl Event Trigger" Cyl 0 103 1 /end RASTER
 /begin RASTER "AMAF Trigger" 1.00 1 3 1 /end RASTER
 /begin RASTER "3.91ms Trigger" 3.91 2 1 391 /end RASTER
 /begin RASTER "7.81ms Trigger" 7.81 10 1 781 /end RASTER
 /begin RASTER "15.62ms Trigger" 15.62 11 1 1562 /end RASTER
 /begin RASTER "125ms Trigger" 125 25 3 125 /end RASTER
/end IF_DATA
/begin CHARACTERISTIC C_AECutoffDltTPSThresh "cal comments" VALUE 0x9DDC Scalar_UW 0.0 CM_Percent_0to200_2 0.0 199.9969024658203 /end CHARACTERISTIC
/begin CHARACTERISTIC C_AEEnableDltTPSThresh "cal comments" VALUE 0x9DDA Scalar_SW 0.0 CM_Percent_N200to200 -199.9999847412109 199.9938812255859 /end CHARACTERISTIC
/begin CHARACTERISTIC C_AETPSDecFiltCoef "cal comments" VALUE 0xB3C4 Scalar_UW 0.0 CM_FiltCoef 0.0 0.9999847412109375 /end CHARACTERISTIC
/begin CHARACTERISTIC C_AETPSIncFiltCoef "cal comments" VALUE 0xB3C2 Scalar_UW 0.0 CM_FiltCoef 0.0 0.9999847412109375 /end CHARACTERISTIC
/begin CHARACTERISTIC C_AFLCBaroMinThresh "cal comments" VALUE 0xB370 Scalar_UW 0.0 CM_kpa_0to256_1 0.0 255.99609375 /end CHARACTERISTIC
/begin CHARACTERISTIC C_AFLCCellEngSpdBoundaryHyst "cal comments" VALUE 0xB386 Scalar_UW 0.0 CM_RPM_0to16384 0.0 16383.75 /end CHARACTERISTIC
/begin CHARACTERISTIC C_AFLCCellTPSBoundaryHyst "cal comments" VALUE 0xB388 Scalar_UW 0.0 CM_Percent_0to200_2 0.0 199.9969024658203 /end CHARACTERISTIC
/begin CHARACTERISTIC C_AFLCChargeAirTempMaxThresh "cal comments" VALUE 0xB37C Scalar_SW 0.0 CM_DegC_N256to256 -256.0 255.9921875 /end CHARACTERISTIC
/begin CHARACTERISTIC C_AFLCChargeAirTempMinThresh "cal comments" VALUE 0xB37A Scalar_SW 0.0 CM_DegC_N256to256 -256.0 255.9921875 /end CHARACTERISTIC
/begin CHARACTERISTIC C_AFLCCoolTempMaxThresh "cal comments" VALUE 0xB378 Scalar_SW 0.0 CM_DegC_N256to256 -256.0 255.9921875 /end CHARACTERISTIC
/begin CHARACTERISTIC C_AFLCCoolTempMinThresh "cal comments" VALUE 0xB376 Scalar_SW 0.0 CM_DegC_N256to256 -256.0 255.9921875 /end CHARACTERISTIC
/begin CHARACTERISTIC C_AFLCEngSpdDeltaThresh "cal comments" VALUE 0xB36E Scalar_UW 0.0 CM_RPM_0to16384 0.0 16383.75 /end CHARACTERISTIC
/begin CHARACTERISTIC C_AFLCEngSpdMaxThresh "cal comments" VALUE 0xB374 Scalar_UW 0.0 CM_RPM_0to16384 0.0 16383.75 /end CHARACTERISTIC
/begin CHARACTERISTIC C_AFLCEngSpdMinThresh "cal comments" VALUE 0xB372 Scalar_UW 0.0 CM_RPM_0to16384 0.0 16383.75 /end CHARACTERISTIC
/begin CHARACTERISTIC C_AFLCLearnedMultMax "cal comments" VALUE 0xB380 Scalar_UW 0.0 CM_Ratio_0to2_2 0.0 1.999969482421875 /end CHARACTERISTIC
/begin CHARACTERISTIC C_AFLCLearnedMultMin "cal comments" VALUE 0xB382 Scalar_UW 0.0 CM_Ratio_0to2_2 0.0 1.999969482421875 /end CHARACTERISTIC
/begin CHARACTERISTIC C_AFLCMultLearnCoef "cal comments" VALUE 0xB384 Scalar_UW 0.0 CM_FiltCoef 0.0 0.9999847412109375 /end CHARACTERISTIC
/begin CHARACTERISTIC C_AFLCSteadyStateTime "cal comments" VALUE 0xB37E Scalar_UW 0.0 CM_Second_0to1024 0.0 1023.984375 /end CHARACTERISTIC
/begin CHARACTERISTIC C_AFLCTPSDeltaThresh "cal comments" VALUE 0xB36C Scalar_SW 0.0 CM_Percent_N200to200 -199.9999847412109 199.9938812255859 /end CHARACTERISTIC
/begin CHARACTERISTIC C_AFRLeanLimitDuringAE "cal comments" VALUE 0x922E Scalar_UW 0.0 CM_AFR_0to32 0.0 31.99900627136231 /end CHARACTERISTIC
/begin CHARACTERISTIC C_AFRPERampDownStep "cal comments" VALUE 0x9750 Scalar_UW 0.0 CM_AFR_0to32 0.0 31.99900627136231 /end CHARACTERISTIC
/begin CHARACTERISTIC C_AFRPERampInterval "cal comments" VALUE 0x9752 Scalar_UW 0.0 CM_Seconds_1 0.0 2047.96875 /end CHARACTERISTIC
/begin CHARACTERISTIC C_AFRPERampUpStep "cal comments" VALUE 0x974E Scalar_UW 0.0 CM_AFR_0to32 0.0 31.99900627136231 /end CHARACTERISTIC
/begin CHARACTERISTIC C_AFRRampDownStep "cal comments" VALUE 0x9238 Scalar_UW 0.0 CM_AFR_0to32 0.0 31.99900627136231 /end CHARACTERISTIC
/begin CHARACTERISTIC C_AFRRampIntervalRun "cal comments" VALUE 0x9232 Scalar_UW 0.0 CM_Seconds_1 0.0 2047.96875 /end CHARACTERISTIC
/begin CHARACTERISTIC C_AFRRampUpStepIdle "cal comments" VALUE 0x9234 Scalar_UW 0.0 CM_AFR_0to32 0.0 31.99900627136231 /end CHARACTERISTIC
/begin CHARACTERISTIC C_AFRRampUpStepRun "cal comments" VALUE 0x9236 Scalar_UW 0.0 CM_AFR_0to32 0.0 31.99900627136231 /end CHARACTERISTIC
/begin CHARACTERISTIC C_AFRSensorFiltCoef "cal comments" VALUE 0xB4DC Scalar_UW 0.0 CM_FiltCoef 0.0 0.9999847412109375 /end CHARACTERISTIC
/begin CHARACTERISTIC C_AFRWarmUpOffsetDecayFactor "cal comments" VALUE 0x9AEC Scalar_UW 0.0 CM_FactorRatio 0.0 0.9999847412109375 /end CHARACTERISTIC
/begin CHARACTERISTIC C_AltMAPCalcOffset "cal comments" VALUE 0xB4D6 Scalar_UW 0.0 CM_kpa_0to256_1 0.0 255.99609375 /end CHARACTERISTIC
/begin CHARACTERISTIC C_BaroDefault "cal comments" VALUE 0xB484 Scalar_UW 0.0 CM_kpa_0to256_1 0.0 255.99609375 /end CHARACTERISTIC
/begin CHARACTERISTIC C_BaroMaxLimit "cal comments" VALUE 0xB488 Scalar_UW 0.0 CM_kpa_0to256_1 0.0 255.99609375 /end CHARACTERISTIC
/begin CHARACTERISTIC C_BaroMinLimit "cal comments" VALUE 0xB48A Scalar_UW 0.0 CM_kpa_0to256_1 0.0 255.99609375 /end CHARACTERISTIC
/begin CHARACTERISTIC C_BaroStallUpdateMAPCheckTimes "cal comments" VALUE 0xB4EE Scalar_UW 0.0 CM_Count_0to65535_1 0.0 65535.0 /end CHARACTERISTIC
/begin CHARACTERISTIC C_BaroUpdateDltEngSpdThresh "cal comments" VALUE 0xB4FE Scalar_UW 0.0 CM_RPM_0to16384 0.0 16383.75 /end CHARACTERISTIC
/begin CHARACTERISTIC C_BaroUpdtEngRunTPSDeltaMaxThrsh "cal comments" VALUE 0xB528 Scalar_SW 0.0 CM_Percent_N200to200 -199.9999847412109 199.9938812255859 /end CHARACTERISTIC
/begin CHARACTERISTIC C_BaroUpdtEngSpdThrshHi "cal comments" VALUE 0xB4FC Scalar_UW 0.0 CM_RPM_0to16384 0.0 16383.75 /end CHARACTERISTIC
/begin CHARACTERISTIC C_BaroUpdtFiltCoefRun "cal comments" VALUE 0xB500 Scalar_UW 0.0 CM_FiltCoef 0.0 0.9999847412109375 /end CHARACTERISTIC
/begin CHARACTERISTIC C_BaroUpdtFiltCoefStall "cal comments" VALUE 0xB486 Scalar_UW 0.0 CM_FiltCoef 0.0 0.9999847412109375 /end CHARACTERISTIC
/begin CHARACTERISTIC C_ChargeAirTempFiltCoef "cal comments" VALUE 0x82A6 Scalar_UW 0.0 CM_FiltCoef 0.0 0.9999847412109375 /end CHARACTERISTIC
/begin CHARACTERISTIC C_CIDFailThreshold "cal comments" VALUE 0xB49A Scalar_UW 0.0 CM_Count_0to65535_1 0.0 65535.0 /end CHARACTERISTIC
/begin CHARACTERISTIC C_CIDPassThreshold "cal comments" VALUE 0xB498 Scalar_UW 0.0 CM_Count_0to65535_1 0.0 65535.0 /end CHARACTERISTIC
/begin CHARACTERISTIC C_CLAFREnbCoolTempThresh "cal comments" VALUE 0x965E Scalar_SW 0.0 CM_DegC_N256to256 -256.0 255.9921875 /end CHARACTERISTIC
/begin CHARACTERISTIC C_CLFuelControlEnb "cal comments" VALUE 0x9B3E Scalar_UB 0.0 CM_Boolean1 0.0 1.0 /end CHARACTERISTIC
/begin CHARACTERISTIC C_CLFuelIntegralMultUsed "cal comments" VALUE 0x9B3F Scalar_UB 0.0 CM_Boolean1 0.0 1.0 /end CHARACTERISTIC
/begin CHARACTERISTIC C_StepForceControlEnable "cal comments" VALUE 0xA063 Scalar_UB 0.0 CM_Boolean6 0.0 255.0 /end CHARACTERISTIC
/begin CHARACTERISTIC C_CCPS_U_CcpMaxVolt "cal comments" VALUE 0x0 Scalar_UW 0.0 CM_Volt_0to32_1 0.0 31.99900627136231 /end CHARACTERISTIC
/begin CHARACTERISTIC C_CCPS_t_RunTimeCold "cal comments" VALUE 0x0 Scalar_UW 0.0 CM_Count_0to65535_1 0.0 65535.0 /end CHARACTERISTIC
/begin CHARACTERISTIC C_CCPS_t_RunTimeHot "cal comments" VALUE 0x0 Scalar_UW 0.0 CM_Count_0to65535_1 0.0 65535.0 /end CHARACTERISTIC
/begin CHARACTERISTIC C_CCPS_T_StartupCold "cal comments" VALUE 0x0 Scalar_SW 0.0 CM_DegC_N256to256 -256.0 255.9921875 /end CHARACTERISTIC
/begin CHARACTERISTIC C_CCPS_T_CoolantHigh "cal comments" VALUE 0x0 Scalar_SW 0.0 CM_DegC_N256to256 -256.0 255.9921875 /end CHARACTERISTIC
/begin CHARACTERISTIC C_CCPS_T_CoolantLow "cal comments" VALUE 0x0 Scalar_SW 0.0 CM_DegC_N256to256 -256.0 255.9921875 /end CHARACTERISTIC
/begin CHARACTERISTIC C_CCPS_T_CoolantHyst "cal comments" VALUE 0x0 Scalar_SW 0.0 CM_DegC_N256to256 -256.0 255.9921875 /end CHARACTERISTIC
/begin CHARACTERISTIC C_CCPS_t_DFCOTime "cal comments" VALUE 0x0 Scalar_UW 0.0 CM_Second_0to1024 0.0 1023.984375 /end CHARACTERISTIC
/begin CHARACTERISTIC C_CCPS_t_RichO2Time "cal comments" VALUE 0x0 Scalar_UW 0.0 CM_Second_0to1024 0.0 1023.984375 /end CHARACTERISTIC
/begin CHARACTERISTIC C_CCPS_t_RichO2TimeHyst "cal comments" VALUE 0x0 Scalar_UW 0.0 CM_Second_0to1024 0.0 1023.984375 /end CHARACTERISTIC
/begin CHARACTERISTIC C_CCPS_Pct_TPSHigh "cal comments" VALUE 0x0 Scalar_UW 0.0 CM_Percent_0to200_2 0.0 199.9969024658203 /end CHARACTERISTIC
/begin CHARACTERISTIC C_CCPS_Pct_TPSLow "cal comments" VALUE 0x0 Scalar_UW 0.0 CM_Percent_0to200_2 0.0 199.9969024658203 /end CHARACTERISTIC
/begin CHARACTERISTIC C_CCPS_Pct_TPSHyst "cal comments" VALUE 0x0 Scalar_UW 0.0 CM_Percent_0to200_2 0.0 199.9969024658203 /end CHARACTERISTIC
/begin CHARACTERISTIC C_CCPS_Pct_DutyCycleMin "cal comments" VALUE 0x0 Scalar_UW 0.0 CM_Percent_0to200_2 0.0 199.9969024658203 /end CHARACTERISTIC
/begin CHARACTERISTIC C_CCPS_Pct_DutyCycleIdleMax "cal comments" VALUE 0x0 Scalar_UW 0.0 CM_Percent_0to200_2 0.0 199.9969024658203 /end CHARACTERISTIC
/begin CHARACTERISTIC CT_CCPS_r_BLM_BlmHigh "cal comments" CURVE 0x0 Scalar_UW 0.0 CM_Ratio_0to2_2 0.0 1.999969482421875
 /begin AXIS_DESCR FIX_AXIS NO_INPUT_QUANTITY CM_Equaloutput1 34 0.0 33.0 MAX_GRAD 0.0
  /begin FIX_AXIS_PAR_LIST 1 2 3 4 5 6 7 8 9 10 11 12 13 14 15 16 17 18 19 20 21 22 23 24 25 26 27 28 29 30 31 32 33 34 /end FIX_AXIS_PAR_LIST
 /end AXIS_DESCR
/end CHARACTERISTIC
/begin CHARACTERISTIC CT_CCPS_r_BLM_BlmLow "cal comments" CURVE 0x0 Scalar_UW 0.0 CM_Ratio_0to2_2 0.0 1.999969482421875
 /begin AXIS_DESCR FIX_AXIS NO_INPUT_QUANTITY CM_Equaloutput1 34 0.0 33.0 MAX_GRAD 0.0
  /begin FIX_AXIS_PAR_LIST 1 2 3 4 5 6 7 8 9 10 11 12 13 14 15 16 17 18 19 20 21 22 23 24 25 26 27 28 29 30 31 32 33 34 /end FIX_AXIS_PAR_LIST
 /end AXIS_DESCR
/end CHARACTERISTIC
/begin CHARACTERISTIC CT_CCPS_CL_IntHigh "cal comments" CURVE 0x0 Scalar_SW 0.0 CM_SignedWord_n32768to32768_2 -32768.0 32766.0
 /begin AXIS_DESCR FIX_AXIS NO_INPUT_QUANTITY CM_Equaloutput1 34 0.0 33.0 MAX_GRAD 0.0
  /begin FIX_AXIS_PAR_LIST 1 2 3 4 5 6 7 8 9 10 11 12 13 14 15 16 17 18 19 20 21 22 23 24 25 26 27 28 29 30 31 32 33 34 /end FIX_AXIS_PAR_LIST
 /end AXIS_DESCR
/end CHARACTERISTIC
/begin CHARACTERISTIC CT_CCPS_CL_IntLow "cal comments" CURVE 0x0 Scalar_SW 0.0 CM_SignedWord_n32768to32768_2 -32768.0 32766.0
 /begin AXIS_DESCR FIX_AXIS NO_INPUT_QUANTITY CM_Equaloutput1 34 0.0 33.0 MAX_GRAD 0.0
  /begin FIX_AXIS_PAR_LIST 1 2 3 4 5 6 7 8 9 10 11 12 13 14 15 16 17 18 19 20 21 22 23 24 25 26 27 28 29 30 31 32 33 34 /end FIX_AXIS_PAR_LIST
 /end AXIS_DESCR
/end CHARACTERISTIC
/begin CHARACTERISTIC CT_CCPS_Pct_DutyCycleStepUp "cal comments" CURVE 0x0 Scalar_UW 0.0 CM_Percent_0to200_2 0.0 199.9969024658203
 /begin AXIS_DESCR FIX_AXIS NO_INPUT_QUANTITY CM_Equaloutput1 34 0.0 33.0 MAX_GRAD 0.0
  /begin FIX_AXIS_PAR_LIST 1 2 3 4 5 6 7 8 9 10 11 12 13 14 15 16 17 18 19 20 21 22 23 24 25 26 27 28 29 30 31 32 33 34 /end FIX_AXIS_PAR_LIST
 /end AXIS_DESCR
/end CHARACTERISTIC
/begin CHARACTERISTIC CT_CCPS_Pct_DutyCycleStepDown "cal comments" CURVE 0x0 Scalar_UW 0.0 CM_Percent_0to200_2 0.0 199.9969024658203
 /begin AXIS_DESCR FIX_AXIS NO_INPUT_QUANTITY CM_Equaloutput1 34 0.0 33.0 MAX_GRAD 0.0
  /begin FIX_AXIS_PAR_LIST 1 2 3 4 5 6 7 8 9 10 11 12 13 14 15 16 17 18 19 20 21 22 23 24 25 26 27 28 29 30 31 32 33 34 /end FIX_AXIS_PAR_LIST
 /end AXIS_DESCR
/end CHARACTERISTIC
/begin CHARACTERISTIC CT_CCPS_t_DutyCycleStepTime "cal comments" CURVE 0x0 Scalar_UW 0.0 CM_Second_0to8192 0.0 8191.0
 /begin AXIS_DESCR FIX_AXIS NO_INPUT_QUANTITY CM_Equaloutput1 34 0.0 33.0 MAX_GRAD 0.0
  /begin FIX_AXIS_PAR_LIST 1 2 3 4 5 6 7 8 9 10 11 12 13 14 15 16 17 18 19 20 21 22 23 24 25 26 27 28 29 30 31 32 33 34 /end FIX_AXIS_PAR_LIST
 /end AXIS_DESCR
/end CHARACTERISTIC
/begin CHARACTERISTIC C_CCPS_n_RPMMinHigh "cal comments" VALUE 0x0 Scalar_UW 0.0 udf_CM_18586 0.0 16383.75 /end CHARACTERISTIC
/begin CHARACTERISTIC C_CCPS_n_RPMMinLow "cal comments" VALUE 0x0 Scalar_UW 0.0 udf_CM_18586 0.0 16383.75 /end CHARACTERISTIC
/begin CHARACTERISTIC C_CCPS_t_BPWHigh "cal comments" VALUE 0x0 Scalar_UW 0.0 CM_msec_0to1024 0.0 1023.984375 /end CHARACTERISTIC
/begin CHARACTERISTIC C_CCPS_t_BPWLow "cal comments" VALUE 0x0 Scalar_UW 0.0 CM_msec_0to1024 0.0 1023.984375 /end CHARACTERISTIC
/begin CHARACTERISTIC CT_CCPS_Pct_DutyCycleMax "cal comments" CURVE 0x2 2D_Array_UW 0.0 CM_Percent_0to200_2 0.0 199.9969024658203
 /begin AXIS_DESCR COM_AXIS NO_INPUT_QUANTITY CM_Equaloutput1 17 0.0 16383.75 AXIS_PTS_REF CA_EngSpd17Step1 MAX_GRAD 0.0 /end AXIS_DESCR
/end CHARACTERISTIC
/begin CHARACTERISTIC C_CLIdleEnableDelay "cal comments" VALUE 0x9FF0 Scalar_UW 0.0 CM_Second_0to1024 0.0 1023.984375 /end CHARACTERISTIC
/begin CHARACTERISTIC C_CLIdleSwitchDelay "cal comments" VALUE 0x9FF2 Scalar_UW 0.0 CM_Second_0to1024 0.0 1023.984375 /end CHARACTERISTIC
/begin CHARACTERISTIC C_CLIdleSpdUpDelay "cal comments" VALUE 0x9FF4 Scalar_UW 0.0 CM_Second_0to1024 0.0 1023.984375 /end CHARACTERISTIC
/begin CHARACTERISTIC C_CLIdleSpdDwnDelay "cal comments" VALUE 0x9FF6 Scalar_UW 0.0 CM_Second_0to1024 0.0 1023.984375 /end CHARACTERISTIC
/begin CHARACTERISTIC C_CLIdleSpdH2LDelay "cal comments" VALUE 0x9FF8 Scalar_UW 0.0 CM_Second_0to1024 0.0 1023.984375 /end CHARACTERISTIC
/begin CHARACTERISTIC C_ClosedLoopAFR "cal comments" VALUE 0x9654 Scalar_UW 0.0 CM_AFR_0to32 0.0 31.99900627136231 /end CHARACTERISTIC
/begin CHARACTERISTIC C_CLTThreshToEnbNextPrimePulse "cal comments" VALUE 0x91FA Scalar_SW 0.0 CM_DegC_N256to256 -256.0 255.9921875 /end CHARACTERISTIC
/begin CHARACTERISTIC C_ColdEngineIdleEnrichEnable "cal comments" VALUE 0x922C Scalar_UB 0.0 CM_Boolean2 0.0 1.0 /end CHARACTERISTIC
/begin CHARACTERISTIC C_ColdEnrichCompTempThresh "cal comments" VALUE 0x9230 Scalar_SW 0.0 CM_DegC_N256to256 -256.0 255.9921875 /end CHARACTERISTIC
/begin CHARACTERISTIC C_CoolantTempFiltCoef "cal comments" VALUE 0xB4A4 Scalar_UW 0.0 CM_FiltCoef 0.0 0.9999847412109375 /end CHARACTERISTIC
/begin CHARACTERISTIC C_CrankAFROffset "cal comments" VALUE 0x977E Scalar_UW 0.0 CM_AFR_0to32 0.0 31.99900627136231 /end CHARACTERISTIC
/begin CHARACTERISTIC C_CrankAFROffsetDecayDealy "cal comments" VALUE 0x9780 Scalar_UW 0.0 CM_Count_0to65535 0.0 65535.0 /end CHARACTERISTIC
/begin CHARACTERISTIC C_CrankAFROffsetDecayFactor "cal comments" VALUE 0x9782 Scalar_UW 0.0 CM_FactorRatio 0.0 0.9999847412109375 /end CHARACTERISTIC
/begin CHARACTERISTIC C_CrankAFROffsetDecayInterval "cal comments" VALUE 0x9784 Scalar_UB 0.0 CM_Second_0to8 0.0 7.96875 /end CHARACTERISTIC
/begin CHARACTERISTIC C_CrankAFROffsetResetCltTempThrsh "cal comments" VALUE 0x9786 Scalar_SW 0.0 CM_DegC_N256to256 -256.0 255.9921875 /end CHARACTERISTIC
/begin CHARACTERISTIC C_CrankAFROffsetResetRunTimeThrsh "cal comments" VALUE 0x9788 Scalar_UW 0.0 CM_Second_0to65535 0.0 65535.0 /end CHARACTERISTIC
/begin CHARACTERISTIC C_CrankToRunEngSpdThresh "cal comments" VALUE 0xB468 Scalar_UW 0.0 CM_RPM_0to16384 0.0 16383.75 /end CHARACTERISTIC
/begin CHARACTERISTIC C_CylinderDisplacement "cal comments" VALUE 0x82A4 Scalar_UW 0.0 CM_milliliter_0to1024 0.0 1023.984375 /end CHARACTERISTIC
/begin CHARACTERISTIC C_DECutoffDltTPSThresh "cal comments" VALUE 0x9DDE Scalar_UW 0.0 CM_Percent_0to200_2 0.0 199.9969024658203 /end CHARACTERISTIC
/begin CHARACTERISTIC C_DEEnableDltTPSThresh "cal comments" VALUE 0x9DD8 Scalar_SW 0.0 CM_Percent_N200to200 -199.9999847412109 199.9938812255859 /end CHARACTERISTIC
/begin CHARACTERISTIC C_DEEnableEngSpdThresh "cal comments" VALUE 0x9626 Scalar_UW 0.0 CM_RPM_0to16384 0.0 16383.75 /end CHARACTERISTIC
/begin CHARACTERISTIC C_DefaultCoolTemp "cal comments" VALUE 0xB4E4 Scalar_SW 0.0 CM_DegC_N256to256 -256.0 255.9921875 /end CHARACTERISTIC
/begin CHARACTERISTIC C_DefaultCoolTempRunTimeFactor "cal comments" VALUE 0xB4E2 Scalar_UW 0.0 CM_FactorRatio 0.0 0.9999847412109375 /end CHARACTERISTIC
/begin CHARACTERISTIC C_DeltaMAPThrshForBaroUpdtStall "cal comments" VALUE 0xB4DE Scalar_UW 0.0 CM_kpa_0to256_1 0.0 255.99609375 /end CHARACTERISTIC
/begin CHARACTERISTIC C_IDLELoopCounter "cal comments" VALUE 0xB5C5 Scalar_UB 0.0 CM_Count1 0.0 255.0 /end CHARACTERISTIC
/begin CHARACTERISTIC C_DesireSpeedDecreaseStepFactor "cal comments" VALUE 0xA0CC Scalar_UW 0.0 CM_Ratio_0to2_2 0.0 1.999969482421875 /end CHARACTERISTIC
/begin CHARACTERISTIC C_DesireSpeedDecreaseStepMin "cal comments" VALUE 0xA0CA Scalar_UW 0.0 udf_CM_18586 0.0 16383.75 /end CHARACTERISTIC
/begin CHARACTERISTIC C_DesireSpeedIncreaseStepFactor "cal comments" VALUE 0xA0C8 Scalar_UW 0.0 CM_Ratio_0to2_2 0.0 1.999969482421875 /end CHARACTERISTIC
/begin CHARACTERISTIC C_DesireSpeedIncreaseStepMin "cal comments" VALUE 0xA0C0 Scalar_UW 0.0 udf_CM_18586 0.0 16383.75 /end CHARACTERISTIC
/begin CHARACTERISTIC C_DesireSpeedUpOfst "cal comments" VALUE 0xA0C2 Scalar_UW 0.0 udf_CM_18586 0.0 16383.75 /end CHARACTERISTIC
/begin CHARACTERISTIC C_DesireSpeedDwnOfst "cal comments" VALUE 0xA0C4 Scalar_UW 0.0 udf_CM_18586 0.0 16383.75 /end CHARACTERISTIC
/begin CHARACTERISTIC C_DesireSpeedH2LOfst "cal comments" VALUE 0xA0C6 Scalar_UW 0.0 udf_CM_18586 0.0 16383.75 /end CHARACTERISTIC
/begin CHARACTERISTIC C_DETPSDecFiltCoef "cal comments" VALUE 0xB3C8 Scalar_UW 0.0 CM_FiltCoef 0.0 0.9999847412109375 /end CHARACTERISTIC
/begin CHARACTERISTIC C_DETPSIncFiltCoef "cal comments" VALUE 0xB3C6 Scalar_UW 0.0 CM_FiltCoef 0.0 0.9999847412109375 /end CHARACTERISTIC
/begin CHARACTERISTIC C_EngineRunThreshCold "cal comments" VALUE 0xB476 Scalar_UB 0.0 CM_Count2 0.0 255.0 /end CHARACTERISTIC
/begin CHARACTERISTIC C_EngineRunThreshCoolTempHi "cal comments" VALUE 0xB472 Scalar_SW 0.0 CM_DegC_N256to256 -256.0 255.9921875 /end CHARACTERISTIC
/begin CHARACTERISTIC C_EngineRunThreshCoolTempLo "cal comments" VALUE 0xB470 Scalar_SW 0.0 CM_DegC_N256to256 -256.0 255.9921875 /end CHARACTERISTIC
/begin CHARACTERISTIC C_EngineRunThreshHot "cal comments" VALUE 0xB46E Scalar_UB 0.0 CM_Count2 0.0 255.0 /end CHARACTERISTIC
/begin CHARACTERISTIC C_EngineRunThreshWarm "cal comments" VALUE 0xB477 Scalar_UB 0.0 CM_Count2 0.0 255.0 /end CHARACTERISTIC
/begin CHARACTERISTIC C_EngineTurningResetDelayTime "cal comments" VALUE 0xB496 Scalar_UW 0.0 CM_Second_0to512 0.0 511.9921875 /end CHARACTERISTIC
/begin CHARACTERISTIC C_EngSpdDeltaCalcNumber "cal comments" VALUE 0xB48E Scalar_UB 0.0 CM_Count2 0.0 255.0 /end CHARACTERISTIC
/begin CHARACTERISTIC C_EngSpdFiltCoef "cal comments" VALUE 0xB48C Scalar_UW 0.0 CM_FiltCoef 0.0 0.9999847412109375 /end CHARACTERISTIC
/begin CHARACTERISTIC C_EOIRampInterval "cal comments" VALUE 0x922A Scalar_UW 0.0 CM_Second_0to1024 0.0 1023.984375 /end CHARACTERISTIC
/begin CHARACTERISTIC C_EOIRampStep "cal comments" VALUE 0x9228 Scalar_UW 0.0 CM_CrankAngle_0to1024 0.0 1023.984375 /end CHARACTERISTIC
/begin CHARACTERISTIC C_ExpectMAPUsedTPSThreshHi "cal comments" VALUE 0xB39C Scalar_UW 0.0 CM_Percent_0to200_2 0.0 199.9969024658203 /end CHARACTERISTIC
/begin CHARACTERISTIC C_ExpectMAPUsedTPSThreshLo "cal comments" VALUE 0xB39A Scalar_UW 0.0 CM_Percent_0to200_2 0.0 199.9969024658203 /end CHARACTERISTIC
/begin CHARACTERISTIC C_ExtPEModeAFRExtraOffset "cal comments" VALUE 0x965C Scalar_UW 0.0 CM_AFR_0to32 0.0 31.99900627136231 /end CHARACTERISTIC
/begin CHARACTERISTIC C_ExtPEModeCoolTempThresh "cal comments" VALUE 0x9656 Scalar_SW 0.0 CM_DegC_N256to256 -256.0 255.9921875 /end CHARACTERISTIC
/begin CHARACTERISTIC C_ExtPEModeDisableDelay "cal comments" VALUE 0x965A Scalar_UW 0.0 CM_Second_0to65535 0.0 65535.0 /end CHARACTERISTIC
/begin CHARACTERISTIC C_ExtPEModeEnableDelay "cal comments" VALUE 0x9658 Scalar_UW 0.0 CM_Second_0to65535 0.0 65535.0 /end CHARACTERISTIC
/begin CHARACTERISTIC C_FPWIgnoreThresh "cal comments" VALUE 0x962E Scalar_UW 0.0 CM_msec_0to1024 0.0 1023.984375 /end CHARACTERISTIC
/begin CHARACTERISTIC C_FPWMaxThresh "cal comments" VALUE 0x962A Scalar_UW 0.0 CM_msec_0to1024 0.0 1023.984375 /end CHARACTERISTIC
/begin CHARACTERISTIC C_FPW_IAC_Max "cal comments" VALUE 0x962C Scalar_UW 0.0 CM_msec_0to1024 0.0 1023.984375 /end CHARACTERISTIC
/begin CHARACTERISTIC C_FPWMinThresh "cal comments" VALUE 0x9628 Scalar_UW 0.0 CM_msec_0to1024 0.0 1023.984375 /end CHARACTERISTIC
/begin CHARACTERISTIC C_CylPhase "cal comments" CURVE 0x8074 2D_Array_UW 0.0 CM_Count1 0.0 720.0
 /begin AXIS_DESCR FIX_AXIS NO_INPUT_QUANTITY CM_EOI 4 0.0 4.0 MAX_GRAD 0.0 /begin FIX_AXIS_PAR_LIST 0 1 2 3 /end FIX_AXIS_PAR_LIST /end AXIS_DESCR
/end CHARACTERISTIC
/begin CHARACTERISTIC C_NbOfCyls "cal comments" VALUE 0x8070 Scalar_UB 0.0 CM_Count1 0.0 4.0 /end CHARACTERISTIC
/begin CHARACTERISTIC C_NbOfWheelTeeth "cal comments" VALUE 0x8071 Scalar_UB 0.0 CM_Count1 0.0 60.0 /end CHARACTERISTIC
/begin CHARACTERISTIC C_NbOfMissingTeeth "cal comments" VALUE 0x8072 Scalar_UB 0.0 CM_Count1 0.0 2.0 /end CHARACTERISTIC
/begin CHARACTERISTIC C_MapCylTDCtooth "cal comments" VALUE 0x8073 Scalar_UB 0.0 CM_Count1 0.0 60.0 /end CHARACTERISTIC
/begin CHARACTERISTIC C_RubbishSignalForDucar "cal comments" VALUE 0x807C Scalar_UB 0.0 CM_Boolean6 0.0 255.0 /end CHARACTERISTIC
/begin CHARACTERISTIC C_TwoStrokeCylinder "cal comments" VALUE 0x807D Scalar_UB 0.0 CM_Boolean6 0.0 255.0 /end CHARACTERISTIC
/begin CHARACTERISTIC C_HWIO_CCP_Output_Usage "cal comments" VALUE 0x8002 Scalar_UB 0.0 CM_Count1 0.0 255.0 /end CHARACTERISTIC
/begin CHARACTERISTIC C_HWIO_FPR_Output_Usage "cal comments" VALUE 0x8003 Scalar_UB 0.0 CM_Count1 0.0 255.0 /end CHARACTERISTIC
/begin CHARACTERISTIC C_HWIO_O2HTR_Output_Usage "cal comments" VALUE 0x8004 Scalar_UB 0.0 CM_Count1 0.0 255.0 /end CHARACTERISTIC
/begin CHARACTERISTIC C_HWIO_TACH_Output_Usage "cal comments" VALUE 0x8005 Scalar_UB 0.0 CM_Count1 0.0 255.0 /end CHARACTERISTIC
/begin CHARACTERISTIC C_HWIO_DCM_Output_Usage "cal comments" VALUE 0x8006 Scalar_UB 0.0 CM_Count1 0.0 255.0 /end CHARACTERISTIC
/begin CHARACTERISTIC C_HWIO_SPRK1_Output_Usage "cal comments" VALUE 0x8007 Scalar_UB 0.0 CM_Count1 0.0 255.0 /end CHARACTERISTIC
/begin CHARACTERISTIC C_HWIO_SPRK2_Output_Usage "cal comments" VALUE 0x8008 Scalar_UB 0.0 CM_Count1 0.0 255.0 /end CHARACTERISTIC
/begin CHARACTERISTIC C_HWIO_SPRK3_Output_Usage "cal comments" VALUE 0x8009 Scalar_UB 0.0 CM_Count1 0.0 255.0 /end CHARACTERISTIC
/begin CHARACTERISTIC C_HWIO_SPRK4_Output_Usage "cal comments" VALUE 0x800A Scalar_UB 0.0 CM_Count1 0.0 255.0 /end CHARACTERISTIC
/begin CHARACTERISTIC C_FuelCLEnbRunTimeThrsh "cal comments" VALUE 0x9B42 Scalar_UW 0.0 CM_Second_0to65535 0.0 65535.0 /end CHARACTERISTIC
/begin CHARACTERISTIC C_FuellLowLoadCondEngSpdThrsh "cal comments" VALUE 0x9C3E Scalar_UW 0.0 CM_RPM_0to16384 0.0 16383.75 /end CHARACTERISTIC
/begin CHARACTERISTIC C_FuellLowLoadCondMAPThrsh "cal comments" VALUE 0x9C40 Scalar_UW 0.0 CM_kpa_0to256_1 0.0 255.99609375 /end CHARACTERISTIC
/begin CHARACTERISTIC C_FuelO2RichLeanWindowDelta "cal comments" VALUE 0x9C42 Scalar_UW 0.0 CM_mVolt_1 0.0 1023.96875 /end CHARACTERISTIC
/begin CHARACTERISTIC C_FuelO2RLThreshMaxLimit "cal comments" VALUE 0x9BFA Scalar_UW 0.0 CM_mVolt_1 0.0 1023.96875 /end CHARACTERISTIC
/begin CHARACTERISTIC C_FuelO2RLThreshMinLimit "cal comments" VALUE 0x9BFC Scalar_UW 0.0 CM_mVolt_1 0.0 1023.96875 /end CHARACTERISTIC
/begin CHARACTERISTIC C_FuelPropLowLoadCond "cal comments" VALUE 0x9D3E Scalar_UW 0.0 CM_Percent_0to200_2 0.0 199.9969024658203 /end CHARACTERISTIC
/begin CHARACTERISTIC C_DiagFuelPumpDC "cal comments" VALUE 0x8062 Scalar_UW 0.0 CM_Percent_0to200_2 0.0 199.9969024658203 /end CHARACTERISTIC
/begin CHARACTERISTIC C_FuelPumpFreq "cal comments" VALUE 0x805C Scalar_UW 0.0 CM_Hz_0to16384 0.0 16383.75 /end CHARACTERISTIC
/begin CHARACTERISTIC C_LinFlexFuncSel "cal comments" VALUE 0x805E Scalar_UB 0.0 CM_Count1 0.0 4.0 /end CHARACTERISTIC
/begin CHARACTERISTIC C_ProductTypeSel "cal comments" VALUE 0x805F Scalar_UB 0.0 CM_Count1 0.0 4.0 /end CHARACTERISTIC
/begin CHARACTERISTIC C_FuelPumpOffDelay "cal comments" VALUE 0x91FC Scalar_UW 0.0 CM_Second_0to512 0.0 511.9921875 /end CHARACTERISTIC
/begin CHARACTERISTIC C_FuelSTFTRichClampCltThrsh "cal comments" VALUE 0x9C4C Scalar_SW 0.0 CM_DegC_N256to256 -256.0 255.9921875 /end CHARACTERISTIC
/begin CHARACTERISTIC C_FuelSTFTRichClampVacThrsh "cal comments" VALUE 0x9C4A Scalar_UW 0.0 CM_kpa_0to256_1 0.0 255.99609375 /end CHARACTERISTIC
/begin CHARACTERISTIC C_FuelSTFuelTrimMax "cal comments" VALUE 0x9C28 Scalar_SW 0.0 CM_SignedWord_n32768to32768_2 -32768.0 32766.0 /end CHARACTERISTIC
/begin CHARACTERISTIC C_FuelSTFuelTrimMaxPE "cal comments" VALUE 0x9C2A Scalar_SW 0.0 CM_SignedWord_n32768to32768_2 -32768.0 32766.0 /end CHARACTERISTIC
/begin CHARACTERISTIC C_FuelSTFuelTrimMin "cal comments" VALUE 0x9C2C Scalar_SW 0.0 CM_SignedWord_n32768to32768_2 -32768.0 32766.0 /end CHARACTERISTIC
/begin CHARACTERISTIC C_FuelSTFuelTrimPctConvFactor "cal comments" VALUE 0x9D5E Scalar_UW 0.0 CM_Percent_0to200 0.0 199.9969482421875 /end CHARACTERISTIC
/begin CHARACTERISTIC C_FuelSTFuelTrimPWConvFactor "cal comments" VALUE 0x9C2E Scalar_UW 0.0 CM_Ratio_0to2_1 0.0 1.999969482421875 /end CHARACTERISTIC
/begin CHARACTERISTIC C_FUEL_Pct_ClearFloodTPS "cal comments" VALUE 0x0 Scalar_UW 0.0 CM_Percent_0to200_2 0.0 199.9969024658203 /end CHARACTERISTIC
/begin CHARACTERISTIC C_FUEL_t_ClearFloodTime "cal comments" VALUE 0x0 Scalar_UW 0.0 CM_Second_0to4096 0.0 4095.9375 /end CHARACTERISTIC
/begin CHARACTERISTIC CT_FUEL_Pct_DFCO_TPS_Thrsh "cal comments" CURVE 0x2 2D_Array_UW 0.0 CM_Percent_0to200_2 0.0 199.9969024658203
 /begin AXIS_DESCR FIX_AXIS NO_INPUT_QUANTITY CM_Equaloutput1 17 0.0 12800.0 MAX_GRAD 0.0
  /begin FIX_AXIS_PAR_LIST 0 800 1600 2400 3200 4000 4800 5600 6400 7200 8000 8800 9600 10400 11200 12000 12800 /end FIX_AXIS_PAR_LIST
 /end AXIS_DESCR
/end CHARACTERISTIC
/begin CHARACTERISTIC C_FUEL_Pct_DFCO_TPS_Hys "cal comments" VALUE 0x0 Scalar_UW 0.0 CM_Percent_0to200_2 0.0 199.9969024658203 /end CHARACTERISTIC
/begin CHARACTERISTIC CT_FUEL_t_DFCOMetTime "cal comments" CURVE 0x2 2D_Array_UB 0.0 CM_Second_0to4 0.0 3.984375
 /begin AXIS_DESCR COM_AXIS NO_INPUT_QUANTITY CM_Equaloutput1 9 0.0 16383.75 AXIS_PTS_REF CA_EngSpd9Step1 MAX_GRAD 0.0 /end AXIS_DESCR
/end CHARACTERISTIC
/begin CHARACTERISTIC C_FUEL_n_DFCOdRPMDa "cal comments" VALUE 0x0 Scalar_UW 0.0 CM_RPM_0to16384 0.0 16383.75 /end CHARACTERISTIC
/begin CHARACTERISTIC C_FUEL_n_DFCOEnable_RPMThrsh "cal comments" VALUE 0x0 Scalar_UW 0.0 CM_RPM_0to16384 0.0 16383.75 /end CHARACTERISTIC
/begin CHARACTERISTIC C_FUEL_T_DFCO_CoolTempThrsh "cal comments" VALUE 0x0 Scalar_SW 0.0 CM_DegC_N256to256 -256.0 255.9921875 /end CHARACTERISTIC
/begin CHARACTERISTIC C_FUEL_p_DFCO_MAP_Hys "cal comments" VALUE 0x0 Scalar_UW 0.0 CM_kpa_0to256_1 0.0 255.99609375 /end CHARACTERISTIC
/begin CHARACTERISTIC CT_FUEL_p_DFCO_MAP_Thrsh "cal comments" CURVE 0x2 2D_Array_UB 0.0 CM_kpa_8bit 0.0 127.5
 /begin AXIS_DESCR FIX_AXIS NO_INPUT_QUANTITY CM_Equaloutput1 17 0.0 12800.0 MAX_GRAD 0.0
  /begin FIX_AXIS_PAR_LIST 0 800 1600 2400 3200 4000 4800 5600 6400 7200 8000 8800 9600 10400 11200 12000 12800 /end FIX_AXIS_PAR_LIST
 /end AXIS_DESCR
/end CHARACTERISTIC
/begin CHARACTERISTIC C_FUEL_n_DFCOExit_Thrsh "cal comments" VALUE 0x0 Scalar_UW 0.0 CM_RPM_0to16384 0.0 16383.75 /end CHARACTERISTIC
/begin CHARACTERISTIC C_FUEL_r_DFCOExit_FuelDecayFactor "cal comments" VALUE 0x0 Scalar_UB 0.0 CM_Mult_0to1_2 0.0 0.99609375 /end CHARACTERISTIC
/begin CHARACTERISTIC C_FUEL_t_DFCOExit_FuelDecayTime "cal comments" VALUE 0x0 Scalar_UW 0.0 CM_Second_0to1024 0.0 1023.984375 /end CHARACTERISTIC
/begin CHARACTERISTIC C_FUEL_t_DFCO_RunTimeThrsh "cal comments" VALUE 0x0 Scalar_UW 0.0 CM_Count_0to65535_1 0.0 65535.0 /end CHARACTERISTIC
/begin CHARACTERISTIC C_FUEL_t_DFCO_Spark_Exit_Dly "cal comments" VALUE 0x0 Scalar_UW 0.0 CM_Second_0to1024 0.0 1023.984375 /end CHARACTERISTIC
/begin CHARACTERISTIC C_FUEL_t_DFCO_RampOUT_Interval "cal comments" VALUE 0x0 Scalar_UW 0.0 CM_Second_0to1024 0.0 1023.984375 /end CHARACTERISTIC
/begin CHARACTERISTIC C_FUEL_r_DFCO_RampOUT_Step "cal comments" VALUE 0x0 Scalar_UW 0.0 CM_Ratio_0to2_2 0.0 1.999969482421875 /end CHARACTERISTIC
/begin CHARACTERISTIC C_FUEL_n_DFCO_RampOUT_ExitThresh "cal comments" VALUE 0x0 Scalar_UW 0.0 CM_RPM_0to16384 0.0 16383.75 /end CHARACTERISTIC
/begin CHARACTERISTIC C_FUEL_DFCO_DeclutchExitDFCO "cal comments" VALUE 0x0 Scalar_UB 0.0 CM_Boolean2 0.0 1.0 /end CHARACTERISTIC
/begin CHARACTERISTIC C_FUEL_t_DFCO_Declutch_Delay "cal comments" VALUE 0x0 Scalar_UW 0.0 CM_Second_0to1024 0.0 1023.984375 /end CHARACTERISTIC
/begin CHARACTERISTIC C_FUEL_r_DFCO_RampOUT_Initial "cal comments" VALUE 0x0 Scalar_UW 0.0 CM_Ratio_0to2_2 0.0 1.999969482421875 /end CHARACTERISTIC
/begin CHARACTERISTIC C_FUEL_n_DFCO_RampOUT_MinVSS "cal comments" VALUE 0x0 Scalar_UW 0.0 CM_KPH_0to512 0.0 511.9921875 /end CHARACTERISTIC
/begin CHARACTERISTIC CT_FUEL_r_DFCOExit_TempFactor "cal comments" CURVE 0x2 2D_Array_UB 0.0 CM_Mult0_to_2_ratio 0.0 1.9921875
 /begin AXIS_DESCR FIX_AXIS NO_INPUT_QUANTITY CM_Equaloutput1 17 -28.0 164.0 MAX_GRAD 0.0 /begin FIX_AXIS_PAR_LIST -28 -16 -4 8 20 32 44 56 68 80 92 104 116 128 140 152 164 /end FIX_AXIS_PAR_LIST /end AXIS_DESCR
/end CHARACTERISTIC
/begin CHARACTERISTIC CT_FUEL_t_DFCOExitBPW "cal comments" CURVE 0x2 2D_Array_UW 0.0 CM_msec_0to1024 0.0 1023.984375
 /begin AXIS_DESCR FIX_AXIS NO_INPUT_QUANTITY CM_Second_0to1024 17 0 16.0 MAX_GRAD 0.0
  /begin FIX_AXIS_PAR_LIST 0.0 1.0 2.0 3.0 4.0 5.0 6.0 7.0 8.0 9.0 10.0 11.0 12.0 13.0 14.0 15.0 16.0 /end FIX_AXIS_PAR_LIST
 /end AXIS_DESCR
/end CHARACTERISTIC
/begin CHARACTERISTIC C_GPIO_VSS_FUNC "cal comments" VALUE 0x803C Scalar_UB 0.0 CM_Count1 0.0 255.0 /end CHARACTERISTIC
/begin CHARACTERISTIC C_GPIO_DCMEN_FUNC "cal comments" VALUE 0x8039 Scalar_UB 0.0 CM_Count1 0.0 255.0 /end CHARACTERISTIC
/begin CHARACTERISTIC C_GPIO_DCMCS_FUNC "cal comments" VALUE 0x803A Scalar_UB 0.0 CM_Count1 0.0 255.0 /end CHARACTERISTIC
/begin CHARACTERISTIC C_GPIO_DCMPWM_FUNC "cal comments" VALUE 0x803B Scalar_UB 0.0 CM_Count1 0.0 255.0 /end CHARACTERISTIC
/begin CHARACTERISTIC C_GPIO_LP_SW_FUNC "cal comments" VALUE 0x803D Scalar_UB 0.0 CM_Count1 0.0 255.0 /end CHARACTERISTIC
/begin CHARACTERISTIC C_GPIO_PN_SW_FUNC "cal comments" VALUE 0x803E Scalar_UB 0.0 CM_Count1 0.0 255.0 /end CHARACTERISTIC
/begin CHARACTERISTIC C_GPIO_Rollover_FUNC "cal comments" VALUE 0x803F Scalar_UB 0.0 CM_Count1 0.0 255.0 /end CHARACTERISTIC
/begin CHARACTERISTIC C_GPIO_DIAG_FUNC "cal comments" VALUE 0x8040 Scalar_UB 0.0 CM_Count1 0.0 255.0 /end CHARACTERISTIC
/begin CHARACTERISTIC C_GPIO_O2A_FUNC "cal comments" VALUE 0x8041 Scalar_UB 0.0 CM_Count1 0.0 255.0 /end CHARACTERISTIC
/begin CHARACTERISTIC C_GPIO_O2B_FUNC "cal comments" VALUE 0x8042 Scalar_UB 0.0 CM_Count1 0.0 255.0 /end CHARACTERISTIC
/begin CHARACTERISTIC C_GPIO_CLT_FUNC "cal comments" VALUE 0x8043 Scalar_UB 0.0 CM_Count1 0.0 255.0 /end CHARACTERISTIC
/begin CHARACTERISTIC C_GPIO_MAT_FUNC "cal comments" VALUE 0x8044 Scalar_UB 0.0 CM_Count1 0.0 255.0 /end CHARACTERISTIC
/begin CHARACTERISTIC C_GPIO_MAP_FUNC "cal comments" VALUE 0x8045 Scalar_UB 0.0 CM_Count1 0.0 255.0 /end CHARACTERISTIC
/begin CHARACTERISTIC C_GPIO_TPS1_FUNC "cal comments" VALUE 0x8046 Scalar_UB 0.0 CM_Count1 0.0 255.0 /end CHARACTERISTIC
/begin CHARACTERISTIC C_GPIO_TPS2_FUNC "cal comments" VALUE 0x8047 Scalar_UB 0.0 CM_Count1 0.0 255.0 /end CHARACTERISTIC
/begin CHARACTERISTIC C_GPIO_FCVPS_FUNC "cal comments" VALUE 0x8048 Scalar_UB 0.0 CM_Count1 0.0 255.0 /end CHARACTERISTIC
/begin CHARACTERISTIC C_GPIO_TACH_FUNC "cal comments" VALUE 0x8049 Scalar_UB 0.0 CM_Count1 0.0 255.0 /end CHARACTERISTIC
/begin CHARACTERISTIC C_GPIO_CCP_FUNC "cal comments" VALUE 0x804A Scalar_UB 0.0 CM_Count1 0.0 255.0 /end CHARACTERISTIC
/begin CHARACTERISTIC C_GPIO_IDLE_EN_FUNC "cal comments" VALUE 0x804C Scalar_UB 0.0 CM_Count1 0.0 255.0 /end CHARACTERISTIC
/begin CHARACTERISTIC C_GPIO_IDLE_DIR_FUNC "cal comments" VALUE 0x804D Scalar_UB 0.0 CM_Count1 0.0 255.0 /end CHARACTERISTIC
/begin CHARACTERISTIC C_GPIO_IDLE_STEP_FUNC "cal comments" VALUE 0x804E Scalar_UB 0.0 CM_Count1 0.0 255.0 /end CHARACTERISTIC
/begin CHARACTERISTIC C_GPIO_8101CS_FUNC "cal comments" VALUE 0x804F Scalar_UB 0.0 CM_Count1 0.0 255.0 /end CHARACTERISTIC
/begin CHARACTERISTIC C_GPIO_INJ1_FUNC "cal comments" VALUE 0x8050 Scalar_UB 0.0 CM_Count1 0.0 255.0 /end CHARACTERISTIC
/begin CHARACTERISTIC C_GPIO_INJ2_FUNC "cal comments" VALUE 0x8051 Scalar_UB 0.0 CM_Count1 0.0 255.0 /end CHARACTERISTIC
/begin CHARACTERISTIC C_GPIO_INJ3_FUNC "cal comments" VALUE 0x8052 Scalar_UB 0.0 CM_Count1 0.0 255.0 /end CHARACTERISTIC
/begin CHARACTERISTIC C_GPIO_INJ4_FUNC "cal comments" VALUE 0x8053 Scalar_UB 0.0 CM_Count1 0.0 255.0 /end CHARACTERISTIC
/begin CHARACTERISTIC C_GPIO_MIL_FUNC "cal comments" VALUE 0x804B Scalar_UB 0.0 CM_Count1 0.0 255.0 /end CHARACTERISTIC
/begin CHARACTERISTIC C_GPIO_VI0_FUNC "cal comments" VALUE 0x8054 Scalar_UB 0.0 CM_Count1 0.0 255.0 /end CHARACTERISTIC
/begin CHARACTERISTIC C_GPIO_VI1_FUNC "cal comments" VALUE 0x8055 Scalar_UB 0.0 CM_Count1 0.0 255.0 /end CHARACTERISTIC
/begin CHARACTERISTIC C_GPIO_VI2_FUNC "cal comments" VALUE 0x8056 Scalar_UB 0.0 CM_Count1 0.0 255.0 /end CHARACTERISTIC
/begin CHARACTERISTIC C_GPIO_VI3_FUNC "cal comments" VALUE 0x8057 Scalar_UB 0.0 CM_Count1 0.0 255.0 /end CHARACTERISTIC
/begin CHARACTERISTIC C_GPIO_VI4_FUNC "cal comments" VALUE 0x8058 Scalar_UB 0.0 CM_Count1 0.0 255.0 /end CHARACTERISTIC
/begin CHARACTERISTIC C_GPIO_VI5_FUNC "cal comments" VALUE 0x8059 Scalar_UB 0.0 CM_Count1 0.0 255.0 /end CHARACTERISTIC
/begin CHARACTERISTIC C_GPIO_VI6_FUNC "cal comments" VALUE 0x805A Scalar_UB 0.0 CM_Count1 0.0 255.0 /end CHARACTERISTIC
/begin CHARACTERISTIC C_GPIO_VI7_FUNC "cal comments" VALUE 0x805B Scalar_UB 0.0 CM_Count1 0.0 255.0 /end CHARACTERISTIC
/begin CHARACTERISTIC C_HeatedO2SensorUsed "cal comments" VALUE 0x91F4 Scalar_UB 0.0 CM_Boolean2 0.0 1.0 /end CHARACTERISTIC
/begin CHARACTERISTIC C_HighEngSpdFCOThreshHi "cal comments" VALUE 0x92FE Scalar_UW 0.0 CM_RPM_0to16384 0.0 16383.75 /end CHARACTERISTIC
/begin CHARACTERISTIC C_HighEngSpdFCOThreshLo "cal comments" VALUE 0x92FC Scalar_UW 0.0 CM_RPM_0to16384 0.0 16383.75 /end CHARACTERISTIC
/begin CHARACTERISTIC C_FUEL_n_LackOilHighRPM "cal comments" VALUE 0xBB32 Scalar_UW 0.0 CM_RPM_0to16384 0.0 16383.75 /end CHARACTERISTIC
/begin CHARACTERISTIC C_FUEL_n_LackOilLowRPM "cal comments" VALUE 0xBB34 Scalar_UW 0.0 CM_RPM_0to16384 0.0 16383.75 /end CHARACTERISTIC
/begin CHARACTERISTIC C_FUEL_LackOil_CutOffEn "cal comments" VALUE 0xBB36 Scalar_UB 0.0 CM_Boolean6 0.0 255.0 /end CHARACTERISTIC
/begin CHARACTERISTIC C_OSWPFiltCoef "cal comments" VALUE 0xBB38 Scalar_UW 0.0 CM_FiltCoef 0.0 0.9999847412109375 /end CHARACTERISTIC
/begin CHARACTERISTIC C_OSWPSignalConvSlope "cal comments" VALUE 0xBB3A Scalar_UW 0.0 CM_Percent_0to200_2 0.0 199.9969024658203 /end CHARACTERISTIC
/begin CHARACTERISTIC C_OSWPSignalConvIntercept "cal comments" VALUE 0xBB3C Scalar_SW 0.0 CM_Percent_N200to200 -199.9999847412109 199.9938812255859 /end CHARACTERISTIC
/begin CHARACTERISTIC C_FUEL_n_COAHighRPM "cal comments" VALUE 0xBB3E Scalar_UW 0.0 CM_RPM_0to16384 0.0 16383.75 /end CHARACTERISTIC
/begin CHARACTERISTIC C_FUEL_n_COALowRPM "cal comments" VALUE 0xBB40 Scalar_UW 0.0 CM_RPM_0to16384 0.0 16383.75 /end CHARACTERISTIC
/begin CHARACTERISTIC C_FUEL_COA_CutOffEn "cal comments" VALUE 0xBB42 Scalar_UB 0.0 CM_Boolean6 0.0 255.0 /end CHARACTERISTIC
/begin CHARACTERISTIC C_FUEL_COA_LowActive "cal comments" VALUE 0xBB43 Scalar_UB 0.0 CM_Boolean6 0.0 255.0 /end CHARACTERISTIC
/begin CHARACTERISTIC C_FUEL_t_COA_Ignore "cal comments" VALUE 0xBB44 Scalar_UW 0.0 CM_Seconds_1 0.0 2047.96875 /end CHARACTERISTIC
/begin CHARACTERISTIC C_FUEL_t_COA_Filt "cal comments" VALUE 0xBB46 Scalar_UW 0.0 CM_Seconds_1 0.0 2047.96875 /end CHARACTERISTIC
/begin CHARACTERISTIC C_FUEL_t_COA_Lock "cal comments" VALUE 0xBB48 Scalar_UW 0.0 CM_Seconds_1 0.0 2047.96875 /end CHARACTERISTIC
/begin CHARACTERISTIC C_MultFuelSWFiltTime "cal comments" VALUE 0xBB28 Scalar_UW 0.0 CM_Second_0to4096 0.0 4095.9375 /end CHARACTERISTIC
/begin CHARACTERISTIC C_VIOS_MultFuelSWLowActive "cal comments" VALUE 0xBB2A Scalar_UB 0.0 CM_Boolean6 0.0 255.0 /end CHARACTERISTIC
/begin CHARACTERISTIC C_MultFuelType "cal comments" VALUE 0xBB2B Scalar_UB 0.0 CM_Count1 0.0 255.0 /end CHARACTERISTIC
/begin CHARACTERISTIC C_MultFuelTypeLvl_Gas_NG "cal comments" VALUE 0xBB2C Scalar_UW 0.0 CM_Percent_0to100_1 0.0 99.9984130859375 /end CHARACTERISTIC
/begin CHARACTERISTIC C_MultFuelTypeLvl_NG_LPG "cal comments" VALUE 0xBB2E Scalar_UW 0.0 CM_Percent_0to100_1 0.0 99.9984130859375 /end CHARACTERISTIC
/begin CHARACTERISTIC C_FUEL_n_CltOverHeatHighRPM "cal comments" VALUE 0x99F4 Scalar_UW 0.0 CM_RPM_0to16384 0.0 16383.75 /end CHARACTERISTIC
/begin CHARACTERISTIC C_FUEL_n_CltOverHeatLowRPM "cal comments" VALUE 0x99F6 Scalar_UW 0.0 CM_RPM_0to16384 0.0 16383.75 /end CHARACTERISTIC
/begin CHARACTERISTIC C_FUEL_CltOverHeat_CutOffEn "cal comments" VALUE 0x99F8 Scalar_UB 0.0 CM_Boolean6 0.0 255.0 /end CHARACTERISTIC
/begin CHARACTERISTIC C_Fuel_Cont_IGNOff_HiRPM "cal comments" VALUE 0x99FA Scalar_UW 0.0 CM_RPM_0to16384 0.0 16383.75 /end CHARACTERISTIC
/begin CHARACTERISTIC C_ACSW_Current_High_Thresh "cal comments" VALUE 0xB022 Scalar_UW 0.0 CM_Percent_0to100_1 0.0 99.9984130859375 /end CHARACTERISTIC
/begin CHARACTERISTIC C_ACSW_Current_Hsyt "cal comments" VALUE 0xB024 Scalar_UW 0.0 CM_Percent_0to100_1 0.0 99.9984130859375 /end CHARACTERISTIC
/begin CHARACTERISTIC C_ACSW_IdleDelayTime "cal comments" VALUE 0xB026 Scalar_UW 0.0 CM_Second_0to512 0.0 511.9921875 /end CHARACTERISTIC
/begin CHARACTERISTIC C_DC_CurrentSignalConvIntercept "cal comments" VALUE 0xB02A Scalar_SW 0.0 CM_Ratio_n256to256 -256.0 255.9921875 /end CHARACTERISTIC
/begin CHARACTERISTIC C_DC_CurrentSignalConvSlope "cal comments" VALUE 0xB028 Scalar_UW 0.0 CM_amp_0to512_1 0.0 511.9921875 /end CHARACTERISTIC
/begin CHARACTERISTIC C_DC_CurrentFiltCoef "cal comments" VALUE 0xB02C Scalar_UW 0.0 CM_FiltCoef 0.0 0.9999847412109375 /end CHARACTERISTIC
/begin CHARACTERISTIC C_IDLEMoveBatVoltMaxLimit "cal comments" VALUE 0xB5B4 Scalar_UW 0.0 CM_Volt_0to32_1 0.0 31.99900627136231 /end CHARACTERISTIC
/begin CHARACTERISTIC C_IDLEMoveBatVoltMinLimit "cal comments" VALUE 0xB5B6 Scalar_UW 0.0 CM_Volt_0to32_1 0.0 31.99900627136231 /end CHARACTERISTIC
/begin CHARACTERISTIC C_IdleDerivEngSpdHiDeadBand "cal comments" VALUE 0xA0D0 Scalar_UW 0.0 CM_RPM_0to16384 0.0 16383.75 /end CHARACTERISTIC
/begin CHARACTERISTIC C_IdleDerivEngSpdHiDeadBand2 "cal comments" VALUE 0xA15A Scalar_UW 0.0 CM_RPM_0to16384 0.0 16383.75 /end CHARACTERISTIC
/begin CHARACTERISTIC C_IdleDerivEngSpdLoDeadBand "cal comments" VALUE 0xA0D2 Scalar_UW 0.0 CM_RPM_0to16384 0.0 16383.75 /end CHARACTERISTIC
/begin CHARACTERISTIC C_IdleDerivEngSpdLoDeadBand2 "cal comments" VALUE 0xA15C Scalar_UW 0.0 CM_RPM_0to16384 0.0 16383.75 /end CHARACTERISTIC
/begin CHARACTERISTIC C_IdleEnableEngSpdThresh "cal comments" VALUE 0xA160 Scalar_UW 0.0 CM_RPM_0to16384 0.0 16383.75 /end CHARACTERISTIC
/begin CHARACTERISTIC C_IdleEnableTPSThresh "cal comments" VALUE 0xA162 Scalar_UW 0.0 CM_Percent_0to200_2 0.0 199.9969024658203 /end CHARACTERISTIC
/begin CHARACTERISTIC C_IdleIntEnbEngSpdErrorThresh "cal comments" VALUE 0xA0CE Scalar_UW 0.0 CM_RPM_0to16384 0.0 16383.75 /end CHARACTERISTIC
/begin CHARACTERISTIC C_IdleIntInitDefault "cal comments" VALUE 0xA15E Scalar_UW 0.0 CM_Percent_0to200_2 0.0 199.9969024658203 /end CHARACTERISTIC
/begin CHARACTERISTIC C_IdlePropEngSpdHiDeadBand "cal comments" VALUE 0xA0D4 Scalar_UW 0.0 CM_RPM_0to16384 0.0 16383.75 /end CHARACTERISTIC
/begin CHARACTERISTIC C_IdlePropEngSpdLoDeadBand "cal comments" VALUE 0xA0D6 Scalar_UW 0.0 CM_RPM_0to16384 0.0 16383.75 /end CHARACTERISTIC
/begin CHARACTERISTIC C_IACV_n_BattOffsetMax "cal comments" VALUE 0x9DE0 Scalar_UW 0.0 udf_CM_18586 0.0 16383.75 /end CHARACTERISTIC
/begin CHARACTERISTIC C_IACV_n_BattRPMStep "cal comments" VALUE 0x9DE2 Scalar_UW 0.0 udf_CM_18586 0.0 16383.75 /end CHARACTERISTIC
/begin CHARACTERISTIC C_IACV_r_StartUpFactor "cal comments" VALUE 0x9DE4 Scalar_UW 0.0 CM_FactorRatio 0.0 0.9999847412109375 /end CHARACTERISTIC
/begin CHARACTERISTIC C_IACV_t_BattWaitTime "cal comments" VALUE 0x9DE6 Scalar_UW 0.0 CM_Second_0to1024 0.0 1023.984375 /end CHARACTERISTIC
/begin CHARACTERISTIC C_IACV_t_DsrdSpdSUDecayTime "cal comments" VALUE 0x9DE8 Scalar_UW 0.0 CM_Second_0to1024 0.0 1023.984375 /end CHARACTERISTIC
/begin CHARACTERISTIC C_IACV_t_LowBattWaitTime "cal comments" VALUE 0x9DEA Scalar_UW 0.0 CM_Second_0to1024 0.0 1023.984375 /end CHARACTERISTIC
/begin CHARACTERISTIC C_IACV_U_BattHigh "cal comments" VALUE 0x9DEC Scalar_UW 0.0 CM_Volt_0to32_1 0.0 31.99900627136231 /end CHARACTERISTIC
/begin CHARACTERISTIC C_IACV_U_BattLow "cal comments" VALUE 0x9DEE Scalar_UW 0.0 CM_Volt_0to32_1 0.0 31.99900627136231 /end CHARACTERISTIC
/begin CHARACTERISTIC CT_IACV_n_BaseDsrdSpd "cal comments" CURVE 0x9DF2 2D_Array_UW 0.0 CM_RPM_0to16384 0.0 16383.75
 /begin AXIS_DESCR FIX_AXIS NO_INPUT_QUANTITY CM_Equaloutput1 17 -28.0 164.0 MAX_GRAD 0.0 /begin FIX_AXIS_PAR_LIST -28 -16 -4 8 20 32 44 56 68 80 92 104 116 128 140 152 164 /end FIX_AXIS_PAR_LIST /end AXIS_DESCR
/end CHARACTERISTIC
/begin CHARACTERISTIC CT_IACV_pct_DsrdThrotFollow "cal comments" MAP 0x9E4E 3D_Array_UB 0.0 CM_Percent_0to100 0.0 99.609375
 /begin AXIS_DESCR FIX_AXIS NO_INPUT_QUANTITY CM_Equaloutput1 9 0.0 50.0 MAX_GRAD 0.0 /begin FIX_AXIS_PAR_LIST 0 6.25 12.5 18.75 25 61.25 37.5 43.75 50 /end FIX_AXIS_PAR_LIST /end AXIS_DESCR
 /begin AXIS_DESCR FIX_AXIS NO_INPUT_QUANTITY CM_Equaloutput1 9 800.0 7200.0 MAX_GRAD 0.0 /begin FIX_AXIS_PAR_LIST 800 1600 2400 3200 4000 4800 5600 6400 7200 /end FIX_AXIS_PAR_LIST /end AXIS_DESCR
/end CHARACTERISTIC
/begin CHARACTERISTIC CT_IACV_r_TFDecayCoeff "cal comments" CURVE 0x9EA2 2D_Array_UB 0.0 CM_Mult_0to1 0.0 0.99609375
 /begin AXIS_DESCR FIX_AXIS NO_INPUT_QUANTITY CM_Equaloutput1 9 800.0 7200.0 MAX_GRAD 0.0 /begin FIX_AXIS_PAR_LIST 800 1600 2400 3200 4000 4800 5600 6400 7200 /end FIX_AXIS_PAR_LIST /end AXIS_DESCR
/end CHARACTERISTIC
/begin CHARACTERISTIC CT_IACV_r_TFRampUpCoeff "cal comments" CURVE 0x9EAD 2D_Array_UB 0.0 CM_Mult_0to1 0.0 0.99609375
 /begin AXIS_DESCR FIX_AXIS NO_INPUT_QUANTITY CM_Equaloutput1 9 0.0 50.0 MAX_GRAD 0.0 /begin FIX_AXIS_PAR_LIST 0 6.25 12.5 18.75 25 61.25 37.5 43.75 50 /end FIX_AXIS_PAR_LIST /end AXIS_DESCR
/end CHARACTERISTIC
/begin CHARACTERISTIC CT_IACV_r_ThrotFollowFactor "cal comments" CURVE 0x9EB8 2D_Array_UB 0.0 CM_Mult0_to_2_ratio 0.0 1.9921875
 /begin AXIS_DESCR FIX_AXIS NO_INPUT_QUANTITY CM_Equaloutput1 17 -28.0 164.0 MAX_GRAD 0.0 /begin FIX_AXIS_PAR_LIST -28 -16 -4 8 20 32 44 56 68 80 92 104 116 128 140 152 164 /end FIX_AXIS_PAR_LIST /end AXIS_DESCR
/end CHARACTERISTIC
/begin CHARACTERISTIC C_IACV_r_TF_NeutralDecayCoeff "cal comments" VALUE 0x9ECA Scalar_UW 0.0 CM_FactorRatio 0.0 0.9999847412109375 /end CHARACTERISTIC
/begin CHARACTERISTIC C_IACVEnableEngSpdThresh "cal comments" VALUE 0x9E48 Scalar_UW 0.0 CM_RPM_0to16384 0.0 16383.75 /end CHARACTERISTIC
/begin CHARACTERISTIC C_IACVEnableTPSThresh "cal comments" VALUE 0x9E4A Scalar_UW 0.0 CM_Percent_0to200_2 0.0 199.9969024658203 /end CHARACTERISTIC
/begin CHARACTERISTIC C_IACVIntEnbEngSpdErrorThresh "cal comments" VALUE 0x9ED0 Scalar_UW 0.0 CM_RPM_0to16384 0.0 16383.75 /end CHARACTERISTIC
/begin CHARACTERISTIC C_IACVPropEngSpdHiDeadBand "cal comments" VALUE 0x9ED8 Scalar_UW 0.0 CM_RPM_0to16384 0.0 16383.75 /end CHARACTERISTIC
/begin CHARACTERISTIC C_IACVPropEngSpdLoDeadBand "cal comments" VALUE 0x9EDA Scalar_UW 0.0 CM_RPM_0to16384 0.0 16383.75 /end CHARACTERISTIC
/begin CHARACTERISTIC C_IACV_pct_AiflowLrnBaseVal "cal comments" VALUE 0x9EDC Scalar_UW 0.0 CM_Percent_0to200_2 0.0 199.9969024658203 /end CHARACTERISTIC
/begin CHARACTERISTIC C_IACV_pct_AirflowMaxIntgOffset "cal comments" VALUE 0x9EDE Scalar_UW 0.0 CM_Percent_0to200_2 0.0 199.9969024658203 /end CHARACTERISTIC
/begin CHARACTERISTIC C_IACV_pct_AirflowSlowLrnOffset "cal comments" VALUE 0x9EE0 Scalar_UW 0.0 CM_Percent_0to200_2 0.0 199.9969024658203 /end CHARACTERISTIC
/begin CHARACTERISTIC C_IACV_r_AirflowRPMErrCoeff "cal comments" VALUE 0x9EE2 Scalar_UW 0.0 CM_FactorRatio 0.0 0.9999847412109375 /end CHARACTERISTIC
/begin CHARACTERISTIC C_IACV_r_CrankDecayFactor "cal comments" VALUE 0x9EE4 Scalar_UW 0.0 CM_FactorRatio 0.0 0.9999847412109375 /end CHARACTERISTIC
/begin CHARACTERISTIC C_IACV_r_AirflowICoolMaxFactor "cal comments" VALUE 0x9F8A Scalar_UW 0.0 CM_FactorRatio 0.0 0.9999847412109375 /end CHARACTERISTIC
/begin CHARACTERISTIC C_IACV_t_AirflowBattDelayTime "cal comments" VALUE 0x9EE6 Scalar_UW 0.0 CM_Second_0to1024 0.0 1023.984375 /end CHARACTERISTIC
/begin CHARACTERISTIC C_IACV_t_CrankDecayTime "cal comments" VALUE 0x9EE8 Scalar_UW 0.0 CM_Second_0to1024 0.0 1023.984375 /end CHARACTERISTIC
/begin CHARACTERISTIC C_IACV_t_MotorResetDly "cal comments" VALUE 0x9EEC Scalar_UW 0.0 CM_Second_0to1024 0.0 1023.984375 /end CHARACTERISTIC
/begin CHARACTERISTIC C_IACVCLDelayAftStartUp "cal comments" VALUE 0x9EEE Scalar_UW 0.0 CM_Second_0to1024 0.0 1023.984375 /end CHARACTERISTIC
/begin CHARACTERISTIC C_IACV_U_AirflowAltCrank "cal comments" VALUE 0x9EF0 Scalar_UW 0.0 CM_Volt_0to32_1 0.0 31.99900627136231 /end CHARACTERISTIC
/begin CHARACTERISTIC C_IACV_U_AirflowAltIncVolt "cal comments" VALUE 0x9EF2 Scalar_UW 0.0 CM_Volt_0to32_1 0.0 31.99900627136231 /end CHARACTERISTIC
/begin CHARACTERISTIC C_IACV_T_EngTmpWarm "cal comments" VALUE 0x9EEA Scalar_SW 0.0 CM_DegC_N256to256 -256.0 255.9921875 /end CHARACTERISTIC
/begin CHARACTERISTIC C_IACV_pct_AirflowSlowLrnLimit "cal comments" VALUE 0x9FEE Scalar_UW 0.0 CM_Percent_0to200_2 0.0 199.9969024658203 /end CHARACTERISTIC
/begin CHARACTERISTIC CT_IACV_p_IntegralDeltaHiThrs "cal comments" CURVE 0x9EF6 2D_Array_UB 0.0 CM_kpa_8bit 0.0 127.5
 /begin AXIS_DESCR FIX_AXIS NO_INPUT_QUANTITY CM_Equaloutput1 7 -28.0 164.0 MAX_GRAD 0.0 /begin FIX_AXIS_PAR_LIST -28 4 36 68 100 132 164 /end FIX_AXIS_PAR_LIST /end AXIS_DESCR
/end CHARACTERISTIC
/begin CHARACTERISTIC CT_IACV_p_IntegralDeltaLowThrs "cal comments" CURVE 0x9FE0 2D_Array_UW 0.0 CM_kpa_0to256_1 0.0 255.99609375
 /begin AXIS_DESCR FIX_AXIS NO_INPUT_QUANTITY CM_Equaloutput1 7 -28.0 164.0 MAX_GRAD 0.0 /begin FIX_AXIS_PAR_LIST -28 4 36 68 100 132 164 /end FIX_AXIS_PAR_LIST /end AXIS_DESCR
/end CHARACTERISTIC
/begin CHARACTERISTIC CT_IACV_pct_AirflowBattVoltOff "cal comments" CURVE 0x9EFF 2D_Array_UB 0.0 CM_Percent_0to100 0.0 99.609375
 /begin AXIS_DESCR FIX_AXIS NO_INPUT_QUANTITY CM_Equaloutput1 17 6 18.8 MAX_GRAD 0.0
  /begin FIX_AXIS_PAR_LIST 6 6.8 7.6 8.4 9.2 10 10.8 11.6 12.4 13.2 14.0 14.8 15.6 16.4 17.2 18 18.8 /end FIX_AXIS_PAR_LIST
 /end AXIS_DESCR
/end CHARACTERISTIC
/begin CHARACTERISTIC CT_IACV_pct_AirflowCrankOffset "cal comments" CURVE 0x9F12 2D_Array_UB 0.0 CM_Percent_0to100 0.0 99.609375
 /begin AXIS_DESCR FIX_AXIS NO_INPUT_QUANTITY CM_Equaloutput1 17 -28.0 164.0 MAX_GRAD 0.0 /begin FIX_AXIS_PAR_LIST -28 -16 -4 8 20 32 44 56 68 80 92 104 116 128 140 152 164 /end FIX_AXIS_PAR_LIST /end AXIS_DESCR
/end CHARACTERISTIC
/begin CHARACTERISTIC CT_IACV_r_AirflowICoolOffsetFact "cal comments" CURVE 0x9F8E 2D_Array_UB 0.0 CM_Mult_0to1_2 0.0 0.99609375
 /begin AXIS_DESCR FIX_AXIS NO_INPUT_QUANTITY CM_Equaloutput1 17 -28.0 164.0 MAX_GRAD 0.0 /begin FIX_AXIS_PAR_LIST -28 -16 -4 8 20 32 44 56 68 80 92 104 116 128 140 152 164 /end FIX_AXIS_PAR_LIST /end AXIS_DESCR
/end CHARACTERISTIC
/begin CHARACTERISTIC C_CLIACVEnableDelay "cal comments" VALUE 0x9E14 Scalar_UW 0.0 CM_Second_0to1024 0.0 1023.984375 /end CHARACTERISTIC
/begin CHARACTERISTIC CT_IACVFlowBaroMult "cal comments" CURVE 0x9F38 2D_Array_UB 0.0 CM_Mult_0to8 0.0 7.96875
 /begin AXIS_DESCR FIX_AXIS NO_INPUT_QUANTITY CM_Equaloutput1 6 55.0 105.0 MAX_GRAD 0.0 /begin FIX_AXIS_PAR_LIST 55 65 75 85 95 105 /end FIX_AXIS_PAR_LIST /end AXIS_DESCR
/end CHARACTERISTIC
/begin CHARACTERISTIC CT_IACVAirflowColdOffset "cal comments" CURVE 0x9F25 2D_Array_UB 0.0 CM_Percent_0to100 0.0 99.609375
 /begin AXIS_DESCR FIX_AXIS NO_INPUT_QUANTITY CM_Equaloutput1 17 -28.0 164.0 MAX_GRAD 0.0 /begin FIX_AXIS_PAR_LIST -28 -16 -4 8 20 32 44 56 68 80 92 104 116 128 140 152 164 /end FIX_AXIS_PAR_LIST /end AXIS_DESCR
/end CHARACTERISTIC
/begin CHARACTERISTIC CT_IACVDerivEngSpdHigh "cal comments" CURVE 0x9F40 2D_Array_UB 0.0 CM_Percent_0to100 0.0 99.609375
 /begin AXIS_DESCR FIX_AXIS NO_INPUT_QUANTITY CM_Equaloutput1 17 0.0 128.0 MAX_GRAD 0.0 /begin FIX_AXIS_PAR_LIST 0 8 16 24 32 40 48 56 64 72 80 88 96 104 112 120 128 /end FIX_AXIS_PAR_LIST /end AXIS_DESCR
/end CHARACTERISTIC
/begin CHARACTERISTIC CT_IACVDerivEngSpdLow "cal comments" CURVE 0x9F53 2D_Array_UB 0.0 CM_Percent_0to100 0.0 99.609375
 /begin AXIS_DESCR FIX_AXIS NO_INPUT_QUANTITY CM_Equaloutput1 17 0.0 128.0 MAX_GRAD 0.0 /begin FIX_AXIS_PAR_LIST 0 8 16 24 32 40 48 56 64 72 80 88 96 104 112 120 128 /end FIX_AXIS_PAR_LIST /end AXIS_DESCR
/end CHARACTERISTIC
/begin CHARACTERISTIC CT_IACVDesireSpdStartup "cal comments" CURVE 0x9E18 2D_Array_UW 0.0 CM_RPM_0to16384 0.0 16383.75
 /begin AXIS_DESCR FIX_AXIS NO_INPUT_QUANTITY CM_Equaloutput1 17 -28.0 164.0 MAX_GRAD 0.0 /begin FIX_AXIS_PAR_LIST -28 -16 -4 8 20 32 44 56 68 80 92 104 116 128 140 152 164 /end FIX_AXIS_PAR_LIST /end AXIS_DESCR
/end CHARACTERISTIC
/begin CHARACTERISTIC CT_IACVIntGainEngSpdHigh "cal comments" CURVE 0x9FA1 2D_Array_UB 0.0 CM_Mult0_to_2_ratio1 0.0 1.9921875
 /begin AXIS_DESCR FIX_AXIS NO_INPUT_QUANTITY CM_Equaloutput1 11 0.0 500.0 MAX_GRAD 0.0 /begin FIX_AXIS_PAR_LIST 0 50 100 150 200 250 300 350 400 450 500 /end FIX_AXIS_PAR_LIST /end AXIS_DESCR
/end CHARACTERISTIC
/begin CHARACTERISTIC CT_IACVIntGainEngSpdLow "cal comments" CURVE 0x9FAE 2D_Array_UB 0.0 CM_Mult0_to_2_ratio1 0.0 1.9921875
 /begin AXIS_DESCR FIX_AXIS NO_INPUT_QUANTITY CM_Equaloutput1 11 0.0 500.0 MAX_GRAD 0.0 /begin FIX_AXIS_PAR_LIST 0 50 100 150 200 250 300 350 400 450 500 /end FIX_AXIS_PAR_LIST /end AXIS_DESCR
/end CHARACTERISTIC
/begin CHARACTERISTIC CT_IACVPropEngSpdHigh "cal comments" CURVE 0x9F66 2D_Array_UB 0.0 CM_Percent_0to100 0.0 99.609375
 /begin AXIS_DESCR COM_AXIS NO_INPUT_QUANTITY CM_Equaloutput1 17 0.0 16383.75 AXIS_PTS_REF CA_EngSpd17Step4 MAX_GRAD 0.0 /end AXIS_DESCR
/end CHARACTERISTIC
/begin CHARACTERISTIC CT_IACVPropEngSpdLow "cal comments" CURVE 0x9F79 2D_Array_UB 0.0 CM_Percent_0to100 0.0 99.609375
 /begin AXIS_DESCR COM_AXIS NO_INPUT_QUANTITY CM_Equaloutput1 17 0.0 16383.75 AXIS_PTS_REF CA_EngSpd17Step4 MAX_GRAD 0.0 /end AXIS_DESCR
/end CHARACTERISTIC
/begin CHARACTERISTIC CT_IACV_t_CoolantDecayTime "cal comments" CURVE 0x9FBC 2D_Array_UW 0.0 CM_Second_0to1024 0.0 1023.984375
 /begin AXIS_DESCR FIX_AXIS NO_INPUT_QUANTITY CM_Equaloutput1 17 -28.0 164.0 MAX_GRAD 0.0 /begin FIX_AXIS_PAR_LIST -28 -16 -4 8 20 32 44 56 68 80 92 104 116 128 140 152 164 /end FIX_AXIS_PAR_LIST /end AXIS_DESCR
/end CHARACTERISTIC
/begin CHARACTERISTIC C_IACV_CL_VSS_Present "cal comments" VALUE 0x9ECC Scalar_UB 0.0 CM_Boolean6 0.0 255.0 /end CHARACTERISTIC
/begin CHARACTERISTIC C_VIOS_IACV_PstnDft "cal comments" VALUE 0xB5AB Scalar_UB 0.0 CM_Count4 0.0 255.0 /end CHARACTERISTIC
/begin CHARACTERISTIC C_VIOS_IACV_PstnMax "cal comments" VALUE 0xB5AC Scalar_UB 0.0 CM_Count4 0.0 255.0 /end CHARACTERISTIC
/begin CHARACTERISTIC C_VIOS_IACV_PstnMin "cal comments" VALUE 0xB5AD Scalar_UB 0.0 CM_Count4 0.0 255.0 /end CHARACTERISTIC
/begin CHARACTERISTIC C_IACVMotorParkDelay "cal comments" VALUE 0xB5AE Scalar_UW 0.0 CM_Count_0to65535 0.0 65535.0 /end CHARACTERISTIC
/begin CHARACTERISTIC C_IACVStepMotorHiEn "cal comments" VALUE 0xB5B0 Scalar_UB 0.0 CM_Boolean6 0.0 255.0 /end CHARACTERISTIC
/begin CHARACTERISTIC C_IACVStepMotorDir "cal comments" VALUE 0xB5B1 Scalar_UB 0.0 CM_Boolean6 0.0 255.0 /end CHARACTERISTIC
/begin CHARACTERISTIC C_IACVLoopCounter "cal comments" VALUE 0xB5B2 Scalar_UB 0.0 CM_Count1 0.0 255.0 /end CHARACTERISTIC
/begin CHARACTERISTIC C_IACVMoveBatVoltMaxLimit "cal comments" VALUE 0xB57E Scalar_UW 0.0 CM_Volt_0to32_1 0.0 31.99900627136231 /end CHARACTERISTIC
/begin CHARACTERISTIC C_IACVMoveBatVoltMinLimit "cal comments" VALUE 0xB580 Scalar_UW 0.0 CM_Volt_0to32_1 0.0 31.99900627136231 /end CHARACTERISTIC
/begin CHARACTERISTIC C_IACVMotorDirChangeDelay "cal comments" VALUE 0xB584 Scalar_UB 0.0 CM_Count4 0.0 255.0 /end CHARACTERISTIC
/begin CHARACTERISTIC C_IACVMotorStartDelay "cal comments" VALUE 0xB582 Scalar_UB 0.0 CM_Count4 0.0 255.0 /end CHARACTERISTIC
/begin CHARACTERISTIC C_IACVMotorStartDelaySteps "cal comments" VALUE 0xB583 Scalar_UB 0.0 CM_Count4 0.0 255.0 /end CHARACTERISTIC
/begin CHARACTERISTIC CT_IACVDsrdMtrPstn "cal comments" CURVE 0xB587 2D_Array_UB 0.0 CM_Count4 0.0 255.0
 /begin AXIS_DESCR FIX_AXIS NO_INPUT_QUANTITY CM_Equaloutput1 17 0.0 100.0 MAX_GRAD 0.0
  /begin FIX_AXIS_PAR_LIST 0.0 6.25 12.5 18.75 25.0 31.25 37.5 43.75 50.0 56.25 62.5 68.75 75.0 81.25 87.5 93.75 100.0 /end FIX_AXIS_PAR_LIST
 /end AXIS_DESCR
/end CHARACTERISTIC
/begin CHARACTERISTIC CT_IACV_ParkPstn "cal comments" CURVE 0xB59A 2D_Array_UB 0.0 CM_Count4 0.0 255.0
 /begin AXIS_DESCR FIX_AXIS NO_INPUT_QUANTITY CM_Equaloutput1 17 -28.0 164.0 MAX_GRAD 0.0 /begin FIX_AXIS_PAR_LIST -28 -16 -4 8 20 32 44 56 68 80 92 104 116 128 140 152 164 /end FIX_AXIS_PAR_LIST /end AXIS_DESCR
/end CHARACTERISTIC
/begin CHARACTERISTIC C_IACV_ForChokeEnable "cal comments" VALUE 0x9E3A Scalar_UB 0.0 CM_Boolean6 0.0 255.0 /end CHARACTERISTIC
/begin CHARACTERISTIC C_IACVMotorResetEachPowerDown "cal comments" VALUE 0x9E44 Scalar_UB 0.0 CM_Boolean1 0.0 1.0 /end CHARACTERISTIC
/begin CHARACTERISTIC C_IACVMotorRstEn "cal comments" VALUE 0x9E46 Scalar_UB 0.0 CM_Boolean1 0.0 1.0 /end CHARACTERISTIC
/begin CHARACTERISTIC C_IACVMotorResetEngSpdThresh "cal comments" VALUE 0x9E3E Scalar_UW 0.0 CM_RPM_0to16384 0.0 16383.75 /end CHARACTERISTIC
/begin CHARACTERISTIC C_IACVMotorResetIGNOffDelay "cal comments" VALUE 0x9E42 Scalar_UW 0.0 CM_Second_0to512 0.0 511.9921875 /end CHARACTERISTIC
/begin CHARACTERISTIC C_IACVMotorResetMaxPintleSeatStep "cal comments" VALUE 0x9E45 Scalar_UB 0.0 CM_Count4 0.0 255.0 /end CHARACTERISTIC
/begin CHARACTERISTIC C_IACVMotorResetTPSThresh "cal comments" VALUE 0x9E40 Scalar_UW 0.0 CM_Percent_0to200_2 0.0 199.9969024658203 /end CHARACTERISTIC
/begin CHARACTERISTIC C_IACVPosLostCoolTempThresh "cal comments" VALUE 0x9E3C Scalar_SW 0.0 CM_DegC_N256to256 -256.0 255.9921875 /end CHARACTERISTIC
/begin CHARACTERISTIC CT_BSTPPropCntrHigh "cal comments" CURVE 0x8F66 2D_Array_UB 0.0 CM_Percent_0to100 0.0 99.609375
 /begin AXIS_DESCR COM_AXIS NO_INPUT_QUANTITY CM_Equaloutput1 9 0.0 255.99609375 AXIS_PTS_REF CA_MAP9Step2 MAX_GRAD 0.0 /end AXIS_DESCR
/end CHARACTERISTIC
/begin CHARACTERISTIC CT_BSTPPropCntrLow "cal comments" CURVE 0x8F79 2D_Array_UB 0.0 CM_Percent_0to100 0.0 99.609375
 /begin AXIS_DESCR COM_AXIS NO_INPUT_QUANTITY CM_Equaloutput1 9 0.0 255.99609375 AXIS_PTS_REF CA_MAP9Step2 MAX_GRAD 0.0 /end AXIS_DESCR
/end CHARACTERISTIC
/begin CHARACTERISTIC CT_BSTPIntGainHigh "cal comments" CURVE 0x8F8C 2D_Array_UB 0.0 CM_Mult0_to_2_ratio 0.0 1.9921875
 /begin AXIS_DESCR COM_AXIS NO_INPUT_QUANTITY CM_Equaloutput1 9 0.0 255.99609375 AXIS_PTS_REF CA_MAP9Step2 MAX_GRAD 0.0 /end AXIS_DESCR
/end CHARACTERISTIC
/begin CHARACTERISTIC CT_BSTPIntGainLow "cal comments" CURVE 0x8F99 2D_Array_UB 0.0 CM_Mult0_to_2_ratio 0.0 1.9921875
 /begin AXIS_DESCR COM_AXIS NO_INPUT_QUANTITY CM_Equaloutput1 9 0.0 255.99609375 AXIS_PTS_REF CA_MAP9Step2 MAX_GRAD 0.0 /end AXIS_DESCR
/end CHARACTERISTIC
/begin CHARACTERISTIC C_BSTPClosedLoopOffset "cal comments" VALUE 0x8FB8 Scalar_UW 0.0 CM_kpa_0to256_1 0.0 255.99609375 /end CHARACTERISTIC
/begin CHARACTERISTIC C_BSTPCLControlRange "cal comments" VALUE 0x8FBA Scalar_UW 0.0 CM_kpa_0to256_1 0.0 255.99609375 /end CHARACTERISTIC
/begin CHARACTERISTIC C_BSTPIntEnbErrorThresh "cal comments" VALUE 0x8F5E Scalar_UW 0.0 CM_kpa_0to256_1 0.0 255.99609375 /end CHARACTERISTIC
/begin CHARACTERISTIC C_BSTPPropHiDeadBand "cal comments" VALUE 0x8F60 Scalar_UW 0.0 CM_kpa_0to256_1 0.0 255.99609375 /end CHARACTERISTIC
/begin CHARACTERISTIC C_BSTPPropLoDeadBand "cal comments" VALUE 0x8F62 Scalar_UW 0.0 CM_kpa_0to256_1 0.0 255.99609375 /end CHARACTERISTIC
/begin CHARACTERISTIC C_BSTPControlEnable "cal comments" VALUE 0x8F5C Scalar_UB 0.0 CM_Count1 0.0 255.0 /end CHARACTERISTIC
/begin CHARACTERISTIC C_CLBSTPEnableDelay "cal comments" VALUE 0x8F5A Scalar_UW 0.0 CM_Second_0to1024 0.0 1023.984375 /end CHARACTERISTIC
/begin CHARACTERISTIC CT_BSTPDsrd "cal comments" MAP 0x8FBF 3D_Array_UB 0.0 CM_kpa_0_256_8bit 0.0 255
 /begin AXIS_DESCR COM_AXIS NO_INPUT_QUANTITY CM_Equaloutput1 21 0.0 511.9921875 AXIS_PTS_REF CA_GramStep21 MAX_GRAD 0.0 /end AXIS_DESCR
 /begin AXIS_DESCR COM_AXIS NO_INPUT_QUANTITY CM_Equaloutput1 17 0.0 16383.75 AXIS_PTS_REF CA_EngSpd17Step1 MAX_GRAD 0.0 /end AXIS_DESCR
/end CHARACTERISTIC
/begin CHARACTERISTIC CT_BSTPDsrdMaxLimit "cal comments" MAP 0x9127 3D_Array_UB 0.0 CM_kpa_0_256_8bit 0.0 255
 /begin AXIS_DESCR FIX_AXIS NO_INPUT_QUANTITY CM_Equaloutput1 9 -28.0 36.0 MAX_GRAD 0.0 /begin FIX_AXIS_PAR_LIST -28 -20 -12 -4 4 12 20 28 36 /end FIX_AXIS_PAR_LIST /end AXIS_DESCR
 /begin AXIS_DESCR COM_AXIS NO_INPUT_QUANTITY CM_Equaloutput1 17 0.0 16383.75 AXIS_PTS_REF CA_EngSpd17Step1 MAX_GRAD 0.0 /end AXIS_DESCR
/end CHARACTERISTIC
/begin CHARACTERISTIC CT_BSTPWithoutControl "cal comments" CURVE 0x8FA6 2D_Array_UB 0 CM_kpa_0_256_8bit 0.0 255
 /begin AXIS_DESCR COM_AXIS NO_INPUT_QUANTITY CM_Equaloutput1 17 0.0 16383.75 AXIS_PTS_REF CA_EngSpd17Step1 MAX_GRAD 0.0 /end AXIS_DESCR
/end CHARACTERISTIC
/begin CHARACTERISTIC CT_BSTPFactorIATCorr "cal comments" CURVE 0x91C2 2D_Array_UB 0.0 CM_Mult0_to_2_ratio 0.0 1.9921875
 /begin AXIS_DESCR FIX_AXIS NO_INPUT_QUANTITY CM_Equaloutput1 9 -28.0 36.0 MAX_GRAD 0.0 /begin FIX_AXIS_PAR_LIST -28 -20 -12 -4 4 12 20 28 36 /end FIX_AXIS_PAR_LIST /end AXIS_DESCR
/end CHARACTERISTIC
/begin CHARACTERISTIC C_IgnCoil_Prot_Current "cal comments" CURVE 0x8064 2D_Array_UB 0.0 CM_Count1 0.0 255.0
 /begin AXIS_DESCR FIX_AXIS NO_INPUT_QUANTITY CM_EOI 4 0.0 4.0 MAX_GRAD 0.0 /begin FIX_AXIS_PAR_LIST 0 1 2 3 /end FIX_AXIS_PAR_LIST /end AXIS_DESCR
/end CHARACTERISTIC
/begin CHARACTERISTIC C_IgnCoil_STG_Threhold "cal comments" CURVE 0x8068 2D_Array_UB 0.0 CM_Count1 0.0 255.0
 /begin AXIS_DESCR FIX_AXIS NO_INPUT_QUANTITY CM_EOI 4 0.0 4.0 MAX_GRAD 0.0 /begin FIX_AXIS_PAR_LIST 0 1 2 3 /end FIX_AXIS_PAR_LIST /end AXIS_DESCR
/end CHARACTERISTIC
/begin CHARACTERISTIC C_InjectorType "cal comments" CURVE 0x806C 2D_Array_UB 0.0 CM_Count1 0.0 255.0
 /begin AXIS_DESCR FIX_AXIS NO_INPUT_QUANTITY CM_EOI 4 0.0 4.0 MAX_GRAD 0.0 /begin FIX_AXIS_PAR_LIST 0 1 2 3 /end FIX_AXIS_PAR_LIST /end AXIS_DESCR
/end CHARACTERISTIC
/begin CHARACTERISTIC C_IGNOffDelayTime "cal comments" VALUE 0xB47C Scalar_UW 0.0 CM_Second_0to512 0.0 511.9921875 /end CHARACTERISTIC
/begin CHARACTERISTIC C_IGNOnDelay "cal comments" VALUE 0xB4E8 Scalar_UW 0.0 CM_Second_0to512 0.0 511.9921875 /end CHARACTERISTIC
/begin CHARACTERISTIC C_IGNOnDelayEngSpdThreshHi "cal comments" VALUE 0xB4EC Scalar_UW 0.0 CM_RPM_0to16384 0.0 16383.75 /end CHARACTERISTIC
/begin CHARACTERISTIC C_IGNOnDelayEngSpdThreshLo "cal comments" VALUE 0xB4EA Scalar_UW 0.0 CM_RPM_0to16384 0.0 16383.75 /end CHARACTERISTIC
/begin CHARACTERISTIC C_IGNOnVoltThreshHi "cal comments" VALUE 0xB478 Scalar_UW 0.0 CM_Volt_0to32_1 0.0 31.99900627136231 /end CHARACTERISTIC
/begin CHARACTERISTIC C_IGNOnVoltThreshLo "cal comments" VALUE 0xB47A Scalar_UW 0.0 CM_Volt_0to32_1 0.0 31.99900627136231 /end CHARACTERISTIC
/begin CHARACTERISTIC C_IGNVoltFiltCoef "cal comments" VALUE 0xB47E Scalar_UW 0.0 CM_FiltCoef 0.0 0.9999847412109375 /end CHARACTERISTIC
/begin CHARACTERISTIC C_InjectorFlow "cal comments" VALUE 0x9222 Scalar_UW 0.0 CM_GramPerSecond 0.0 15.999755859375 /end CHARACTERISTIC
/begin CHARACTERISTIC C_ValveFlow "cal comments" VALUE 0x9224 Scalar_UW 0.0 CM_GramPerSecond 0.0 15.999755859375 /end CHARACTERISTIC
/begin CHARACTERISTIC C_IntakeAirTempDefault "cal comments" VALUE 0xB4E0 Scalar_SW 0.0 CM_DegC_N256to256 -256.0 255.9921875 /end CHARACTERISTIC
/begin CHARACTERISTIC C_IntakeAirTempFiltCoef "cal comments" VALUE 0xB46C Scalar_UW 0.0 CM_FiltCoef 0.0 0.9999847412109375 /end CHARACTERISTIC
/begin CHARACTERISTIC C_MAPCIDEnable "cal comments" VALUE 0xB01F Scalar_UB 0.0 CM_Boolean4 0.0 1.0 /end CHARACTERISTIC
/begin CHARACTERISTIC C_MAPCIDEngSpdErrorThresh "cal comments" VALUE 0xB4A0 Scalar_SW 0.0 CM_RPM_n8192to8192 -8192.0 8191.75 /end CHARACTERISTIC
/begin CHARACTERISTIC C_MAPCIDEngSpdThreshHi "cal comments" VALUE 0xB49C Scalar_UW 0.0 CM_RPM_0to16384 0.0 16383.75 /end CHARACTERISTIC
/begin CHARACTERISTIC C_MAPCIDEngSpdThreshLo "cal comments" VALUE 0xB49E Scalar_UW 0.0 CM_RPM_0to16384 0.0 16383.75 /end CHARACTERISTIC
/begin CHARACTERISTIC C_MAPCIDMAPFiltCoef "cal comments" VALUE 0xB4A8 Scalar_UW 0.0 CM_FiltCoef 0.0 0.9999847412109375 /end CHARACTERISTIC
/begin CHARACTERISTIC C_MAPCIDMAPThresh "cal comments" VALUE 0xB4A6 Scalar_UW 0.0 CM_kpa_0to256_1 0.0 255.99609375 /end CHARACTERISTIC
/begin CHARACTERISTIC C_MAPCIDTPSDeltaThresh "cal comments" VALUE 0xB346 Scalar_SW 0.0 CM_Percent_N200to200 -199.9999847412109 199.9938812255859 /end CHARACTERISTIC
/begin CHARACTERISTIC C_MAPFiltCoef "cal comments" VALUE 0xB4C6 Scalar_UW 0.0 CM_FiltCoef 0.0 0.9999847412109375 /end CHARACTERISTIC
/begin CHARACTERISTIC C_MAPMaxLimit "cal comments" VALUE 0xB4AA Scalar_UW 0.0 CM_kpa_0to256_1 0.0 255.99609375 /end CHARACTERISTIC
/begin CHARACTERISTIC C_MAPMinLimit "cal comments" VALUE 0xB4AC Scalar_UW 0.0 CM_kpa_0to256_1 0.0 255.99609375 /end CHARACTERISTIC
/begin CHARACTERISTIC C_MAPReadingAngleMaxLimit "cal comments" VALUE 0xB4D8 Scalar_UW 0.0 CM_CrankAngle_0to1024 0.0 1023.984375 /end CHARACTERISTIC
/begin CHARACTERISTIC C_MAPReadingAngleMinLimit "cal comments" VALUE 0xB4DA Scalar_UW 0.0 CM_CrankAngle_0to1024 0.0 1023.984375 /end CHARACTERISTIC
/begin CHARACTERISTIC C_MAPSignalConvIntercept "cal comments" VALUE 0xB482 Scalar_SW 0.0 CM_Ratio_n128to128 -128.0 127.99609375 /end CHARACTERISTIC
/begin CHARACTERISTIC C_MAPSignalConvSlope "cal comments" VALUE 0xB480 Scalar_UW 0.0 CM_kpa_0to512_1 0.0 511.9921875 /end CHARACTERISTIC
/begin CHARACTERISTIC C_FPSignalConvIntercept "cal comments" VALUE 0xBB52 Scalar_SW 0.0 CM_Ratio_n128to128 -128.0 127.99609375 /end CHARACTERISTIC
/begin CHARACTERISTIC C_FPSignalConvSlope "cal comments" VALUE 0xBB50 Scalar_SW 0.0 CM_Ratio_n512to512 -512.0 511.984375 /end CHARACTERISTIC
/begin CHARACTERISTIC C_FPFiltCoef "cal comments" VALUE 0xBB54 Scalar_UW 0.0 CM_FiltCoef 0.0 0.9999847412109375 /end CHARACTERISTIC
/begin CHARACTERISTIC C_BSTPSignalConvIntercept "cal comments" VALUE 0xB920 Scalar_SW 0.0 CM_Ratio_n128to128 -128.0 127.99609375 /end CHARACTERISTIC
/begin CHARACTERISTIC C_BSTPSignalConvSlope "cal comments" VALUE 0xB91E Scalar_UW 0.0 CM_kpa_0to512_1 0.0 511.9921875 /end CHARACTERISTIC
/begin CHARACTERISTIC C_BSTPFiltCoef "cal comments" VALUE 0xB922 Scalar_UW 0.0 CM_FiltCoef 0.0 0.9999847412109375 /end CHARACTERISTIC
/begin CHARACTERISTIC CT_BSTCDutyCycleBase "cal comments" MAP 0xB928 3D_Array_UW 0.0 CM_Percent_0to200_2 0.0 199.9969024658203
 /begin AXIS_DESCR COM_AXIS NO_INPUT_QUANTITY CM_Equaloutput1 22 0.0 255.99609375 AXIS_PTS_REF CA_MAP22Step1 MAX_GRAD 0.0 /end AXIS_DESCR
 /begin AXIS_DESCR COM_AXIS NO_INPUT_QUANTITY CM_Equaloutput1 15 0.0 255.99609375 AXIS_PTS_REF CA_MAP15Step1 MAX_GRAD 0.0 /end AXIS_DESCR
/end CHARACTERISTIC
/begin CHARACTERISTIC C_BSTCPWMFrequency "cal comments" VALUE 0xBB26 Scalar_UW 0.0 CM_Hz_0to16384 0.0 16383.75 /end CHARACTERISTIC
/begin CHARACTERISTIC C_WPSignalConvIntercept "cal comments" VALUE 0xBB4C Scalar_SW 0.0 CM_Ratio_n8to8 -8.0 7.999755859375 /end CHARACTERISTIC
/begin CHARACTERISTIC C_WPSignalConvSlope "cal comments" VALUE 0xBB4A Scalar_UW 0.0 CM_mpa_0to16_1 0.0 15.999755859375 /end CHARACTERISTIC
/begin CHARACTERISTIC C_MaxBatteryVoltForO2Heater "cal comments" VALUE 0x91F2 Scalar_UW 0.0 CM_Volt_0to32_1 0.0 31.99900627136231 /end CHARACTERISTIC
/begin CHARACTERISTIC C_MaxDwellMult "cal comments" VALUE 0x800D Scalar_UB 0.0 CM_Mult_0to2 0.0 1.9921875 /end CHARACTERISTIC
/begin CHARACTERISTIC C_MinDwellMult "cal comments" VALUE 0x800C Scalar_UB 0.0 CM_Mult_0to2 0.0 1.9921875 /end CHARACTERISTIC
/begin CHARACTERISTIC C_MinRefPeriodUpdtMinEngSpd "cal comments" VALUE 0xB490 Scalar_UW 0.0 CM_Second_0to512 0.0 511.9921875 /end CHARACTERISTIC
/begin CHARACTERISTIC C_NVMForceReset "cal comments" VALUE 0x91CB Scalar_UB 0.0 CM_Boolean2 0.0 1.0 /end CHARACTERISTIC
/begin CHARACTERISTIC C_O2ErrorMaxLimit "cal comments" VALUE 0x9C0E Scalar_UW 0.0 CM_mVolt_1 0.0 1023.96875 /end CHARACTERISTIC
/begin CHARACTERISTIC C_O2FiltVoltInitValue "cal comments" VALUE 0x9B7E Scalar_UW 0.0 CM_mVolt_1 0.0 1023.96875 /end CHARACTERISTIC
/begin CHARACTERISTIC C_O2HeaterAccFuelMassUpdateTime "cal comments" VALUE 0x91F6 Scalar_UW 0.0 CM_Second_0to4096 0.0 4095.9375 /end CHARACTERISTIC
/begin CHARACTERISTIC C_O2HeaterCoolantTempThresh "cal comments" VALUE 0x91CC Scalar_SW 0.0 CM_DegC_N256to256 -256.0 255.9921875 /end CHARACTERISTIC
/begin CHARACTERISTIC C_O2HeaterDCNormFactor "cal comments" VALUE 0xB054 Scalar_UB 0.0 CM_Mult0_to_2_ratio 0.0 1.9921875 /end CHARACTERISTIC
/begin CHARACTERISTIC C_O2HeaterDCReducedEngSpdThrsh "cal comments" VALUE 0xB056 Scalar_UW 0.0 CM_RPM_0to16384 0.0 16383.75 /end CHARACTERISTIC
/begin CHARACTERISTIC C_O2HeaterDCReducedFactor "cal comments" VALUE 0xB055 Scalar_UB 0.0 CM_Mult0_to_2_ratio 0.0 1.9921875 /end CHARACTERISTIC
/begin CHARACTERISTIC C_O2HeaterDCReducedMAPThrsh "cal comments" VALUE 0xB058 Scalar_UW 0.0 CM_kpa_0to256_1 0.0 255.99609375 /end CHARACTERISTIC
/begin CHARACTERISTIC C_O2HeaterEnbKeyOnDelay "cal comments" VALUE 0x91F8 Scalar_UW 0.0 CM_Second_0to4096 0.0 4095.9375 /end CHARACTERISTIC
/begin CHARACTERISTIC C_O2HeaterPWMFrequency "cal comments" VALUE 0xB052 Scalar_UW 0.0 CM_Hz_0to16384 0.0 16383.75 /end CHARACTERISTIC
/begin CHARACTERISTIC C_O2ReadyResetTimeThresh "cal comments" VALUE 0x9B6A Scalar_UW 0.0 CM_Second_0to1024 0.0 1023.984375 /end CHARACTERISTIC
/begin CHARACTERISTIC C_O2ReadyThresh "cal comments" VALUE 0x9B68 Scalar_UW 0.0 CM_mVolt_1 0.0 1023.96875 /end CHARACTERISTIC
/begin CHARACTERISTIC C_O2ReadyTimeThresh "cal comments" VALUE 0x9B6C Scalar_UW 0.0 CM_Second_0to1024 0.0 1023.984375 /end CHARACTERISTIC
/begin CHARACTERISTIC C_PEIdleWithAFROLEngSpdThresh "cal comments" VALUE 0x9D76 Scalar_UW 0.0 CM_RPM_0to16384 0.0 16383.75 /end CHARACTERISTIC
/begin CHARACTERISTIC C_PowerdownDelayTime "cal comments" VALUE 0xB474 Scalar_UW 0.0 CM_Second_0to512 0.0 511.9921875 /end CHARACTERISTIC
/begin CHARACTERISTIC C_PowerEnrichDsblTPSThrshHyst "cal comments" VALUE 0x9D74 Scalar_UW 0.0 CM_Percent_0to200_2 0.0 199.9969024658203 /end CHARACTERISTIC
/begin CHARACTERISTIC C_PrimePulseForceEnb "cal comments" VALUE 0x978A Scalar_UB 0.0 CM_Boolean1 0.0 1.0 /end CHARACTERISTIC
/begin CHARACTERISTIC C_PrimeToSequentialFuelDelay "cal comments" VALUE 0x9226 Scalar_UB 0.0 CM_Count1 0.0 255.0 /end CHARACTERISTIC
/begin CHARACTERISTIC C_ReferenceBaro "cal comments" VALUE 0xB3CA Scalar_UW 0.0 CM_kpa_0to256_1 0.0 255.99609375 /end CHARACTERISTIC
/begin CHARACTERISTIC C_RunToCrankEngSpdThresh "cal comments" VALUE 0xB46A Scalar_UW 0.0 CM_RPM_0to16384 0.0 16383.75 /end CHARACTERISTIC
/begin CHARACTERISTIC C_SMTR_LowActive "cal comments" VALUE 0xA168 Scalar_UB 0.0 CM_Boolean6 0.0 255.0 /end CHARACTERISTIC
/begin CHARACTERISTIC C_SMTR_FaultStart_Forbid "cal comments" VALUE 0xA169 Scalar_UB 0.0 CM_Boolean6 0.0 255.0 /end CHARACTERISTIC
/begin CHARACTERISTIC C_SMTR_IGN_Start "cal comments" VALUE 0xA16A Scalar_UB 0.0 CM_Boolean6 0.0 255.0 /end CHARACTERISTIC
/begin CHARACTERISTIC C_SMTR_t_Duration "cal comments" VALUE 0xA16C Scalar_UW 0.0 CM_Seconds_1 0.0 2047.96875 /end CHARACTERISTIC
/begin CHARACTERISTIC C_SMTR_t_Interval "cal comments" VALUE 0xA16E Scalar_UW 0.0 CM_Seconds_1 0.0 2047.96875 /end CHARACTERISTIC
/begin CHARACTERISTIC C_SMTR_t_Button_Delay "cal comments" VALUE 0xA172 Scalar_UW 0.0 CM_Seconds_1 0.0 2047.96875 /end CHARACTERISTIC
/begin CHARACTERISTIC C_SMTR_c_Attempt "cal comments" VALUE 0xA170 Scalar_UB 0.0 CM_Count3 0.0 255.0 /end CHARACTERISTIC
/begin CHARACTERISTIC C_SMTR_DutyCycle "cal comments" VALUE 0xA174 Scalar_UW 0.0 CM_Percent_0to200_2 0.0 199.9969024658203 /end CHARACTERISTIC
/begin CHARACTERISTIC C_FUEL_STP_En "cal comments" VALUE 0xBB30 Scalar_UB 0.0 CM_Boolean6 0.0 255.0 /end CHARACTERISTIC
/begin CHARACTERISTIC C_FUEL_STP_LowActive "cal comments" VALUE 0xBB31 Scalar_UB 0.0 CM_Boolean6 0.0 255.0 /end CHARACTERISTIC
/begin CHARACTERISTIC CT_ETCMSprTPSHigh "cal comments" CURVE 0xA190 2D_Array_UB 0.0 CM_Percent_0to100 0.0 99.609375
 /begin AXIS_DESCR COM_AXIS NO_INPUT_QUANTITY CM_Percent_0to200_2 11 0.0 199.9969024658203 AXIS_PTS_REF CA_TPS11Step MAX_GRAD 0.0 /end AXIS_DESCR
/end CHARACTERISTIC
/begin CHARACTERISTIC CT_ETCMSprTPSLow "cal comments" CURVE 0xA19D 2D_Array_UB 0.0 CM_Percent_0to100 0.0 99.609375
 /begin AXIS_DESCR COM_AXIS NO_INPUT_QUANTITY CM_Percent_0to200_2 11 0.0 199.9969024658203 AXIS_PTS_REF CA_TPS11Step MAX_GRAD 0.0 /end AXIS_DESCR
/end CHARACTERISTIC
/begin CHARACTERISTIC CT_ETCMDerivTPSHigh "cal comments" CURVE 0xA1AA 2D_Array_UB 0.0 CM_Percent_0to100 0.0 99.609375
 /begin AXIS_DESCR COM_AXIS NO_INPUT_QUANTITY CM_Percent_0to200_2 11 0.0 199.9969024658203 AXIS_PTS_REF CA_TPS11Step MAX_GRAD 0.0 /end AXIS_DESCR
/end CHARACTERISTIC
/begin CHARACTERISTIC CT_ETCMDerivTPSLow "cal comments" CURVE 0xA1B7 2D_Array_UB 0.0 CM_Percent_0to100 0.0 99.609375
 /begin AXIS_DESCR COM_AXIS NO_INPUT_QUANTITY CM_Percent_0to200_2 11 0.0 199.9969024658203 AXIS_PTS_REF CA_TPS11Step MAX_GRAD 0.0 /end AXIS_DESCR
/end CHARACTERISTIC
/begin CHARACTERISTIC CT_ETCMPropTPSHigh "cal comments" CURVE 0xA1C4 2D_Array_UB 0.0 CM_Percent_0to100 0.0 99.609375
 /begin AXIS_DESCR COM_AXIS NO_INPUT_QUANTITY CM_Percent_0to200_2 11 0.0 199.9969024658203 AXIS_PTS_REF CA_TPS11Step MAX_GRAD 0.0 /end AXIS_DESCR
/end CHARACTERISTIC
/begin CHARACTERISTIC CT_ETCMPropTPSLow "cal comments" CURVE 0xA1D1 2D_Array_UB 0.0 CM_Percent_0to100 0.0 99.609375
 /begin AXIS_DESCR COM_AXIS NO_INPUT_QUANTITY CM_Percent_0to200_2 11 0.0 199.9969024658203 AXIS_PTS_REF CA_TPS11Step MAX_GRAD 0.0 /end AXIS_DESCR
/end CHARACTERISTIC
/begin CHARACTERISTIC CT_ETCMIntGainTPSHigh "cal comments" CURVE 0xA1DE 2D_Array_UB 0.0 CM_Mult0_to_2_ratio1 0.0 1.9921875
 /begin AXIS_DESCR COM_AXIS NO_INPUT_QUANTITY CM_Percent_0to200_2 11 0.0 199.9969024658203 AXIS_PTS_REF CA_TPS11Step MAX_GRAD 0.0 /end AXIS_DESCR
/end CHARACTERISTIC
/begin CHARACTERISTIC CT_ETCMIntGainTPSLow "cal comments" CURVE 0xA1EB 2D_Array_UB 0.0 CM_Mult0_to_2_ratio1 0.0 1.9921875
 /begin AXIS_DESCR COM_AXIS NO_INPUT_QUANTITY CM_Percent_0to200_2 11 0.0 199.9969024658203 AXIS_PTS_REF CA_TPS11Step MAX_GRAD 0.0 /end AXIS_DESCR
/end CHARACTERISTIC
/begin CHARACTERISTIC CT_ETCM_LTermOpenMax "cal comments" CURVE 0xA1F8 2D_Array_UB 0.0 CM_Percent_0to200_3 0.0 199.21875
 /begin AXIS_DESCR FIX_AXIS NO_INPUT_QUANTITY CM_Equaloutput1 9 6.400000095367432 19.20000076293945 MAX_GRAD 0.0 /begin FIX_AXIS_PAR_LIST 6.4 8 9.6 11.2 12.8 14.4 16 17.6 19.2 /end FIX_AXIS_PAR_LIST /end AXIS_DESCR
/end CHARACTERISTIC
/begin CHARACTERISTIC CT_ETCM_LTermCloseMax "cal comments" CURVE 0xA203 2D_Array_UB 0.0 CM_Percent_0to200_3 0.0 199.21875
 /begin AXIS_DESCR FIX_AXIS NO_INPUT_QUANTITY CM_Equaloutput1 9 6.400000095367432 19.20000076293945 MAX_GRAD 0.0 /begin FIX_AXIS_PAR_LIST 6.4 8 9.6 11.2 12.8 14.4 16 17.6 19.2 /end FIX_AXIS_PAR_LIST /end AXIS_DESCR
/end CHARACTERISTIC
/begin CHARACTERISTIC C_ETCM_AntiFrictClsPulse "cal comments" VALUE 0xA20C Scalar_UW 0.0 CM_Percent_0to200_2 0.0 199.9969024658203 /end CHARACTERISTIC
/begin CHARACTERISTIC C_ETCM_AntiFrictOpnPulse "cal comments" VALUE 0xA20E Scalar_UW 0.0 CM_Percent_0to200_2 0.0 199.9969024658203 /end CHARACTERISTIC
/begin CHARACTERISTIC C_DC_ETCM_OpeningMax "cal comments" VALUE 0xA214 Scalar_UW 0.0 CM_Percent_0to200_2 0.0 199.9969024658203 /end CHARACTERISTIC
/begin CHARACTERISTIC C_DC_ETCM_ClosingMax "cal comments" VALUE 0xA216 Scalar_UW 0.0 CM_Percent_0to200_2 0.0 199.9969024658203 /end CHARACTERISTIC
/begin CHARACTERISTIC C_ETCM_AboveLTDCTime "cal comments" VALUE 0xA218 Scalar_UW 0.0 CM_Second_0to512 0.0 511.9921875 /end CHARACTERISTIC
/begin CHARACTERISTIC C_ETCM_ClipLTDCTime "cal comments" VALUE 0xA21A Scalar_UW 0.0 CM_Second_0to512 0.0 511.9921875 /end CHARACTERISTIC
/begin CHARACTERISTIC C_ETCMSprTPSDeadBand "cal comments" VALUE 0xA21E Scalar_UW 0.0 CM_Percent_0to200_2 0.0 199.9969024658203 /end CHARACTERISTIC
/begin CHARACTERISTIC C_ETCMFricTPSDeadBand "cal comments" VALUE 0xA220 Scalar_UW 0.0 CM_Percent_0to200_2 0.0 199.9969024658203 /end CHARACTERISTIC
/begin CHARACTERISTIC C_ETCMDerivTPSHiDeadBand "cal comments" VALUE 0xA222 Scalar_UW 0.0 CM_Percent_0to200_2 0.0 199.9969024658203 /end CHARACTERISTIC
/begin CHARACTERISTIC C_ETCMDerivTPSLoDeadBand "cal comments" VALUE 0xA224 Scalar_UW 0.0 CM_Percent_0to200_2 0.0 199.9969024658203 /end CHARACTERISTIC
/begin CHARACTERISTIC C_ETCMPropTPSHiDeadBand "cal comments" VALUE 0xA226 Scalar_UW 0.0 CM_Percent_0to200_2 0.0 199.9969024658203 /end CHARACTERISTIC
/begin CHARACTERISTIC C_ETCMPropTPSLoDeadBand "cal comments" VALUE 0xA228 Scalar_UW 0.0 CM_Percent_0to200_2 0.0 199.9969024658203 /end CHARACTERISTIC
/begin CHARACTERISTIC C_ETCMIntTPSDeadBand "cal comments" VALUE 0xA22A Scalar_UW 0.0 CM_Percent_0to200_2 0.0 199.9969024658203 /end CHARACTERISTIC
/begin CHARACTERISTIC C_ETCMIntTPSDltRange "cal comments" VALUE 0xA22C Scalar_UW 0.0 CM_Percent_0to200_2 0.0 199.9969024658203 /end CHARACTERISTIC
/begin CHARACTERISTIC C_ETCM_IntegralNegLimit "cal comments" VALUE 0xA22E Scalar_SW 0.0 CM_Percent_N200to200 -199.9999847412109 199.9938812255859 /end CHARACTERISTIC
/begin CHARACTERISTIC C_ETCM_IntegralPosLimit "cal comments" VALUE 0xA230 Scalar_SW 0.0 CM_Percent_N200to200 -199.9999847412109 199.9938812255859 /end CHARACTERISTIC
/begin CHARACTERISTIC C_ETCM_SteeringDCmin "cal comments" VALUE 0xA232 Scalar_SW 0.0 CM_Percent_N200to200 -199.9999847412109 199.9938812255859 /end CHARACTERISTIC
/begin CHARACTERISTIC C_ETCM_SteeringDCmax "cal comments" VALUE 0xA234 Scalar_SW 0.0 CM_Percent_N200to200 -199.9999847412109 199.9938812255859 /end CHARACTERISTIC
/begin CHARACTERISTIC C_ETCM_UsedForSteering "cal comments" VALUE 0xA210 Scalar_UB 0.0 CM_Boolean6 0.0 255.0 /end CHARACTERISTIC
/begin CHARACTERISTIC C_ETCM_DirLogic "cal comments" VALUE 0xA211 Scalar_UB 0.0 CM_Boolean6 0.0 255.0 /end CHARACTERISTIC
/begin CHARACTERISTIC C_ETCM_Frequency "cal comments" VALUE 0xA21C Scalar_UW 0.0 CM_Hz_0to16384 0.0 16383.75 /end CHARACTERISTIC
/begin CHARACTERISTIC C_ETCM_IGNRef "cal comments" VALUE 0xA212 Scalar_UW 0.0 CM_Volt_0to32_1 0.0 31.99900627136231 /end CHARACTERISTIC
/begin CHARACTERISTIC C_U_GEN_VOLT_RESCALE "cal comments" VALUE 0x0 Scalar_UW 0.0 CM_Volt_0to1024_1 0.0 1023.984375 /end CHARACTERISTIC
/begin CHARACTERISTIC C_GENVFiltCoef "cal comments" VALUE 0x0 Scalar_UW 0.0 CM_FiltCoef 0.0 0.9999847412109375 /end CHARACTERISTIC
/begin CHARACTERISTIC C_GENVDesired "cal comments" VALUE 0x0 Scalar_UW 0.0 CM_Volt_0to1024_1 0.0 1023.984375 /end CHARACTERISTIC
/begin CHARACTERISTIC C_GENVPropVOLTHiDeadBand "cal comments" VALUE 0x0 Scalar_UW 0.0 CM_Volt_0to1024_1 0.0 1023.984375 /end CHARACTERISTIC
/begin CHARACTERISTIC C_GENVPropVOLTLoDeadBand "cal comments" VALUE 0x0 Scalar_UW 0.0 CM_Volt_0to1024_1 0.0 1023.984375 /end CHARACTERISTIC
/begin CHARACTERISTIC C_GENVIntVOLTDeadBand "cal comments" VALUE 0x0 Scalar_UW 0.0 CM_Volt_0to1024_1 0.0 1023.984375 /end CHARACTERISTIC
/begin CHARACTERISTIC C_GENVIntVOLTDltRange "cal comments" VALUE 0x0 Scalar_UW 0.0 CM_Volt_0to1024_1 0.0 1023.984375 /end CHARACTERISTIC
/begin CHARACTERISTIC CT_GENVPropVOLTHigh "cal comments" CURVE 0x2 2D_Array_UB 0.0 CM_Percent_0to100 0.0 99.609375
 /begin AXIS_DESCR COM_AXIS NO_INPUT_QUANTITY CM_Volt_0to1024_1 11 0.0 1023.984375 AXIS_PTS_REF CA_GENV11Step MAX_GRAD 0.0 /end AXIS_DESCR
/end CHARACTERISTIC
/begin CHARACTERISTIC CT_GENVPropVOLTLow "cal comments" CURVE 0x2 2D_Array_UB 0.0 CM_Percent_0to100 0.0 99.609375
 /begin AXIS_DESCR COM_AXIS NO_INPUT_QUANTITY CM_Volt_0to1024_1 11 0.0 1023.984375 AXIS_PTS_REF CA_GENV11Step MAX_GRAD 0.0 /end AXIS_DESCR
/end CHARACTERISTIC
/begin CHARACTERISTIC CT_GENVIntGainVOLTHigh "cal comments" CURVE 0x2 2D_Array_UB 0.0 CM_Mult0_to_2_ratio1 0.0 1.9921875
 /begin AXIS_DESCR COM_AXIS NO_INPUT_QUANTITY CM_Volt_0to1024_1 11 0.0 1023.984375 AXIS_PTS_REF CA_GENV11Step MAX_GRAD 0.0 /end AXIS_DESCR
/end CHARACTERISTIC
/begin CHARACTERISTIC CT_GENVIntGainVOLTLow "cal comments" CURVE 0x2 2D_Array_UB 0.0 CM_Mult0_to_2_ratio1 0.0 1.9921875
 /begin AXIS_DESCR COM_AXIS NO_INPUT_QUANTITY CM_Volt_0to1024_1 11 0.0 1023.984375 AXIS_PTS_REF CA_GENV11Step MAX_GRAD 0.0 /end AXIS_DESCR
/end CHARACTERISTIC
/begin CHARACTERISTIC D_TACHShortFailThresh "cal comments" VALUE 0xBC99 Scalar_UB 0.0 CM_Count1 0.0 255.0 /end CHARACTERISTIC
/begin CHARACTERISTIC C_SMTR_n_Rotate_Dsbl_Thrsh "cal comments" VALUE 0xA164 Scalar_UW 0.0 CM_RPM_0to16384 0.0 16383.75 /end CHARACTERISTIC
/begin CHARACTERISTIC C_SMTR_n_Rotate_Enbl_Thrsh "cal comments" VALUE 0xA166 Scalar_UW 0.0 CM_RPM_0to16384 0.0 16383.75 /end CHARACTERISTIC
/begin CHARACTERISTIC C_SACrankExitRampInterval "cal comments" VALUE 0xA26E Scalar_UW 0.0 CM_Second_0to1024 0.0 1023.984375 /end CHARACTERISTIC
/begin CHARACTERISTIC C_SACrankExitRampStep "cal comments" VALUE 0xA274 Scalar_SW 0.0 CM_SparkAngle_N256to256 -256.0 255.9921875 /end CHARACTERISTIC
/begin CHARACTERISTIC C_SANormalRampDownStep "cal comments" VALUE 0xA270 Scalar_SW 0.0 CM_SparkAngle_N256to256 -256.0 255.9921875 /end CHARACTERISTIC
/begin CHARACTERISTIC C_SANormalRampUpStep "cal comments" VALUE 0xA272 Scalar_SW 0.0 CM_SparkAngle_N256to256 -256.0 255.9921875 /end CHARACTERISTIC
/begin CHARACTERISTIC C_SparkAdvanceMaxLimit "cal comments" VALUE 0xA25A Scalar_SW 0.0 CM_SparkAngle_N256to256 -256.0 255.9921875 /end CHARACTERISTIC
/begin CHARACTERISTIC C_SparkAdvanceMinLimit "cal comments" VALUE 0xA25C Scalar_SW 0.0 CM_SparkAngle_N256to256 -256.0 255.9921875 /end CHARACTERISTIC
/begin CHARACTERISTIC C_SPRK_phi_DFCO "cal comments" VALUE 0xA25E Scalar_SW 0.0 CM_SparkAngle_N256to256 -256.0 255.9921875 /end CHARACTERISTIC
/begin CHARACTERISTIC C_SparkDeliverModeAfterCID "cal comments" VALUE 0xB4A2 Scalar_UB 0.0 CM_Boolean4 0.0 1.0 /end CHARACTERISTIC
/begin CHARACTERISTIC C_SparkDwellIATMultRumTimeThrsh "cal comments" VALUE 0xAFC2 Scalar_UW 0.0 CM_Second_0to65535 0.0 65535.0 /end CHARACTERISTIC
/begin CHARACTERISTIC C_SparkPETableUsed "cal comments" VALUE 0xAFC4 Scalar_UB 0.0 CM_Boolean1 0.0 1.0 /end CHARACTERISTIC
/begin CHARACTERISTIC C_IGNOff_Through_Spark "cal comments" VALUE 0xAFEB Scalar_UB 0.0 CM_Boolean1 0.0 1.0 /end CHARACTERISTIC
/begin CHARACTERISTIC C_SparkPowerOffDwell "cal comments" VALUE 0xAED8 Scalar_UW 0.0 CM_msec_0to1024 0.0 1023.984375 /end CHARACTERISTIC
/begin CHARACTERISTIC C_SpdCntrlDerivInterval "cal comments" VALUE 0xA159 Scalar_UB 0.0 CM_Count4 0.0 255.0 /end CHARACTERISTIC
/begin CHARACTERISTIC C_SpeedControlEnable "cal comments" VALUE 0xA062 Scalar_UB 0.0 CM_Count1 0.0 255.0 /end CHARACTERISTIC
/begin CHARACTERISTIC C_SpeedControlIntDerivLearnning "cal comments" VALUE 0xA064 Scalar_UB 0.0 CM_Boolean6 0.0 255.0 /end CHARACTERISTIC
/begin CHARACTERISTIC C_SpeedControlLvl0 "cal comments" VALUE 0xA032 Scalar_UW 0.0 CM_Percent_0to100_1 0.0 99.9984130859375 /end CHARACTERISTIC
/begin CHARACTERISTIC C_SpeedControlLvl1 "cal comments" VALUE 0xA034 Scalar_UW 0.0 CM_Percent_0to100_1 0.0 99.9984130859375 /end CHARACTERISTIC
/begin CHARACTERISTIC C_SpeedControlLvl2 "cal comments" VALUE 0xA036 Scalar_UW 0.0 CM_Percent_0to100_1 0.0 99.9984130859375 /end CHARACTERISTIC
/begin CHARACTERISTIC C_SpeedControlLvl3 "cal comments" VALUE 0xA038 Scalar_UW 0.0 CM_Percent_0to100_1 0.0 99.9984130859375 /end CHARACTERISTIC
/begin CHARACTERISTIC C_SpeedControlLvl4 "cal comments" VALUE 0xA03A Scalar_UW 0.0 CM_Percent_0to100_1 0.0 99.9984130859375 /end CHARACTERISTIC
/begin CHARACTERISTIC C_SpeedControlLvl5 "cal comments" VALUE 0xA03C Scalar_UW 0.0 CM_Percent_0to100_1 0.0 99.9984130859375 /end CHARACTERISTIC
/begin CHARACTERISTIC C_IDLEMotorDirChangeDelay "cal comments" VALUE 0xB5BA Scalar_UB 0.0 CM_Count4 0.0 255.0 /end CHARACTERISTIC
/begin CHARACTERISTIC C_IDLEMotorStartDelay "cal comments" VALUE 0xB5B8 Scalar_UB 0.0 CM_Count4 0.0 255.0 /end CHARACTERISTIC
/begin CHARACTERISTIC C_IDLEMotorStartDelaySteps "cal comments" VALUE 0xB5B9 Scalar_UB 0.0 CM_Count4 0.0 255.0 /end CHARACTERISTIC
/begin CHARACTERISTIC C_IDLEStepMotorHiEn "cal comments" VALUE 0xB5BB Scalar_UB 0.0 CM_Boolean6 0.0 255.0 /end CHARACTERISTIC
/begin CHARACTERISTIC C_IDLEStepMotorDir "cal comments" VALUE 0xB5BC Scalar_UB 0.0 CM_Boolean6 0.0 255.0 /end CHARACTERISTIC
/begin CHARACTERISTIC C_FCVMoveBatVoltMaxLimit "cal comments" VALUE 0xB5C6 Scalar_UW 0.0 CM_Volt_0to32_1 0.0 31.99900627136231 /end CHARACTERISTIC
/begin CHARACTERISTIC C_FCVMoveBatVoltMinLimit "cal comments" VALUE 0xB5C8 Scalar_UW 0.0 CM_Volt_0to32_1 0.0 31.99900627136231 /end CHARACTERISTIC
/begin CHARACTERISTIC C_FCVMotorDirChangeDelay "cal comments" VALUE 0xB5CC Scalar_UB 0.0 CM_Count4 0.0 255.0 /end CHARACTERISTIC
/begin CHARACTERISTIC C_FCVMotorStartDelay "cal comments" VALUE 0xB5CA Scalar_UB 0.0 CM_Count4 0.0 255.0 /end CHARACTERISTIC
/begin CHARACTERISTIC C_FCVMotorStartDelaySteps "cal comments" VALUE 0xB5CB Scalar_UB 0.0 CM_Count4 0.0 255.0 /end CHARACTERISTIC
/begin CHARACTERISTIC C_FCVStepMotorHiEn "cal comments" VALUE 0xB5CD Scalar_UB 0.0 CM_Boolean6 0.0 255.0 /end CHARACTERISTIC
/begin CHARACTERISTIC C_FCVStepMotorDir "cal comments" VALUE 0xB5CE Scalar_UB 0.0 CM_Boolean6 0.0 255.0 /end CHARACTERISTIC
/begin CHARACTERISTIC C_FCVPSCloseSlowZone "cal comments" VALUE 0xB5D2 Scalar_UW 0.0 CM_Percent_0to200_2 0.0 199.9969024658203 /end CHARACTERISTIC
/begin CHARACTERISTIC C_FCVMtrFCVPSDeltaOneStep "cal comments" VALUE 0xB5D0 Scalar_UW 0.0 CM_Percent_0to200_2 0.0 199.9969024658203 /end CHARACTERISTIC
/begin CHARACTERISTIC C_FCVPSFiltCoef "cal comments" VALUE 0xB91C Scalar_UW 0.0 CM_FiltCoef 0.0 0.9999847412109375 /end CHARACTERISTIC
/begin CHARACTERISTIC C_FCVPSOpenSlowZone "cal comments" VALUE 0xB5D4 Scalar_UW 0.0 CM_Percent_0to200_2 0.0 199.9969024658203 /end CHARACTERISTIC
/begin CHARACTERISTIC C_FCVPSSlope "cal comments" VALUE 0xB91A Scalar_UW 0.0 CM_Ratio_0to8 0.0 7.9998779296875 /end CHARACTERISTIC
/begin CHARACTERISTIC C_FCVPSZeroInitial "cal comments" VALUE 0xB918 Scalar_UW 0.0 CM_Percent_0to200_2 0.0 199.9969024658203 /end CHARACTERISTIC
/begin CHARACTERISTIC C_FCVPSMinimumLrnCntThresh "cal comments" VALUE 0xB5D6 Scalar_UB 0.0 CM_Count1 0.0 255.0 /end CHARACTERISTIC
/begin CHARACTERISTIC C_FCVLoopCounter "cal comments" VALUE 0xB5D7 Scalar_UB 0.0 CM_Count1 0.0 255.0 /end CHARACTERISTIC
/begin CHARACTERISTIC C_FCV_PstnMax "cal comments" VALUE 0xB5D8 Scalar_UB 0.0 CM_Count4 0.0 255.0 /end CHARACTERISTIC
/begin CHARACTERISTIC C_FCVStepMotorCLEn "cal comments" VALUE 0xB5D9 Scalar_UB 0.0 CM_Boolean6 0.0 255.0 /end CHARACTERISTIC
/begin CHARACTERISTIC C_FCVMotorParkDelay "cal comments" VALUE 0xB5EE Scalar_UW 0.0 CM_Count_0to65535 0.0 65535.0 /end CHARACTERISTIC
/begin CHARACTERISTIC CT_FCVPS_ParkPstn "cal comments" CURVE 0xB5DC 2D_Array_UB 0.0 CM_Percent_0to100 0.0 99.609375
 /begin AXIS_DESCR FIX_AXIS NO_INPUT_QUANTITY CM_Equaloutput1 17 -28.0 164.0 MAX_GRAD 0.0 /begin FIX_AXIS_PAR_LIST -28 -16 -4 8 20 32 44 56 68 80 92 104 116 128 140 152 164 /end FIX_AXIS_PAR_LIST /end AXIS_DESCR
/end CHARACTERISTIC
/begin CHARACTERISTIC CT_FCVPSCorrFactor "cal comments" MAP 0xB64B 3D_Array_UB 0.0 CM_Mult0_to_2_ratio 0.0 1.9921875
 /begin AXIS_DESCR COM_AXIS NO_INPUT_QUANTITY CM_Equaloutput1 12 0.0 511.9921875 AXIS_PTS_REF CA_MAP12Step1 MAX_GRAD 0.0 /end AXIS_DESCR
 /begin AXIS_DESCR FIX_AXIS NO_INPUT_QUANTITY CM_Equaloutput1 11 55.0 105.0 MAX_GRAD 0.0 /begin FIX_AXIS_PAR_LIST 55 60 65 70 75 80 85 90 95 100 105 /end FIX_AXIS_PAR_LIST /end AXIS_DESCR
/end CHARACTERISTIC
/begin CHARACTERISTIC CT_DesireFCVPS_NG "cal comments" MAP 0xB6D2 3D_Array_UB 0.0 CM_Percent_0to100 0.0 99.609375
 /begin AXIS_DESCR COM_AXIS NO_INPUT_QUANTITY CM_Equaloutput1 17 0.0 511.9921875 AXIS_PTS_REF CA_AirGramStep17 MAX_GRAD 0.0 /end AXIS_DESCR
 /begin AXIS_DESCR COM_AXIS NO_INPUT_QUANTITY CM_Equaloutput1 17 0.0 15.999755859375 AXIS_PTS_REF CA_FuelGramStep17 MAX_GRAD 0.0 /end AXIS_DESCR
/end CHARACTERISTIC
/begin CHARACTERISTIC CT_DesireFCVPS_LPG "cal comments" MAP 0xB7F6 3D_Array_UB 0.0 CM_Percent_0to100 0.0 99.609375
 /begin AXIS_DESCR COM_AXIS NO_INPUT_QUANTITY CM_Equaloutput1 17 0.0 511.9921875 AXIS_PTS_REF CA_AirGramStep17 MAX_GRAD 0.0 /end AXIS_DESCR
 /begin AXIS_DESCR COM_AXIS NO_INPUT_QUANTITY CM_Equaloutput1 17 0.0 15.999755859375 AXIS_PTS_REF CA_FuelGramStep17 MAX_GRAD 0.0 /end AXIS_DESCR
/end CHARACTERISTIC
/begin CHARACTERISTIC C_TachOutOption "cal comments" VALUE 0x8060 Scalar_UB 0.0 CM_Enum_0to4 0.0 255.0 /end CHARACTERISTIC
/begin CHARACTERISTIC C_TargetWheelErrorOfst "cal comments" VALUE 0xB4E6 Scalar_SW 0.0 CM_SparkAngle_N256to256 -256.0 255.9921875 /end CHARACTERISTIC
/begin CHARACTERISTIC C_TeethNumBeforeSync "cal comments" VALUE 0x800B Scalar_UB 0.0 CM_Count1 0.0 255.0 /end CHARACTERISTIC
/begin CHARACTERISTIC C_IDLETPSCloseSlowZone "cal comments" VALUE 0xB5C0 Scalar_UW 0.0 CM_Percent_0to200_2 0.0 199.9969024658203 /end CHARACTERISTIC
/begin CHARACTERISTIC C_IDLEMtrTPSDeltaOneStep "cal comments" VALUE 0xB5BE Scalar_UW 0.0 CM_Percent_0to200_2 0.0 199.9969024658203 /end CHARACTERISTIC
/begin CHARACTERISTIC C_TPSFiltCoef "cal comments" VALUE 0xB342 Scalar_UW 0.0 CM_FiltCoef 0.0 0.9999847412109375 /end CHARACTERISTIC
/begin CHARACTERISTIC C_IDLETPSMinimumLrnCntThresh "cal comments" VALUE 0xB5C4 Scalar_UB 0.0 CM_Count1 0.0 255.0 /end CHARACTERISTIC
/begin CHARACTERISTIC C_IDLETPSOpenSlowZone "cal comments" VALUE 0xB5C2 Scalar_UW 0.0 CM_Percent_0to200_2 0.0 199.9969024658203 /end CHARACTERISTIC
/begin CHARACTERISTIC C_TPSSensorPresent "cal comments" VALUE 0x8038 Scalar_UB 0.0 CM_Boolean4 0.0 1.0 /end CHARACTERISTIC
/begin CHARACTERISTIC C_TPSSlope "cal comments" VALUE 0xB344 Scalar_UW 0.0 CM_Ratio_0to8 0.0 7.9998779296875 /end CHARACTERISTIC
/begin CHARACTERISTIC C_TPSSpdCtrlMinimum "cal comments" VALUE 0xA0BE Scalar_UW 0.0 CM_Percent_0to200_2 0.0 199.9969024658203 /end CHARACTERISTIC
/begin CHARACTERISTIC C_TPSZeroInitialDefault "cal comments" VALUE 0xB340 Scalar_UW 0.0 CM_Percent_0to200_2 0.0 199.9969024658203 /end CHARACTERISTIC
/begin CHARACTERISTIC C_TransientFuelEnable "cal comments" VALUE 0x9686 Scalar_UB 0.0 CM_Boolean1 0.0 1.0 /end CHARACTERISTIC
/begin CHARACTERISTIC C_TrimPulseEnbEngSpdThresh "cal comments" VALUE 0x9DBC Scalar_UW 0.0 CM_RPM_0to16384 0.0 16383.75 /end CHARACTERISTIC
/begin CHARACTERISTIC C_TrimPulseEnbEngSpdThreshHyst "cal comments" VALUE 0x9DBE Scalar_UW 0.0 CM_RPM_0to16384 0.0 16383.75 /end CHARACTERISTIC
/begin CHARACTERISTIC C_TrimPulseScalarCyl "cal comments" CURVE 0x9DB4 2D_Array_UW 0.0 CM_Ratio_0to2_2 0.0 1.999969482421875
 /begin AXIS_DESCR FIX_AXIS NO_INPUT_QUANTITY CM_EOI 4 0.0 4.0 MAX_GRAD 0.0 /begin FIX_AXIS_PAR_LIST 0 1 2 3 /end FIX_AXIS_PAR_LIST /end AXIS_DESCR
/end CHARACTERISTIC
/begin CHARACTERISTIC C_TrimPulseWidthMinLimit "cal comments" VALUE 0x9DB2 Scalar_UW 0.0 CM_msec_0to1024 0.0 1023.984375 /end CHARACTERISTIC
/begin CHARACTERISTIC C_TwoCylinderEngine "cal comments" VALUE 0xB020 Scalar_UB 0.0 CM_Boolean4 0.0 1.0 /end CHARACTERISTIC
/begin CHARACTERISTIC C_ValidToothOccurredResetTime "cal comments" VALUE 0xB494 Scalar_UW 0.0 CM_Second_0to512 0.0 511.9921875 /end CHARACTERISTIC
/begin CHARACTERISTIC CT_AccEnrichDecayFactorCoolTemp "cal comments" CURVE 0x9A22 2D_Array_UB 0.0 CM_Mult_0to1 0.0 0.99609375
 /begin AXIS_DESCR FIX_AXIS NO_INPUT_QUANTITY CM_Equaloutput1 17 -28.0 164.0 MAX_GRAD 0.0 /begin FIX_AXIS_PAR_LIST -28 -16 -4 8 20 32 44 56 68 80 92 104 116 128 140 152 164 /end FIX_AXIS_PAR_LIST /end AXIS_DESCR
/end CHARACTERISTIC
/begin CHARACTERISTIC CT_AccEnrichDecayFactorEngSpd "cal comments" CURVE 0x9302 2D_Array_UB 0.0 CM_Mult_0to1_2 0.0 0.99609375
 /begin AXIS_DESCR COM_AXIS NO_INPUT_QUANTITY CM_Equaloutput1 17 0.0 16383.75 AXIS_PTS_REF CA_EngSpd17Step1 MAX_GRAD 0.0 /end AXIS_DESCR
/end CHARACTERISTIC
/begin CHARACTERISTIC CT_AEDeltaFuelMultBase "cal comments" CURVE 0x9328 2D_Array_UW 0.0 CM_Grams0to8 0.0 7.999755859375
 /begin AXIS_DESCR FIX_AXIS NO_INPUT_QUANTITY CM_Equaloutput1 18 0.0 1.700000092387199e-002 MAX_GRAD 0.0
  /begin FIX_AXIS_PAR_LIST 0 1.e-003 2.e-003 3.e-003 4.e-003 5.e-003 6.e-003 7.e-003 8.e-003 8.999999999999999e-003 1.e-002 1.1e-002 1.2e-002 1.3e-002 1.4e-002 1.5e-002 1.6e-002 1.7e-002 /end FIX_AXIS_PAR_LIST
 /end AXIS_DESCR
/end CHARACTERISTIC
/begin CHARACTERISTIC CT_AEDeltaFuelMultCoolTemp "cal comments" CURVE 0x9A48 2D_Array_UB 0.0 CM_mult_0to4 0.0 3.984375
 /begin AXIS_DESCR FIX_AXIS NO_INPUT_QUANTITY CM_Equaloutput1 17 -28.0 164.0 MAX_GRAD 0.0 /begin FIX_AXIS_PAR_LIST -28 -16 -4 8 20 32 44 56 68 80 92 104 116 128 140 152 164 /end FIX_AXIS_PAR_LIST /end AXIS_DESCR
/end CHARACTERISTIC
/begin CHARACTERISTIC CT_AEDeltaFuelMultSpeedLoad "cal comments" MAP 0x9376 3D_Array_UW 0.0 CM_Grams0to2 0.0 1.99993896484375
 /begin AXIS_DESCR COM_AXIS NO_INPUT_QUANTITY CM_Equaloutput1 17 0.0 16383.75 AXIS_PTS_REF CA_EngSpd17Step2 MAX_GRAD 0.0 /end AXIS_DESCR
 /begin AXIS_DESCR FIX_AXIS NO_INPUT_QUANTITY CM_Equaloutput1 10 15.0 105.0 MAX_GRAD 0.0 /begin FIX_AXIS_PAR_LIST 15 25 35 45 55 65 75 85 95 105 /end FIX_AXIS_PAR_LIST /end AXIS_DESCR
/end CHARACTERISTIC
/begin CHARACTERISTIC CT_AFLCCellEngSpdBoundary "cal comments" VAL_BLK 0xB394 ValueBlock_UW 0.0 CM_RPM_0to16384_1 0.0 16383.75 NUMBER 3 /end CHARACTERISTIC
/begin CHARACTERISTIC CT_AFLCCellTPSBoundary "cal comments" VAL_BLK 0xB38A ValueBlock_UW 0.0 CM_Percent_0to200_1 0.0 199.9969024658203 NUMBER 5 /end CHARACTERISTIC
/begin CHARACTERISTIC CT_AFLCTPSMaxThresh "cal comments" CURVE 0xB34A 2D_Array_UW 0.0 CM_Percent_0to200_2 0.0 199.9969024658203
 /begin AXIS_DESCR COM_AXIS NO_INPUT_QUANTITY CM_Equaloutput1 17 0.0 16383.75 AXIS_PTS_REF CA_EngSpd17Step1 MAX_GRAD 0.0 /end AXIS_DESCR
/end CHARACTERISTIC
/begin CHARACTERISTIC CT_AFRCrank "cal comments" CURVE 0x9AC8 2D_Array_UB 0.0 CM_AFR_8bit 0.0 31.875
 /begin AXIS_DESCR FIX_AXIS NO_INPUT_QUANTITY CM_Equaloutput1 17 -28.0 164.0 MAX_GRAD 0.0 /begin FIX_AXIS_PAR_LIST -28 -16 -4 8 20 32 44 56 68 80 92 104 116 128 140 152 164 /end FIX_AXIS_PAR_LIST /end AXIS_DESCR
/end CHARACTERISTIC
/begin CHARACTERISTIC CT_AFRCrankBaroComp "cal comments" CURVE 0x9689 2D_Array_SB 0.0 CM_AFR_n4to4 -4.0 3.96875
 /begin AXIS_DESCR FIX_AXIS NO_INPUT_QUANTITY CM_Equaloutput1 6 55.0 105.0 MAX_GRAD 0.0 /begin FIX_AXIS_PAR_LIST 55 65 75 85 95 105 /end FIX_AXIS_PAR_LIST /end AXIS_DESCR
/end CHARACTERISTIC
/begin CHARACTERISTIC C_AFRCrankToRunDecayFactor "cal comments" VALUE 0x9B28 Scalar_UW 0.0 CM_FactorRatio 0.0 0.9999847412109375 /end CHARACTERISTIC
/begin CHARACTERISTIC CT_AFRCrankToRunDecayInterval "cal comments" CURVE 0x9B16 2D_Array_UB 0.0 CM_Second_0to8 0.0 7.96875
 /begin AXIS_DESCR FIX_AXIS NO_INPUT_QUANTITY CM_Equaloutput1 17 -28.0 164.0 MAX_GRAD 0.0 /begin FIX_AXIS_PAR_LIST -28 -16 -4 8 20 32 44 56 68 80 92 104 116 128 140 152 164 /end FIX_AXIS_PAR_LIST /end AXIS_DESCR
/end CHARACTERISTIC
/begin CHARACTERISTIC CT_AFRLeanLimit "cal comments" CURVE 0x923C 2D_Array_UB 0.0 CM_AFR_8bit 0.0 31.875
 /begin AXIS_DESCR FIX_AXIS NO_INPUT_QUANTITY CM_Equaloutput1 17 -28.0 164.0 MAX_GRAD 0.0 /begin FIX_AXIS_PAR_LIST -28 -16 -4 8 20 32 44 56 68 80 92 104 116 128 140 152 164 /end FIX_AXIS_PAR_LIST /end AXIS_DESCR
/end CHARACTERISTIC
/begin CHARACTERISTIC CT_AFRLeanLimitForColdIdleEnrich "cal comments" CURVE 0x924F 2D_Array_UB 0.0 CM_AFR_8bit 0.0 31.875
 /begin AXIS_DESCR FIX_AXIS NO_INPUT_QUANTITY CM_Equaloutput1 17 -28.0 164.0 MAX_GRAD 0.0 /begin FIX_AXIS_PAR_LIST -28 -16 -4 8 20 32 44 56 68 80 92 104 116 128 140 152 164 /end FIX_AXIS_PAR_LIST /end AXIS_DESCR
/end CHARACTERISTIC
/begin CHARACTERISTIC CT_AFROpenLoopInPEIdle "cal comments" CURVE 0x977A 2D_Array_UB 0.0 CM_AFR_8bit 0.0 31.875
 /begin AXIS_DESCR COM_AXIS NO_INPUT_QUANTITY CM_Equaloutput1 4 0.0 16383.75 AXIS_PTS_REF CA_EngSpd4Step1 MAX_GRAD 0.0 /end AXIS_DESCR
/end CHARACTERISTIC
/begin CHARACTERISTIC CT_AFRPECoolTempMult "cal comments" CURVE 0x9A6E 2D_Array_UB 0.0 CM_Mult0_to_2_ratio 0.0 1.9921875
 /begin AXIS_DESCR FIX_AXIS NO_INPUT_QUANTITY CM_Equaloutput1 17 -28.0 164.0 MAX_GRAD 0.0 /begin FIX_AXIS_PAR_LIST -28 -16 -4 8 20 32 44 56 68 80 92 104 116 128 140 152 164 /end FIX_AXIS_PAR_LIST /end AXIS_DESCR
/end CHARACTERISTIC
/begin CHARACTERISTIC CT_AFRPowerEnrich "cal comments" MAP 0x9A82 3D_Array_UB 0.0 CM_AFR_8bit 0.0 31.875
 /begin AXIS_DESCR COM_AXIS NO_INPUT_QUANTITY CM_Equaloutput1 4 0.0 199.9969024658203 AXIS_PTS_REF CA_Percent1 MAX_GRAD 0.0 /end AXIS_DESCR
 /begin AXIS_DESCR COM_AXIS NO_INPUT_QUANTITY CM_Equaloutput1 17 0.0 16383.75 AXIS_PTS_REF CA_EngSpd17Step1 MAX_GRAD 0.0 /end AXIS_DESCR
/end CHARACTERISTIC
/begin CHARACTERISTIC CT_AFRWarmUpOffsetBaroCompIdle "cal comments" CURVE 0x9699 2D_Array_SB 0.0 CM_AFR_n4to4 -4.0 3.96875
 /begin AXIS_DESCR FIX_AXIS NO_INPUT_QUANTITY CM_Equaloutput1 6 55.0 105.0 MAX_GRAD 0.0 /begin FIX_AXIS_PAR_LIST 55 65 75 85 95 105 /end FIX_AXIS_PAR_LIST /end AXIS_DESCR
/end CHARACTERISTIC
/begin CHARACTERISTIC CT_AFRWarmUpOffsetBaroCompRun "cal comments" CURVE 0x9691 2D_Array_SB 0.0 CM_AFR_n4to4 -4.0 3.96875
 /begin AXIS_DESCR FIX_AXIS NO_INPUT_QUANTITY CM_Equaloutput1 6 55.0 105.0 MAX_GRAD 0.0 /begin FIX_AXIS_PAR_LIST 55 65 75 85 95 105 /end FIX_AXIS_PAR_LIST /end AXIS_DESCR
/end CHARACTERISTIC
/begin CHARACTERISTIC CT_AFRWarmUpOffsetDecayIntervel "cal comments" CURVE 0x9ADB 2D_Array_UB 0.0 CM_Second_0to8 0.0 7.96875
 /begin AXIS_DESCR FIX_AXIS NO_INPUT_QUANTITY CM_Equaloutput1 17 -28.0 164.0 MAX_GRAD 0.0 /begin FIX_AXIS_PAR_LIST -28 -16 -4 8 20 32 44 56 68 80 92 104 116 128 140 152 164 /end FIX_AXIS_PAR_LIST /end AXIS_DESCR
/end CHARACTERISTIC
/begin CHARACTERISTIC CT_AFRWarmUpOffsetIdle "cal comments" CURVE 0x9AF0 2D_Array_UB 0.0 CM_AFR_8bit 0.0 31.875
 /begin AXIS_DESCR FIX_AXIS NO_INPUT_QUANTITY CM_Equaloutput1 17 -28.0 164.0 MAX_GRAD 0.0 /begin FIX_AXIS_PAR_LIST -28 -16 -4 8 20 32 44 56 68 80 92 104 116 128 140 152 164 /end FIX_AXIS_PAR_LIST /end AXIS_DESCR
/end CHARACTERISTIC
/begin CHARACTERISTIC CT_AFRWarmUpOffsetRun "cal comments" CURVE 0x9B03 2D_Array_UB 0.0 CM_AFR_8bit 0.0 31.875
 /begin AXIS_DESCR FIX_AXIS NO_INPUT_QUANTITY CM_Equaloutput1 17 -28.0 164.0 MAX_GRAD 0.0 /begin FIX_AXIS_PAR_LIST -28 -16 -4 8 20 32 44 56 68 80 92 104 116 128 140 152 164 /end FIX_AXIS_PAR_LIST /end AXIS_DESCR
/end CHARACTERISTIC
/begin CHARACTERISTIC CT_AirFuelRatioBase "cal comments" MAP 0x96A2 3D_Array_UB 0.0 CM_AFR_8bit 0.0 31.875
 /begin AXIS_DESCR COM_AXIS NO_INPUT_QUANTITY CM_Equaloutput1 17 0.0 16383.75 AXIS_PTS_REF CA_EngSpd17Step2 MAX_GRAD 0.0 /end AXIS_DESCR
 /begin AXIS_DESCR COM_AXIS NO_INPUT_QUANTITY CM_Equaloutput1 10 0.0 255.99609375 AXIS_PTS_REF CA_MAP10Step1 MAX_GRAD 0.0 /end AXIS_DESCR
/end CHARACTERISTIC
/begin CHARACTERISTIC CT_AirFuelRatioBaseCoolTempMult "cal comments" CURVE 0x9B2C 2D_Array_UB 0.0 CM_Mult0_to_2_ratio 0.0 1.9921875
 /begin AXIS_DESCR FIX_AXIS NO_INPUT_QUANTITY CM_Equaloutput1 17 -28.0 164.0 MAX_GRAD 0.0 /begin FIX_AXIS_PAR_LIST -28 -16 -4 8 20 32 44 56 68 80 92 104 116 128 140 152 164 /end FIX_AXIS_PAR_LIST /end AXIS_DESCR
/end CHARACTERISTIC
/begin CHARACTERISTIC CT_AltMAPCalcMult "cal comments" CURVE 0xB4CA 2D_Array_UB 0.0 CM_Mult0_to_2_ratio 0.0 1.9921875
 /begin AXIS_DESCR FIX_AXIS NO_INPUT_QUANTITY CM_Equaloutput1 11 55.0 105.0 MAX_GRAD 0.0 /begin FIX_AXIS_PAR_LIST 55 60 65 70 75 80 85 90 95 100 105 /end FIX_AXIS_PAR_LIST /end AXIS_DESCR
/end CHARACTERISTIC
/begin CHARACTERISTIC CT_BaroReadTooth "cal comments" CURVE 0xB4F2 2D_Array_UB 0.0 CM_Count3 0.0 255.0
 /begin AXIS_DESCR COM_AXIS NO_INPUT_QUANTITY CM_Equaloutput1 9 0.0 16383.75 AXIS_PTS_REF CA_EngSpd9Step1 MAX_GRAD 0.0 /end AXIS_DESCR
/end CHARACTERISTIC
/begin CHARACTERISTIC C_MapBaroUsed "cal comments" VALUE 0xB4FB Scalar_UB 0.0 CM_Boolean4 0.0 1.0 /end CHARACTERISTIC
/begin CHARACTERISTIC CT_BaroUpdtEngRunOfstMain "cal comments" MAP 0xB52D 3D_Array_UB 0.0 CM_kpa_8bit 0.0 127.5
 /begin AXIS_DESCR FIX_AXIS NO_INPUT_QUANTITY CM_Equaloutput1 9 0.0 100.0 MAX_GRAD 0.0 /begin FIX_AXIS_PAR_LIST 0 12.5 25 37.5 50 62.5 75 87.5 100 /end FIX_AXIS_PAR_LIST /end AXIS_DESCR
 /begin AXIS_DESCR COM_AXIS NO_INPUT_QUANTITY CM_Equaloutput1 9 0.0 16383.75 AXIS_PTS_REF CA_EngSpd9Step1 MAX_GRAD 0.0 /end AXIS_DESCR
/end CHARACTERISTIC
/begin CHARACTERISTIC CT_BaroUpdtEngRunTPSMaxThresh "cal comments" CURVE 0xB517 2D_Array_UB 0.0 CM_Percent_0to200_3 0.0 199.21875
 /begin AXIS_DESCR COM_AXIS NO_INPUT_QUANTITY CM_Equaloutput1 17 0.0 16383.75 AXIS_PTS_REF CA_EngSpd17Step1 MAX_GRAD 0.0 /end AXIS_DESCR
/end CHARACTERISTIC
/begin CHARACTERISTIC CT_BaroUpdtEngRunTPSMinThresh "cal comments" CURVE 0xB504 2D_Array_UB 0.0 CM_Percent_0to200_3 0.0 199.21875
 /begin AXIS_DESCR COM_AXIS NO_INPUT_QUANTITY CM_Equaloutput1 17 0.0 16383.75 AXIS_PTS_REF CA_EngSpd17Step1 MAX_GRAD 0.0 /end AXIS_DESCR
/end CHARACTERISTIC
/begin CHARACTERISTIC CT_CATFactorCLTIATCorr "cal comments" MAP 0x8F0F D_Array_SB 0.0 CM_Ratio_n2to2 -2.0 1.984375
 /begin AXIS_DESCR FIX_AXIS NO_INPUT_QUANTITY CM_Equaloutput1 6 -28.0 92.0 MAX_GRAD 0.0 /begin FIX_AXIS_PAR_LIST -28 -4 20 44 68 92 /end FIX_AXIS_PAR_LIST /end AXIS_DESCR
 /begin AXIS_DESCR FIX_AXIS NO_INPUT_QUANTITY CM_Equaloutput1 9 -28.0 164.0 MAX_GRAD 0.0 /begin FIX_AXIS_PAR_LIST -28 -4 20 44 68 92 116 140 164 /end FIX_AXIS_PAR_LIST /end AXIS_DESCR
/end CHARACTERISTIC
/begin CHARACTERISTIC CT_ChargeAirTempFactorCyl1 "cal comments" MAP 0x82AB D_Array_SB 0.0 CM_Ratio_n2to2 -2.0 1.984375
 /begin AXIS_DESCR FIX_AXIS NO_INPUT_QUANTITY CM_Equaloutput1 9 25.0 105.0 MAX_GRAD 0.0 /begin FIX_AXIS_PAR_LIST 25 35 45 55 65 75 85 95 105 /end FIX_AXIS_PAR_LIST /end AXIS_DESCR
 /begin AXIS_DESCR COM_AXIS NO_INPUT_QUANTITY CM_Equaloutput1 10 0.0 16383.75 AXIS_PTS_REF CA_EngSpd10Step1 MAX_GRAD 0.0 /end AXIS_DESCR
/end CHARACTERISTIC
/begin CHARACTERISTIC CT_ColdEngFPWMultIdle "cal comments" CURVE 0x9662 2D_Array_UB 0.0 CM_Mult0_to_2_ratio 0.0 1.9921875
 /begin AXIS_DESCR FIX_AXIS NO_INPUT_QUANTITY CM_Equaloutput1 17 -28.0 164.0 MAX_GRAD 0.0 /begin FIX_AXIS_PAR_LIST -28 -16 -4 8 20 32 44 56 68 80 92 104 116 128 140 152 164 /end FIX_AXIS_PAR_LIST /end AXIS_DESCR
/end CHARACTERISTIC
/begin CHARACTERISTIC CT_ColdEngFPWMultRun "cal comments" CURVE 0x9675 2D_Array_UB 0.0 CM_Mult0_to_2_ratio 0.0 1.9921875
 /begin AXIS_DESCR FIX_AXIS NO_INPUT_QUANTITY CM_Equaloutput1 17 -28.0 164.0 MAX_GRAD 0.0 /begin FIX_AXIS_PAR_LIST -28 -16 -4 8 20 32 44 56 68 80 92 104 116 128 140 152 164 /end FIX_AXIS_PAR_LIST /end AXIS_DESCR
/end CHARACTERISTIC
/begin CHARACTERISTIC CT_CoolantTemp "cal comments" CURVE 0xB412 2D_Array_SW 0.0 CM_DegC_N256to256 -256.0 255.9921875
 /begin AXIS_DESCR FIX_AXIS NO_INPUT_QUANTITY CM_Equaloutput1 33 0.0 100.0 MAX_GRAD 0.0
  /begin FIX_AXIS_PAR_LIST 0 3.125 6.25 9.375 12.5 15.625 18.75 21.875 25 28.125 31.25 34.375 37.5 40.625 43.75 46.875 50 53.125 56.25 59.375 62.5 65.625 68.75 71.875 75 78.125 81.25 84.375 87.5 90.625 93.75 96.875 100 /end FIX_AXIS_PAR_LIST
 /end AXIS_DESCR
/end CHARACTERISTIC
/begin CHARACTERISTIC CT_CrankAngleReadlEleLag "cal comments" CURVE 0x8010 2D_Array_UW 0.0 CM_Microsecond_1 0.0 524280.0
 /begin AXIS_DESCR FIX_AXIS NO_INPUT_QUANTITY CM_Equaloutput1 9 0.0 6400.0 MAX_GRAD 0.0 /begin FIX_AXIS_PAR_LIST 0 800 1600 2400 3200 4000 4800 5600 6400 /end FIX_AXIS_PAR_LIST /end AXIS_DESCR
/end CHARACTERISTIC
/begin CHARACTERISTIC CT_DecEnleanDecayFactorCoolTemp "cal comments" CURVE 0x9A35 2D_Array_UB 0.0 CM_Mult_0to1 0.0 0.99609375
 /begin AXIS_DESCR FIX_AXIS NO_INPUT_QUANTITY CM_Equaloutput1 17 -28.0 164.0 MAX_GRAD 0.0 /begin FIX_AXIS_PAR_LIST -28 -16 -4 8 20 32 44 56 68 80 92 104 116 128 140 152 164 /end FIX_AXIS_PAR_LIST /end AXIS_DESCR
/end CHARACTERISTIC
/begin CHARACTERISTIC CT_DecEnleanDecayFactorEngSpd "cal comments" CURVE 0x9315 2D_Array_UB 0.0 CM_Mult_0to1_2 0.0 0.99609375
 /begin AXIS_DESCR COM_AXIS NO_INPUT_QUANTITY CM_Equaloutput1 17 0.0 16383.75 AXIS_PTS_REF CA_EngSpd17Step1 MAX_GRAD 0.0 /end AXIS_DESCR
/end CHARACTERISTIC
/begin CHARACTERISTIC CT_DEDeltaFuelMultBase "cal comments" CURVE 0x934E 2D_Array_UW 0.0 CM_Grams0to8 0.0 7.999755859375
 /begin AXIS_DESCR FIX_AXIS NO_INPUT_QUANTITY CM_Equaloutput1 18 0.0 1.700000092387199e-002 MAX_GRAD 0.0
  /begin FIX_AXIS_PAR_LIST 0 1.e-003 2.e-003 3.e-003 4.e-003 5.e-003 6.e-003 7.e-003 8.e-003 8.999999999999999e-003 1.e-002 1.1e-002 1.2e-002 1.3e-002 1.4e-002 1.5e-002 1.6e-002 1.7e-002 /end FIX_AXIS_PAR_LIST
 /end AXIS_DESCR
/end CHARACTERISTIC
/begin CHARACTERISTIC CT_DEDeltaFuelMultCoolTemp "cal comments" CURVE 0x9A5B 2D_Array_UB 0.0 CM_mult_0to4 0.0 3.984375
 /begin AXIS_DESCR FIX_AXIS NO_INPUT_QUANTITY CM_Equaloutput1 17 -28.0 164.0 MAX_GRAD 0.0 /begin FIX_AXIS_PAR_LIST -28 -16 -4 8 20 32 44 56 68 80 92 104 116 128 140 152 164 /end FIX_AXIS_PAR_LIST /end AXIS_DESCR
/end CHARACTERISTIC
/begin CHARACTERISTIC CT_DEDeltaFuelMultSpeedLoad "cal comments" MAP 0x94CE 3D_Array_UW 0.0 CM_Grams0to2 0.0 1.99993896484375
 /begin AXIS_DESCR COM_AXIS NO_INPUT_QUANTITY CM_Equaloutput1 17 0.0 16383.75 AXIS_PTS_REF CA_EngSpd17Step2 MAX_GRAD 0.0 /end AXIS_DESCR
 /begin AXIS_DESCR FIX_AXIS NO_INPUT_QUANTITY CM_Equaloutput1 10 15.0 105.0 MAX_GRAD 0.0 /begin FIX_AXIS_PAR_LIST 15 25 35 45 55 65 75 85 95 105 /end FIX_AXIS_PAR_LIST /end AXIS_DESCR
/end CHARACTERISTIC
/begin CHARACTERISTIC CT_DefaultTPS "cal comments" CURVE 0xB3A0 2D_Array_UW 0.0 CM_Percent_0to200_2 0.0 199.9969024658203
 /begin AXIS_DESCR FIX_AXIS NO_INPUT_QUANTITY CM_Equaloutput1 17 0.0 6400.0 MAX_GRAD 0.0
  /begin FIX_AXIS_PAR_LIST 0 400 800 1200 1600 2000 2400 2800 3200 3600 4000 4400 4800 5200 5600 6000 6400 /end FIX_AXIS_PAR_LIST
 /end AXIS_DESCR
/end CHARACTERISTIC
/begin CHARACTERISTIC CT_DesireEngineSpeed "cal comments" CURVE 0x9FFA 2D_Array_UW 0.0 udf_CM_18586 0.0 16383.75
 /begin AXIS_DESCR FIX_AXIS NO_INPUT_QUANTITY CM_Equaloutput1 5 1.0 5.0 MAX_GRAD 0.0 /begin FIX_AXIS_PAR_LIST 1 2 3 4 5 /end FIX_AXIS_PAR_LIST /end AXIS_DESCR
/end CHARACTERISTIC
/begin CHARACTERISTIC CT_DesireEngSpdLinear "cal comments" CURVE 0xA006 2D_Array_UW 0.0 CM_RPM_0to16384 0.0 16383.75
 /begin AXIS_DESCR FIX_AXIS NO_INPUT_QUANTITY CM_Equaloutput1 2 20.0 80.0 MAX_GRAD 0.0 /begin FIX_AXIS_PAR_LIST 20.0 80.0 /end FIX_AXIS_PAR_LIST /end AXIS_DESCR
/end CHARACTERISTIC
/begin CHARACTERISTIC CT_EstimatedTorque "cal comments" MAP 0x9790 udf_RL_19771 0.0 udf_CM_18544 -128.0 127.99609375
 /begin AXIS_DESCR COM_AXIS NO_INPUT_QUANTITY CM_Equaloutput1 18 0.0 255.99609375 AXIS_PTS_REF CA_MAP18Step1 MAX_GRAD 0.0 /end AXIS_DESCR
 /begin AXIS_DESCR COM_AXIS NO_INPUT_QUANTITY CM_Equaloutput1 17 0.0 16383.75 AXIS_PTS_REF CA_EngSpd17Step1 MAX_GRAD 0.0 /end AXIS_DESCR
/end CHARACTERISTIC
/begin CHARACTERISTIC CT_FPWCorrFactorForFPVolt "cal comments" CURVE 0x92F3 2D_Array_UB 0.0 CM_Mult0_to_2_ratio 0.0 1.9921875
 /begin AXIS_DESCR FIX_AXIS NO_INPUT_QUANTITY CM_Equaloutput1 9 6.400000095367432 19.20000076293945 MAX_GRAD 0.0 /begin FIX_AXIS_PAR_LIST 6.4 8 9.6 11.2 12.8 14.4 16 17.6 19.2 /end FIX_AXIS_PAR_LIST /end AXIS_DESCR
/end CHARACTERISTIC
/begin CHARACTERISTIC CT_FuelCLEnbCoolTempThrsh "cal comments" CURVE 0x9B46 2D_Array_SW 0.0 CM_DegC_N256to256 -256.0 255.9921875
 /begin AXIS_DESCR FIX_AXIS NO_INPUT_QUANTITY CM_Equaloutput1 17 -28.0 164.0 MAX_GRAD 0.0 /begin FIX_AXIS_PAR_LIST -28 -16 -4 8 20 32 44 56 68 80 92 104 116 128 140 152 164 /end FIX_AXIS_PAR_LIST /end AXIS_DESCR
/end CHARACTERISTIC
/begin CHARACTERISTIC CT_FuelCLIntDelayO2ErrMult "cal comments" CURVE 0x9C21 2D_Array_UB 0.0 CM_Mult_0to1_2 0.0 0.99609375
 /begin AXIS_DESCR FIX_AXIS NO_INPUT_QUANTITY CM_Equaloutput1 6 0.0 347.5 MAX_GRAD 0.0 /begin FIX_AXIS_PAR_LIST 0 69.5 139 208.5 278 347.5 /end FIX_AXIS_PAR_LIST /end AXIS_DESCR
/end CHARACTERISTIC
/begin CHARACTERISTIC CT_FuelCLIntLearningDelay "cal comments" CURVE 0x9C12 2D_Array_UB 0.0 CM_Second_0to4 0.0 3.984375
 /begin AXIS_DESCR COM_AXIS NO_INPUT_QUANTITY CM_Equaloutput1 13 0.0 16383.75 AXIS_PTS_REF CA_EngSpd13Step3 MAX_GRAD 0.0 /end AXIS_DESCR
/end CHARACTERISTIC
/begin CHARACTERISTIC CT_FuelEOICrank "cal comments" CURVE 0x92C6 2D_Array_UW 0.0 CM_CrankAngle_0to1024 0.0 1023.984375
 /begin AXIS_DESCR FIX_AXIS NO_INPUT_QUANTITY CM_Equaloutput1 9 -40.0 152.0 MAX_GRAD 0.0 /begin FIX_AXIS_PAR_LIST -40 -16 8 32 56 80 104 128 152 /end FIX_AXIS_PAR_LIST /end AXIS_DESCR
/end CHARACTERISTIC
/begin CHARACTERISTIC CT_FuelEOIRun "cal comments" CURVE 0x92DA 2D_Array_UW 0.0 CM_CrankAngle_0to1024 0.0 1023.984375
 /begin AXIS_DESCR COM_AXIS NO_INPUT_QUANTITY CM_Equaloutput1 6 0.0 16383.75 AXIS_PTS_REF CA_EngSpd6Step2 MAX_GRAD 0.0 /end AXIS_DESCR
/end CHARACTERISTIC
/begin CHARACTERISTIC CT_FuelEOITrimPulse "cal comments" CURVE 0x9DC2 2D_Array_UW 0.0 CM_CrankAngle_0to1024 0.0 1023.984375
 /begin AXIS_DESCR FIX_AXIS NO_INPUT_QUANTITY CM_Equaloutput1 9 -40.0 152.0 MAX_GRAD 0.0 /begin FIX_AXIS_PAR_LIST -40 -16 8 32 56 80 104 128 152 /end FIX_AXIS_PAR_LIST /end AXIS_DESCR
/end CHARACTERISTIC
/begin CHARACTERISTIC C_TrimPulseBeforeCIDsucceed "cal comments" VALUE 0x9DD4 Scalar_UB 0.0 CM_Boolean1 0.0 1.0 /end CHARACTERISTIC
/begin CHARACTERISTIC C_TrimPulseEnbTPSThresh "cal comments" VALUE 0x9DD6 Scalar_UW 0.0 CM_Percent_0to200_2 0.0 199.9969024658203 /end CHARACTERISTIC
/begin CHARACTERISTIC CT_FuelO2RichLeanThreshBase "cal comments" MAP 0x9B83 3D_Array_UB 0.0 CM_mVolt 0.0 1016.0
 /begin AXIS_DESCR FIX_AXIS NO_INPUT_QUANTITY CM_Equaloutput1 9 20.0 100.0 MAX_GRAD 0.0 /begin FIX_AXIS_PAR_LIST 20 30 40 50 60 70 80 90 100 /end FIX_AXIS_PAR_LIST /end AXIS_DESCR
 /begin AXIS_DESCR COM_AXIS NO_INPUT_QUANTITY CM_Equaloutput1 13 0.0 16383.75 AXIS_PTS_REF CA_EngSpd13Step3 MAX_GRAD 0.0 /end AXIS_DESCR
/end CHARACTERISTIC
/begin CHARACTERISTIC CT_FuelPropLeanToRich "cal comments" MAP 0x9CC9 3D_Array_UB 0.0 CM_Percent_0to100 0.0 99.609375
 /begin AXIS_DESCR FIX_AXIS NO_INPUT_QUANTITY CM_Equaloutput1 9 20.0 100.0 MAX_GRAD 0.0 /begin FIX_AXIS_PAR_LIST 20 30 40 50 60 70 80 90 100 /end FIX_AXIS_PAR_LIST /end AXIS_DESCR
 /begin AXIS_DESCR COM_AXIS NO_INPUT_QUANTITY CM_Equaloutput1 13 0.0 16383.75 AXIS_PTS_REF CA_EngSpd13Step3 MAX_GRAD 0.0 /end AXIS_DESCR
/end CHARACTERISTIC
/begin CHARACTERISTIC CT_FuelPropMinDuration "cal comments" CURVE 0x9D42 2D_Array_UB 0.0 CM_Second_0to4 0.0 3.984375
 /begin AXIS_DESCR COM_AXIS NO_INPUT_QUANTITY CM_Equaloutput1 13 0.0 16383.75 AXIS_PTS_REF CA_EngSpd13Step3 MAX_GRAD 0.0 /end AXIS_DESCR
/end CHARACTERISTIC
/begin CHARACTERISTIC CT_FuelPropO2ErrMult "cal comments" CURVE 0x9C32 2D_Array_UW 0.0 CM_FactorRatio 0.0 0.9999847412109375
 /begin AXIS_DESCR FIX_AXIS NO_INPUT_QUANTITY CM_Equaloutput1 6 0.0 347.5 MAX_GRAD 0.0 /begin FIX_AXIS_PAR_LIST 0 69.5 139 208.5 278 347.5 /end FIX_AXIS_PAR_LIST /end AXIS_DESCR
/end CHARACTERISTIC
/begin CHARACTERISTIC CT_FuelPropRichBiasHoldTimeGain "cal comments" CURVE 0x9D51 2D_Array_UB 0.0 CM_Mult0_to_2_ratio 0.0 1.9921875
 /begin AXIS_DESCR COM_AXIS NO_INPUT_QUANTITY CM_Equaloutput1 13 0.0 16383.75 AXIS_PTS_REF CA_EngSpd13Step3 MAX_GRAD 0.0 /end AXIS_DESCR
/end CHARACTERISTIC
/begin CHARACTERISTIC CT_FuelPropRichToLean "cal comments" MAP 0x9C51 3D_Array_UB 0.0 CM_Percent_0to100 0.0 99.609375
 /begin AXIS_DESCR FIX_AXIS NO_INPUT_QUANTITY CM_Equaloutput1 9 20.0 100.0 MAX_GRAD 0.0 /begin FIX_AXIS_PAR_LIST 20 30 40 50 60 70 80 90 100 /end FIX_AXIS_PAR_LIST /end AXIS_DESCR
 /begin AXIS_DESCR COM_AXIS NO_INPUT_QUANTITY CM_Equaloutput1 13 0.0 16383.75 AXIS_PTS_REF CA_EngSpd13Step3 MAX_GRAD 0.0 /end AXIS_DESCR
/end CHARACTERISTIC
/begin CHARACTERISTIC CT_FuelPumpDutyCycle "cal comments" CURVE 0x92A2 2D_Array_UW 0.0 CM_Percent_0to200_2 0.0 199.9969024658203
 /begin AXIS_DESCR FIX_AXIS NO_INPUT_QUANTITY CM_Equaloutput1 17 6.0 18.79999923706055 MAX_GRAD 0.0
  /begin FIX_AXIS_PAR_LIST 6 6.8 7.6 8.4 9.199999999999999 10 10.8 11.6 12.4 13.2 14 14.8 15.6 16.4 17.2 18 18.8 /end FIX_AXIS_PAR_LIST
 /end AXIS_DESCR
/end CHARACTERISTIC
/begin CHARACTERISTIC CT_FuelPumpWorkTimeForPP "cal comments" CURVE 0x9200 2D_Array_UW 0.0 CM_Second_0to512 0.0 511.9921875
 /begin AXIS_DESCR FIX_AXIS NO_INPUT_QUANTITY CM_Equaloutput1 17 -28.0 164.0 MAX_GRAD 0.0 /begin FIX_AXIS_PAR_LIST -28 -16 -4 8 20 32 44 56 68 80 92 104 116 128 140 152 164 /end FIX_AXIS_PAR_LIST /end AXIS_DESCR
/end CHARACTERISTIC
/begin CHARACTERISTIC CT_IdleAirflowColdOffset "cal comments" CURVE 0xA0DA 2D_Array_UB 0.0 CM_Percent_0to100 0.0 99.609375
 /begin AXIS_DESCR FIX_AXIS NO_INPUT_QUANTITY CM_Equaloutput1 17 -28.0 164.0 MAX_GRAD 0.0 /begin FIX_AXIS_PAR_LIST -28 -16 -4 8 20 32 44 56 68 80 92 104 116 128 140 152 164 /end FIX_AXIS_PAR_LIST /end AXIS_DESCR
/end CHARACTERISTIC
/begin CHARACTERISTIC CT_IdleDerivEngSpdHigh "cal comments" CURVE 0xA0ED 2D_Array_UB 0.0 CM_Percent_0to100 0.0 99.609375
 /begin AXIS_DESCR FIX_AXIS NO_INPUT_QUANTITY CM_Equaloutput1 17 0.0 128.0 MAX_GRAD 0.0 /begin FIX_AXIS_PAR_LIST 0 8 16 24 32 40 48 56 64 72 80 88 96 104 112 120 128 /end FIX_AXIS_PAR_LIST /end AXIS_DESCR
/end CHARACTERISTIC
/begin CHARACTERISTIC CT_IdleDerivEngSpdLow "cal comments" CURVE 0xA100 2D_Array_UB 0.0 CM_Percent_0to100 0.0 99.609375
 /begin AXIS_DESCR FIX_AXIS NO_INPUT_QUANTITY CM_Equaloutput1 17 0.0 128.0 MAX_GRAD 0.0 /begin FIX_AXIS_PAR_LIST 0 8 16 24 32 40 48 56 64 72 80 88 96 104 112 120 128 /end FIX_AXIS_PAR_LIST /end AXIS_DESCR
/end CHARACTERISTIC
/begin CHARACTERISTIC CT_IdleDesireSpdStartup "cal comments" CURVE 0xA040 2D_Array_UW 0.0 CM_RPM_0to16384 0.0 16383.75
 /begin AXIS_DESCR FIX_AXIS NO_INPUT_QUANTITY CM_Equaloutput1 17 -28.0 164.0 MAX_GRAD 0.0 /begin FIX_AXIS_PAR_LIST -28 -16 -4 8 20 32 44 56 68 80 92 104 116 128 140 152 164 /end FIX_AXIS_PAR_LIST /end AXIS_DESCR
/end CHARACTERISTIC
/begin CHARACTERISTIC CT_IdleIntGainEngSpdHigh "cal comments" CURVE 0xA141 2D_Array_UB 0.0 CM_Mult0_to_2_ratio1 0.0 1.9921875
 /begin AXIS_DESCR FIX_AXIS NO_INPUT_QUANTITY CM_Equaloutput1 11 0.0 500.0 MAX_GRAD 0.0 /begin FIX_AXIS_PAR_LIST 0 50 100 150 200 250 300 350 400 450 500 /end FIX_AXIS_PAR_LIST /end AXIS_DESCR
/end CHARACTERISTIC
/begin CHARACTERISTIC CT_IdleIntGainEngSpdLow "cal comments" CURVE 0xA14E 2D_Array_UB 0.0 CM_Mult0_to_2_ratio1 0.0 1.9921875
 /begin AXIS_DESCR FIX_AXIS NO_INPUT_QUANTITY CM_Equaloutput1 11 0.0 500.0 MAX_GRAD 0.0 /begin FIX_AXIS_PAR_LIST 0 50 100 150 200 250 300 350 400 450 500 /end FIX_AXIS_PAR_LIST /end AXIS_DESCR
/end CHARACTERISTIC
/begin CHARACTERISTIC CT_IdlePropEngSpdHigh "cal comments" CURVE 0xA113 2D_Array_UB 0.0 CM_Percent_0to100 0.0 99.609375
 /begin AXIS_DESCR COM_AXIS NO_INPUT_QUANTITY CM_Equaloutput1 17 0.0 16383.75 AXIS_PTS_REF CA_EngSpd17Step4 MAX_GRAD 0.0 /end AXIS_DESCR
/end CHARACTERISTIC
/begin CHARACTERISTIC CT_IdlePropEngSpdLow "cal comments" CURVE 0xA126 2D_Array_UB 0.0 CM_Percent_0to100 0.0 99.609375
 /begin AXIS_DESCR COM_AXIS NO_INPUT_QUANTITY CM_Equaloutput1 17 0.0 16383.75 AXIS_PTS_REF CA_EngSpd17Step4 MAX_GRAD 0.0 /end AXIS_DESCR
/end CHARACTERISTIC
/begin CHARACTERISTIC CT_InjectorOffset "cal comments" CURVE 0x92E8 2D_Array_UB 0.0 CM_msec_0to4 0.0 3.984375
 /begin AXIS_DESCR FIX_AXIS NO_INPUT_QUANTITY CM_Equaloutput1 9 6.400000095367432 19.20000076293945 MAX_GRAD 0.0 /begin FIX_AXIS_PAR_LIST 6.4 8 9.6 11.2 12.8 14.4 16 17.6 19.2 /end FIX_AXIS_PAR_LIST /end AXIS_DESCR
/end CHARACTERISTIC
/begin CHARACTERISTIC CT_IntakeAirTemp "cal comments" CURVE 0xB3CE 2D_Array_SW 0.0 CM_DegC_N256to256 -256.0 255.9921875
 /begin AXIS_DESCR FIX_AXIS NO_INPUT_QUANTITY CM_Equaloutput1 33 0.0 100.0 MAX_GRAD 0.0
  /begin FIX_AXIS_PAR_LIST 0 3.125 6.25 9.375 12.5 15.625 18.75 21.875 25 28.125 31.25 34.375 37.5 40.625 43.75 46.875 50 53.125 56.25 59.375 62.5 65.625 68.75 71.875 75 78.125 81.25 84.375 87.5 90.625 93.75 96.875 100 /end FIX_AXIS_PAR_LIST
 /end AXIS_DESCR
/end CHARACTERISTIC
/begin CHARACTERISTIC CT_MAPCIDEnableMAPThresh "cal comments" CURVE 0xB456 2D_Array_UB 0.0 CM_kpa_8bit 0.0 127.5
 /begin AXIS_DESCR FIX_AXIS NO_INPUT_QUANTITY CM_Equaloutput1 17 0.0 12800.0 MAX_GRAD 0.0
  /begin FIX_AXIS_PAR_LIST 0 800 1600 2400 3200 4000 4800 5600 6400 7200 8000 8800 9600 10400 11200 12000 12800 /end FIX_AXIS_PAR_LIST
 /end AXIS_DESCR
/end CHARACTERISTIC
/begin CHARACTERISTIC CT_MAPDefault "cal comments" CURVE 0xB4B0 2D_Array_UW 0.0 CM_kpa_0to256_1 0.0 255.99609375
 /begin AXIS_DESCR FIX_AXIS NO_INPUT_QUANTITY CM_Equaloutput1 11 55.0 105.0 MAX_GRAD 0.0 /begin FIX_AXIS_PAR_LIST 55 60 65 70 75 80 85 90 95 100 105 /end FIX_AXIS_PAR_LIST /end AXIS_DESCR
/end CHARACTERISTIC
/begin CHARACTERISTIC CT_MAPEstimateMain "cal comments" MAP 0xB10F 3D_Array_UB 0.0 CM_kpa_8bit 0.0 127.5
 /begin AXIS_DESCR COM_AXIS NO_INPUT_QUANTITY CM_Equaloutput1 17 0.0 16383.75 AXIS_PTS_REF CA_EngSpd17Step2 MAX_GRAD 0.0 /end AXIS_DESCR
 /begin AXIS_DESCR FIX_AXIS NO_INPUT_QUANTITY CM_Equaloutput1 33 0.0 100.0 MAX_GRAD 0.0
  /begin FIX_AXIS_PAR_LIST 0 3.125 6.25 9.375 12.5 15.625 18.75 21.875 25 28.125 31.25 34.375 37.5 40.625 43.75 46.875 50 53.125 56.25 59.375 62.5 65.625 68.75 71.875 75 78.125 81.25 84.375 87.5 90.625 93.75 96.875 100 /end FIX_AXIS_PAR_LIST
 /end AXIS_DESCR
/end CHARACTERISTIC
/begin CHARACTERISTIC CT_MAPReadAngleMain "cal comments" MAP 0xB06A 3D_Array_UW 0.0 CM_CrankAngle_0to1024 0.0 1023.984375
 /begin AXIS_DESCR COM_AXIS NO_INPUT_QUANTITY CM_Equaloutput1 9 0.0 255.99609375 AXIS_PTS_REF CA_MAP9Step1 MAX_GRAD 0.0 /end AXIS_DESCR
 /begin AXIS_DESCR COM_AXIS NO_INPUT_QUANTITY CM_Equaloutput1 9 0.0 16383.75 AXIS_PTS_REF CA_EngSpd9Step1 MAX_GRAD 0.0 /end AXIS_DESCR
/end CHARACTERISTIC
/begin CHARACTERISTIC CT_O2ErrorCalcOffset "cal comments" CURVE 0x9C00 2D_Array_UB 0.0 CM_mVolt 0.0 1016.0
 /begin AXIS_DESCR COM_AXIS NO_INPUT_QUANTITY CM_Equaloutput1 13 0.0 16383.75 AXIS_PTS_REF CA_EngSpd13Step3 MAX_GRAD 0.0 /end AXIS_DESCR
/end CHARACTERISTIC
/begin CHARACTERISTIC CT_O2HeaterAccFuelMassThresh "cal comments" CURVE 0x91D0 2D_Array_UW 0.0 CM_Grams0to8_1 0.0 7.999755859375
 /begin AXIS_DESCR FIX_AXIS NO_INPUT_QUANTITY CM_Equaloutput1 17 -28.0 164.0 MAX_GRAD 0.0 /begin FIX_AXIS_PAR_LIST -28 -16 -4 8 20 32 44 56 68 80 92 104 116 128 140 152 164 /end FIX_AXIS_PAR_LIST /end AXIS_DESCR
/end CHARACTERISTIC
/begin CHARACTERISTIC CT_O2HeaterDutyCycleMain "cal comments" CURVE 0xB030 2D_Array_UW 0.0 CM_Percent_0to200_2 0.0 199.9969024658203
 /begin AXIS_DESCR FIX_AXIS NO_INPUT_QUANTITY CM_Equaloutput1 17 -28.0 164.0 MAX_GRAD 0.0 /begin FIX_AXIS_PAR_LIST -28 -16 -4 8 20 32 44 56 68 80 92 104 116 128 140 152 164 /end FIX_AXIS_PAR_LIST /end AXIS_DESCR
/end CHARACTERISTIC
/begin CHARACTERISTIC CT_O2SignalFiltCoef "cal comments" CURVE 0x9B70 2D_Array_UB 0.0 CM_FiltCoef_1 0.0 0.99609375
 /begin AXIS_DESCR COM_AXIS NO_INPUT_QUANTITY CM_Equaloutput1 13 0.0 16383.75 AXIS_PTS_REF CA_EngSpd13Step3 MAX_GRAD 0.0 /end AXIS_DESCR
/end CHARACTERISTIC
/begin CHARACTERISTIC CT_PowerEnrichDelayTime "cal comments" CURVE 0x9632 2D_Array_UW 0.0 CM_Second_0to1024 0.0 1023.984375
 /begin AXIS_DESCR FIX_AXIS NO_INPUT_QUANTITY CM_Equaloutput1 17 0.0 12800.0 MAX_GRAD 0.0
  /begin FIX_AXIS_PAR_LIST 0 800 1600 2400 3200 4000 4800 5600 6400 7200 8000 8800 9600 10400 11200 12000 12800 /end FIX_AXIS_PAR_LIST
 /end AXIS_DESCR
/end CHARACTERISTIC
/begin CHARACTERISTIC CT_PowerEnrichEnbTPSThresh "cal comments" CURVE 0x9D62 2D_Array_UB 0.0 CM_Percent_0to200_3 0.0 199.21875
 /begin AXIS_DESCR COM_AXIS NO_INPUT_QUANTITY CM_Equaloutput1 17 0.0 16383.75 AXIS_PTS_REF CA_EngSpd17Step1 MAX_GRAD 0.0 /end AXIS_DESCR
/end CHARACTERISTIC
/begin CHARACTERISTIC CT_PowerEnrichExitDelay "cal comments" CURVE 0x9756 2D_Array_UW 0.0 CM_Second_0to1024 0.0 1023.984375
 /begin AXIS_DESCR FIX_AXIS NO_INPUT_QUANTITY CM_Equaloutput1 17 0.0 12800.0 MAX_GRAD 0.0
  /begin FIX_AXIS_PAR_LIST 0 800 1600 2400 3200 4000 4800 5600 6400 7200 8000 8800 9600 10400 11200 12000 12800 /end FIX_AXIS_PAR_LIST
 /end AXIS_DESCR
/end CHARACTERISTIC
/begin CHARACTERISTIC CT_PrimePulseBaroMult "cal comments" CURVE 0x929A 2D_Array_UB 0.0 CM_Mult0_to_2_ratio 0.0 1.9921875
 /begin AXIS_DESCR FIX_AXIS NO_INPUT_QUANTITY CM_Equaloutput1 6 55.0 105.0 MAX_GRAD 0.0 /begin FIX_AXIS_PAR_LIST 55 65 75 85 95 105 /end FIX_AXIS_PAR_LIST /end AXIS_DESCR
/end CHARACTERISTIC
/begin CHARACTERISTIC CT_PrimePulseDelay "cal comments" CURVE 0x9262 2D_Array_UB 0.0 CM_Mult0_to_2_second 0.0 1.9921875
 /begin AXIS_DESCR FIX_AXIS NO_INPUT_QUANTITY CM_Equaloutput1 17 -28.0 164.0 MAX_GRAD 0.0 /begin FIX_AXIS_PAR_LIST -28 -16 -4 8 20 32 44 56 68 80 92 104 116 128 140 152 164 /end FIX_AXIS_PAR_LIST /end AXIS_DESCR
/end CHARACTERISTIC
/begin CHARACTERISTIC CT_PrimePulseWidth "cal comments" CURVE 0x99FE 2D_Array_UW 0.0 CM_msec_0to1024 0.0 1023.984375
 /begin AXIS_DESCR FIX_AXIS NO_INPUT_QUANTITY CM_Equaloutput1 17 -28.0 164.0 MAX_GRAD 0.0 /begin FIX_AXIS_PAR_LIST -28 -16 -4 8 20 32 44 56 68 80 92 104 116 128 140 152 164 /end FIX_AXIS_PAR_LIST /end AXIS_DESCR
/end CHARACTERISTIC
/begin CHARACTERISTIC CT_RunTimeThreshToEnbNextPrimePulse "cal comments" CURVE 0x9276 2D_Array_UW 0.0 CM_Second_0to512 0.0 511.9921875
 /begin AXIS_DESCR FIX_AXIS NO_INPUT_QUANTITY CM_Equaloutput1 17 -28.0 164.0 MAX_GRAD 0.0 /begin FIX_AXIS_PAR_LIST -28 -16 -4 8 20 32 44 56 68 80 92 104 116 128 140 152 164 /end FIX_AXIS_PAR_LIST /end AXIS_DESCR
/end CHARACTERISTIC
/begin CHARACTERISTIC CT_SACoolTempOfst "cal comments" MAP 0xA439 D_Array_SB 0.0 CM_Angle_8bit -64.0 63.5
 /begin AXIS_DESCR FIX_AXIS NO_INPUT_QUANTITY CM_Equaloutput1 17 -28.0 164.0 MAX_GRAD 0.0 /begin FIX_AXIS_PAR_LIST -28 -16 -4 8 20 32 44 56 68 80 92 104 116 128 140 152 164 /end FIX_AXIS_PAR_LIST /end AXIS_DESCR
 /begin AXIS_DESCR FIX_AXIS NO_INPUT_QUANTITY CM_Equaloutput1 9 15.0 115.0 MAX_GRAD 0.0 /begin FIX_AXIS_PAR_LIST 15 27.5 40 52.5 65 77.5 90 102.5 115 /end FIX_AXIS_PAR_LIST /end AXIS_DESCR
/end CHARACTERISTIC
/begin CHARACTERISTIC CT_SACrankBaroOffset "cal comments" CURVE 0xB014 2D_Array_SB 0.0 CM_Angle_8bit -64.0 63.5
 /begin AXIS_DESCR FIX_AXIS NO_INPUT_QUANTITY CM_Equaloutput1 11 55.0 105.0 MAX_GRAD 0.0 /begin FIX_AXIS_PAR_LIST 55 60 65 70 75 80 85 90 95 100 105 /end FIX_AXIS_PAR_LIST /end AXIS_DESCR
/end CHARACTERISTIC
/begin CHARACTERISTIC CT_SACrankMain "cal comments" CURVE 0xAFEE 2D_Array_SB 0.0 CM_Angle_8bit -64.0 63.5
 /begin AXIS_DESCR FIX_AXIS NO_INPUT_QUANTITY CM_Equaloutput1 17 -28.0 164.0 MAX_GRAD 0.0 /begin FIX_AXIS_PAR_LIST -28 -16 -4 8 20 32 44 56 68 80 92 104 116 128 140 152 164 /end FIX_AXIS_PAR_LIST /end AXIS_DESCR
/end CHARACTERISTIC
/begin CHARACTERISTIC CT_SAIntakeAirTempOfst "cal comments" MAP 0xA39D D_Array_SB 0.0 CM_Angle_8bit -64.0 63.5
 /begin AXIS_DESCR FIX_AXIS NO_INPUT_QUANTITY CM_Equaloutput1 17 -28.0 164.0 MAX_GRAD 0.0 /begin FIX_AXIS_PAR_LIST -28 -16 -4 8 20 32 44 56 68 80 92 104 116 128 140 152 164 /end FIX_AXIS_PAR_LIST /end AXIS_DESCR
 /begin AXIS_DESCR FIX_AXIS NO_INPUT_QUANTITY CM_Equaloutput1 9 15.0 115.0 MAX_GRAD 0.0 /begin FIX_AXIS_PAR_LIST 15 27.5 40 52.5 65 77.5 90 102.5 115 /end FIX_AXIS_PAR_LIST /end AXIS_DESCR
/end CHARACTERISTIC
/begin CHARACTERISTIC CT_SAPEMainCyl1 "cal comments" MAP 0xAEDD D_Array_SB 0.0 CM_Angle_8bit -64.0 63.5
 /begin AXIS_DESCR FIX_AXIS NO_INPUT_QUANTITY CM_Equaloutput1 6 50.0 100.0 MAX_GRAD 0.0 /begin FIX_AXIS_PAR_LIST 50 60 70 80 90 100 /end FIX_AXIS_PAR_LIST /end AXIS_DESCR
 /begin AXIS_DESCR COM_AXIS NO_INPUT_QUANTITY CM_Equaloutput1 17 0.0 16383.75 AXIS_PTS_REF CA_EngSpd17Step3 MAX_GRAD 0.0 /end AXIS_DESCR
/end CHARACTERISTIC
/begin CHARACTERISTIC CT_SAPESubCyl1 "cal comments" MAP 0xAF46 D_Array_SB 0.0 CM_Angle_8bit -64.0 63.5
 /begin AXIS_DESCR FIX_AXIS NO_INPUT_QUANTITY CM_Equaloutput1 6 50.0 100.0 MAX_GRAD 0.0 /begin FIX_AXIS_PAR_LIST 50 60 70 80 90 100 /end FIX_AXIS_PAR_LIST /end AXIS_DESCR
 /begin AXIS_DESCR COM_AXIS NO_INPUT_QUANTITY CM_Equaloutput1 17 0.0 16383.75 AXIS_PTS_REF CA_EngSpd17Step3 MAX_GRAD 0.0 /end AXIS_DESCR
/end CHARACTERISTIC
/begin CHARACTERISTIC CT_SparkAdvanceMain "cal comments" MAP 0xA4D5 D_Array_SB 0.0 CM_Angle_8bit -64.0 63.5
 /begin AXIS_DESCR COM_AXIS NO_INPUT_QUANTITY CM_Equaloutput1 18 0.0 255.99609375 AXIS_PTS_REF CA_MAP18Step1 MAX_GRAD 0.0 /end AXIS_DESCR
 /begin AXIS_DESCR COM_AXIS NO_INPUT_QUANTITY CM_Equaloutput1 17 0.0 16383.75 AXIS_PTS_REF CA_EngSpd17Step1 MAX_GRAD 0.0 /end AXIS_DESCR
/end CHARACTERISTIC
/begin CHARACTERISTIC CT_SparkAdvanceCyl2Offset2Main "cal comments" MAP 0xA60A D_Array_SB 0.0 CM_Angle_8bit -64.0 63.5
 /begin AXIS_DESCR COM_AXIS NO_INPUT_QUANTITY CM_Equaloutput1 18 0.0 255.99609375 AXIS_PTS_REF CA_MAP18Step1 MAX_GRAD 0.0 /end AXIS_DESCR
 /begin AXIS_DESCR COM_AXIS NO_INPUT_QUANTITY CM_Equaloutput1 17 0.0 16383.75 AXIS_PTS_REF CA_EngSpd17Step1 MAX_GRAD 0.0 /end AXIS_DESCR
/end CHARACTERISTIC
/begin CHARACTERISTIC CT_SparkAdvanceCyl3Offset2Main "cal comments" MAP 0xA73F D_Array_SB 0.0 CM_Angle_8bit -64.0 63.5
 /begin AXIS_DESCR COM_AXIS NO_INPUT_QUANTITY CM_Equaloutput1 18 0.0 255.99609375 AXIS_PTS_REF CA_MAP18Step1 MAX_GRAD 0.0 /end AXIS_DESCR
 /begin AXIS_DESCR COM_AXIS NO_INPUT_QUANTITY CM_Equaloutput1 17 0.0 16383.75 AXIS_PTS_REF CA_EngSpd17Step1 MAX_GRAD 0.0 /end AXIS_DESCR
/end CHARACTERISTIC
/begin CHARACTERISTIC CT_SparkAdvanceCyl4Offset2Main "cal comments" MAP 0xA874 D_Array_SB 0.0 CM_Angle_8bit -64.0 63.5
 /begin AXIS_DESCR COM_AXIS NO_INPUT_QUANTITY CM_Equaloutput1 18 0.0 255.99609375 AXIS_PTS_REF CA_MAP18Step1 MAX_GRAD 0.0 /end AXIS_DESCR
 /begin AXIS_DESCR COM_AXIS NO_INPUT_QUANTITY CM_Equaloutput1 17 0.0 16383.75 AXIS_PTS_REF CA_EngSpd17Step1 MAX_GRAD 0.0 /end AXIS_DESCR
/end CHARACTERISTIC
/begin CHARACTERISTIC CT_SparkAdvanceSub "cal comments" MAP 0xA9A9 D_Array_SB 0.0 CM_Angle_8bit -64.0 63.5
 /begin AXIS_DESCR COM_AXIS NO_INPUT_QUANTITY CM_Equaloutput1 18 0.0 255.99609375 AXIS_PTS_REF CA_MAP18Step1 MAX_GRAD 0.0 /end AXIS_DESCR
 /begin AXIS_DESCR COM_AXIS NO_INPUT_QUANTITY CM_Equaloutput1 17 0.0 16383.75 AXIS_PTS_REF CA_EngSpd17Step1 MAX_GRAD 0.0 /end AXIS_DESCR
/end CHARACTERISTIC
/begin CHARACTERISTIC CT_SparkAdvanceCyl2Offset2Sub "cal comments" MAP 0xAADE D_Array_SB 0.0 CM_Angle_8bit -64.0 63.5
 /begin AXIS_DESCR COM_AXIS NO_INPUT_QUANTITY CM_Equaloutput1 18 0.0 255.99609375 AXIS_PTS_REF CA_MAP18Step1 MAX_GRAD 0.0 /end AXIS_DESCR
 /begin AXIS_DESCR COM_AXIS NO_INPUT_QUANTITY CM_Equaloutput1 17 0.0 16383.75 AXIS_PTS_REF CA_EngSpd17Step1 MAX_GRAD 0.0 /end AXIS_DESCR
/end CHARACTERISTIC
/begin CHARACTERISTIC CT_SparkAdvanceCyl3Offset2Sub "cal comments" MAP 0xAC13 D_Array_SB 0.0 CM_Angle_8bit -64.0 63.5
 /begin AXIS_DESCR COM_AXIS NO_INPUT_QUANTITY CM_Equaloutput1 18 0.0 255.99609375 AXIS_PTS_REF CA_MAP18Step1 MAX_GRAD 0.0 /end AXIS_DESCR
 /begin AXIS_DESCR COM_AXIS NO_INPUT_QUANTITY CM_Equaloutput1 17 0.0 16383.75 AXIS_PTS_REF CA_EngSpd17Step1 MAX_GRAD 0.0 /end AXIS_DESCR
/end CHARACTERISTIC
/begin CHARACTERISTIC CT_SparkAdvanceCyl4Offset2Sub "cal comments" MAP 0xAD48 D_Array_SB 0.0 CM_Angle_8bit -64.0 63.5
 /begin AXIS_DESCR COM_AXIS NO_INPUT_QUANTITY CM_Equaloutput1 18 0.0 255.99609375 AXIS_PTS_REF CA_MAP18Step1 MAX_GRAD 0.0 /end AXIS_DESCR
 /begin AXIS_DESCR COM_AXIS NO_INPUT_QUANTITY CM_Equaloutput1 17 0.0 16383.75 AXIS_PTS_REF CA_EngSpd17Step1 MAX_GRAD 0.0 /end AXIS_DESCR
/end CHARACTERISTIC
/begin CHARACTERISTIC CT_SparkCalcDeadBandAngle "cal comments" CURVE 0x8024 2D_Array_UW 0.0 CM_CrankAngle_0to512 0.0 511.9921875
 /begin AXIS_DESCR FIX_AXIS NO_INPUT_QUANTITY CM_Equaloutput1 9 0.0 6400.0 MAX_GRAD 0.0 /begin FIX_AXIS_PAR_LIST 0 800 1600 2400 3200 4000 4800 5600 6400 /end FIX_AXIS_PAR_LIST /end AXIS_DESCR
/end CHARACTERISTIC
/begin CHARACTERISTIC C_PickupTooth2TDCAngle "cal comments" VALUE 0x8036 Scalar_SW 0.0 CM_SparkAngle_N256to256 -256.0 255.9921875 /end CHARACTERISTIC
/begin CHARACTERISTIC CT_SparkDwellIntakeAirTempMult "cal comments" CURVE 0xAFB8 2D_Array_UB 0.0 CM_Mult0_to_2_ratio 0.0 1.9921875
 /begin AXIS_DESCR FIX_AXIS NO_INPUT_QUANTITY CM_Equaloutput1 9 -28.0 36.0 MAX_GRAD 0.0 /begin FIX_AXIS_PAR_LIST -28 -20 -12 -4 4 12 20 28 36 /end FIX_AXIS_PAR_LIST /end AXIS_DESCR
/end CHARACTERISTIC
/begin CHARACTERISTIC CT_SparkDwellMain "cal comments" MAP 0xA279 3D_Array_UB 0.0 CM_msec 0.0 15.9375
 /begin AXIS_DESCR FIX_AXIS NO_INPUT_QUANTITY CM_Equaloutput1 17 6.0 18.79999923706055 MAX_GRAD 0.0
  /begin FIX_AXIS_PAR_LIST 6 6.8 7.6 8.4 9.199999999999999 10 10.8 11.6 12.4 13.2 14 14.8 15.6 16.4 17.2 18 18.8 /end FIX_AXIS_PAR_LIST
 /end AXIS_DESCR
 /begin AXIS_DESCR FIX_AXIS NO_INPUT_QUANTITY CM_Equaloutput1 17 0.0 12800.0 MAX_GRAD 0.0
  /begin FIX_AXIS_PAR_LIST 0 800 1600 2400 3200 4000 4800 5600 6400 7200 8000 8800 9600 10400 11200 12000 12800 /end FIX_AXIS_PAR_LIST
 /end AXIS_DESCR
/end CHARACTERISTIC
/begin CHARACTERISTIC CT_SparkDwellMaxLimit "cal comments" CURVE 0xAECC 2D_Array_UB 0.0 CM_msec 0.0 15.9375
 /begin AXIS_DESCR FIX_AXIS NO_INPUT_QUANTITY CM_Equaloutput1 9 0.0 12800.0 MAX_GRAD 0.0 /begin FIX_AXIS_PAR_LIST 0 1600 3200 4800 6400 8000 9600 11200 12800 /end FIX_AXIS_PAR_LIST /end AXIS_DESCR
/end CHARACTERISTIC
/begin CHARACTERISTIC CT_SpeedControlDerivLvlMult "cal comments" CURVE 0xA028 2D_Array_UW 0.0 udf_CM_18376 0.0 15.999755859375
 /begin AXIS_DESCR FIX_AXIS NO_INPUT_QUANTITY CM_Equaloutput1 5 1.0 5.0 MAX_GRAD 0.0 /begin FIX_AXIS_PAR_LIST 1 2 3 4 5 /end FIX_AXIS_PAR_LIST /end AXIS_DESCR
/end CHARACTERISTIC
/begin CHARACTERISTIC CT_SpeedControlFlowBaroMult "cal comments" CURVE 0xA139 2D_Array_UB 0.0 CM_Mult_0to8 0.0 7.96875
 /begin AXIS_DESCR FIX_AXIS NO_INPUT_QUANTITY CM_Equaloutput1 6 55.0 105.0 MAX_GRAD 0.0 /begin FIX_AXIS_PAR_LIST 55 65 75 85 95 105 /end FIX_AXIS_PAR_LIST /end AXIS_DESCR
/end CHARACTERISTIC
/begin CHARACTERISTIC CT_SpeedControlInitFlowLvlMult "cal comments" CURVE 0xA00A 2D_Array_UW 0.0 udf_CM_18376 0.0 15.999755859375
 /begin AXIS_DESCR FIX_AXIS NO_INPUT_QUANTITY CM_Equaloutput1 5 1.0 5.0 MAX_GRAD 0.0 /begin FIX_AXIS_PAR_LIST 1 2 3 4 5 /end FIX_AXIS_PAR_LIST /end AXIS_DESCR
/end CHARACTERISTIC
/begin CHARACTERISTIC CT_SpeedControlIntglLvlMult "cal comments" CURVE 0xA01E 2D_Array_UW 0.0 udf_CM_18376 0.0 15.999755859375
 /begin AXIS_DESCR FIX_AXIS NO_INPUT_QUANTITY CM_Equaloutput1 5 1.0 5.0 MAX_GRAD 0.0 /begin FIX_AXIS_PAR_LIST 1 2 3 4 5 /end FIX_AXIS_PAR_LIST /end AXIS_DESCR
/end CHARACTERISTIC
/begin CHARACTERISTIC CT_SpeedControlPropLvlMult "cal comments" CURVE 0xA014 2D_Array_UW 0.0 udf_CM_18376 0.0 15.999755859375
 /begin AXIS_DESCR FIX_AXIS NO_INPUT_QUANTITY CM_Equaloutput1 5 1.0 5.0 MAX_GRAD 0.0 /begin FIX_AXIS_PAR_LIST 1 2 3 4 5 /end FIX_AXIS_PAR_LIST /end AXIS_DESCR
/end CHARACTERISTIC
/begin CHARACTERISTIC CT_ThrottleFlow "cal comments" CURVE 0xA068 2D_Array_UW 0.0 udf_CM_18698 0.0 511.9921875
 /begin AXIS_DESCR COM_AXIS NO_INPUT_QUANTITY CM_Equaloutput1 21 0.0 199.9969024658203 AXIS_PTS_REF CA_PercentStep21 MAX_GRAD 0.0 /end AXIS_DESCR
/end CHARACTERISTIC
/begin CHARACTERISTIC CT_ThrottleFlow_Reverse "cal comments" CURVE 0xA094 2D_Array_UW 0.0 CM_Percent_0to200_2 0.0 199.9969024658203
 /begin AXIS_DESCR COM_AXIS NO_INPUT_QUANTITY CM_Equaloutput1 21 0.0 511.9921875 AXIS_PTS_REF CA_GramStep21 MAX_GRAD 0.0 /end AXIS_DESCR
/end CHARACTERISTIC
/begin CHARACTERISTIC CT_TimpPulseWidthMult "cal comments" MAP 0x9D7B 3D_Array_UB 0.0 CM_Mult_0to8 0.0 7.96875
 /begin AXIS_DESCR FIX_AXIS NO_INPUT_QUANTITY CM_Equaloutput1 9 -28.0 164.0 MAX_GRAD 0.0 /begin FIX_AXIS_PAR_LIST -28 -4 20 44 68 92 116 140 164 /end FIX_AXIS_PAR_LIST /end AXIS_DESCR
 /begin AXIS_DESCR FIX_AXIS NO_INPUT_QUANTITY CM_Equaloutput1 6 800.0 2800.0 MAX_GRAD 0.0 /begin FIX_AXIS_PAR_LIST 800 1200 1600 2000 2400 2800 /end FIX_AXIS_PAR_LIST /end AXIS_DESCR
/end CHARACTERISTIC
/begin CHARACTERISTIC CT_VEAltCorrFactor "cal comments" MAP 0x8ECA 3D_Array_UB 0.0 CM_Mult0_to_2_ratio 0.0 1.9921875
 /begin AXIS_DESCR COM_AXIS NO_INPUT_QUANTITY CM_Equaloutput1 6 0.0 255.99609375 AXIS_PTS_REF CA_VELoad6Step MAX_GRAD 0.0 /end AXIS_DESCR
 /begin AXIS_DESCR FIX_AXIS NO_INPUT_QUANTITY CM_Equaloutput1 11 55.0 105.0 MAX_GRAD 0.0 /begin FIX_AXIS_PAR_LIST 55 60 65 70 75 80 85 90 95 100 105 /end FIX_AXIS_PAR_LIST /end AXIS_DESCR
/end CHARACTERISTIC
/begin CHARACTERISTIC CT_VEMainHighLoadCyl1 "cal comments" MAP 0x830A 3D_Array_UW 0.0 CM_Percent_0to200_2 0.0 199.9969024658203
 /begin AXIS_DESCR COM_AXIS NO_INPUT_QUANTITY CM_Equaloutput1 22 0.0 255.99609375 AXIS_PTS_REF CA_MAP22Step1 MAX_GRAD 0.0 /end AXIS_DESCR
 /begin AXIS_DESCR COM_AXIS NO_INPUT_QUANTITY CM_Equaloutput1 17 0.0 16383.75 AXIS_PTS_REF CA_EngSpd17Step1 MAX_GRAD 0.0 /end AXIS_DESCR
/end CHARACTERISTIC
/begin CHARACTERISTIC CT_VEMainHighLoadCyl2 "cal comments" MAP 0x85FA 3D_Array_UW 0.0 CM_Percent_0to200_2 0.0 199.9969024658203
 /begin AXIS_DESCR COM_AXIS NO_INPUT_QUANTITY CM_Equaloutput1 22 0.0 255.99609375 AXIS_PTS_REF CA_MAP22Step1 MAX_GRAD 0.0 /end AXIS_DESCR
 /begin AXIS_DESCR COM_AXIS NO_INPUT_QUANTITY CM_Equaloutput1 17 0.0 16383.75 AXIS_PTS_REF CA_EngSpd17Step1 MAX_GRAD 0.0 /end AXIS_DESCR
/end CHARACTERISTIC
/begin CHARACTERISTIC CT_VEMainHighLoadCyl3 "cal comments" MAP 0x88EA 3D_Array_UW 0.0 CM_Percent_0to200_2 0.0 199.9969024658203
 /begin AXIS_DESCR COM_AXIS NO_INPUT_QUANTITY CM_Equaloutput1 22 0.0 255.99609375 AXIS_PTS_REF CA_MAP22Step1 MAX_GRAD 0.0 /end AXIS_DESCR
 /begin AXIS_DESCR COM_AXIS NO_INPUT_QUANTITY CM_Equaloutput1 17 0.0 16383.75 AXIS_PTS_REF CA_EngSpd17Step1 MAX_GRAD 0.0 /end AXIS_DESCR
/end CHARACTERISTIC
/begin CHARACTERISTIC CT_VEMainHighLoadCyl4 "cal comments" MAP 0x8BDA 3D_Array_UW 0.0 CM_Percent_0to200_2 0.0 199.9969024658203
 /begin AXIS_DESCR COM_AXIS NO_INPUT_QUANTITY CM_Equaloutput1 22 0.0 255.99609375 AXIS_PTS_REF CA_MAP22Step1 MAX_GRAD 0.0 /end AXIS_DESCR
 /begin AXIS_DESCR COM_AXIS NO_INPUT_QUANTITY CM_Equaloutput1 17 0.0 16383.75 AXIS_PTS_REF CA_EngSpd17Step1 MAX_GRAD 0.0 /end AXIS_DESCR
/end CHARACTERISTIC
/begin CHARACTERISTIC C_VESynForCalEn "cal comments" VALUE 0x8EC6 Scalar_UB 0.0 CM_Boolean6 0.0 255.0 /end CHARACTERISTIC
/begin CHARACTERISTIC CT_VirtualTPS "cal comments" CURVE 0xB05C 2D_Array_UB 0.0 CM_Percent_0to200_3 0.0 199.21875
 /begin AXIS_DESCR COM_AXIS NO_INPUT_QUANTITY CM_Equaloutput1 10 0.0 255.99609375 AXIS_PTS_REF CA_MAP10Step1 MAX_GRAD 0.0 /end AXIS_DESCR
/end CHARACTERISTIC
/begin CHARACTERISTIC D_BatteryVoltTooHighThresh "cal comments" VALUE 0xBC7E Scalar_UW 0.0 CM_Volt_0to32_2 0.0 31.99900627136231 /end CHARACTERISTIC
/begin CHARACTERISTIC D_BatteryVoltTooLowThresh "cal comments" VALUE 0xBC80 Scalar_UW 0.0 CM_Volt_0to32_2 0.0 31.99900627136231 /end CHARACTERISTIC
/begin CHARACTERISTIC D_BatVoltDiagPassTimeThrsh "cal comments" VALUE 0xBCBE Scalar_UW 0.0 CM_Count_0to65535_2 0.0 65535.0 /end CHARACTERISTIC
/begin CHARACTERISTIC D_BatVoltEnb "cal comments" VALUE 0xBCC4 Scalar_UB 0.0 CM_Boolean6 0.0 255.0 /end CHARACTERISTIC
/begin CHARACTERISTIC D_BatVoltHighFailTimeThrsh "cal comments" VALUE 0xBCBC Scalar_UW 0.0 CM_Count_0to65535_2 0.0 65535.0 /end CHARACTERISTIC
/begin CHARACTERISTIC D_BatVoltLightEnb "cal comments" VALUE 0xBCC5 Scalar_UB 0.0 CM_Boolean6 0.0 255.0 /end CHARACTERISTIC
/begin CHARACTERISTIC D_BatVoltLowFailTimeThrsh "cal comments" VALUE 0xBCBA Scalar_UW 0.0 CM_Count_0to65535_2 0.0 65535.0 /end CHARACTERISTIC
/begin CHARACTERISTIC D_BatVoltRangeThreshHi "cal comments" VALUE 0xBCC2 Scalar_UW 0.0 CM_Volt_0to32_1 0.0 31.99900627136231 /end CHARACTERISTIC
/begin CHARACTERISTIC D_BatVoltRangeThreshLo "cal comments" VALUE 0xBCC0 Scalar_UW 0.0 CM_Volt_0to32_1 0.0 31.99900627136231 /end CHARACTERISTIC
/begin CHARACTERISTIC D_GENVDiagPassTimeThrsh "cal comments" VALUE 0x0 Scalar_UW 0.0 CM_Count_0to65535_2 0.0 65535.0 /end CHARACTERISTIC
/begin CHARACTERISTIC D_GENVEnb "cal comments" VALUE 0x0 Scalar_UB 0.0 CM_Boolean6 0.0 255.0 /end CHARACTERISTIC
/begin CHARACTERISTIC D_GENVHighFailTimeThrsh "cal comments" VALUE 0x0 Scalar_UW 0.0 CM_Count_0to65535_2 0.0 65535.0 /end CHARACTERISTIC
/begin CHARACTERISTIC D_GENVLightEnb "cal comments" VALUE 0x0 Scalar_UB 0.0 CM_Boolean6 0.0 255.0 /end CHARACTERISTIC
/begin CHARACTERISTIC D_GENVLowFailTimeThrsh "cal comments" VALUE 0x0 Scalar_UW 0.0 CM_Count_0to65535_2 0.0 65535.0 /end CHARACTERISTIC
/begin CHARACTERISTIC D_GENVRangeThreshHi "cal comments" VALUE 0x0 Scalar_UW 0.0 CM_Volt_0to1024_1 0.0 1023.984375 /end CHARACTERISTIC
/begin CHARACTERISTIC D_GENVRangeThreshLo "cal comments" VALUE 0x0 Scalar_UW 0.0 CM_Volt_0to1024_1 0.0 1023.984375 /end CHARACTERISTIC
/begin CHARACTERISTIC D_CoolTempShortEnb "cal comments" VALUE 0xBB76 Scalar_UB 0.0 CM_Boolean6 0.0 255.0 /end CHARACTERISTIC
/begin CHARACTERISTIC D_CoolTempShortHiDiagRunTimeThrsh "cal comments" VALUE 0xBB70 Scalar_UW 0.0 CM_Count_0to65535_1 0.0 65535.0 /end CHARACTERISTIC
/begin CHARACTERISTIC D_CoolTempShortHighFailTimeThrsh "cal comments" VALUE 0xBB5C Scalar_UW 0.0 CM_Count_0to65535_1 0.0 65535.0 /end CHARACTERISTIC
/begin CHARACTERISTIC D_CoolTempShortHighPassTimeThrsh "cal comments" VALUE 0xBB5E Scalar_UW 0.0 CM_Count_0to65535_1 0.0 65535.0 /end CHARACTERISTIC
/begin CHARACTERISTIC D_CoolTempShortLightEnb "cal comments" VALUE 0xBB77 Scalar_UB 0.0 CM_Boolean6 0.0 255.0 /end CHARACTERISTIC
/begin CHARACTERISTIC D_CoolTempShortLoDiagRunTimeThrsh "cal comments" VALUE 0xBB72 Scalar_UW 0.0 CM_Count_0to65535_1 0.0 65535.0 /end CHARACTERISTIC
/begin CHARACTERISTIC D_CoolTempShortLowFailTimeThrsh "cal comments" VALUE 0xBB60 Scalar_UW 0.0 CM_Count_0to65535_1 0.0 65535.0 /end CHARACTERISTIC
/begin CHARACTERISTIC D_CoolTempShortLowPassTimeThrsh "cal comments" VALUE 0xBB62 Scalar_UW 0.0 CM_Count_0to65535_1 0.0 65535.0 /end CHARACTERISTIC
/begin CHARACTERISTIC D_CoolTempShortRangeThreshHi "cal comments" VALUE 0xBB68 Scalar_UW 0.0 CM_Percent_0to100_1 0.0 99.9984130859375 /end CHARACTERISTIC
/begin CHARACTERISTIC D_CoolTempShortRangeThreshLo "cal comments" VALUE 0xBB6A Scalar_UW 0.0 CM_Percent_0to100_1 0.0 99.9984130859375 /end CHARACTERISTIC
/begin CHARACTERISTIC D_CoolTempOverHeatLightEnb "cal comments" VALUE 0xBB78 Scalar_UB 0.0 CM_Boolean6 0.0 255.0 /end CHARACTERISTIC
/begin CHARACTERISTIC D_CoolTempOverHeatDiagRunTimeThrsh "cal comments" VALUE 0xBB74 Scalar_UW 0.0 CM_Count_0to65535_1 0.0 65535.0 /end CHARACTERISTIC
/begin CHARACTERISTIC D_CoolTempOverHeatFailTimeThrsh "cal comments" VALUE 0xBB64 Scalar_UW 0.0 CM_Count_0to65535_1 0.0 65535.0 /end CHARACTERISTIC
/begin CHARACTERISTIC D_CoolTempOverHeatPassTimeThrsh "cal comments" VALUE 0xBB66 Scalar_UW 0.0 CM_Count_0to65535_1 0.0 65535.0 /end CHARACTERISTIC
/begin CHARACTERISTIC D_CoolTempOverHeatThresh "cal comments" VALUE 0xBB6C Scalar_SW 0.0 CM_DegC_N256to256 -256.0 255.9921875 /end CHARACTERISTIC
/begin CHARACTERISTIC D_CoolTempOverHeatHsyt "cal comments" VALUE 0xBB6E Scalar_SW 0.0 CM_DegC_N256to256 -256.0 255.9921875 /end CHARACTERISTIC
/begin CHARACTERISTIC D_CoolTemp2ShortEnb "cal comments" VALUE 0xBB8A Scalar_UB 0.0 CM_Boolean6 0.0 255.0 /end CHARACTERISTIC
/begin CHARACTERISTIC D_CoolTemp2ShortHiDiagRunTimeThrsh "cal comments" VALUE 0xBB86 Scalar_UW 0.0 CM_Count_0to65535_1 0.0 65535.0 /end CHARACTERISTIC
/begin CHARACTERISTIC D_CoolTemp2ShortHighFailTimeThrsh "cal comments" VALUE 0xBB7A Scalar_UW 0.0 CM_Count_0to65535_1 0.0 65535.0 /end CHARACTERISTIC
/begin CHARACTERISTIC D_CoolTemp2ShortHighPassTimeThrsh "cal comments" VALUE 0xBB7C Scalar_UW 0.0 CM_Count_0to65535_1 0.0 65535.0 /end CHARACTERISTIC
/begin CHARACTERISTIC D_CoolTemp2ShortLightEnb "cal comments" VALUE 0xBB8B Scalar_UB 0.0 CM_Boolean6 0.0 255.0 /end CHARACTERISTIC
/begin CHARACTERISTIC D_CoolTemp2ShortLoDiagRunTimeThrsh "cal comments" VALUE 0xBB88 Scalar_UW 0.0 CM_Count_0to65535_1 0.0 65535.0 /end CHARACTERISTIC
/begin CHARACTERISTIC D_CoolTemp2ShortLowFailTimeThrsh "cal comments" VALUE 0xBB7E Scalar_UW 0.0 CM_Count_0to65535_1 0.0 65535.0 /end CHARACTERISTIC
/begin CHARACTERISTIC D_CoolTemp2ShortLowPassTimeThrsh "cal comments" VALUE 0xBB80 Scalar_UW 0.0 CM_Count_0to65535_1 0.0 65535.0 /end CHARACTERISTIC
/begin CHARACTERISTIC D_CoolTemp2ShortRangeThreshHi "cal comments" VALUE 0xBB82 Scalar_UW 0.0 CM_Percent_0to100_1 0.0 99.9984130859375 /end CHARACTERISTIC
/begin CHARACTERISTIC D_CoolTemp2ShortRangeThreshLo "cal comments" VALUE 0xBB84 Scalar_UW 0.0 CM_Percent_0to100_1 0.0 99.9984130859375 /end CHARACTERISTIC
/begin CHARACTERISTIC D_CrankNoisySignalFailTimeThrsh "cal comments" VALUE 0xBBA2 Scalar_UW 0.0 CM_Count_0to65535 0.0 65535.0 /end CHARACTERISTIC
/begin CHARACTERISTIC D_CrankNoisySignalPassTimeThrsh "cal comments" VALUE 0xBBA4 Scalar_UW 0.0 CM_Count_0to65535 0.0 65535.0 /end CHARACTERISTIC
/begin CHARACTERISTIC D_CrankNoisySignalToothErrThrsh "cal comments" VALUE 0xBBA0 Scalar_UW 0.0 CM_Count_0to65535 0.0 65535.0 /end CHARACTERISTIC
/begin CHARACTERISTIC D_CrankNoSignalDeltaIGNVoltThrsh "cal comments" VALUE 0xBBAA Scalar_UW 0.0 CM_Volt_0to32_1 0.0 31.99900627136231 /end CHARACTERISTIC
/begin CHARACTERISTIC D_CrankNoSignalDeltaMAPThrsh "cal comments" VALUE 0xBBA6 Scalar_UW 0.0 CM_kpa_0to256_1 0.0 255.99609375 /end CHARACTERISTIC
/begin CHARACTERISTIC D_CrankNoSignalFailTimeThrsh "cal comments" VALUE 0xBBA8 Scalar_UW 0.0 CM_Second_0to512_1 0.0 511.9921875 /end CHARACTERISTIC
/begin CHARACTERISTIC D_CrankNoSignalPassTimeThrsh "cal comments" VALUE 0xBBAC Scalar_UW 0.0 CM_Second_0to512_1 0.0 511.9921875 /end CHARACTERISTIC
/begin CHARACTERISTIC D_CrankSignalEnb "cal comments" VALUE 0xBBAE Scalar_UB 0.0 CM_Boolean6 0.0 255.0 /end CHARACTERISTIC
/begin CHARACTERISTIC D_CrankSignalLightEnb "cal comments" VALUE 0xBBAF Scalar_UB 0.0 CM_Boolean6 0.0 255.0 /end CHARACTERISTIC
/begin CHARACTERISTIC D_FuelPumpShortEnb "cal comments" VALUE 0xBBB8 Scalar_UB 0.0 CM_Boolean6 0.0 255.0 /end CHARACTERISTIC
/begin CHARACTERISTIC D_FuelPumpShortFailThresh "cal comments" VALUE 0xBC93 Scalar_UB 0.0 CM_Count1 0.0 255.0 /end CHARACTERISTIC
/begin CHARACTERISTIC D_FuelPumpShortLightEnb "cal comments" VALUE 0xBBB9 Scalar_UB 0.0 CM_Boolean6 0.0 255.0 /end CHARACTERISTIC
/begin CHARACTERISTIC D_FuelPumpShortPassThresh "cal comments" VALUE 0xBC94 Scalar_UB 0.0 CM_Count1 0.0 255.0 /end CHARACTERISTIC
/begin CHARACTERISTIC D_DCMShortEnb "cal comments" VALUE 0xBB58 Scalar_UB 0.0 CM_Boolean6 0.0 255.0 /end CHARACTERISTIC
/begin CHARACTERISTIC D_DCMShortFailThresh "cal comments" VALUE 0xBC9B Scalar_UB 0.0 CM_Count1 0.0 255.0 /end CHARACTERISTIC
/begin CHARACTERISTIC D_DCMShortLightEnb "cal comments" VALUE 0xBB59 Scalar_UB 0.0 CM_Boolean6 0.0 255.0 /end CHARACTERISTIC
/begin CHARACTERISTIC D_DCMShortPassThresh "cal comments" VALUE 0xBC9C Scalar_UB 0.0 CM_Count1 0.0 255.0 /end CHARACTERISTIC
/begin CHARACTERISTIC D_TACHShortEnb "cal comments" VALUE 0xBCAC Scalar_UB 0.0 CM_Boolean6 0.0 255.0 /end CHARACTERISTIC
/begin CHARACTERISTIC D_TACHShortFailThresh "cal comments" VALUE 0xBC99 Scalar_UB 0.0 CM_Count1 0.0 255.0 /end CHARACTERISTIC
/begin CHARACTERISTIC D_TACHShortLightEnb "cal comments" VALUE 0xBCAD Scalar_UB 0.0 CM_Boolean6 0.0 255.0 /end CHARACTERISTIC
/begin CHARACTERISTIC D_TACHShortPassThresh "cal comments" VALUE 0xBC9A Scalar_UB 0.0 CM_Count1 0.0 255.0 /end CHARACTERISTIC
/begin CHARACTERISTIC D_CCPShortEnb "cal comments" VALUE 0xBB56 Scalar_UB 0.0 CM_Boolean6 0.0 255.0 /end CHARACTERISTIC
/begin CHARACTERISTIC D_CCPShortFailThresh "cal comments" VALUE 0xBC97 Scalar_UB 0.0 CM_Count1 0.0 255.0 /end CHARACTERISTIC
/begin CHARACTERISTIC D_CCPShortLightEnb "cal comments" VALUE 0xBB57 Scalar_UB 0.0 CM_Boolean6 0.0 255.0 /end CHARACTERISTIC
/begin CHARACTERISTIC D_CCPShortPassThresh "cal comments" VALUE 0xBC98 Scalar_UB 0.0 CM_Count1 0.0 255.0 /end CHARACTERISTIC
/begin CHARACTERISTIC D_IgnitionCoilEnb "cal comments" CURVE 0xBBB0 2D_Array_UB 0.0 CM_Count1 0.0 1.0
 /begin AXIS_DESCR FIX_AXIS NO_INPUT_QUANTITY CM_EOI 4 0.0 4.0 MAX_GRAD 0.0 /begin FIX_AXIS_PAR_LIST 0 1 2 3 /end FIX_AXIS_PAR_LIST /end AXIS_DESCR
/end CHARACTERISTIC
/begin CHARACTERISTIC D_IgnitionCoilLightEnb "cal comments" CURVE 0xBBB4 2D_Array_UB 0.0 CM_Count1 0.0 1.0
 /begin AXIS_DESCR FIX_AXIS NO_INPUT_QUANTITY CM_EOI 4 0.0 4.0 MAX_GRAD 0.0 /begin FIX_AXIS_PAR_LIST 0 1 2 3 /end FIX_AXIS_PAR_LIST /end AXIS_DESCR
/end CHARACTERISTIC
/begin CHARACTERISTIC D_InjCyShortFailThresh "cal comments" CURVE 0xBC8B 2D_Array_UB 0.0 CM_Count1 0.0 255.0
 /begin AXIS_DESCR FIX_AXIS NO_INPUT_QUANTITY CM_EOI 4 0.0 4.0 MAX_GRAD 0.0 /begin FIX_AXIS_PAR_LIST 0 1 2 3 /end FIX_AXIS_PAR_LIST /end AXIS_DESCR
/end CHARACTERISTIC
/begin CHARACTERISTIC D_InjCyShortPassThresh "cal comments" CURVE 0xBC8F 2D_Array_UB 0.0 CM_Count1 0.0 255.0
 /begin AXIS_DESCR FIX_AXIS NO_INPUT_QUANTITY CM_EOI 4 0.0 4.0 MAX_GRAD 0.0 /begin FIX_AXIS_PAR_LIST 0 1 2 3 /end FIX_AXIS_PAR_LIST /end AXIS_DESCR
/end CHARACTERISTIC
/begin CHARACTERISTIC D_InjectorCylEnb "cal comments" CURVE 0xBC38 2D_Array_UB 0.0 CM_Count1 0.0 1.0
 /begin AXIS_DESCR FIX_AXIS NO_INPUT_QUANTITY CM_EOI 4 0.0 4.0 MAX_GRAD 0.0 /begin FIX_AXIS_PAR_LIST 0 1 2 3 /end FIX_AXIS_PAR_LIST /end AXIS_DESCR
/end CHARACTERISTIC
/begin CHARACTERISTIC D_InjectorCylLightEnb "cal comments" CURVE 0xBC3C 2D_Array_UB 0.0 CM_Count1 0.0 1.0
 /begin AXIS_DESCR FIX_AXIS NO_INPUT_QUANTITY CM_EOI 4 0.0 4.0 MAX_GRAD 0.0 /begin FIX_AXIS_PAR_LIST 0 1 2 3 /end FIX_AXIS_PAR_LIST /end AXIS_DESCR
/end CHARACTERISTIC
/begin CHARACTERISTIC D_IntakeAirTempShortEnb "cal comments" VALUE 0xBBE8 Scalar_UB 0.0 CM_Boolean6 0.0 255.0 /end CHARACTERISTIC
/begin AXIS_PTS CA_TPS11Step "AXIS comments" 0xA178 NO_INPUT_QUANTITY AxisPtsX_UW 0.0 CM_Percent_0to200_2 11 0.0 199.9969024658203 /end AXIS_PTS
/begin AXIS_PTS CA_GENV11Step "AXIS comments" 0x2 NO_INPUT_QUANTITY AxisPtsX_UW 0.0 CM_Volt_0to1024_1 11 0.0 1023.984375 /end AXIS_PTS
/begin AXIS_PTS CA_EngSpd10Step1 "AXIS comments" 0x8094 NO_INPUT_QUANTITY AxisPtsX_UW 0.0 CM_RPM_0to16384 10 0.0 16383.75 /end AXIS_PTS
/begin AXIS_PTS CA_EngSpd13Step3 "AXIS comments" 0x80AA NO_INPUT_QUANTITY AxisPtsX_UW 0.0 CM_RPM_0to16384 13 0.0 16383.75 /end AXIS_PTS
/begin AXIS_PTS CA_EngSpd17Step1 "AXIS comments" 0x80C6 NO_INPUT_QUANTITY AxisPtsX_UW 0.0 CM_RPM_0to16384 17 0.0 16383.75 /end AXIS_PTS
/begin AXIS_PTS CA_EngSpd17Step2 "AXIS comments" 0x81A2 NO_INPUT_QUANTITY AxisPtsX_UW 0.0 CM_RPM_0to16384 17 0.0 16383.75 /end AXIS_PTS
/begin AXIS_PTS CA_EngSpd17Step3 "AXIS comments" 0xA238 NO_INPUT_QUANTITY AxisPtsX_UW 0.0 CM_RPM_0to16384 17 0.0 16383.75 /end AXIS_PTS
/begin AXIS_PTS CA_EngSpd17Step4 "AXIS comments" 0x81C6 NO_INPUT_QUANTITY AxisPtsX_UW 0.0 CM_RPM_0to16384 17 0.0 16383.75 /end AXIS_PTS
/begin AXIS_PTS CA_EngSpd4Step1 "AXIS comments" 0x8210 NO_INPUT_QUANTITY AxisPtsX_UW 0.0 CM_RPM_0to16384 4 0.0 16383.75 /end AXIS_PTS
/begin AXIS_PTS CA_EngSpd6Step2 "AXIS comments" 0x81EA NO_INPUT_QUANTITY AxisPtsX_UW 0.0 CM_RPM_0to16384 6 0.0 16383.75 /end AXIS_PTS
/begin AXIS_PTS CA_EngSpd9Step1 "AXIS comments" 0x8080 NO_INPUT_QUANTITY AxisPtsX_UW 0.0 CM_RPM_0to16384 9 0.0 16383.75 /end AXIS_PTS
/begin AXIS_PTS CA_GramStep21 "AXIS comments" 0x8246 NO_INPUT_QUANTITY AxisPtsX_UW 0.0 udf_CM_18705 21 0.0 511.9921875 /end AXIS_PTS
/begin AXIS_PTS CA_AirGramStep17 "AXIS comments" 0xB61E NO_INPUT_QUANTITY AxisPtsX_UW 0.0 udf_CM_18705 17 0.0 511.9921875 /end AXIS_PTS
/begin AXIS_PTS CA_FuelGramStep17 "AXIS comments" 0xB5F2 NO_INPUT_QUANTITY AxisPtsX_UW 0.0 udf_CM_16444 17 0.0 15.999755859375 /end AXIS_PTS
/begin AXIS_PTS CA_MAP10Step1 "AXIS comments" 0x80FE NO_INPUT_QUANTITY AxisPtsX_UW 0.0 CM_kpa_0to256_1 10 0.0 255.99609375 /end AXIS_PTS
/begin AXIS_PTS CA_MAP18Step1 "AXIS comments" 0x8114 NO_INPUT_QUANTITY AxisPtsX_UW 0.0 CM_kpa_0to256_1 18 0.0 255.99609375 /end AXIS_PTS
/begin AXIS_PTS CA_MAP15Step1 "AXIS comments" 0x813A NO_INPUT_QUANTITY AxisPtsX_UW 0.0 CM_kpa_0to256_1 15 0.0 255.99609375 /end AXIS_PTS
/begin AXIS_PTS CA_MAP22Step1 "AXIS comments" 0x8174 NO_INPUT_QUANTITY AxisPtsX_UW 0.0 CM_kpa_0to256_1 22 0.0 255.99609375 /end AXIS_PTS
/begin AXIS_PTS CA_MAP12Step1 "AXIS comments" 0x815A NO_INPUT_QUANTITY AxisPtsX_UW 0.0 CM_kpa_0to512_1 12 0.0 511.9921875 /end AXIS_PTS
/begin AXIS_PTS CA_MAP9Step1 "AXIS comments" 0x80EA NO_INPUT_QUANTITY AxisPtsX_UW 0.0 CM_kpa_0to256_1 9 0.0 255.99609375 /end AXIS_PTS
/begin AXIS_PTS CA_MAP9Step2 "AXIS comments" 0x8F48 NO_INPUT_QUANTITY AxisPtsX_UW 0.0 CM_kpa_0to256_1 9 0.0 255.99609375 /end AXIS_PTS
/begin AXIS_PTS CA_Percent1 "AXIS comments" 0x81F8 NO_INPUT_QUANTITY AxisPtsX_UW 0.0 CM_Percent_0to200_2 4 0.0 199.9969024658203 /end AXIS_PTS
/begin AXIS_PTS CA_PercentStep21 "AXIS comments" 0x821A NO_INPUT_QUANTITY AxisPtsX_UW 0.0 CM_Percent_0to200_2 21 0.0 199.9969024658203 /end AXIS_PTS
/begin AXIS_PTS CA_VELoad6Step "AXIS comments" 0x8298 NO_INPUT_QUANTITY AxisPtsX_UW 0.0 CM_kpa_0to256_1 6 0.0 255.99609375 /end AXIS_PTS
/begin COMPU_METHOD CM_Boolean1 "" RAT_FUNC "%1.0" "bool" COEFFS 0 1 0 0 0 1 /end COMPU_METHOD
/begin COMPU_METHOD CM_Boolean2 "" RAT_FUNC "%1.0" "boolean" COEFFS 0 1 0 0 0 1 /end COMPU_METHOD
/begin COMPU_METHOD CM_Boolean4 "" RAT_FUNC "%1.0" "None" COEFFS 0 1 0 0 0 1 /end COMPU_METHOD
/begin COMPU_METHOD CM_Count1 "" RAT_FUNC "%3.0" "count" COEFFS 0 1 0 0 0 1 /end COMPU_METHOD
/begin COMPU_METHOD CM_Count2 "" RAT_FUNC "%3.0" "counts" COEFFS 0 1 0 0 0 1 /end COMPU_METHOD
/begin COMPU_METHOD CM_Count3 "" RAT_FUNC "%3.0" "None" COEFFS 0 1 0 0 0 1 /end COMPU_METHOD
/begin COMPU_METHOD CM_Count4 "" RAT_FUNC "%3.0" "steps" COEFFS 0 1 0 0 0 1 /end COMPU_METHOD
/begin COMPU_METHOD CM_EOI "" TAB_VERB "%10.4" "" COMPU_TAB_REF CM_EOI_TAB /end COMPU_METHOD
/begin COMPU_METHOD udf_CM_16276 "Ax + B" RAT_FUNC "%4.0" "boolean" COEFFS 0 1 0 0 0 1 /end COMPU_METHOD
/begin COMPU_METHOD udf_CM_16444 "Ax + B" RAT_FUNC "%4.4" "grm" COEFFS 0.0 4096.0 0.0 0.0 0.0 1.0 /end COMPU_METHOD
/begin COMPU_METHOD udf_CM_16878 "Ax + B" RAT_FUNC "%4.4" "msec" COEFFS 0.0 64.0 0.0 0.0 0.0 1.0 /end COMPU_METHOD
/begin COMPU_METHOD udf_CM_16997 "Ax + B" RAT_FUNC "%4.0" "Counts" COEFFS 0 1 0 0 0 1 /end COMPU_METHOD
/begin COMPU_METHOD udf_CM_17004 "Ax + B" RAT_FUNC "%4.0" "None" COEFFS 0 1 0 0 0 1 /end COMPU_METHOD
/begin COMPU_METHOD udf_CM_17011 "Ax + B" RAT_FUNC "%4.0" "None" COEFFS 0 1 0 0 0 1 /end COMPU_METHOD
/begin COMPU_METHOD udf_CM_17018 "Ax + B" RAT_FUNC "%4.0" "None" COEFFS 0 1 0 0 0 1 /end COMPU_METHOD
/begin COMPU_METHOD udf_CM_17025 "Ax + B" RAT_FUNC "%4.0" "Counts" COEFFS 0 1 0 0 0 1 /end COMPU_METHOD
/begin COMPU_METHOD udf_CM_17032 "Ax + B" RAT_FUNC "%4.0" "None" COEFFS 0 1 0 0 0 1 /end COMPU_METHOD
/begin COMPU_METHOD udf_CM_17039 "Ax + B" RAT_FUNC "%4.0" "None" COEFFS 0 1 0 0 0 1 /end COMPU_METHOD
/begin COMPU_METHOD CM_Microsecond_1 "" RAT_FUNC "%6.0" "micro-seconds" COEFFS 0.0 0.125 0.0 0.0 0.0 1.0 /end COMPU_METHOD
/begin COMPU_METHOD CM_Mult_0to2 "" RAT_FUNC "%5.4" "Mul_0_to_2" COEFFS 0.0 128.0 0.0 0.0 0.0 1.0 /end COMPU_METHOD
/begin COMPU_METHOD CM_Mult0_to_2_ratio "" RAT_FUNC "%5.4" "ratio" COEFFS 0.0 128.0 0.0 0.0 0.0 1.0 /end COMPU_METHOD
/begin COMPU_METHOD CM_Mult0_to_2_ratio1 "" RAT_FUNC "%5.4" "ratio/512rpm" COEFFS 0.0 128.0 0.0 0.0 0.0 1.0 /end COMPU_METHOD
/begin COMPU_METHOD CM_Mult0_to_2_second "" RAT_FUNC "%5.4" "sec" COEFFS 0.0 128.0 0.0 0.0 0.0 1.0 /end COMPU_METHOD
/begin COMPU_METHOD CM_Equaloutput1 "Default N=E compu method" RAT_FUNC "%10.4" "" COEFFS 0 1 0 0 0 1 /end COMPU_METHOD
/begin COMPU_METHOD CM_Boolean6 "Default N=E compu method" RAT_FUNC "%10.4" "Boolean" COEFFS 0 1 0 0 0 1 /end COMPU_METHOD
/begin COMPU_METHOD udf_CM_17690 "Ax + B" RAT_FUNC "%4.0" "None" COEFFS 0 1 0 0 0 1 /end COMPU_METHOD
/begin COMPU_METHOD udf_CM_17704 "Ax + B" RAT_FUNC "%4.4" "percent" COEFFS 0.0 327.6800000536871 0.0 0.0 0.0 1.0 /end COMPU_METHOD
/begin COMPU_METHOD udf_CM_17788 "Hex No Scale" RAT_FUNC "%4.4" "none" COEFFS 0 1 0 0 0 1 /end COMPU_METHOD
/begin COMPU_METHOD CM_Enum_0to4 "" RAT_FUNC "%1.0" "enum" COEFFS 0 1 0 0 0 1 /end COMPU_METHOD
/begin COMPU_METHOD CM_AFR_8bit "" RAT_FUNC "%4.2" "afr" COEFFS 0.0 8.0 0.0 0.0 0.0 1.0 /end COMPU_METHOD
/begin COMPU_METHOD CM_AFR_n4to4 "" RAT_FUNC "%4.3" "afr" COEFFS 0.0 32.0 0.0 0.0 0.0 1.0 /end COMPU_METHOD
/begin COMPU_METHOD CM_Angle_8bit "" RAT_FUNC "%3.1" "angle" COEFFS 0.0 2.0 0.0 0.0 0.0 1.0 /end COMPU_METHOD
/begin COMPU_METHOD CM_Grams0to2 "" RAT_FUNC "%6.5" "gms" COEFFS 0.0 32768.00013421773 0.0 0.0 0.0 1.0 /end COMPU_METHOD
/begin COMPU_METHOD CM_Grams0to8 "" RAT_FUNC "%6.5" "gms" COEFFS 0.0 8192.000033554432 0.0 0.0 0.0 1.0 /end COMPU_METHOD
/begin COMPU_METHOD CM_Grams0to8_1 "" RAT_FUNC "%6.5" "grams" COEFFS 0.0 8192.000033554432 0.0 0.0 0.0 1.0 /end COMPU_METHOD
/begin COMPU_METHOD CM_FiltCoef "" RAT_FUNC "%7.6" "coef" COEFFS 0.0 65536.00026843546 0.0 0.0 0.0 1.0 /end COMPU_METHOD
/begin COMPU_METHOD CM_FactorRatio "" RAT_FUNC "%7.6" "ratio" COEFFS 0.0 65536.00026843546 0.0 0.0 0.0 1.0 /end COMPU_METHOD
/begin COMPU_METHOD CM_GramPerSecond "" RAT_FUNC "%7.5" "grams/sec" COEFFS 0.0 4096.0 0.0 0.0 0.0 1.0 /end COMPU_METHOD
/begin COMPU_METHOD udf_CM_18376 "" RAT_FUNC "%7.5" "ratio" COEFFS 0.0 4096.0 0.0 0.0 0.0 1.0 /end COMPU_METHOD
/begin COMPU_METHOD CM_kpa_8bit "" RAT_FUNC "%4.1" "kpa" COEFFS 0.0 2.0 0.0 0.0 0.0 1.0 /end COMPU_METHOD
/begin COMPU_METHOD CM_kpa_0_256_8bit "" RAT_FUNC "%4.1" "kpa" COEFFS 0.0 1.0 0.0 0.0 0.0 1.0 /end COMPU_METHOD
/begin COMPU_METHOD CM_msec "" RAT_FUNC "%5.3" "msec" COEFFS 0.0 16.0 0.0 0.0 0.0 1.0 /end COMPU_METHOD
/begin COMPU_METHOD CM_mVolt "" RAT_FUNC "%4.0" "millivolt" COEFFS 0.0 0.25 0.0 0.0 0.0 1.0 /end COMPU_METHOD
/begin COMPU_METHOD CM_mVolt_1 "" RAT_FUNC "%7.3" "millivolt" COEFFS 0.0 64.0 0.0 0.0 0.0 1.0 /end COMPU_METHOD
/begin COMPU_METHOD CM_Ratio_0to2_1 "" RAT_FUNC "%6.5" "msec/count" COEFFS 0.0 32768.00013421773 0.0 0.0 0.0 1.0 /end COMPU_METHOD
/begin COMPU_METHOD CM_Ratio_0to2_2 "" RAT_FUNC "%6.5" "ratio" COEFFS 0.0 32768.00013421773 0.0 0.0 0.0 1.0 /end COMPU_METHOD
/begin COMPU_METHOD CM_Seconds_1 "" RAT_FUNC "%7.3" "sec" COEFFS 0.0 32.0 0.0 0.0 0.0 1.0 /end COMPU_METHOD
/begin COMPU_METHOD CM_Percent_N200to200 "" RAT_FUNC "%7.4" "percent" COEFFS 0.0 163.8400167772177 0.0 0.0 0.0 1.0 /end COMPU_METHOD
/begin COMPU_METHOD CM_SparkAngle_N256to256 "" RAT_FUNC "%7.4" "angle" COEFFS 0.0 128.0 0.0 0.0 0.0 1.0 /end COMPU_METHOD
/begin COMPU_METHOD CM_DegC_N256to256 "" RAT_FUNC "%7.4" "degC" COEFFS 0.0 128.0 0.0 0.0 0.0 1.0 /end COMPU_METHOD
/begin COMPU_METHOD CM_FiltCoef_1 "" RAT_FUNC "%5.4" "coef" COEFFS 0.0 256.0 0.0 0.0 0.0 1.0 /end COMPU_METHOD
/begin COMPU_METHOD CM_Mult_0to1 "" RAT_FUNC "%5.4" "not_specified" COEFFS 0.0 256.0 0.0 0.0 0.0 1.0 /end COMPU_METHOD
/begin COMPU_METHOD CM_Mult_0to1_2 "" RAT_FUNC "%5.4" "ratio" COEFFS 0.0 256.0 0.0 0.0 0.0 1.0 /end COMPU_METHOD
/begin COMPU_METHOD CM_Percent_0to200 "" RAT_FUNC "%8.5" "percent/count" COEFFS 0.0 327.6800000536871 0.0 0.0 0.0 1.0 /end COMPU_METHOD
/begin COMPU_METHOD CM_Percent_0to100 "" RAT_FUNC "%5.3" "percent" COEFFS 0.0 2.56 0.0 0.0 0.0 1.0 /end COMPU_METHOD
/begin COMPU_METHOD CM_Percent_0to100_1 "" RAT_FUNC "%6.4" "percent" COEFFS 0.0 655.3603892316423 0.0 0.0 0.0 1.0 /end COMPU_METHOD
/begin COMPU_METHOD CM_Percent_0to200_1 "" RAT_FUNC "%7.4" "" COEFFS 0.0 327.6800872415464 0.0 0.0 0.0 1.0 /end COMPU_METHOD
/begin COMPU_METHOD CM_Percent_0to200_2 "" RAT_FUNC "%7.4" "percent" COEFFS 0.0 327.6800872415464 0.0 0.0 0.0 1.0 /end COMPU_METHOD
/begin COMPU_METHOD CM_Percent_0to200_3 "" RAT_FUNC "%6.3" "percent" COEFFS 0.0 1.28 0.0 0.0 0.0 1.0 /end COMPU_METHOD
/begin COMPU_METHOD CM_Ratio_0to8 "" RAT_FUNC "%6.5" "ratio" COEFFS 0.0 8192.0 0.0 0.0 0.0 1.0 /end COMPU_METHOD
/begin COMPU_METHOD CM_Ratio_n256to256 "" RAT_FUNC "%7.4" "amps" COEFFS 0.0 128.0 0.0 0.0 0.0 1.0 /end COMPU_METHOD
/begin COMPU_METHOD CM_Ratio_n128to128 "" RAT_FUNC "%7.4" "kpa" COEFFS 0.0 256.0 0.0 0.0 0.0 1.0 /end COMPU_METHOD
/begin COMPU_METHOD CM_Ratio_n512to512 "" RAT_FUNC "%7.4" "kpa" COEFFS 0.0 64.0 0.0 0.0 0.0 1.0 /end COMPU_METHOD
/begin COMPU_METHOD CM_Ratio_n8to8 "" RAT_FUNC "%7.4" "mpa" COEFFS 0.0 4096.0 0.0 0.0 0.0 1.0 /end COMPU_METHOD
/begin COMPU_METHOD udf_CM_18544 "" RAT_FUNC "%7.4" "NM" COEFFS 0.0 256.0 0.0 0.0 0.0 1.0 /end COMPU_METHOD
/begin COMPU_METHOD CM_Ratio_n2to2 "" RAT_FUNC "%4.3" "ratio" COEFFS 0.0 64.0 0.0 0.0 0.0 1.0 /end COMPU_METHOD
/begin COMPU_METHOD CM_RPM_n8192to8192 "" RAT_FUNC "%6.2" "rpm" COEFFS 0.0 4.0 0.0 0.0 0.0 1.0 /end COMPU_METHOD
/begin COMPU_METHOD CM_RPM_0to16384_1 "" RAT_FUNC "%7.2" "" COEFFS 0.0 4.0 0.0 0.0 0.0 1.0 /end COMPU_METHOD
/begin COMPU_METHOD CM_Hz_0to16384 "" RAT_FUNC "%7.2" "hertz" COEFFS 0.0 4.0 0.0 0.0 0.0 1.0 /end COMPU_METHOD
/begin COMPU_METHOD CM_RPM_0to16384 "" RAT_FUNC "%7.2" "rpm" COEFFS 0.0 4.0 0.0 0.0 0.0 1.0 /end COMPU_METHOD
/begin COMPU_METHOD udf_CM_18586 "" RAT_FUNC "%7.2" "RPM" COEFFS 0.0 4.0 0.0 0.0 0.0 1.0 /end COMPU_METHOD
/begin COMPU_METHOD CM_amp_0to512_1 "" RAT_FUNC "%7.4" "amp" COEFFS 0.0 128.0 0.0 0.0 0.0 1.0 /end COMPU_METHOD
/begin COMPU_METHOD CM_kpa_0to512_1 "" RAT_FUNC "%7.4" "kpa" COEFFS 0.0 128.0 0.0 0.0 0.0 1.0 /end COMPU_METHOD
/begin COMPU_METHOD CM_kpa_0to256_1 "" RAT_FUNC "%7.4" "kpa" COEFFS 0.0 256.0 0.0 0.0 0.0 1.0 /end COMPU_METHOD
/begin COMPU_METHOD CM_mpa_0to16_1 "" RAT_FUNC "%7.4" "mpa" COEFFS 0.0 4096.0 0.0 0.0 0.0 1.0 /end COMPU_METHOD
/begin COMPU_METHOD CM_CrankAngle_0to1024 "" RAT_FUNC "%7.3" "angle" COEFFS 0.0 64.0 0.0 0.0 0.0 1.0 /end COMPU_METHOD
/begin COMPU_METHOD CM_milliliter_0to1024 "" RAT_FUNC "%7.3" "milliliter" COEFFS 0.0 64.0 0.0 0.0 0.0 1.0 /end COMPU_METHOD
/begin COMPU_METHOD CM_msec_0to1024 "" RAT_FUNC "%7.3" "msec" COEFFS 0.0 64.0 0.0 0.0 0.0 1.0 /end COMPU_METHOD
/begin COMPU_METHOD CM_Second_0to1024 "" RAT_FUNC "%7.3" "sec" COEFFS 0.0 64.0 0.0 0.0 0.0 1.0 /end COMPU_METHOD
/begin COMPU_METHOD CM_Second_0to8192 "" RAT_FUNC "%7.3" "sec" COEFFS 0.0 8.0 0.0 0.0 0.0 1.0 /end COMPU_METHOD
/begin COMPU_METHOD CM_SignedWord_n32768to32768_2 "" RAT_FUNC "%5.0" "counts" COEFFS 0 1 0 0 0 1 /end COMPU_METHOD
/begin COMPU_METHOD CM_AFR_0to32 "" RAT_FUNC "%6.4" "afr" COEFFS 0.0 2048.001048576537 0.0 0.0 0.0 1.0 /end COMPU_METHOD
/begin COMPU_METHOD CM_Volt_0to32_1 "" RAT_FUNC "%6.4" "volt" COEFFS 0.0 2048.001048576537 0.0 0.0 0.0 1.0 /end COMPU_METHOD
/begin COMPU_METHOD CM_Volt_0to1024_1 "" RAT_FUNC "%6.4" "volt" COEFFS 0.0 64.0 0.0 0.0 0.0 1.0 /end COMPU_METHOD
/begin COMPU_METHOD CM_Volt_0to32_2 "" RAT_FUNC "%6.4" "volts" COEFFS 0.0 2048.001048576537 0.0 0.0 0.0 1.0 /end COMPU_METHOD
/begin COMPU_METHOD CM_Second_0to4096 "" RAT_FUNC "%7.3" "sec" COEFFS 0.0 16.0 0.0 0.0 0.0 1.0 /end COMPU_METHOD
/begin COMPU_METHOD CM_CrankAngle_0to512 "" RAT_FUNC "%7.4" "degrees" COEFFS 0.0 128.0 0.0 0.0 0.0 1.0 /end COMPU_METHOD
/begin COMPU_METHOD CM_KPH_0to512 "" RAT_FUNC "%7.4" "kph" COEFFS 0.0 128.0 0.0 0.0 0.0 1.0 /end COMPU_METHOD
/begin COMPU_METHOD udf_CM_18698 "" RAT_FUNC "%7.4" "gram" COEFFS 0.0 128.0 0.0 0.0 0.0 1.0 /end COMPU_METHOD
/begin COMPU_METHOD udf_CM_18705 "" RAT_FUNC "%7.4" "grams" COEFFS 0.0 128.0 0.0 0.0 0.0 1.0 /end COMPU_METHOD
/begin COMPU_METHOD CM_Second_0to512 "" RAT_FUNC "%7.4" "sec" COEFFS 0.0 128.0 0.0 0.0 0.0 1.0 /end COMPU_METHOD
/begin COMPU_METHOD CM_Second_0to512_1 "" RAT_FUNC "%7.4" "seconds" COEFFS 0.0 128.0 0.0 0.0 0.0 1.0 /end COMPU_METHOD
/begin COMPU_METHOD CM_Count_0to65535 "" RAT_FUNC "%5.0" "count" COEFFS 0 1 0 0 0 1 /end COMPU_METHOD
/begin COMPU_METHOD CM_Count_0to65535_1 "" RAT_FUNC "%5.0" "counts" COEFFS 0 1 0 0 0 1 /end COMPU_METHOD
/begin COMPU_METHOD CM_Count_0to65535_2 "" RAT_FUNC "%5.0" "None" COEFFS 0 1 0 0 0 1 /end COMPU_METHOD
/begin COMPU_METHOD CM_Second_0to65535 "" RAT_FUNC "%5.0" "sec" COEFFS 0 1 0 0 0 1 /end COMPU_METHOD
/begin COMPU_METHOD CM_msec_0to4 "" RAT_FUNC "%4.3" "msec" COEFFS 0.0 64.0 0.0 0.0 0.0 1.0 /end COMPU_METHOD
/begin COMPU_METHOD CM_mult_0to4 "" RAT_FUNC "%4.3" "not_specified" COEFFS 0.0 64.0 0.0 0.0 0.0 1.0 /end COMPU_METHOD
/begin COMPU_METHOD CM_Second_0to4 "" RAT_FUNC "%4.3" "sec" COEFFS 0.0 64.0 0.0 0.0 0.0 1.0 /end COMPU_METHOD
/begin COMPU_METHOD CM_Mult_0to8 "" RAT_FUNC "%4.3" "ratio" COEFFS 0.0 32.0 0.0 0.0 0.0 1.0 /end COMPU_METHOD
/begin COMPU_METHOD CM_Second_0to8 "" RAT_FUNC "%4.3" "sec" COEFFS 0.0 32.0 0.0 0.0 0.0 1.0 /end COMPU_METHOD
/begin COMPU_VTAB CM_EOI_TAB "" TAB_VERB 4 0 "Cyl1" 1 "Cyl2" 2 "Cyl3" 3 "Cyl4" /end COMPU_VTAB
/begin RECORD_LAYOUT 2D_Array_SB FNC_VALUES 1 SBYTE COLUMN_DIR DIRECT ALIGNMENT_WORD 1 ALIGNMENT_LONG 2 /end RECORD_LAYOUT
/begin RECORD_LAYOUT 2D_Array_SW FNC_VALUES 1 SWORD COLUMN_DIR DIRECT ALIGNMENT_WORD 1 ALIGNMENT_LONG 2 /end RECORD_LAYOUT
/begin RECORD_LAYOUT 2D_Array_UB FNC_VALUES 1 UBYTE COLUMN_DIR DIRECT ALIGNMENT_WORD 1 ALIGNMENT_LONG 2 /end RECORD_LAYOUT
/begin RECORD_LAYOUT 2D_Array_UW FNC_VALUES 1 UWORD COLUMN_DIR DIRECT ALIGNMENT_WORD 1 ALIGNMENT_LONG 2 /end RECORD_LAYOUT
/begin RECORD_LAYOUT D_Array_SB FNC_VALUES 1 SBYTE COLUMN_DIR DIRECT ALIGNMENT_WORD 1 ALIGNMENT_LONG 2 /end RECORD_LAYOUT
/begin RECORD_LAYOUT udf_RL_19771 FNC_VALUES 1 SWORD COLUMN_DIR DIRECT ALIGNMENT_WORD 1 ALIGNMENT_LONG 2 /end RECORD_LAYOUT
/begin RECORD_LAYOUT 3D_Array_UB FNC_VALUES 1 UBYTE COLUMN_DIR DIRECT ALIGNMENT_WORD 1 ALIGNMENT_LONG 2 /end RECORD_LAYOUT
/begin RECORD_LAYOUT 3D_Array_UW FNC_VALUES 1 UWORD COLUMN_DIR DIRECT ALIGNMENT_WORD 1 ALIGNMENT_LONG 2 /end RECORD_LAYOUT
/begin RECORD_LAYOUT AxisPtsX_UW AXIS_PTS_X 1 UWORD INDEX_INCR DIRECT ALIGNMENT_WORD 1 ALIGNMENT_LONG 2 /end RECORD_LAYOUT
/begin RECORD_LAYOUT Scalar_SW FNC_VALUES 1 SWORD COLUMN_DIR DIRECT ALIGNMENT_WORD 1 ALIGNMENT_LONG 2 /end RECORD_LAYOUT
/begin RECORD_LAYOUT Scalar_UB FNC_VALUES 1 UBYTE COLUMN_DIR DIRECT ALIGNMENT_WORD 1 ALIGNMENT_LONG 2 /end RECORD_LAYOUT
/begin RECORD_LAYOUT Scalar_UW FNC_VALUES 1 UWORD COLUMN_DIR DIRECT ALIGNMENT_WORD 1 ALIGNMENT_LONG 2 /end RECORD_LAYOUT
/begin RECORD_LAYOUT ValueBlock_UW FNC_VALUES 1 UWORD COLUMN_DIR DIRECT ALIGNMENT_WORD 1 ALIGNMENT_LONG 2 /end RECORD_LAYOUT
/end MODULE
/end PROJECT
